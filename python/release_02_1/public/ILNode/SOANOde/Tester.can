/*@!Encoding:65001*/
includes
{
  #include "../SOALib/SOALib_Node.cin"
}

variables
{
  char     SOA_NodeName[512] = "Tester";
  
  dword    SOA_NodeProtocol = 17;
  dword    SOA_NodePort = 55114;
  
  const SOA_NodeProvidedServiceListNum = 1;
  struct SOALib_ProvidedServiceType SOA_NodeProvidedServiceList[SOA_NodeProvidedServiceListNum] = 
  {
    
    { 0x0000, 0x00, 0x00, 0x00 }
    
  };
  
  const SOA_NodeConsumedServiceListNum = 66;
  struct SOALib_ConsumedServiceType SOA_NodeConsumedServiceList[SOA_NodeConsumedServiceListNum] = 
  {
    
    { 0x0000, 0x00, 0x00, 0x00 },
    
    { 0x0041, 0x01, 0x01, 0x00 },
    
    { 0x0050, 0x01, 0x01, 0x00 },
    
    { 0x0051, 0x01, 0x01, 0x00 },
    
    { 0x0054, 0x01, 0x01, 0x00 },
    
    { 0x0058, 0x01, 0x01, 0x00 },
    
    { 0x0059, 0x01, 0x01, 0x00 },
    
    { 0x005A, 0x01, 0x01, 0x00 },
    
    { 0x005B, 0x01, 0x01, 0x00 },
    
    { 0x005D, 0x01, 0x01, 0x00 },
    
    { 0x0060, 0x01, 0x01, 0x00 },
    
    { 0x0061, 0x01, 0x01, 0x00 },
    
    { 0x0062, 0x01, 0x01, 0x00 },
    
    { 0x0063, 0x01, 0x01, 0x00 },
    
    { 0x0064, 0x01, 0x01, 0x00 },
    
    { 0x0065, 0x01, 0x01, 0x00 },
    
    { 0x0066, 0x01, 0x01, 0x00 },
    
    { 0x006C, 0x01, 0x01, 0x00 },
    
    { 0x006D, 0x01, 0x01, 0x00 },
    
    { 0x006E, 0x01, 0x01, 0x00 },
    
    { 0x0200, 0x01, 0x01, 0x00 },
    
    { 0x0300, 0x01, 0x01, 0x00 },
    
    { 0x0301, 0x01, 0x01, 0x00 },
    
    { 0x0400, 0x01, 0x01, 0x00 },
    
    { 0x0401, 0x01, 0x01, 0x00 },
    
    { 0x0501, 0x01, 0x01, 0x00 },
    
    { 0x1100, 0x01, 0x01, 0x00 },
    
    { 0x1101, 0x01, 0x01, 0x00 },
    
    { 0x2001, 0x01, 0x01, 0x00 },
    
    { 0x2002, 0x01, 0x01, 0x00 },
    
    { 0x2006, 0x01, 0x01, 0x00 },
    
    { 0x2007, 0x01, 0x01, 0x00 },
    
    { 0x2008, 0x01, 0x01, 0x00 },
    
    { 0x2009, 0x01, 0x01, 0x00 },
    
    { 0x200A, 0x01, 0x01, 0x00 },
    
    { 0x200B, 0x01, 0x01, 0x00 },
    
    { 0x200C, 0x01, 0x01, 0x00 },
    
    { 0x200E, 0x01, 0x01, 0x00 },
    
    { 0x200F, 0x01, 0x01, 0x00 },
    
    { 0x2010, 0x01, 0x01, 0x00 },
    
    { 0x0052, 0x01, 0x01, 0x00 },
    
    { 0x0053, 0x01, 0x01, 0x00 },
    
    { 0x0057, 0x01, 0x01, 0x00 },
    
    { 0x005E, 0x01, 0x01, 0x00 },
    
    { 0x0100, 0x01, 0x01, 0x00 },
    
    { 0x0103, 0x01, 0x01, 0x00 },
    
    { 0x0104, 0x01, 0x01, 0x00 },
    
    { 0x0105, 0x01, 0x01, 0x00 },
    
    { 0x200D, 0x01, 0x01, 0x00 },
    
    { 0x2011, 0x01, 0x01, 0x00 },
    
    { 0x2012, 0x01, 0x01, 0x00 },
    
    { 0x2013, 0x01, 0x01, 0x00 },
    
    { 0x9000, 0x01, 0x01, 0x00 },
    
    { 0x0101, 0x01, 0x01, 0x00 },
    
    { 0x0088, 0x01, 0x01, 0x00 },
    
    { 0x0110, 0x01, 0x01, 0x00 },
    
    { 0x0136, 0x01, 0x01, 0x00 },
    
    { 0x0185, 0x01, 0x01, 0x00 },
    
    { 0x0069, 0x01, 0x01, 0x00 },
    
    { 0x0093, 0x01, 0x01, 0x00 },
    
    { 0x0073, 0x01, 0x01, 0x00 },
    
    { 0x0055, 0x01, 0x01, 0x00 },
    
    { 0x0056, 0x01, 0x01, 0x00 },
    
    { 0x0068, 0x01, 0x01, 0x00 },
    
    { 0x4020, 0x01, 0x01, 0x00 },
    
    { 0x0106, 0x01, 0x01, 0x00 }
    
  };
}