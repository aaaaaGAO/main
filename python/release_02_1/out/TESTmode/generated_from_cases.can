/*@!Encoding:936*/
/*@!Encoding:936*/
includes
{
  #include "..\..\..\Public\TESTmode\TestMoudleControl\TestMoudleControl_Swc.can"
  #include "..\..\..\Public\ILNode\SecOc\CAN\RDCU.cin"
  #include "Testcases\generated_from_cases_pythongongjuzhuanyijiaoyan_V1_0_TC.can"
}