/*@!Encoding:65001*/
/*@!Encoding:65001*/
includes
{
  #include "..\..\..\Public\TESTmode\TestMoudleControl\TestMoudleControl_Swc.cin"
  #include "..\..\..\Public\ILNode\SecOc\CAN\LDCU.cin"
  #include "generated_from_keyword.cin"
  #include "Testcases\generated_from_cases_TC_LDCU_cheliangdianyuanmoshiguanli_MQB_AGT_V1_0_TC.can"
}