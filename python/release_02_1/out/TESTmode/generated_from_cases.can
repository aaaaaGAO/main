/*@!Encoding:936*/
/*@!Encoding:936*/
includes
{
  #include "TestMoudleControl\TestMoudleControl_Swc.can"
  #include "..\ILNode\SecOc\CAN\LDCU.cin"
  #include "generated_from_keyword.cin"
  #include "Testcases\generated_from_cases_MQB_20260318_xiugai_yichaifen_OMS_DMS.can"
  #include "Testcases\generated_from_cases_MQB_20260318_xiugai_yichaifen_T1-SleepMode-Standby.can"
  #include "Testcases\generated_from_cases_MQB_20260318_xiugai_yichaifen_T10-AbnormalSleep-Work.can"
  #include "Testcases\generated_from_cases_MQB_20260318_xiugai_yichaifen_T12-Standby-Backup.can"
  #include "Testcases\generated_from_cases_MQB_20260318_xiugai_yichaifen_T13-Work-Backup.can"
  #include "Testcases\generated_from_cases_MQB_20260318_xiugai_yichaifen_T14.can"
  #include "Testcases\generated_from_cases_MQB_20260318_xiugai_yichaifen_T15.can"
  #include "Testcases\generated_from_cases_MQB_20260318_xiugai_yichaifen_T16.can"
  #include "Testcases\generated_from_cases_MQB_20260318_xiugai_yichaifen_T17.can"
  #include "Testcases\generated_from_cases_MQB_20260318_xiugai_yichaifen_T2-StandbyMode-Work.can"
  #include "Testcases\generated_from_cases_MQB_20260318_xiugai_yichaifen_T3-WorkMode-Standby.can"
  #include "Testcases\generated_from_cases_MQB_20260318_xiugai_yichaifen_T4-StandbyMode-Sleep.can"
  #include "Testcases\generated_from_cases_MQB_20260318_xiugai_yichaifen_T8-Standby-Abnormal.can"
  #include "Testcases\generated_from_cases_MQB_20260318_xiugai_yichaifen_T9-Abnormal-Standby.can"
  #include "Testcases\generated_from_cases_MQB_20260318_xiugai_yichaifen_bolijiare.can"
  #include "Testcases\generated_from_cases_MQB_20260318_xiugai_yichaifen_chechuang.can"
  #include "Testcases\generated_from_cases_MQB_20260318_xiugai_yichaifen_dianchidianyaqianyijiance.can"
  #include "Testcases\generated_from_cases_MQB_20260318_xiugai_yichaifen_dianyuanguanli-maoyan.can"
  #include "Testcases\generated_from_cases_MQB_20260318_xiugai_yichaifen_fangxiangpanjiare.can"
  #include "Testcases\generated_from_cases_MQB_20260318_xiugai_yichaifen_jichufuwu_S2S.can"
  #include "Testcases\generated_from_cases_MQB_20260318_xiugai_yichaifen_kongtiao.can"
  #include "Testcases\generated_from_cases_MQB_20260318_xiugai_yichaifen_mensuo-IPDT7_0.can"
  #include "Testcases\generated_from_cases_MQB_20260318_xiugai_yichaifen_xiangfen.can"
  #include "Testcases\generated_from_cases_MQB_20260318_xiugai_yichaifen_zhengchedianyuanzhuangtai.can"
  #include "Testcases\generated_from_cases_MQB_20260318_xiugai_yichaifen_zuoyianmo_tongfeng_jiare_shuhuan.can"
}