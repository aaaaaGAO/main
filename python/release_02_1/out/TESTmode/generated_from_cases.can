/*@!Encoding:65001*/
/*@!Encoding:65001*/
includes
{
  #include "..\..\..\Public\TESTmode\TestMoudleControl\TestMoudleControl_Swc.cin"
  #include "..\..\..\Public\ILNode\SecOc\CAN\CDCU.cin"
  #include "Testcases\generated_from_cases_pythongongjuzhuanyijiaoyan_V1_0_TC.can"
}