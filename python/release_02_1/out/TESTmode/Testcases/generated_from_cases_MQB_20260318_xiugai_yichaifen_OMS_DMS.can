/*@!Encoding: 936*/

includes
{
}

variables
{
}

testcase SYS_CDCU_OMSpeidian_0001()
{
  TestDescription("前置环境设置");
  teststep("warning","原始用例id为SYS-CDCU-OMS配电-0001");
  g_EM_Equipment_Swc_TC_IG("ON"); // 测试步骤 TC_IG ON
  g_EM_Equipment_Swc_TC_Set_InputVolt_V_WithCh("12&CH1"); // 测试步骤 TC_Set_InputVolt_V_WithCh 12&CH1
  g_CAN_Bus_Swc_AllCANDataDefaultAllCh(); // 测试步骤 TC_CANTest SET AllCANDataDefaultAllCh
  g_EM_Equipment_Swc_TC_4G_Time_Delay_Second("3"); // 测试步骤 TC_Sleep 3
  g_CAN_Bus_Swc_Disable_AllSentMessage(); // 测试步骤 TC_CANTest Disable AllSentMessage
  g_EM_Equipment_Swc_TC_4G_Time_Delay_Second("3"); // 测试步骤 TC_Sleep 3
  g_EM_UDS_ETH_Swc_DOIP_Disconnect(); // 测试步骤 TC_CANTest DOIP Disconnect
  g_EM_UDS_CAN_Swc_Diag("10 03"); // 测试步骤 TC_CANTest Diag 10 03
  g_EM_UDS_CAN_Swc_TC_CheckDiagRes("50 03 *"); // 预期结果 TC_CheckDiagRes 50 03 *
  g_EM_UDS_CAN_Swc_Diag_SA_01_02(); // 测试步骤 TC_CANTest Diag SA_01_02//一级解锁
  g_EM_UDS_CAN_Swc_TC_CheckDiagRes("67 02"); // 预期结果 TC_CheckDiagRes 67 02
  g_EM_UDS_CAN_Swc_Diag("2E CF 00 02 00 00 00 00 00 00 00 00 00"); // 测试步骤 TC_CANTest Diag 2E CF 00 02 00 00 00 00 00 00 00 00 00
  g_EM_UDS_CAN_Swc_TC_CheckDiagRes("6E CF 00 *"); // 预期结果 TC_CheckDiagRes 6E CF 00 *
  g_EM_UDS_CAN_Swc_Diag("2E CF 0A 01"); // 测试步骤 TC_CANTest Diag 2E CF 0A 01//KL30唤醒未使能
  g_EM_UDS_CAN_Swc_TC_CheckDiagRes("6E CF 0A *"); // 预期结果 TC_CheckDiagRes 6E CF 0A *
  g_EM_UDS_CAN_Swc_Diag("2E CF 0C 01"); // 测试步骤 TC_CANTest Diag 2E CF 0C 01
  g_EM_UDS_CAN_Swc_Diag("2E A5 F5 00"); // 测试步骤 TC_CANTest Diag 2E A5 F5 00//关闭SOC异常监控
  g_EM_UDS_CAN_Swc_TC_CheckDiagRes("6E A5 F5 *"); // 预期结果 TC_CheckDiagRes 6E A5 F5 *
  g_EM_UDS_CAN_Swc_Diag("11 01"); // 测试步骤 TC_CANTest Diag 11 01
  g_EM_Equipment_Swc_TC_4G_Time_Delay_Second("5"); // 测试步骤 TC_Sleep 5
}
