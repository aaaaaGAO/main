/*@!Encoding: 936*/

includes
{
}

variables
{
}

testcase SYS_LDCU_Powermode_0002()
{
  TestDescription("OFF车辆电源模式");
  g_HIL_Clib_Swc_Clib_OFF(); // 测试步骤 Step Clib OFF
  g_HIL_Bus_Swc_Check("I_LDCU_BodySysSt1::I_LDCU_PowerMode 0"); // 预期结果 Step Check I_LDCU_BodySysSt1::I_LDCU_PowerMode 0 //OFF
  g_HIL_Bus_Swc_Check("VTS::VT2848_2_Ch26::CurBit 0"); // 预期结果 Step Check J_DO_HS_KL15_BackUp Inactive
}

testcase SYS_LDCU_Powermode_0003()
{
  TestDescription("Convenience车辆电源模式");
  g_HIL_Clib_Swc_Clib_Convenience(); // 测试步骤 Step Clib Convenience
  g_HIL_Bus_Swc_Check("I_LDCU_BodySysSt1::I_LDCU_PowerMode 3"); // 预期结果 Step Check I_LDCU_BodySysSt1::I_LDCU_PowerMode 3 //Convenience
  g_HIL_Bus_Swc_Check("VTS::VT2848_2_Ch26::CurBit 1"); // 预期结果 Step Check J_DO_HS_KL15_BackUp Active
}

testcase SYS_LDCU_Powermode_0004()
{
  TestDescription("LocalON车辆电源模式");
  g_HIL_Clib_Swc_Clib_LocalON(); // 测试步骤 Step Clib LocalON
  g_HIL_Bus_Swc_Check("I_LDCU_BodySysSt1::I_LDCU_PowerMode 1"); // 预期结果 Step Check I_LDCU_BodySysSt1::I_LDCU_PowerMode 1 //LocalON
  g_HIL_Bus_Swc_Check("VTS::VT2848_2_Ch26::CurBit 1"); // 预期结果 Step Check J_DO_HS_KL15_BackUp Active
}

testcase SYS_LDCU_Powermode_0005()
{
  TestDescription("Remote on车辆电源模式");
  g_HIL_Clib_Swc_Clib_RemoteON(); // 测试步骤 Step Clib RemoteON
  g_HIL_Bus_Swc_Check("I_LDCU_BodySysSt1::I_LDCU_PowerMode 2"); // 预期结果 Step Check I_LDCU_BodySysSt1::I_LDCU_PowerMode 2 //RemoteON
  g_HIL_Bus_Swc_Check("VTS::VT2848_2_Ch26::CurBit 1"); // 预期结果 Step Check J_DO_HS_KL15_BackUp Active
}

testcase SYS_LDCU_Powermode_0006()
{
  TestDescription("车内有合法钥匙时踩刹车按启动按钮上电-1");
  g_HIL_Clib_Swc_Clib_OFF(); // 测试步骤 Step Clib OFF//非强制下电
  g_HIL_Bus_Swc_Check("I_LDCU_BodySysSt1::I_LDCU_PowerMode 0"); // 预期结果 Step Check I_LDCU_BodySysSt1::I_LDCU_PowerMode 0//OFF
  g_HIL_Clib_Swc_Clib_Convenience(); // 测试步骤 Step Clib Convenience
  g_HIL_Bus_Swc_Check("I_LDCU_BodySysSt1::I_LDCU_PowerMode 3"); // 预期结果 Step Check I_LDCU_BodySysSt1::I_LDCU_PowerMode 3 //Convenience
  g_HIL_Bus_Swc_Set("VTS::VT2848_4_Ch22::DigitalOutput 1"); // 测试步骤 Step Set J_DI_BrakeSw2_HS Pressed
  g_HIL_Bus_Swc_Set("VTS::VT2848_4_Ch17::DigitalOutput 1"); // 测试步骤 Step Set J_DI_BrakeSw1_HS Pressed
  g_HIL_Bus_Swc_Check("C_LDCU_SysSt::C_LDCU_BrkPedalSt 1 1 s"); // 预期结果 Step Check C_LDCU_SysSt::C_LDCU_BrkPedalSt 1 1 s//Pressed
  g_HIL_Gen_Swc_Wait("1 s"); // 测试步骤 Step Wait 1 s
  g_HIL_Bus_Swc_Check("C_LDCU_SysSt::C_LDCU_BrkPedalStVD 1"); // 预期结果 Step Check C_LDCU_SysSt::C_LDCU_BrkPedalStVD 1//valid
  g_HIL_Bus_Swc_Set("VTS::VT2848_4_Ch27::DigitalOutput 1"); // 测试步骤 Step Set J_DI_SSBPin4SW_LS 0
  g_HIL_Bus_Swc_Set("VTS::VT2848_4_Ch32::DigitalOutput 1"); // 测试步骤 Step Set J_DI_SSBPin6SW_LS 0
  g_HIL_Bus_Swc_Check("I_LDCU_BodySysSt2::I_LDCU_ZATButtonSwSt 1 1 s"); // 预期结果 Step Check I_LDCU_BodySysSt2::I_LDCU_ZATButtonSwSt 1 1 s//Active
  g_HIL_Bus_Swc_Check("I_LDCU_BodySysSt2::I_LDCU_PowerONSource 6 1 s"); // 预期结果 Step Check I_LDCU_BodySysSt2::I_LDCU_PowerONSource 6 1 s//ZAT and Pedal Pressed
  g_HIL_Bus_Swc_Check("I_LDCU_BodySysSt1::I_LDCU_PowerMode 1"); // 预期结果 Step Check I_LDCU_BodySysSt1::I_LDCU_PowerMode 1//Local ON
  g_HIL_Bus_Swc_Check("VTS::VT2848_2_Ch26::CurBit 1"); // 预期结果 Step Check J_DO_HS_KL15_BackUp Active
  g_HIL_Bus_Swc_Set("VTS::VT2848_4_Ch27::DigitalOutput 0"); // 测试步骤 Step Set J_DI_SSBPin4SW_LS 1
  g_HIL_Bus_Swc_Set("VTS::VT2848_4_Ch32::DigitalOutput 0"); // 测试步骤 Step Set J_DI_SSBPin6SW_LS 1
  g_HIL_Bus_Swc_Check("I_LDCU_BodySysSt2::I_LDCU_ZATButtonSwSt 0 1 s"); // 预期结果 Step Check I_LDCU_BodySysSt2::I_LDCU_ZATButtonSwSt 0 1 s//NotActive
  g_HIL_Bus_Swc_Set("VTS::VT2848_4_Ch17::DigitalOutput 0"); // 测试步骤 Step Set J_DI_BrakeSw1_HS NotPressed
  g_HIL_Bus_Swc_Set("VTS::VT2848_4_Ch22::DigitalOutput 0"); // 测试步骤 Step Set J_DI_BrakeSw2_HS NotPressed
  g_HIL_Bus_Swc_Check("C_LDCU_SysSt::C_LDCU_BrkPedalSt 0"); // 预期结果 Step Check C_LDCU_SysSt::C_LDCU_BrkPedalSt 0//NotPressed
}

testcase SYS_LDCU_Powermode_0007()
{
  TestDescription("车内有合法钥匙时踩刹车按启动按钮上电-2");
  g_HIL_Clib_Swc_Clib_Convenience(); // 测试步骤 Step Clib Convenience
  g_HIL_Bus_Swc_Check("I_LDCU_BodySysSt1::I_LDCU_PowerMode 3"); // 预期结果 Step Check I_LDCU_BodySysSt1::I_LDCU_PowerMode 3 //Convenience
  g_HIL_Clib_Swc_Clib_P(); // 测试步骤 Step Clib P
  g_HIL_Bus_Swc_Set("VTS::VT2848_4_Ch22::DigitalOutput 1"); // 测试步骤 Step Set J_DI_BrakeSw2_HS Pressed
  g_HIL_Bus_Swc_Set("VTS::VT2848_4_Ch17::DigitalOutput 1"); // 测试步骤 Step Set J_DI_BrakeSw1_HS Pressed
  g_HIL_Bus_Swc_Check("C_LDCU_SysSt::C_LDCU_BrkPedalSt 1 1 s"); // 预期结果 Step Check C_LDCU_SysSt::C_LDCU_BrkPedalSt 1 1 s//Pressed
  g_HIL_Bus_Swc_Check("C_LDCU_SysSt::C_LDCU_BrkPedalStVD 1"); // 预期结果 Step Check C_LDCU_SysSt::C_LDCU_BrkPedalStVD 1//valid
  g_HIL_Bus_Swc_Set("VTS::VT2848_4_Ch27::DigitalOutput 1"); // 测试步骤 Step Set J_DI_SSBPin4SW_LS 0
  g_HIL_Bus_Swc_Set("VTS::VT2848_4_Ch32::DigitalOutput 1"); // 测试步骤 Step Set J_DI_SSBPin6SW_LS 0
  g_HIL_Bus_Swc_Check("I_LDCU_BodySysSt2::I_LDCU_ZATButtonSwSt 1 1 s"); // 预期结果 Step Check I_LDCU_BodySysSt2::I_LDCU_ZATButtonSwSt 1 1 s//Active
  g_HIL_Bus_Swc_Check("I_LDCU_BodySysSt2::I_LDCU_PowerONSource 6 1 s"); // 预期结果 Step Check I_LDCU_BodySysSt2::I_LDCU_PowerONSource 6 1 s//ZAT and Pedal Pressed
  g_HIL_Bus_Swc_Check("I_LDCU_BodySysSt1::I_LDCU_PowerMode 1"); // 预期结果 Step Check I_LDCU_BodySysSt1::I_LDCU_PowerMode 1//Local ON
  g_HIL_Bus_Swc_Check("VTS::VT2848_2_Ch26::CurBit 1"); // 预期结果 Step Check J_DO_HS_KL15_BackUp Active
  g_HIL_Bus_Swc_Set("VTS::VT2848_4_Ch27::DigitalOutput 0"); // 测试步骤 Step Set J_DI_SSBPin4SW_LS 1
  g_HIL_Bus_Swc_Set("VTS::VT2848_4_Ch32::DigitalOutput 0"); // 测试步骤 Step Set J_DI_SSBPin6SW_LS 1
  g_HIL_Bus_Swc_Check("I_LDCU_BodySysSt2::I_LDCU_ZATButtonSwSt 0 1 s"); // 预期结果 Step Check I_LDCU_BodySysSt2::I_LDCU_ZATButtonSwSt 0 1 s//NotActive
  g_HIL_Bus_Swc_Set("VTS::VT2848_4_Ch17::DigitalOutput 0"); // 测试步骤 Step Set J_DI_BrakeSw1_HS NotPressed
  g_HIL_Bus_Swc_Set("VTS::VT2848_4_Ch22::DigitalOutput 0"); // 测试步骤 Step Set J_DI_BrakeSw2_HS NotPressed
  g_HIL_Bus_Swc_Check("C_LDCU_SysSt::C_LDCU_BrkPedalSt 0"); // 预期结果 Step Check C_LDCU_SysSt::C_LDCU_BrkPedalSt 0//NotPressed
}

testcase SYS_LDCU_Powermode_0008()
{
  TestDescription("车内有合法钥匙时按启动按钮上电");
  g_HIL_Clib_Swc_Clib_OFF(); // 测试步骤 Step Clib OFF//非强制下电
  g_HIL_Bus_Swc_Check("I_LDCU_BodySysSt1::I_LDCU_PowerMode 0"); // 预期结果 Step Check I_LDCU_BodySysSt1::I_LDCU_PowerMode 0//OFF
  g_HIL_Bus_Swc_Set("VTS::VT2848_4_Ch17::DigitalOutput 0"); // 测试步骤 Step Set J_DI_BrakeSw1_HS NotPressed
  g_HIL_Bus_Swc_Set("VTS::VT2848_4_Ch22::DigitalOutput 0"); // 测试步骤 Step Set J_DI_BrakeSw2_HS NotPressed
  g_HIL_Bus_Swc_Check("C_LDCU_SysSt::C_LDCU_BrkPedalSt 0"); // 预期结果 Step Check C_LDCU_SysSt::C_LDCU_BrkPedalSt 0//Not Pressed
  g_HIL_Bus_Swc_Check("C_LDCU_SysSt::C_LDCU_BrkPedalStVD 1"); // 预期结果 Step Check C_LDCU_SysSt::C_LDCU_BrkPedalStVD 1//valid
  g_HIL_Bus_Swc_Set("VTS::VT2848_4_Ch27::DigitalOutput 1"); // 测试步骤 Step Set J_DI_SSBPin4SW_LS 0
  g_HIL_Bus_Swc_Set("VTS::VT2848_4_Ch32::DigitalOutput 1"); // 测试步骤 Step Set J_DI_SSBPin6SW_LS 0
  g_HIL_Bus_Swc_Check("I_LDCU_BodySysSt2::I_LDCU_ZATButtonSwSt 1 1 s"); // 预期结果 Step Check I_LDCU_BodySysSt2::I_LDCU_ZATButtonSwSt 1 1 s//Active
  g_HIL_Bus_Swc_Check("I_LDCU_BodySysSt2::I_LDCU_PowerONSource 5 1 s"); // 预期结果 Step Check I_LDCU_BodySysSt2::I_LDCU_PowerONSource 5 1 s//Only ZAT Pressed
  g_HIL_Bus_Swc_Check("I_LDCU_BodySysSt1::I_LDCU_PowerMode 1"); // 预期结果 Step Check I_LDCU_BodySysSt1::I_LDCU_PowerMode 1//Local ON
  g_HIL_Bus_Swc_Check("VTS::VT2848_2_Ch26::CurBit 1"); // 预期结果 Step Check J_DO_HS_KL15_BackUp Active
  g_HIL_Bus_Swc_Set("VTS::VT2848_4_Ch27::DigitalOutput 0"); // 测试步骤 Step Set J_DI_SSBPin4SW_LS 1
  g_HIL_Bus_Swc_Set("VTS::VT2848_4_Ch32::DigitalOutput 0"); // 测试步骤 Step Set J_DI_SSBPin6SW_LS 1
  g_HIL_Bus_Swc_Check("I_LDCU_BodySysSt2::I_LDCU_ZATButtonSwSt 0 1 s"); // 预期结果 Step Check I_LDCU_BodySysSt2::I_LDCU_ZATButtonSwSt 0 1 s//NotActive
}

testcase SYS_LDCU_Powermode_0009()
{
  TestDescription("车内有合法钥匙时踩刹车按启动按钮上电-1");
  g_HIL_Clib_Swc_Clib_ForceOFF(); // 测试步骤 Step Clib ForceOFF//强制下电
  g_HIL_Bus_Swc_Check("I_LDCU_BodySysSt2::I_LDCU_PowerOFFSource 2"); // 预期结果 Step Check I_LDCU_BodySysSt2::I_LDCU_PowerOFFSource 2//强制下电
  g_HIL_Clib_Swc_Clib_P(); // 测试步骤 Step Clib P
  g_HIL_Bus_Swc_Set("VTS::VT2848_4_Ch22::DigitalOutput 1"); // 测试步骤 Step Set J_DI_BrakeSw2_HS Pressed
  g_HIL_Bus_Swc_Set("VTS::VT2848_4_Ch17::DigitalOutput 1"); // 测试步骤 Step Set J_DI_BrakeSw1_HS Pressed
  g_HIL_Bus_Swc_Check("C_LDCU_SysSt::C_LDCU_BrkPedalSt 1 1 s"); // 预期结果 Step Check C_LDCU_SysSt::C_LDCU_BrkPedalSt 1 1 s//Pressed
  g_HIL_Bus_Swc_Check("C_LDCU_SysSt::C_LDCU_BrkPedalStVD 1"); // 预期结果 Step Check C_LDCU_SysSt::C_LDCU_BrkPedalStVD 1//valid
  g_HIL_Bus_Swc_Set("VTS::VT2848_4_Ch27::DigitalOutput 1"); // 测试步骤 Step Set J_DI_SSBPin4SW_LS 0
  g_HIL_Bus_Swc_Set("VTS::VT2848_4_Ch32::DigitalOutput 1"); // 测试步骤 Step Set J_DI_SSBPin6SW_LS 0
  g_HIL_Bus_Swc_Check("I_LDCU_BodySysSt2::I_LDCU_ZATButtonSwSt 1 1 s"); // 预期结果 Step Check I_LDCU_BodySysSt2::I_LDCU_ZATButtonSwSt 1 1 s//Active
  g_HIL_Bus_Swc_Check("I_LDCU_BodySysSt2::I_LDCU_PowerONSource 6 1 s"); // 预期结果 Step Check I_LDCU_BodySysSt2::I_LDCU_PowerONSource 6 1 s//ZAT and Pedal Pressed
  g_HIL_Bus_Swc_Check("I_LDCU_BodySysSt1::I_LDCU_PowerMode 1"); // 预期结果 Step Check I_LDCU_BodySysSt1::I_LDCU_PowerMode 1//Local ON
  g_HIL_Bus_Swc_Check("VTS::VT2848_2_Ch26::CurBit 1"); // 预期结果 Step Check J_DO_HS_KL15_BackUp Active
  g_HIL_Bus_Swc_Set("VTS::VT2848_4_Ch27::DigitalOutput 0"); // 测试步骤 Step Set J_DI_SSBPin4SW_LS 1
  g_HIL_Bus_Swc_Set("VTS::VT2848_4_Ch32::DigitalOutput 0"); // 测试步骤 Step Set J_DI_SSBPin6SW_LS 1
  g_HIL_Bus_Swc_Check("I_LDCU_BodySysSt2::I_LDCU_ZATButtonSwSt 0 1 s"); // 预期结果 Step Check I_LDCU_BodySysSt2::I_LDCU_ZATButtonSwSt 0 1 s//NotActive
  g_HIL_Bus_Swc_Set("VTS::VT2848_4_Ch17::DigitalOutput 0"); // 测试步骤 Step Set J_DI_BrakeSw1_HS NotPressed
  g_HIL_Bus_Swc_Set("VTS::VT2848_4_Ch22::DigitalOutput 0"); // 测试步骤 Step Set J_DI_BrakeSw2_HS NotPressed
  g_HIL_Bus_Swc_Check("C_LDCU_SysSt::C_LDCU_BrkPedalSt 0"); // 预期结果 Step Check C_LDCU_SysSt::C_LDCU_BrkPedalSt 0//NotPressed
}

testcase SYS_LDCU_Powermode_0010()
{
  TestDescription("车内有合法钥匙时踩刹车按启动按钮上电-2");
  g_HIL_Clib_Swc_Clib_OFF(); // 测试步骤 Step Clib OFF//非强制下电
  g_HIL_Bus_Swc_Check("I_LDCU_BodySysSt1::I_LDCU_PowerMode 0"); // 预期结果 Step Check I_LDCU_BodySysSt1::I_LDCU_PowerMode 0//OFF
  g_HIL_Bus_Swc_Set("VTS::VT2848_4_Ch22::DigitalOutput 1"); // 测试步骤 Step Set J_DI_BrakeSw2_HS Pressed
  g_HIL_Bus_Swc_Set("VTS::VT2848_4_Ch17::DigitalOutput 1"); // 测试步骤 Step Set J_DI_BrakeSw1_HS Pressed
  g_HIL_Bus_Swc_Check("C_LDCU_SysSt::C_LDCU_BrkPedalSt 1 1 s"); // 预期结果 Step Check C_LDCU_SysSt::C_LDCU_BrkPedalSt 1 1 s//Pressed
  g_HIL_Bus_Swc_Check("C_LDCU_SysSt::C_LDCU_BrkPedalStVD 1"); // 预期结果 Step Check C_LDCU_SysSt::C_LDCU_BrkPedalStVD 1//valid
  g_HIL_Bus_Swc_Set("VTS::VT2848_4_Ch27::DigitalOutput 1"); // 测试步骤 Step Set J_DI_SSBPin4SW_LS 0
  g_HIL_Bus_Swc_Set("VTS::VT2848_4_Ch32::DigitalOutput 1"); // 测试步骤 Step Set J_DI_SSBPin6SW_LS 0
  g_HIL_Bus_Swc_Check("I_LDCU_BodySysSt2::I_LDCU_ZATButtonSwSt 1 1 s"); // 预期结果 Step Check I_LDCU_BodySysSt2::I_LDCU_ZATButtonSwSt 1 1 s//Active
  g_HIL_Bus_Swc_Check("I_LDCU_BodySysSt2::I_LDCU_PowerONSource 6 1 s"); // 预期结果 Step Check I_LDCU_BodySysSt2::I_LDCU_PowerONSource 6 1 s//ZAT and Pedal Pressed
  g_HIL_Bus_Swc_Check("I_LDCU_BodySysSt1::I_LDCU_PowerMode 1"); // 预期结果 Step Check I_LDCU_BodySysSt1::I_LDCU_PowerMode 1//Local ON
  g_HIL_Bus_Swc_Check("VTS::VT2848_2_Ch26::CurBit 1"); // 预期结果 Step Check J_DO_HS_KL15_BackUp Active
  g_HIL_Bus_Swc_Set("VTS::VT2848_4_Ch27::DigitalOutput 0"); // 测试步骤 Step Set J_DI_SSBPin4SW_LS 1
  g_HIL_Bus_Swc_Set("VTS::VT2848_4_Ch32::DigitalOutput 0"); // 测试步骤 Step Set J_DI_SSBPin6SW_LS 1
  g_HIL_Bus_Swc_Check("I_LDCU_BodySysSt2::I_LDCU_ZATButtonSwSt 0 1 s"); // 预期结果 Step Check I_LDCU_BodySysSt2::I_LDCU_ZATButtonSwSt 0 1 s//NotActive
  g_HIL_Bus_Swc_Set("VTS::VT2848_4_Ch17::DigitalOutput 0"); // 测试步骤 Step Set J_DI_BrakeSw1_HS NotPressed
  g_HIL_Bus_Swc_Set("VTS::VT2848_4_Ch22::DigitalOutput 0"); // 测试步骤 Step Set J_DI_BrakeSw2_HS NotPressed
  g_HIL_Bus_Swc_Check("C_LDCU_SysSt::C_LDCU_BrkPedalSt 0"); // 预期结果 Step Check C_LDCU_SysSt::C_LDCU_BrkPedalSt 0//NotPressed
}

testcase SYS_LDCU_Powermode_0011()
{
  TestDescription("离车下电-1");
  g_HIL_XCP_Swc_Set_XCP("CalEn_Vcu_MO_Motor_laeuft 1"); // 测试步骤 Step Set_XCP CalEn_Vcu_MO_Motor_laeuft 1
  g_HIL_XCP_Swc_Set_XCP("CalVal_Vcu_MO_Motor_laeuft 0"); // 测试步骤 Step Set_XCP CalVal_Vcu_MO_Motor_laeuft 0
  g_HIL_Bus_Swc_Check("C_Motor_14::C_MO_Motor_laeuft 0"); // 预期结果 Step Check C_Motor_14::C_MO_Motor_laeuft 0//Motor_laeuft_nicht
  g_HIL_Clib_Swc_Clib_LocalON(); // 测试步骤 Step Clib LocalON
  g_HIL_Bus_Swc_Check("I_LDCU_BodySysSt1::I_LDCU_PowerMode 1"); // 预期结果 Step Check I_LDCU_BodySysSt1::I_LDCU_PowerMode 1 //LocalON
  g_HIL_Clib_Swc_Clib_P(); // 测试步骤 Step Clib P
  g_HIL_Bus_Swc_Set("C_CDCU_DiagnosticSt::C_CDCU_DiagnosticSt 0"); // 测试步骤 Step Set C_CDCU_DiagnosticSt::C_CDCU_DiagnosticSt 0//No diagnostic
  g_HIL_Bus_Swc_Set("C_SRS_SysSt::C_SRS_DrvSeatBeltBuckleSt 0"); // 测试步骤 Step Set C_SRS_SysSt::C_SRS_DrvSeatBeltBuckleSt 0//Unbuckled
  g_HIL_Bus_Swc_Set("VTS::VT2848_3_Ch34::DigitalOutput 0"); // 测试步骤 Step Set J_DI_FLDoorAjarSW_LS 1//Close
  g_HIL_Bus_Swc_Set("VTS::VT2848_3_Ch34::DigitalOutput 1"); // 测试步骤 Step Set J_DI_FLDoorAjarSW_LS 0//Open
  g_HIL_Bus_Swc_Check("I_LDCU_NM::I_LDCU_FLDoorAjarSW 1"); // 预期结果 Step Check I_LDCU_NM::I_LDCU_FLDoorAjarSW 1//Active
  g_HIL_Bus_Swc_Check("I_LDCU_BodySysSt1::I_LDCU_PowerMode 0 1 s"); // 预期结果 Step Check I_LDCU_BodySysSt1::I_LDCU_PowerMode 0 1 s//OFF
  g_HIL_Bus_Swc_Check("I_LDCU_BodySysSt2::I_LDCU_PowerOFFSource 7"); // 预期结果 Step Check I_LDCU_BodySysSt2::I_LDCU_PowerOFFSource 7//Door Open
  g_HIL_Bus_Swc_Set("VTS::VT2848_3_Ch34::DigitalOutput 0"); // 测试步骤 Step Set J_DI_FLDoorAjarSW_LS 1//Close
}

testcase SYS_LDCU_Powermode_0012()
{
  TestDescription("离车下电-2");
  g_HIL_XCP_Swc_Set_XCP("CalEn_Vcu_MO_Motor_laeuft 1"); // 测试步骤 Step Set_XCP CalEn_Vcu_MO_Motor_laeuft 1
  g_HIL_XCP_Swc_Set_XCP("CalVal_Vcu_MO_Motor_laeuft 0"); // 测试步骤 Step Set_XCP CalVal_Vcu_MO_Motor_laeuft 0
  g_HIL_Bus_Swc_Check("C_Motor_14::C_MO_Motor_laeuft 0"); // 预期结果 Step Check C_Motor_14::C_MO_Motor_laeuft 0//Motor_laeuft_nicht
  g_HIL_Clib_Swc_Clib_LocalON(); // 测试步骤 Step Clib LocalON
  g_HIL_Bus_Swc_Check("I_LDCU_BodySysSt1::I_LDCU_PowerMode 1"); // 预期结果 Step Check I_LDCU_BodySysSt1::I_LDCU_PowerMode 1 //LocalON
  g_HIL_Clib_Swc_Clib_P(); // 测试步骤 Step Clib P
  g_HIL_Bus_Swc_Set("C_CDCU_DiagnosticSt::C_CDCU_DiagnosticSt 1"); // 测试步骤 Step Set C_CDCU_DiagnosticSt::C_CDCU_DiagnosticSt 1//OBD-CAN
  g_HIL_Bus_Swc_Set("C_SRS_SysSt::C_SRS_DrvSeatBeltBuckleSt 0"); // 测试步骤 Step Set C_SRS_SysSt::C_SRS_DrvSeatBeltBuckleSt 0//Unbuckled
  g_HIL_Bus_Swc_Set("VTS::VT2848_3_Ch34::DigitalOutput 0"); // 测试步骤 Step Set J_DI_FLDoorAjarSW_LS 1//Close
  g_HIL_Bus_Swc_Set("VTS::VT2848_3_Ch34::DigitalOutput 1"); // 测试步骤 Step Set J_DI_FLDoorAjarSW_LS 0//Open
  g_HIL_Bus_Swc_Check("I_LDCU_NM::I_LDCU_FLDoorAjarSW 1"); // 预期结果 Step Check I_LDCU_NM::I_LDCU_FLDoorAjarSW 1//Active
  g_HIL_Bus_Swc_Check("I_LDCU_BodySysSt1::I_LDCU_PowerMode 0 1 s"); // 预期结果 Step Check I_LDCU_BodySysSt1::I_LDCU_PowerMode 0 1 s//OFF
  g_HIL_Bus_Swc_Check("I_LDCU_BodySysSt2::I_LDCU_PowerOFFSource 7"); // 预期结果 Step Check I_LDCU_BodySysSt2::I_LDCU_PowerOFFSource 7//Door Open
  g_HIL_Bus_Swc_Set("C_CDCU_DiagnosticSt::C_CDCU_DiagnosticSt 0"); // 测试步骤 Step Set C_CDCU_DiagnosticSt::C_CDCU_DiagnosticSt 0//No diagnostic
  g_HIL_Bus_Swc_Set("VTS::VT2848_3_Ch34::DigitalOutput 0"); // 测试步骤 Step Set J_DI_FLDoorAjarSW_LS 1//Close
}

testcase SYS_LDCU_Powermode_0013()
{
  TestDescription("离车下电-3");
  g_HIL_XCP_Swc_Set_XCP("CalEn_Vcu_MO_Motor_laeuft 1"); // 测试步骤 Step Set_XCP CalEn_Vcu_MO_Motor_laeuft 1
  g_HIL_XCP_Swc_Set_XCP("CalVal_Vcu_MO_Motor_laeuft 0"); // 测试步骤 Step Set_XCP CalVal_Vcu_MO_Motor_laeuft 0
  g_HIL_Bus_Swc_Check("C_Motor_14::C_MO_Motor_laeuft 0"); // 预期结果 Step Check C_Motor_14::C_MO_Motor_laeuft 0//Motor_laeuft_nicht
  g_HIL_Clib_Swc_Clib_LocalON(); // 测试步骤 Step Clib LocalON
  g_HIL_Bus_Swc_Check("I_LDCU_BodySysSt1::I_LDCU_PowerMode 1"); // 预期结果 Step Check I_LDCU_BodySysSt1::I_LDCU_PowerMode 1 //LocalON
  g_HIL_Clib_Swc_Clib_P(); // 测试步骤 Step Clib P
  g_HIL_Bus_Swc_Set("C_CDCU_DiagnosticSt::C_CDCU_DiagnosticSt 2"); // 测试步骤 Step Set C_CDCU_DiagnosticSt::C_CDCU_DiagnosticSt 2//OBD-Ethernet
  g_HIL_Bus_Swc_Set("C_SRS_SysSt::C_SRS_DrvSeatBeltBuckleSt 0"); // 测试步骤 Step Set C_SRS_SysSt::C_SRS_DrvSeatBeltBuckleSt 0//Unbuckled
  g_HIL_Bus_Swc_Set("VTS::VT2848_3_Ch34::DigitalOutput 0"); // 测试步骤 Step Set J_DI_FLDoorAjarSW_LS 1//Close
  g_HIL_Bus_Swc_Set("VTS::VT2848_3_Ch34::DigitalOutput 1"); // 测试步骤 Step Set J_DI_FLDoorAjarSW_LS 0//Open
  g_HIL_Bus_Swc_Check("I_LDCU_NM::I_LDCU_FLDoorAjarSW 1"); // 预期结果 Step Check I_LDCU_NM::I_LDCU_FLDoorAjarSW 1//Active
  g_HIL_Bus_Swc_Check("I_LDCU_BodySysSt1::I_LDCU_PowerMode 0 1 s"); // 预期结果 Step Check I_LDCU_BodySysSt1::I_LDCU_PowerMode 0 1 s//OFF
  g_HIL_Bus_Swc_Check("I_LDCU_BodySysSt2::I_LDCU_PowerOFFSource 7"); // 预期结果 Step Check I_LDCU_BodySysSt2::I_LDCU_PowerOFFSource 7//Door Open
  g_HIL_Bus_Swc_Set("C_CDCU_DiagnosticSt::C_CDCU_DiagnosticSt 0"); // 测试步骤 Step Set C_CDCU_DiagnosticSt::C_CDCU_DiagnosticSt 0//No diagnostic
  g_HIL_Bus_Swc_Set("VTS::VT2848_3_Ch34::DigitalOutput 0"); // 测试步骤 Step Set J_DI_FLDoorAjarSW_LS 1//Close
}

testcase SYS_LDCU_Powermode_0014()
{
  TestDescription("离车下电-4");
  g_HIL_XCP_Swc_Set_XCP("CalEn_Vcu_MO_Motor_laeuft 1"); // 测试步骤 Step Set_XCP CalEn_Vcu_MO_Motor_laeuft 1
  g_HIL_XCP_Swc_Set_XCP("CalVal_Vcu_MO_Motor_laeuft 0"); // 测试步骤 Step Set_XCP CalVal_Vcu_MO_Motor_laeuft 0
  g_HIL_Bus_Swc_Check("C_Motor_14::C_MO_Motor_laeuft 0"); // 预期结果 Step Check C_Motor_14::C_MO_Motor_laeuft 0//Motor_laeuft_nicht
  g_HIL_Clib_Swc_Clib_LocalON(); // 测试步骤 Step Clib LocalON
  g_HIL_Bus_Swc_Check("I_LDCU_BodySysSt1::I_LDCU_PowerMode 1"); // 预期结果 Step Check I_LDCU_BodySysSt1::I_LDCU_PowerMode 1 //LocalON
  g_HIL_Clib_Swc_Clib_P(); // 测试步骤 Step Clib P
  g_HIL_Bus_Swc_Set("C_CDCU_DiagnosticSt::C_CDCU_DiagnosticSt 3"); // 测试步骤 Step Set C_CDCU_DiagnosticSt::C_CDCU_DiagnosticSt 3//T1-Diag
  g_HIL_Bus_Swc_Set("C_SRS_SysSt::C_SRS_DrvSeatBeltBuckleSt 0"); // 测试步骤 Step Set C_SRS_SysSt::C_SRS_DrvSeatBeltBuckleSt 0//Unbuckled
  g_HIL_Bus_Swc_Set("VTS::VT2848_3_Ch34::DigitalOutput 0"); // 测试步骤 Step Set J_DI_FLDoorAjarSW_LS 1//Close
  g_HIL_Bus_Swc_Set("VTS::VT2848_3_Ch34::DigitalOutput 1"); // 测试步骤 Step Set J_DI_FLDoorAjarSW_LS 0//Open
  g_HIL_Bus_Swc_Check("I_LDCU_NM::I_LDCU_FLDoorAjarSW 1"); // 预期结果 Step Check I_LDCU_NM::I_LDCU_FLDoorAjarSW 1//Active
  g_HIL_Bus_Swc_Check("I_LDCU_BodySysSt1::I_LDCU_PowerMode 0 1 s"); // 预期结果 Step Check I_LDCU_BodySysSt1::I_LDCU_PowerMode 0 1 s//OFF
  g_HIL_Bus_Swc_Check("I_LDCU_BodySysSt2::I_LDCU_PowerOFFSource 7"); // 预期结果 Step Check I_LDCU_BodySysSt2::I_LDCU_PowerOFFSource 7//Door Open
  g_HIL_Bus_Swc_Set("C_CDCU_DiagnosticSt::C_CDCU_DiagnosticSt 0"); // 测试步骤 Step Set C_CDCU_DiagnosticSt::C_CDCU_DiagnosticSt 0//No diagnostic
  g_HIL_Bus_Swc_Set("VTS::VT2848_3_Ch34::DigitalOutput 0"); // 测试步骤 Step Set J_DI_FLDoorAjarSW_LS 1//Close
}

testcase SYS_LDCU_Powermode_0016()
{
  TestDescription("短按启动按钮-1");
  g_HIL_Clib_Swc_Clib_LocalON(); // 测试步骤 Step Clib LocalON
  g_HIL_Bus_Swc_Check("I_LDCU_BodySysSt1::I_LDCU_PowerMode 1"); // 预期结果 Step Check I_LDCU_BodySysSt1::I_LDCU_PowerMode 1 //LocalON
  g_HIL_Clib_Swc_Clib_P(); // 测试步骤 Step Clib P
  g_HIL_XCP_Swc_Set_XCP("CalEn_Vcu_MO_Motor_laeuft 1"); // 测试步骤 Step Set_XCP CalEn_Vcu_MO_Motor_laeuft 1
  g_HIL_XCP_Swc_Set_XCP("CalVal_Vcu_MO_Motor_laeuft 1"); // 测试步骤 Step Set_XCP CalVal_Vcu_MO_Motor_laeuft 1
  g_HIL_Bus_Swc_Set("C_CDCU_DiagnosticSt::C_CDCU_DiagnosticSt 0"); // 测试步骤 Step Set C_CDCU_DiagnosticSt::C_CDCU_DiagnosticSt 0//No diagnostic
  g_HIL_Bus_Swc_Set("C_SRS_SysSt::C_SRS_DrvSeatBeltBuckleSt 0"); // 测试步骤 Step Set C_SRS_SysSt::C_SRS_DrvSeatBeltBuckleSt 0//Unbuckled
  g_HIL_Bus_Swc_Set("VTS::VT2848_4_Ch27::DigitalOutput 1"); // 测试步骤 Step Set J_DI_SSBPin4SW_LS 0
  g_HIL_Bus_Swc_Set("VTS::VT2848_4_Ch32::DigitalOutput 1"); // 测试步骤 Step Set J_DI_SSBPin6SW_LS 0
  g_HIL_Gen_Swc_Wait("100 ms"); // 测试步骤 Step Wait 100 ms
  g_HIL_Bus_Swc_Check("I_LDCU_BodySysSt2::I_LDCU_ZATButtonSwSt 1 1 s"); // 预期结果 Step Check I_LDCU_BodySysSt2::I_LDCU_ZATButtonSwSt 1 1 s//Active
  g_HIL_Bus_Swc_Set("VTS::VT2848_4_Ch27::DigitalOutput 0"); // 测试步骤 Step Set J_DI_SSBPin4SW_LS 1
  g_HIL_Bus_Swc_Set("VTS::VT2848_4_Ch32::DigitalOutput 0"); // 测试步骤 Step Set J_DI_SSBPin6SW_LS 1
  g_HIL_Bus_Swc_Check("I_LDCU_BodySysSt2::I_LDCU_ZATButtonSwSt 0 1 s"); // 预期结果 Step Check I_LDCU_BodySysSt2::I_LDCU_ZATButtonSwSt 0 1 s//NotActive
  g_HIL_Bus_Swc_Check("I_LDCU_BodySysSt1::I_LDCU_PowerMode 3"); // 预期结果 Step Check I_LDCU_BodySysSt1::I_LDCU_PowerMode 3 //Convenience
  g_HIL_XCP_Swc_Set_XCP("CalVal_Vcu_MO_Motor_laeuft 0"); // 测试步骤 Step Set_XCP CalVal_Vcu_MO_Motor_laeuft 0
  g_HIL_Bus_Swc_Check("I_LDCU_BodySysSt2::I_LDCU_PowerONSource 5"); // 预期结果 Step Check I_LDCU_BodySysSt2::I_LDCU_PowerONSource 5// ZAT Pressed
}

testcase SYS_LDCU_Powermode_0017()
{
  TestDescription("短按启动按钮-2");
  g_HIL_Clib_Swc_Clib_LocalON(); // 测试步骤 Step Clib LocalON
  g_HIL_Bus_Swc_Check("I_LDCU_BodySysSt1::I_LDCU_PowerMode 1"); // 预期结果 Step Check I_LDCU_BodySysSt1::I_LDCU_PowerMode 1 //LocalON
  g_HIL_Clib_Swc_Clib_P(); // 测试步骤 Step Clib P
  g_HIL_XCP_Swc_Set_XCP("CalEn_Vcu_MO_Motor_laeuft 1"); // 测试步骤 Step Set_XCP CalEn_Vcu_MO_Motor_laeuft 1
  g_HIL_XCP_Swc_Set_XCP("CalVal_Vcu_MO_Motor_laeuft 1"); // 测试步骤 Step Set_XCP CalVal_Vcu_MO_Motor_laeuft 1
  g_HIL_Bus_Swc_Set("C_CDCU_DiagnosticSt::C_CDCU_DiagnosticSt 1"); // 测试步骤 Step Set C_CDCU_DiagnosticSt::C_CDCU_DiagnosticSt 1//OBD-CAN
  g_HIL_Bus_Swc_Set("C_SRS_SysSt::C_SRS_DrvSeatBeltBuckleSt 0"); // 测试步骤 Step Set C_SRS_SysSt::C_SRS_DrvSeatBeltBuckleSt 0//Unbuckled
  g_HIL_Bus_Swc_Set("VTS::VT2848_4_Ch27::DigitalOutput 1"); // 测试步骤 Step Set J_DI_SSBPin4SW_LS 0
  g_HIL_Bus_Swc_Set("VTS::VT2848_4_Ch32::DigitalOutput 1"); // 测试步骤 Step Set J_DI_SSBPin6SW_LS 0
  g_HIL_Gen_Swc_Wait("100 ms"); // 测试步骤 Step Wait 100 ms
  g_HIL_Bus_Swc_Check("I_LDCU_BodySysSt2::I_LDCU_ZATButtonSwSt 1 1 s"); // 预期结果 Step Check I_LDCU_BodySysSt2::I_LDCU_ZATButtonSwSt 1 1 s//Active
  g_HIL_Bus_Swc_Set("VTS::VT2848_4_Ch27::DigitalOutput 0"); // 测试步骤 Step Set J_DI_SSBPin4SW_LS 1
  g_HIL_Bus_Swc_Set("VTS::VT2848_4_Ch32::DigitalOutput 0"); // 测试步骤 Step Set J_DI_SSBPin6SW_LS 1
  g_HIL_Bus_Swc_Check("I_LDCU_BodySysSt2::I_LDCU_ZATButtonSwSt 0 1 s"); // 预期结果 Step Check I_LDCU_BodySysSt2::I_LDCU_ZATButtonSwSt 0 1 s//NotActive
  g_HIL_Bus_Swc_Check("I_LDCU_BodySysSt1::I_LDCU_PowerMode 3"); // 预期结果 Step Check I_LDCU_BodySysSt1::I_LDCU_PowerMode 3 //Convenience
  g_HIL_XCP_Swc_Set_XCP("CalVal_Vcu_MO_Motor_laeuft 0"); // 测试步骤 Step Set_XCP CalVal_Vcu_MO_Motor_laeuft 0
  g_HIL_Bus_Swc_Check("I_LDCU_BodySysSt2::I_LDCU_PowerONSource 5"); // 预期结果 Step Check I_LDCU_BodySysSt2::I_LDCU_PowerONSource 5// ZAT Pressed
  g_HIL_Bus_Swc_Set("C_CDCU_DiagnosticSt::C_CDCU_DiagnosticSt 0"); // 测试步骤 Step Set C_CDCU_DiagnosticSt::C_CDCU_DiagnosticSt 0//No diagnostic
}

testcase SYS_LDCU_Powermode_0018()
{
  TestDescription("短按启动按钮-3");
  g_HIL_Clib_Swc_Clib_LocalON(); // 测试步骤 Step Clib LocalON
  g_HIL_Bus_Swc_Check("I_LDCU_BodySysSt1::I_LDCU_PowerMode 1"); // 预期结果 Step Check I_LDCU_BodySysSt1::I_LDCU_PowerMode 1 //LocalON
  g_HIL_Clib_Swc_Clib_P(); // 测试步骤 Step Clib P
  g_HIL_XCP_Swc_Set_XCP("CalEn_Vcu_MO_Motor_laeuft 1"); // 测试步骤 Step Set_XCP CalEn_Vcu_MO_Motor_laeuft 1
  g_HIL_XCP_Swc_Set_XCP("CalVal_Vcu_MO_Motor_laeuft 1"); // 测试步骤 Step Set_XCP CalVal_Vcu_MO_Motor_laeuft 1
  g_HIL_Bus_Swc_Set("C_CDCU_DiagnosticSt::C_CDCU_DiagnosticSt 2"); // 测试步骤 Step Set C_CDCU_DiagnosticSt::C_CDCU_DiagnosticSt 2//OBD-Ethernet
  g_HIL_Bus_Swc_Set("C_SRS_SysSt::C_SRS_DrvSeatBeltBuckleSt 0"); // 测试步骤 Step Set C_SRS_SysSt::C_SRS_DrvSeatBeltBuckleSt 0//Unbuckled
  g_HIL_Bus_Swc_Set("VTS::VT2848_4_Ch27::DigitalOutput 1"); // 测试步骤 Step Set J_DI_SSBPin4SW_LS 0
  g_HIL_Bus_Swc_Set("VTS::VT2848_4_Ch32::DigitalOutput 1"); // 测试步骤 Step Set J_DI_SSBPin6SW_LS 0
  g_HIL_Gen_Swc_Wait("100 ms"); // 测试步骤 Step Wait 100 ms
  g_HIL_Bus_Swc_Check("I_LDCU_BodySysSt2::I_LDCU_ZATButtonSwSt 1 1 s"); // 预期结果 Step Check I_LDCU_BodySysSt2::I_LDCU_ZATButtonSwSt 1 1 s//Active
  g_HIL_Bus_Swc_Set("VTS::VT2848_4_Ch27::DigitalOutput 0"); // 测试步骤 Step Set J_DI_SSBPin4SW_LS 1
  g_HIL_Bus_Swc_Set("VTS::VT2848_4_Ch32::DigitalOutput 0"); // 测试步骤 Step Set J_DI_SSBPin6SW_LS 1
  g_HIL_Bus_Swc_Check("I_LDCU_BodySysSt2::I_LDCU_ZATButtonSwSt 0 1 s"); // 预期结果 Step Check I_LDCU_BodySysSt2::I_LDCU_ZATButtonSwSt 0 1 s//NotActive
  g_HIL_Bus_Swc_Check("I_LDCU_BodySysSt1::I_LDCU_PowerMode 3"); // 预期结果 Step Check I_LDCU_BodySysSt1::I_LDCU_PowerMode 3 //Convenience
  g_HIL_Bus_Swc_Set("C_CDCU_DiagnosticSt::C_CDCU_DiagnosticSt 0"); // 测试步骤 Step Set C_CDCU_DiagnosticSt::C_CDCU_DiagnosticSt 0//No diagnostic
  g_HIL_Bus_Swc_Check("I_LDCU_BodySysSt2::I_LDCU_PowerONSource 5"); // 预期结果 Step Check I_LDCU_BodySysSt2::I_LDCU_PowerONSource 5// ZAT Pressed
  g_HIL_XCP_Swc_Set_XCP("CalVal_Vcu_MO_Motor_laeuft 0"); // 测试步骤 Step Set_XCP CalVal_Vcu_MO_Motor_laeuft 0
}

testcase SYS_LDCU_Powermode_0019()
{
  TestDescription("短按启动按钮-4");
  g_HIL_Clib_Swc_Clib_LocalON(); // 测试步骤 Step Clib LocalON
  g_HIL_Bus_Swc_Check("I_LDCU_BodySysSt1::I_LDCU_PowerMode 1"); // 预期结果 Step Check I_LDCU_BodySysSt1::I_LDCU_PowerMode 1 //LocalON
  g_HIL_Clib_Swc_Clib_P(); // 测试步骤 Step Clib P
  g_HIL_Bus_Swc_Set("C_CDCU_DiagnosticSt::C_CDCU_DiagnosticSt 0"); // 测试步骤 Step Set C_CDCU_DiagnosticSt::C_CDCU_DiagnosticSt 0//No diagnostic
  g_HIL_Bus_Swc_Set("C_SRS_SysSt::C_SRS_DrvSeatBeltBuckleSt 0"); // 测试步骤 Step Set C_SRS_SysSt::C_SRS_DrvSeatBeltBuckleSt 0//Unbuckled
  g_HIL_Bus_Swc_Set("VTS::VT2848_4_Ch17::DigitalOutput 0"); // 测试步骤 Step Set J_DI_BrakeSw1_HS NotPressed
  g_HIL_Bus_Swc_Set("VTS::VT2848_4_Ch22::DigitalOutput 0"); // 测试步骤 Step Set J_DI_BrakeSw2_HS NotPressed
  g_HIL_Bus_Swc_Check("C_LDCU_SysSt::C_LDCU_BrkPedalSt 0"); // 预期结果 Step Check C_LDCU_SysSt::C_LDCU_BrkPedalSt 0//NotPressed
  g_HIL_Bus_Swc_Set("VTS::VT2848_4_Ch27::DigitalOutput 1"); // 测试步骤 Step Set J_DI_SSBPin4SW_LS 0
  g_HIL_Bus_Swc_Check("C_LDCU_SysSt::C_LDCU_BrkPedalStVD 1"); // 预期结果 Step Check C_LDCU_SysSt::C_LDCU_BrkPedalStVD 1//valid
  g_HIL_Bus_Swc_Set("VTS::VT2848_4_Ch32::DigitalOutput 1"); // 测试步骤 Step Set J_DI_SSBPin6SW_LS 0
  g_HIL_Gen_Swc_Wait("100 ms"); // 测试步骤 Step Wait 100 ms
  g_HIL_Bus_Swc_Check("I_LDCU_BodySysSt2::I_LDCU_ZATButtonSwSt 1 1 s"); // 预期结果 Step Check I_LDCU_BodySysSt2::I_LDCU_ZATButtonSwSt 1 1 s//Active
  g_HIL_Bus_Swc_Set("VTS::VT2848_4_Ch27::DigitalOutput 0"); // 测试步骤 Step Set J_DI_SSBPin4SW_LS 1
  g_HIL_Bus_Swc_Set("VTS::VT2848_4_Ch32::DigitalOutput 0"); // 测试步骤 Step Set J_DI_SSBPin6SW_LS 1
  g_HIL_Bus_Swc_Check("I_LDCU_BodySysSt2::I_LDCU_ZATButtonSwSt 0 1 s"); // 预期结果 Step Check I_LDCU_BodySysSt2::I_LDCU_ZATButtonSwSt 0 1 s//NotActive
  g_HIL_Bus_Swc_Check("I_LDCU_BodySysSt1::I_LDCU_PowerMode 3"); // 预期结果 Step Check I_LDCU_BodySysSt1::I_LDCU_PowerMode 3 //Convenience
  g_HIL_Bus_Swc_Check("I_LDCU_BodySysSt2::I_LDCU_PowerONSource 5"); // 预期结果 Step Check I_LDCU_BodySysSt2::I_LDCU_PowerONSource 5// ZAT Pressed
}

testcase SYS_LDCU_Powermode_0020()
{
  TestDescription("短按启动按钮-5");
  g_HIL_Clib_Swc_Clib_LocalON(); // 测试步骤 Step Clib LocalON
  g_HIL_Bus_Swc_Check("I_LDCU_BodySysSt1::I_LDCU_PowerMode 1"); // 预期结果 Step Check I_LDCU_BodySysSt1::I_LDCU_PowerMode 1 //LocalON
  g_HIL_Clib_Swc_Clib_P(); // 测试步骤 Step Clib P
  g_HIL_Bus_Swc_Set("C_CDCU_DiagnosticSt::C_CDCU_DiagnosticSt 1"); // 测试步骤 Step Set C_CDCU_DiagnosticSt::C_CDCU_DiagnosticSt 1//OBD-CAN
  g_HIL_Bus_Swc_Set("C_SRS_SysSt::C_SRS_DrvSeatBeltBuckleSt 0"); // 测试步骤 Step Set C_SRS_SysSt::C_SRS_DrvSeatBeltBuckleSt 0//Unbuckled
  g_HIL_Bus_Swc_Set("VTS::VT2848_4_Ch17::DigitalOutput 0"); // 测试步骤 Step Set J_DI_BrakeSw1_HS NotPressed
  g_HIL_Bus_Swc_Set("VTS::VT2848_4_Ch22::DigitalOutput 0"); // 测试步骤 Step Set J_DI_BrakeSw2_HS NotPressed
  g_HIL_Bus_Swc_Check("C_LDCU_SysSt::C_LDCU_BrkPedalSt 0"); // 预期结果 Step Check C_LDCU_SysSt::C_LDCU_BrkPedalSt 0//NotPressed
  g_HIL_Bus_Swc_Set("VTS::VT2848_4_Ch27::DigitalOutput 1"); // 测试步骤 Step Set J_DI_SSBPin4SW_LS 0
  g_HIL_Bus_Swc_Check("C_LDCU_SysSt::C_LDCU_BrkPedalStVD 1"); // 预期结果 Step Check C_LDCU_SysSt::C_LDCU_BrkPedalStVD 1//valid
  g_HIL_Bus_Swc_Set("VTS::VT2848_4_Ch32::DigitalOutput 1"); // 测试步骤 Step Set J_DI_SSBPin6SW_LS 0
  g_HIL_Gen_Swc_Wait("100 ms"); // 测试步骤 Step Wait 100 ms
  g_HIL_Bus_Swc_Check("I_LDCU_BodySysSt2::I_LDCU_ZATButtonSwSt 1 1 s"); // 预期结果 Step Check I_LDCU_BodySysSt2::I_LDCU_ZATButtonSwSt 1 1 s//Active
  g_HIL_Bus_Swc_Set("VTS::VT2848_4_Ch27::DigitalOutput 0"); // 测试步骤 Step Set J_DI_SSBPin4SW_LS 1
  g_HIL_Bus_Swc_Set("VTS::VT2848_4_Ch32::DigitalOutput 0"); // 测试步骤 Step Set J_DI_SSBPin6SW_LS 1
  g_HIL_Bus_Swc_Check("I_LDCU_BodySysSt2::I_LDCU_ZATButtonSwSt 0 1 s"); // 预期结果 Step Check I_LDCU_BodySysSt2::I_LDCU_ZATButtonSwSt 0 1 s//NotActive
  g_HIL_Bus_Swc_Check("I_LDCU_BodySysSt1::I_LDCU_PowerMode 3"); // 预期结果 Step Check I_LDCU_BodySysSt1::I_LDCU_PowerMode 3 //Convenience
  g_HIL_Bus_Swc_Set("C_CDCU_DiagnosticSt::C_CDCU_DiagnosticSt 0"); // 测试步骤 Step Set C_CDCU_DiagnosticSt::C_CDCU_DiagnosticSt 0//No diagnostic
  g_HIL_Bus_Swc_Check("I_LDCU_BodySysSt2::I_LDCU_PowerONSource 5"); // 预期结果 Step Check I_LDCU_BodySysSt2::I_LDCU_PowerONSource 5// ZAT Pressed
}

testcase SYS_LDCU_Powermode_0021()
{
  TestDescription("短按启动按钮-6");
  g_HIL_Clib_Swc_Clib_LocalON(); // 测试步骤 Step Clib LocalON
  g_HIL_Bus_Swc_Check("I_LDCU_BodySysSt1::I_LDCU_PowerMode 1"); // 预期结果 Step Check I_LDCU_BodySysSt1::I_LDCU_PowerMode 1 //LocalON
  g_HIL_Clib_Swc_Clib_P(); // 测试步骤 Step Clib P
  g_HIL_Bus_Swc_Set("C_CDCU_DiagnosticSt::C_CDCU_DiagnosticSt 2"); // 测试步骤 Step Set C_CDCU_DiagnosticSt::C_CDCU_DiagnosticSt 2//OBD-Ethernet
  g_HIL_Bus_Swc_Set("C_SRS_SysSt::C_SRS_DrvSeatBeltBuckleSt 0"); // 测试步骤 Step Set C_SRS_SysSt::C_SRS_DrvSeatBeltBuckleSt 0//Unbuckled
  g_HIL_Bus_Swc_Set("VTS::VT2848_4_Ch17::DigitalOutput 0"); // 测试步骤 Step Set J_DI_BrakeSw1_HS NotPressed
  g_HIL_Bus_Swc_Set("VTS::VT2848_4_Ch22::DigitalOutput 0"); // 测试步骤 Step Set J_DI_BrakeSw2_HS NotPressed
  g_HIL_Bus_Swc_Check("C_LDCU_SysSt::C_LDCU_BrkPedalSt 0"); // 预期结果 Step Check C_LDCU_SysSt::C_LDCU_BrkPedalSt 0//NotPressed
  g_HIL_Bus_Swc_Set("VTS::VT2848_4_Ch27::DigitalOutput 1"); // 测试步骤 Step Set J_DI_SSBPin4SW_LS 0
  g_HIL_Bus_Swc_Check("C_LDCU_SysSt::C_LDCU_BrkPedalStVD 1"); // 预期结果 Step Check C_LDCU_SysSt::C_LDCU_BrkPedalStVD 1//valid
  g_HIL_Bus_Swc_Set("VTS::VT2848_4_Ch32::DigitalOutput 1"); // 测试步骤 Step Set J_DI_SSBPin6SW_LS 0
  g_HIL_Gen_Swc_Wait("100 ms"); // 测试步骤 Step Wait 100 ms
  g_HIL_Bus_Swc_Check("I_LDCU_BodySysSt2::I_LDCU_ZATButtonSwSt 1 1 s"); // 预期结果 Step Check I_LDCU_BodySysSt2::I_LDCU_ZATButtonSwSt 1 1 s//Active
  g_HIL_Bus_Swc_Set("VTS::VT2848_4_Ch27::DigitalOutput 0"); // 测试步骤 Step Set J_DI_SSBPin4SW_LS 1
  g_HIL_Bus_Swc_Set("VTS::VT2848_4_Ch32::DigitalOutput 0"); // 测试步骤 Step Set J_DI_SSBPin6SW_LS 1
  g_HIL_Bus_Swc_Check("I_LDCU_BodySysSt2::I_LDCU_ZATButtonSwSt 0 1 s"); // 预期结果 Step Check I_LDCU_BodySysSt2::I_LDCU_ZATButtonSwSt 0 1 s//NotActive
  g_HIL_Bus_Swc_Check("I_LDCU_BodySysSt1::I_LDCU_PowerMode 3"); // 预期结果 Step Check I_LDCU_BodySysSt1::I_LDCU_PowerMode 3 //Convenience
  g_HIL_Bus_Swc_Set("C_CDCU_DiagnosticSt::C_CDCU_DiagnosticSt 0"); // 测试步骤 Step Set C_CDCU_DiagnosticSt::C_CDCU_DiagnosticSt 0//No diagnostic
  g_HIL_Bus_Swc_Check("I_LDCU_BodySysSt2::I_LDCU_PowerONSource 5"); // 预期结果 Step Check I_LDCU_BodySysSt2::I_LDCU_PowerONSource 5// ZAT Pressed
}

testcase SYS_LDCU_Powermode_0022()
{
  TestDescription("Convenience闭锁下电-1");
  g_HIL_Clib_Swc_Clib_Convenience(); // 测试步骤 Step Clib Convenience
  g_HIL_Bus_Swc_Check("I_LDCU_BodySysSt1::I_LDCU_PowerMode 3"); // 预期结果 Step Check I_LDCU_BodySysSt1::I_LDCU_PowerMode 3 //Convenience
  g_HIL_Clib_Swc_Clib_P(); // 测试步骤 Step Clib P
  g_HIL_Bus_Swc_Set("C_CDCU_DiagnosticSt::C_CDCU_DiagnosticSt 0"); // 测试步骤 Step Set C_CDCU_DiagnosticSt::C_CDCU_DiagnosticSt 0//No diagnostic
  g_HIL_Clib_Swc_Clib_AllDoorClosed(); // 测试步骤 Step Clib AllDoorClosed
  g_HIL_Bus_Swc_Set("I_TBOX_WinRemoteCtrl::I_TBOX_LDCU_DoorLockReq 0"); // 测试步骤 Step Set I_TBOX_WinRemoteCtrl::I_TBOX_LDCU_DoorLockReq 0//No operation
  g_HIL_Gen_Swc_Wait("301 ms"); // 测试步骤 Step Wait 301 ms
  g_HIL_Bus_Swc_Set("I_TBOX_WinRemoteCtrl::I_TBOX_LDCU_DoorLockReq 1"); // 测试步骤 Step Set I_TBOX_WinRemoteCtrl::I_TBOX_LDCU_DoorLockReq 1//SDK Self Lock or 4G Door Lock or 4G Polling Lock
  g_HIL_Gen_Swc_Wait("301 ms"); // 测试步骤 Step Wait 301 ms
  g_HIL_Bus_Swc_Check("I_LDCU_BodySysSt2::I_LDCU_PowerOFFSource 1 1 s"); // 预期结果 Step Check I_LDCU_BodySysSt2::I_LDCU_PowerOFFSource 1 1 s//闭锁下电
  g_HIL_Bus_Swc_Set("I_TBOX_WinRemoteCtrl::I_TBOX_LDCU_DoorLockReq 0"); // 测试步骤 Step Set I_TBOX_WinRemoteCtrl::I_TBOX_LDCU_DoorLockReq 0//No operation
  g_HIL_Bus_Swc_Check("I_LDCU_BodySysSt1::I_LDCU_PowerMode 0"); // 预期结果 Step Check I_LDCU_BodySysSt1::I_LDCU_PowerMode 0//OFF
  g_HIL_Bus_Swc_Check("VTS::VT2848_2_Ch26::CurBit 0"); // 预期结果 Step Check J_DO_HS_KL15_BackUp Inactive
}

testcase SYS_LDCU_Powermode_0023()
{
  TestDescription("Convenience闭锁下电-2");
  g_HIL_Clib_Swc_Clib_Convenience(); // 测试步骤 Step Clib Convenience
  g_HIL_Bus_Swc_Check("I_LDCU_BodySysSt1::I_LDCU_PowerMode 3"); // 预期结果 Step Check I_LDCU_BodySysSt1::I_LDCU_PowerMode 3 //Convenience
  g_HIL_Clib_Swc_Clib_P(); // 测试步骤 Step Clib P
  g_HIL_Bus_Swc_Set("C_CDCU_DiagnosticSt::C_CDCU_DiagnosticSt 1"); // 测试步骤 Step Set C_CDCU_DiagnosticSt::C_CDCU_DiagnosticSt 1//OBD-CAN
  g_HIL_Clib_Swc_Clib_AllDoorClosed(); // 测试步骤 Step Clib AllDoorClosed
  g_HIL_Bus_Swc_Set("I_TBOX_WinRemoteCtrl::I_TBOX_LDCU_DoorLockReq 0"); // 测试步骤 Step Set I_TBOX_WinRemoteCtrl::I_TBOX_LDCU_DoorLockReq 0//No operation
  g_HIL_Gen_Swc_Wait("301 ms"); // 测试步骤 Step Wait 301 ms
  g_HIL_Bus_Swc_Set("I_TBOX_WinRemoteCtrl::I_TBOX_LDCU_DoorLockReq 1"); // 测试步骤 Step Set I_TBOX_WinRemoteCtrl::I_TBOX_LDCU_DoorLockReq 1//SDK Self Lock or 4G Door Lock or 4G Polling Lock
  g_HIL_Gen_Swc_Wait("301 ms"); // 测试步骤 Step Wait 301 ms
  g_HIL_Bus_Swc_Check("I_LDCU_BodySysSt2::I_LDCU_PowerOFFSource 1 1 s"); // 预期结果 Step Check I_LDCU_BodySysSt2::I_LDCU_PowerOFFSource 1 1 s//闭锁下电
  g_HIL_Bus_Swc_Set("I_TBOX_WinRemoteCtrl::I_TBOX_LDCU_DoorLockReq 0"); // 测试步骤 Step Set I_TBOX_WinRemoteCtrl::I_TBOX_LDCU_DoorLockReq 0//No operation
  g_HIL_Bus_Swc_Check("I_LDCU_BodySysSt1::I_LDCU_PowerMode 0"); // 预期结果 Step Check I_LDCU_BodySysSt1::I_LDCU_PowerMode 0//OFF
  g_HIL_Bus_Swc_Set("C_CDCU_DiagnosticSt::C_CDCU_DiagnosticSt 0"); // 测试步骤 Step Set C_CDCU_DiagnosticSt::C_CDCU_DiagnosticSt 0//No diagnostic
  g_HIL_Bus_Swc_Check("VTS::VT2848_2_Ch26::CurBit 0"); // 预期结果 Step Check J_DO_HS_KL15_BackUp Inactive
}

testcase SYS_LDCU_Powermode_0024()
{
  TestDescription("Convenience闭锁下电-3");
  g_HIL_Clib_Swc_Clib_Convenience(); // 测试步骤 Step Clib Convenience
  g_HIL_Bus_Swc_Check("I_LDCU_BodySysSt1::I_LDCU_PowerMode 3"); // 预期结果 Step Check I_LDCU_BodySysSt1::I_LDCU_PowerMode 3 //Convenience
  g_HIL_Clib_Swc_Clib_P(); // 测试步骤 Step Clib P
  g_HIL_Bus_Swc_Set("C_CDCU_DiagnosticSt::C_CDCU_DiagnosticSt 2"); // 测试步骤 Step Set C_CDCU_DiagnosticSt::C_CDCU_DiagnosticSt 2//OBD-Ethernet
  g_HIL_Clib_Swc_Clib_AllDoorClosed(); // 测试步骤 Step Clib AllDoorClosed
  g_HIL_Bus_Swc_Set("I_TBOX_WinRemoteCtrl::I_TBOX_LDCU_DoorLockReq 0"); // 测试步骤 Step Set I_TBOX_WinRemoteCtrl::I_TBOX_LDCU_DoorLockReq 0//No operation
  g_HIL_Gen_Swc_Wait("301 ms"); // 测试步骤 Step Wait 301 ms
  g_HIL_Bus_Swc_Set("I_TBOX_WinRemoteCtrl::I_TBOX_LDCU_DoorLockReq 1"); // 测试步骤 Step Set I_TBOX_WinRemoteCtrl::I_TBOX_LDCU_DoorLockReq 1//SDK Self Lock or 4G Door Lock or 4G Polling Lock
  g_HIL_Gen_Swc_Wait("301 ms"); // 测试步骤 Step Wait 301 ms
  g_HIL_Bus_Swc_Check("I_LDCU_BodySysSt2::I_LDCU_PowerOFFSource 1 1 s"); // 预期结果 Step Check I_LDCU_BodySysSt2::I_LDCU_PowerOFFSource 1 1 s//闭锁下电
  g_HIL_Bus_Swc_Set("I_TBOX_WinRemoteCtrl::I_TBOX_LDCU_DoorLockReq 0"); // 测试步骤 Step Set I_TBOX_WinRemoteCtrl::I_TBOX_LDCU_DoorLockReq 0//No operation
  g_HIL_Bus_Swc_Check("I_LDCU_BodySysSt1::I_LDCU_PowerMode 0"); // 预期结果 Step Check I_LDCU_BodySysSt1::I_LDCU_PowerMode 0//OFF
  g_HIL_Bus_Swc_Set("C_CDCU_DiagnosticSt::C_CDCU_DiagnosticSt 0"); // 测试步骤 Step Set C_CDCU_DiagnosticSt::C_CDCU_DiagnosticSt 0//No diagnostic
  g_HIL_Bus_Swc_Check("VTS::VT2848_2_Ch26::CurBit 0"); // 预期结果 Step Check J_DO_HS_KL15_BackUp Inactive
}

testcase SYS_LDCU_Powermode_0025()
{
  TestDescription("Convenience闭锁下电-4");
  g_HIL_Clib_Swc_Clib_Convenience(); // 测试步骤 Step Clib Convenience
  g_HIL_Bus_Swc_Check("I_LDCU_BodySysSt1::I_LDCU_PowerMode 3"); // 预期结果 Step Check I_LDCU_BodySysSt1::I_LDCU_PowerMode 3 //Convenience
  g_HIL_Clib_Swc_Clib_P(); // 测试步骤 Step Clib P
  g_HIL_Bus_Swc_Set("C_CDCU_DiagnosticSt::C_CDCU_DiagnosticSt 0"); // 测试步骤 Step Set C_CDCU_DiagnosticSt::C_CDCU_DiagnosticSt 0//No diagnostic
  g_HIL_Clib_Swc_Clib_AllDoorClosed(); // 测试步骤 Step Clib AllDoorClosed
  g_HIL_Bus_Swc_Set("I_TBOX_WinRemoteCtrl::I_TBOX_LDCU_DoorLockReq 0"); // 测试步骤 Step Set I_TBOX_WinRemoteCtrl::I_TBOX_LDCU_DoorLockReq 0//No operation
  g_HIL_Gen_Swc_Wait("301 ms"); // 测试步骤 Step Wait 301 ms
  g_HIL_Bus_Swc_Set("I_TBOX_WinRemoteCtrl::I_TBOX_LDCU_DoorLockReq 5"); // 测试步骤 Step Set I_TBOX_WinRemoteCtrl::I_TBOX_LDCU_DoorLockReq 5//BLE polling lock
  g_HIL_Gen_Swc_Wait("301 ms"); // 测试步骤 Step Wait 301 ms
  g_HIL_Bus_Swc_Check("I_LDCU_BodySysSt2::I_LDCU_PowerOFFSource 1 1 s"); // 预期结果 Step Check I_LDCU_BodySysSt2::I_LDCU_PowerOFFSource 1 1 s//闭锁下电
  g_HIL_Bus_Swc_Set("I_TBOX_WinRemoteCtrl::I_TBOX_LDCU_DoorLockReq 0"); // 测试步骤 Step Set I_TBOX_WinRemoteCtrl::I_TBOX_LDCU_DoorLockReq 0//No operation
  g_HIL_Bus_Swc_Check("I_LDCU_BodySysSt1::I_LDCU_PowerMode 0"); // 预期结果 Step Check I_LDCU_BodySysSt1::I_LDCU_PowerMode 0//OFF
  g_HIL_Bus_Swc_Set("C_CDCU_DiagnosticSt::C_CDCU_DiagnosticSt 0"); // 测试步骤 Step Set C_CDCU_DiagnosticSt::C_CDCU_DiagnosticSt 0//No diagnostic
  g_HIL_Bus_Swc_Check("VTS::VT2848_2_Ch26::CurBit 0"); // 预期结果 Step Check J_DO_HS_KL15_BackUp Inactive
}

testcase SYS_LDCU_Powermode_0026()
{
  TestDescription("Convenience闭锁下电-5");
  g_HIL_Clib_Swc_Clib_Convenience(); // 测试步骤 Step Clib Convenience
  g_HIL_Bus_Swc_Check("I_LDCU_BodySysSt1::I_LDCU_PowerMode 3"); // 预期结果 Step Check I_LDCU_BodySysSt1::I_LDCU_PowerMode 3 //Convenience
  g_HIL_Clib_Swc_Clib_P(); // 测试步骤 Step Clib P
  g_HIL_Bus_Swc_Set("C_CDCU_DiagnosticSt::C_CDCU_DiagnosticSt 1"); // 测试步骤 Step Set C_CDCU_DiagnosticSt::C_CDCU_DiagnosticSt 1//OBD-CAN
  g_HIL_Clib_Swc_Clib_AllDoorClosed(); // 测试步骤 Step Clib AllDoorClosed
  g_HIL_Bus_Swc_Set("I_TBOX_WinRemoteCtrl::I_TBOX_LDCU_DoorLockReq 0"); // 测试步骤 Step Set I_TBOX_WinRemoteCtrl::I_TBOX_LDCU_DoorLockReq 0//No operation
  g_HIL_Gen_Swc_Wait("301 ms"); // 测试步骤 Step Wait 301 ms
  g_HIL_Bus_Swc_Set("I_TBOX_WinRemoteCtrl::I_TBOX_LDCU_DoorLockReq 5"); // 测试步骤 Step Set I_TBOX_WinRemoteCtrl::I_TBOX_LDCU_DoorLockReq 5//BLE polling lock
  g_HIL_Gen_Swc_Wait("301 ms"); // 测试步骤 Step Wait 301 ms
  g_HIL_Bus_Swc_Check("I_LDCU_BodySysSt2::I_LDCU_PowerOFFSource 1 1 s"); // 预期结果 Step Check I_LDCU_BodySysSt2::I_LDCU_PowerOFFSource 1 1 s//闭锁下电
  g_HIL_Bus_Swc_Set("I_TBOX_WinRemoteCtrl::I_TBOX_LDCU_DoorLockReq 0"); // 测试步骤 Step Set I_TBOX_WinRemoteCtrl::I_TBOX_LDCU_DoorLockReq 0//No operation
  g_HIL_Bus_Swc_Check("I_LDCU_BodySysSt1::I_LDCU_PowerMode 0"); // 预期结果 Step Check I_LDCU_BodySysSt1::I_LDCU_PowerMode 0//OFF
  g_HIL_Bus_Swc_Set("C_CDCU_DiagnosticSt::C_CDCU_DiagnosticSt 0"); // 测试步骤 Step Set C_CDCU_DiagnosticSt::C_CDCU_DiagnosticSt 0//No diagnostic
  g_HIL_Bus_Swc_Check("VTS::VT2848_2_Ch26::CurBit 0"); // 预期结果 Step Check J_DO_HS_KL15_BackUp Inactive
}

testcase SYS_LDCU_Powermode_0027()
{
  TestDescription("Convenience闭锁下电-6");
  g_HIL_Clib_Swc_Clib_Convenience(); // 测试步骤 Step Clib Convenience
  g_HIL_Bus_Swc_Check("I_LDCU_BodySysSt1::I_LDCU_PowerMode 3"); // 预期结果 Step Check I_LDCU_BodySysSt1::I_LDCU_PowerMode 3 //Convenience
  g_HIL_Clib_Swc_Clib_P(); // 测试步骤 Step Clib P
  g_HIL_Bus_Swc_Set("C_CDCU_DiagnosticSt::C_CDCU_DiagnosticSt 2"); // 测试步骤 Step Set C_CDCU_DiagnosticSt::C_CDCU_DiagnosticSt 2//OBD-Ethernet
  g_HIL_Clib_Swc_Clib_AllDoorClosed(); // 测试步骤 Step Clib AllDoorClosed
  g_HIL_Bus_Swc_Set("I_TBOX_WinRemoteCtrl::I_TBOX_LDCU_DoorLockReq 0"); // 测试步骤 Step Set I_TBOX_WinRemoteCtrl::I_TBOX_LDCU_DoorLockReq 0//No operation
  g_HIL_Gen_Swc_Wait("301 ms"); // 测试步骤 Step Wait 301 ms
  g_HIL_Bus_Swc_Set("I_TBOX_WinRemoteCtrl::I_TBOX_LDCU_DoorLockReq 5"); // 测试步骤 Step Set I_TBOX_WinRemoteCtrl::I_TBOX_LDCU_DoorLockReq 5//BLE polling lock
  g_HIL_Gen_Swc_Wait("301 ms"); // 测试步骤 Step Wait 301 ms
  g_HIL_Bus_Swc_Check("I_LDCU_BodySysSt2::I_LDCU_PowerOFFSource 1 1 s"); // 预期结果 Step Check I_LDCU_BodySysSt2::I_LDCU_PowerOFFSource 1 1 s//闭锁下电
  g_HIL_Bus_Swc_Set("I_TBOX_WinRemoteCtrl::I_TBOX_LDCU_DoorLockReq 0"); // 测试步骤 Step Set I_TBOX_WinRemoteCtrl::I_TBOX_LDCU_DoorLockReq 0//No operation
  g_HIL_Bus_Swc_Check("I_LDCU_BodySysSt1::I_LDCU_PowerMode 0"); // 预期结果 Step Check I_LDCU_BodySysSt1::I_LDCU_PowerMode 0//OFF
  g_HIL_Bus_Swc_Set("C_CDCU_DiagnosticSt::C_CDCU_DiagnosticSt 0"); // 测试步骤 Step Set C_CDCU_DiagnosticSt::C_CDCU_DiagnosticSt 0//No diagnostic
  g_HIL_Bus_Swc_Check("VTS::VT2848_2_Ch26::CurBit 0"); // 预期结果 Step Check J_DO_HS_KL15_BackUp Inactive
}

testcase SYS_LDCU_Powermode_0028()
{
  TestDescription("Convenience短按启动按钮下电-1");
  g_HIL_Clib_Swc_Clib_Convenience(); // 测试步骤 Step Clib Convenience
  g_HIL_Bus_Swc_Check("I_LDCU_BodySysSt1::I_LDCU_PowerMode 3"); // 预期结果 Step Check I_LDCU_BodySysSt1::I_LDCU_PowerMode 3 //Convenience
  g_HIL_Clib_Swc_Clib_P(); // 测试步骤 Step Clib P
  g_HIL_Bus_Swc_Set("C_CDCU_DiagnosticSt::C_CDCU_DiagnosticSt 0"); // 测试步骤 Step Set C_CDCU_DiagnosticSt::C_CDCU_DiagnosticSt 0//No diagnostic
  g_HIL_Bus_Swc_Set("VTS::VT2848_4_Ch17::DigitalOutput 0"); // 测试步骤 Step Set J_DI_BrakeSw1_HS NotPressed
  g_HIL_Bus_Swc_Set("VTS::VT2848_4_Ch22::DigitalOutput 0"); // 测试步骤 Step Set J_DI_BrakeSw2_HS NotPressed
  g_HIL_Bus_Swc_Check("C_LDCU_SysSt::C_LDCU_BrkPedalSt 0"); // 预期结果 Step Check C_LDCU_SysSt::C_LDCU_BrkPedalSt 0//NotPressed
  g_HIL_Bus_Swc_Set("VTS::VT2848_4_Ch27::DigitalOutput 1"); // 测试步骤 Step Set J_DI_SSBPin4SW_LS 0
  g_HIL_Bus_Swc_Check("C_LDCU_SysSt::C_LDCU_BrkPedalStVD 1"); // 预期结果 Step Check C_LDCU_SysSt::C_LDCU_BrkPedalStVD 1//valid
  g_HIL_Bus_Swc_Set("VTS::VT2848_4_Ch32::DigitalOutput 1"); // 测试步骤 Step Set J_DI_SSBPin6SW_LS 0
  g_HIL_Gen_Swc_Wait("100 ms"); // 测试步骤 Step Wait 100 ms
  g_HIL_Bus_Swc_Check("I_LDCU_BodySysSt2::I_LDCU_ZATButtonSwSt 1 1 s"); // 预期结果 Step Check I_LDCU_BodySysSt2::I_LDCU_ZATButtonSwSt 1 1 s//Active
  g_HIL_Bus_Swc_Set("VTS::VT2848_4_Ch27::DigitalOutput 0"); // 测试步骤 Step Set J_DI_SSBPin4SW_LS 1
  g_HIL_Bus_Swc_Set("VTS::VT2848_4_Ch32::DigitalOutput 0"); // 测试步骤 Step Set J_DI_SSBPin6SW_LS 1
  g_HIL_Bus_Swc_Check("I_LDCU_BodySysSt2::I_LDCU_ZATButtonSwSt 0 1 s"); // 预期结果 Step Check I_LDCU_BodySysSt2::I_LDCU_ZATButtonSwSt 0 1 s//NotActive
  g_HIL_Bus_Swc_Check("I_LDCU_BodySysSt1::I_LDCU_PowerMode 0"); // 预期结果 Step Check I_LDCU_BodySysSt1::I_LDCU_PowerMode 0 //OFF
  g_HIL_Bus_Swc_Set("C_CDCU_DiagnosticSt::C_CDCU_DiagnosticSt 0"); // 测试步骤 Step Set C_CDCU_DiagnosticSt::C_CDCU_DiagnosticSt 0//No diagnostic
  g_HIL_Bus_Swc_Check("I_LDCU_BodySysSt2::I_LDCU_PowerOFFSource 6"); // 预期结果 Step Check I_LDCU_BodySysSt2::I_LDCU_PowerOFFSource 6// ZAT Pressed
}

testcase SYS_LDCU_Powermode_0029()
{
  TestDescription("Convenience短按启动按钮下电-2");
  g_HIL_Clib_Swc_Clib_Convenience(); // 测试步骤 Step Clib Convenience
  g_HIL_Bus_Swc_Check("I_LDCU_BodySysSt1::I_LDCU_PowerMode 3"); // 预期结果 Step Check I_LDCU_BodySysSt1::I_LDCU_PowerMode 3 //Convenience
  g_HIL_Clib_Swc_Clib_P(); // 测试步骤 Step Clib P
  g_HIL_Bus_Swc_Set("C_CDCU_DiagnosticSt::C_CDCU_DiagnosticSt 1"); // 测试步骤 Step Set C_CDCU_DiagnosticSt::C_CDCU_DiagnosticSt 1//OBD-CAN
  g_HIL_Bus_Swc_Set("VTS::VT2848_4_Ch17::DigitalOutput 0"); // 测试步骤 Step Set J_DI_BrakeSw1_HS NotPressed
  g_HIL_Bus_Swc_Set("VTS::VT2848_4_Ch22::DigitalOutput 0"); // 测试步骤 Step Set J_DI_BrakeSw2_HS NotPressed
  g_HIL_Bus_Swc_Check("C_LDCU_SysSt::C_LDCU_BrkPedalSt 0"); // 预期结果 Step Check C_LDCU_SysSt::C_LDCU_BrkPedalSt 0//NotPressed
  g_HIL_Bus_Swc_Set("VTS::VT2848_4_Ch27::DigitalOutput 1"); // 测试步骤 Step Set J_DI_SSBPin4SW_LS 0
  g_HIL_Bus_Swc_Check("C_LDCU_SysSt::C_LDCU_BrkPedalStVD 1"); // 预期结果 Step Check C_LDCU_SysSt::C_LDCU_BrkPedalStVD 1//valid
  g_HIL_Bus_Swc_Set("VTS::VT2848_4_Ch32::DigitalOutput 1"); // 测试步骤 Step Set J_DI_SSBPin6SW_LS 0
  g_HIL_Gen_Swc_Wait("100 ms"); // 测试步骤 Step Wait 100 ms
  g_HIL_Bus_Swc_Check("I_LDCU_BodySysSt2::I_LDCU_ZATButtonSwSt 1 1 s"); // 预期结果 Step Check I_LDCU_BodySysSt2::I_LDCU_ZATButtonSwSt 1 1 s//Active
  g_HIL_Bus_Swc_Set("VTS::VT2848_4_Ch27::DigitalOutput 0"); // 测试步骤 Step Set J_DI_SSBPin4SW_LS 1
  g_HIL_Bus_Swc_Set("VTS::VT2848_4_Ch32::DigitalOutput 0"); // 测试步骤 Step Set J_DI_SSBPin6SW_LS 1
  g_HIL_Bus_Swc_Check("I_LDCU_BodySysSt2::I_LDCU_ZATButtonSwSt 0 1 s"); // 预期结果 Step Check I_LDCU_BodySysSt2::I_LDCU_ZATButtonSwSt 0 1 s//NotActive
  g_HIL_Bus_Swc_Check("I_LDCU_BodySysSt1::I_LDCU_PowerMode 0"); // 预期结果 Step Check I_LDCU_BodySysSt1::I_LDCU_PowerMode 0 //OFF
  g_HIL_Bus_Swc_Set("C_CDCU_DiagnosticSt::C_CDCU_DiagnosticSt 0"); // 测试步骤 Step Set C_CDCU_DiagnosticSt::C_CDCU_DiagnosticSt 0//No diagnostic
  g_HIL_Bus_Swc_Check("I_LDCU_BodySysSt2::I_LDCU_PowerOFFSource 6"); // 预期结果 Step Check I_LDCU_BodySysSt2::I_LDCU_PowerOFFSource 6// ZAT Pressed
}

testcase SYS_LDCU_Powermode_0030()
{
  TestDescription("Convenience短按启动按钮下电-3");
  g_HIL_Clib_Swc_Clib_Convenience(); // 测试步骤 Step Clib Convenience
  g_HIL_Bus_Swc_Check("I_LDCU_BodySysSt1::I_LDCU_PowerMode 3"); // 预期结果 Step Check I_LDCU_BodySysSt1::I_LDCU_PowerMode 3 //Convenience
  g_HIL_Clib_Swc_Clib_P(); // 测试步骤 Step Clib P
  g_HIL_Bus_Swc_Set("C_CDCU_DiagnosticSt::C_CDCU_DiagnosticSt 2"); // 测试步骤 Step Set C_CDCU_DiagnosticSt::C_CDCU_DiagnosticSt 2//OBD-Ethernet
  g_HIL_Bus_Swc_Set("VTS::VT2848_4_Ch17::DigitalOutput 0"); // 测试步骤 Step Set J_DI_BrakeSw1_HS NotPressed
  g_HIL_Bus_Swc_Set("VTS::VT2848_4_Ch22::DigitalOutput 0"); // 测试步骤 Step Set J_DI_BrakeSw2_HS NotPressed
  g_HIL_Bus_Swc_Check("C_LDCU_SysSt::C_LDCU_BrkPedalSt 0"); // 预期结果 Step Check C_LDCU_SysSt::C_LDCU_BrkPedalSt 0//NotPressed
  g_HIL_Bus_Swc_Set("VTS::VT2848_4_Ch27::DigitalOutput 1"); // 测试步骤 Step Set J_DI_SSBPin4SW_LS 0
  g_HIL_Bus_Swc_Check("C_LDCU_SysSt::C_LDCU_BrkPedalStVD 1"); // 预期结果 Step Check C_LDCU_SysSt::C_LDCU_BrkPedalStVD 1//valid
  g_HIL_Bus_Swc_Set("VTS::VT2848_4_Ch32::DigitalOutput 1"); // 测试步骤 Step Set J_DI_SSBPin6SW_LS 0
  g_HIL_Gen_Swc_Wait("100 ms"); // 测试步骤 Step Wait 100 ms
  g_HIL_Bus_Swc_Check("I_LDCU_BodySysSt2::I_LDCU_ZATButtonSwSt 1 1 s"); // 预期结果 Step Check I_LDCU_BodySysSt2::I_LDCU_ZATButtonSwSt 1 1 s//Active
  g_HIL_Bus_Swc_Set("VTS::VT2848_4_Ch27::DigitalOutput 0"); // 测试步骤 Step Set J_DI_SSBPin4SW_LS 1
  g_HIL_Bus_Swc_Set("VTS::VT2848_4_Ch32::DigitalOutput 0"); // 测试步骤 Step Set J_DI_SSBPin6SW_LS 1
  g_HIL_Bus_Swc_Check("I_LDCU_BodySysSt2::I_LDCU_ZATButtonSwSt 0 1 s"); // 预期结果 Step Check I_LDCU_BodySysSt2::I_LDCU_ZATButtonSwSt 0 1 s//NotActive
  g_HIL_Bus_Swc_Check("I_LDCU_BodySysSt1::I_LDCU_PowerMode 0"); // 预期结果 Step Check I_LDCU_BodySysSt1::I_LDCU_PowerMode 0 //OFF
  g_HIL_Bus_Swc_Set("C_CDCU_DiagnosticSt::C_CDCU_DiagnosticSt 0"); // 测试步骤 Step Set C_CDCU_DiagnosticSt::C_CDCU_DiagnosticSt 0//No diagnostic
  g_HIL_Bus_Swc_Check("I_LDCU_BodySysSt2::I_LDCU_PowerOFFSource 6"); // 预期结果 Step Check I_LDCU_BodySysSt2::I_LDCU_PowerOFFSource 6// ZAT Pressed
}

testcase SYS_LDCU_Powermode_0031()
{
  TestDescription("开门下电-1");
  g_HIL_Clib_Swc_Clib_Convenience(); // 测试步骤 Step Clib Convenience
  g_HIL_Bus_Swc_Check("I_LDCU_BodySysSt1::I_LDCU_PowerMode 3"); // 预期结果 Step Check I_LDCU_BodySysSt1::I_LDCU_PowerMode 3 //Convenience
  g_HIL_Clib_Swc_Clib_P(); // 测试步骤 Step Clib P
  g_HIL_Bus_Swc_Set("C_CDCU_DiagnosticSt::C_CDCU_DiagnosticSt 0"); // 测试步骤 Step Set C_CDCU_DiagnosticSt::C_CDCU_DiagnosticSt 0//No diagnostic
  g_HIL_Bus_Swc_Set("VTS::VT2848_3_Ch34::DigitalOutput 0"); // 测试步骤 Step Set J_DI_FLDoorAjarSW_LS 1//Close
  g_HIL_Bus_Swc_Set("VTS::VT2848_3_Ch34::DigitalOutput 1"); // 测试步骤 Step Set J_DI_FLDoorAjarSW_LS 0//Open
  g_HIL_Bus_Swc_Check("I_LDCU_NM::I_LDCU_FLDoorAjarSW 1"); // 预期结果 Step Check I_LDCU_NM::I_LDCU_FLDoorAjarSW 1//Active
  g_HIL_Bus_Swc_Check("I_LDCU_BodySysSt1::I_LDCU_PowerMode 0 1 s"); // 预期结果 Step Check I_LDCU_BodySysSt1::I_LDCU_PowerMode 0 1 s//OFF
  g_HIL_Bus_Swc_Check("I_LDCU_BodySysSt2::I_LDCU_PowerOFFSource 7"); // 预期结果 Step Check I_LDCU_BodySysSt2::I_LDCU_PowerOFFSource 7//Door Open
  g_HIL_Bus_Swc_Set("VTS::VT2848_3_Ch34::DigitalOutput 0"); // 测试步骤 Step Set J_DI_FLDoorAjarSW_LS 1//Close
}

testcase SYS_LDCU_Powermode_0032()
{
  TestDescription("开门下电-2");
  g_HIL_Clib_Swc_Clib_Convenience(); // 测试步骤 Step Clib Convenience
  g_HIL_Bus_Swc_Check("I_LDCU_BodySysSt1::I_LDCU_PowerMode 3"); // 预期结果 Step Check I_LDCU_BodySysSt1::I_LDCU_PowerMode 3 //Convenience
  g_HIL_Clib_Swc_Clib_P(); // 测试步骤 Step Clib P
  g_HIL_Bus_Swc_Set("C_CDCU_DiagnosticSt::C_CDCU_DiagnosticSt 1"); // 测试步骤 Step Set C_CDCU_DiagnosticSt::C_CDCU_DiagnosticSt 1//OBD-CAN
  g_HIL_Bus_Swc_Set("VTS::VT2848_3_Ch34::DigitalOutput 0"); // 测试步骤 Step Set J_DI_FLDoorAjarSW_LS 1//Close
  g_HIL_Bus_Swc_Set("VTS::VT2848_3_Ch34::DigitalOutput 1"); // 测试步骤 Step Set J_DI_FLDoorAjarSW_LS 0//Open
  g_HIL_Bus_Swc_Check("I_LDCU_NM::I_LDCU_FLDoorAjarSW 1"); // 预期结果 Step Check I_LDCU_NM::I_LDCU_FLDoorAjarSW 1//Active
  g_HIL_Bus_Swc_Check("I_LDCU_BodySysSt1::I_LDCU_PowerMode 0 1 s"); // 预期结果 Step Check I_LDCU_BodySysSt1::I_LDCU_PowerMode 0 1 s//OFF
  g_HIL_Bus_Swc_Check("I_LDCU_BodySysSt2::I_LDCU_PowerOFFSource 7"); // 预期结果 Step Check I_LDCU_BodySysSt2::I_LDCU_PowerOFFSource 7//Door Open
  g_HIL_Bus_Swc_Set("C_CDCU_DiagnosticSt::C_CDCU_DiagnosticSt 0"); // 测试步骤 Step Set C_CDCU_DiagnosticSt::C_CDCU_DiagnosticSt 0//No diagnostic
  g_HIL_Bus_Swc_Set("VTS::VT2848_3_Ch34::DigitalOutput 0"); // 测试步骤 Step Set J_DI_FLDoorAjarSW_LS 1//Close
}

testcase SYS_LDCU_Powermode_0033()
{
  TestDescription("开门下电-3");
  g_HIL_Clib_Swc_Clib_Convenience(); // 测试步骤 Step Clib Convenience
  g_HIL_Bus_Swc_Check("I_LDCU_BodySysSt1::I_LDCU_PowerMode 3"); // 预期结果 Step Check I_LDCU_BodySysSt1::I_LDCU_PowerMode 3 //Convenience
  g_HIL_Clib_Swc_Clib_P(); // 测试步骤 Step Clib P
  g_HIL_Bus_Swc_Set("C_CDCU_DiagnosticSt::C_CDCU_DiagnosticSt 2"); // 测试步骤 Step Set C_CDCU_DiagnosticSt::C_CDCU_DiagnosticSt 2//OBD-Ethernet
  g_HIL_Bus_Swc_Set("VTS::VT2848_3_Ch34::DigitalOutput 0"); // 测试步骤 Step Set J_DI_FLDoorAjarSW_LS 1//Close
  g_HIL_Bus_Swc_Set("VTS::VT2848_3_Ch34::DigitalOutput 1"); // 测试步骤 Step Set J_DI_FLDoorAjarSW_LS 0//Open
  g_HIL_Bus_Swc_Check("I_LDCU_NM::I_LDCU_FLDoorAjarSW 1"); // 预期结果 Step Check I_LDCU_NM::I_LDCU_FLDoorAjarSW 1//Active
  g_HIL_Bus_Swc_Check("I_LDCU_BodySysSt1::I_LDCU_PowerMode 0 1 s"); // 预期结果 Step Check I_LDCU_BodySysSt1::I_LDCU_PowerMode 0 1 s//OFF
  g_HIL_Bus_Swc_Check("I_LDCU_BodySysSt2::I_LDCU_PowerOFFSource 7"); // 预期结果 Step Check I_LDCU_BodySysSt2::I_LDCU_PowerOFFSource 7//Door Open
  g_HIL_Bus_Swc_Set("C_CDCU_DiagnosticSt::C_CDCU_DiagnosticSt 0"); // 测试步骤 Step Set C_CDCU_DiagnosticSt::C_CDCU_DiagnosticSt 0//No diagnostic
  g_HIL_Bus_Swc_Set("VTS::VT2848_3_Ch34::DigitalOutput 0"); // 测试步骤 Step Set J_DI_FLDoorAjarSW_LS 1//Close
}

testcase SYS_LDCU_Powermode_0034()
{
  TestDescription("开门下电-4");
  g_HIL_Clib_Swc_Clib_Convenience(); // 测试步骤 Step Clib Convenience
  g_HIL_Bus_Swc_Check("I_LDCU_BodySysSt1::I_LDCU_PowerMode 3"); // 预期结果 Step Check I_LDCU_BodySysSt1::I_LDCU_PowerMode 3 //Convenience
  g_HIL_Clib_Swc_Clib_P(); // 测试步骤 Step Clib P
  g_HIL_Bus_Swc_Set("C_CDCU_DiagnosticSt::C_CDCU_DiagnosticSt 3"); // 测试步骤 Step Set C_CDCU_DiagnosticSt::C_CDCU_DiagnosticSt 3//T1-Diag
  g_HIL_Bus_Swc_Set("VTS::VT2848_3_Ch34::DigitalOutput 0"); // 测试步骤 Step Set J_DI_FLDoorAjarSW_LS 1//Close
  g_HIL_Bus_Swc_Set("VTS::VT2848_3_Ch34::DigitalOutput 1"); // 测试步骤 Step Set J_DI_FLDoorAjarSW_LS 0//Open
  g_HIL_Bus_Swc_Check("I_LDCU_NM::I_LDCU_FLDoorAjarSW 1"); // 预期结果 Step Check I_LDCU_NM::I_LDCU_FLDoorAjarSW 1//Active
  g_HIL_Bus_Swc_Check("I_LDCU_BodySysSt1::I_LDCU_PowerMode 0 1 s"); // 预期结果 Step Check I_LDCU_BodySysSt1::I_LDCU_PowerMode 0 1 s//OFF
  g_HIL_Bus_Swc_Check("I_LDCU_BodySysSt2::I_LDCU_PowerOFFSource 7"); // 预期结果 Step Check I_LDCU_BodySysSt2::I_LDCU_PowerOFFSource 7//Door Open
  g_HIL_Bus_Swc_Set("C_CDCU_DiagnosticSt::C_CDCU_DiagnosticSt 0"); // 测试步骤 Step Set C_CDCU_DiagnosticSt::C_CDCU_DiagnosticSt 0//No diagnostic
  g_HIL_Bus_Swc_Set("VTS::VT2848_3_Ch34::DigitalOutput 0"); // 测试步骤 Step Set J_DI_FLDoorAjarSW_LS 1//Close
}

testcase SYS_LDCU_Powermode_0035()
{
  TestDescription("离车时激活了远程诊断或者OTA功能-1");
  g_HIL_XCP_Swc_Set_XCP("CalEn_Vcu_MO_Motor_laeuft 1"); // 测试步骤 Step Set_XCP CalEn_Vcu_MO_Motor_laeuft 1
  g_HIL_XCP_Swc_Set_XCP("CalVal_Vcu_MO_Motor_laeuft 0"); // 测试步骤 Step Set_XCP CalVal_Vcu_MO_Motor_laeuft 0
  g_HIL_Bus_Swc_Check("C_Motor_14::C_MO_Motor_laeuft 0"); // 预期结果 Step Check C_Motor_14::C_MO_Motor_laeuft 0//Motor_laeuft_nicht
  g_HIL_Clib_Swc_Clib_LocalON(); // 测试步骤 Step Clib LocalON
  g_HIL_Bus_Swc_Check("I_LDCU_BodySysSt1::I_LDCU_PowerMode 1"); // 预期结果 Step Check I_LDCU_BodySysSt1::I_LDCU_PowerMode 1 //LocalON
  g_HIL_Clib_Swc_Clib_P(); // 测试步骤 Step Clib P
  g_HIL_Bus_Swc_Set("C_CDCU_DiagnosticSt::C_CDCU_DiagnosticSt 4"); // 测试步骤 Step Set C_CDCU_DiagnosticSt::C_CDCU_DiagnosticSt 4//Slient OTA
  g_HIL_Gen_Swc_Wait("100 ms"); // 测试步骤 Step Wait 100 ms
  g_HIL_Bus_Swc_Set("VTS::VT2848_3_Ch34::DigitalOutput 0"); // 测试步骤 Step Set J_DI_FLDoorAjarSW_LS 1//Close
  g_HIL_Bus_Swc_Set("VTS::VT2848_3_Ch34::DigitalOutput 1"); // 测试步骤 Step Set J_DI_FLDoorAjarSW_LS 0//Open
  g_HIL_Bus_Swc_Check("I_LDCU_NM::I_LDCU_FLDoorAjarSW 1"); // 预期结果 Step Check I_LDCU_NM::I_LDCU_FLDoorAjarSW 1//Active
  g_HIL_Gen_Swc_Wait("100 ms"); // 测试步骤 Step Wait 100 ms
  g_HIL_Bus_Swc_Check("I_LDCU_BodySysSt1::I_LDCU_PowerMode 2 1 s"); // 预期结果 Step Check I_LDCU_BodySysSt1::I_LDCU_PowerMode 2 1 s//Remote ON
  g_HIL_Bus_Swc_Check("I_LDCU_BodySysSt2::I_LDCU_PowerONSource 3"); // 预期结果 Step Check I_LDCU_BodySysSt2::I_LDCU_PowerONSource 3//OTA/Remote Diag Req
  g_HIL_Bus_Swc_Set("C_CDCU_DiagnosticSt::C_CDCU_DiagnosticSt 0"); // 测试步骤 Step Set C_CDCU_DiagnosticSt::C_CDCU_DiagnosticSt 0//No diagnostic
  g_HIL_Bus_Swc_Set("VTS::VT2848_3_Ch34::DigitalOutput 0"); // 测试步骤 Step Set J_DI_FLDoorAjarSW_LS 1//Close
  g_HIL_Clib_Swc_Clib_RemoteOFF(); // 测试步骤 Step Clib RemoteOFF
}

testcase SYS_LDCU_Powermode_0036()
{
  TestDescription("离车时激活了远程诊断或者OTA功能-2");
  g_HIL_XCP_Swc_Set_XCP("CalEn_Vcu_MO_Motor_laeuft 1"); // 测试步骤 Step Set_XCP CalEn_Vcu_MO_Motor_laeuft 1
  g_HIL_XCP_Swc_Set_XCP("CalVal_Vcu_MO_Motor_laeuft 0"); // 测试步骤 Step Set_XCP CalVal_Vcu_MO_Motor_laeuft 0
  g_HIL_Bus_Swc_Check("C_Motor_14::C_MO_Motor_laeuft 0"); // 预期结果 Step Check C_Motor_14::C_MO_Motor_laeuft 0//Motor_laeuft_nicht
  g_HIL_Clib_Swc_Clib_LocalON(); // 测试步骤 Step Clib LocalON
  g_HIL_Bus_Swc_Check("I_LDCU_BodySysSt1::I_LDCU_PowerMode 1"); // 预期结果 Step Check I_LDCU_BodySysSt1::I_LDCU_PowerMode 1 //LocalON
  g_HIL_Clib_Swc_Clib_P(); // 测试步骤 Step Clib P
  g_HIL_Bus_Swc_Set("C_CDCU_DiagnosticSt::C_CDCU_DiagnosticSt 5"); // 测试步骤 Step Set C_CDCU_DiagnosticSt::C_CDCU_DiagnosticSt 5//Normal OTA
  g_HIL_Gen_Swc_Wait("100 ms"); // 测试步骤 Step Wait 100 ms
  g_HIL_Bus_Swc_Set("VTS::VT2848_3_Ch34::DigitalOutput 0"); // 测试步骤 Step Set J_DI_FLDoorAjarSW_LS 1//Close
  g_HIL_Bus_Swc_Set("VTS::VT2848_3_Ch34::DigitalOutput 1"); // 测试步骤 Step Set J_DI_FLDoorAjarSW_LS 0//Open
  g_HIL_Bus_Swc_Check("I_LDCU_NM::I_LDCU_FLDoorAjarSW 1"); // 预期结果 Step Check I_LDCU_NM::I_LDCU_FLDoorAjarSW 1//Active
  g_HIL_Gen_Swc_Wait("100 ms"); // 测试步骤 Step Wait 100 ms
  g_HIL_Bus_Swc_Check("I_LDCU_BodySysSt1::I_LDCU_PowerMode 2 1 s"); // 预期结果 Step Check I_LDCU_BodySysSt1::I_LDCU_PowerMode 2 1 s//Remote ON
  g_HIL_Bus_Swc_Check("I_LDCU_BodySysSt2::I_LDCU_PowerONSource 3"); // 预期结果 Step Check I_LDCU_BodySysSt2::I_LDCU_PowerONSource 3//OTA/Remote Diag Req
  g_HIL_Bus_Swc_Set("C_CDCU_DiagnosticSt::C_CDCU_DiagnosticSt 0"); // 测试步骤 Step Set C_CDCU_DiagnosticSt::C_CDCU_DiagnosticSt 0//No diagnostic
  g_HIL_Bus_Swc_Set("VTS::VT2848_3_Ch34::DigitalOutput 0"); // 测试步骤 Step Set J_DI_FLDoorAjarSW_LS 1//Close
  g_HIL_Clib_Swc_Clib_RemoteOFF(); // 测试步骤 Step Clib RemoteOFF
}

testcase SYS_LDCU_Powermode_0037()
{
  TestDescription("离车时激活了远程诊断或者OTA功能-3");
  g_HIL_XCP_Swc_Set_XCP("CalEn_Vcu_MO_Motor_laeuft 1"); // 测试步骤 Step Set_XCP CalEn_Vcu_MO_Motor_laeuft 1
  g_HIL_XCP_Swc_Set_XCP("CalVal_Vcu_MO_Motor_laeuft 0"); // 测试步骤 Step Set_XCP CalVal_Vcu_MO_Motor_laeuft 0
  g_HIL_Bus_Swc_Check("C_Motor_14::C_MO_Motor_laeuft 0"); // 预期结果 Step Check C_Motor_14::C_MO_Motor_laeuft 0//Motor_laeuft_nicht
  g_HIL_Clib_Swc_Clib_LocalON(); // 测试步骤 Step Clib LocalON
  g_HIL_Bus_Swc_Check("I_LDCU_BodySysSt1::I_LDCU_PowerMode 1"); // 预期结果 Step Check I_LDCU_BodySysSt1::I_LDCU_PowerMode 1 //LocalON
  g_HIL_Clib_Swc_Clib_P(); // 测试步骤 Step Clib P
  g_HIL_Bus_Swc_Set("C_CDCU_DiagnosticSt::C_CDCU_DiagnosticSt 6"); // 测试步骤 Step Set C_CDCU_DiagnosticSt::C_CDCU_DiagnosticSt 6//Remote Diag
  g_HIL_Gen_Swc_Wait("100 ms"); // 测试步骤 Step Wait 100 ms
  g_HIL_Bus_Swc_Set("VTS::VT2848_3_Ch34::DigitalOutput 0"); // 测试步骤 Step Set J_DI_FLDoorAjarSW_LS 1//Close
  g_HIL_Bus_Swc_Set("VTS::VT2848_3_Ch34::DigitalOutput 1"); // 测试步骤 Step Set J_DI_FLDoorAjarSW_LS 0//Open
  g_HIL_Bus_Swc_Check("I_LDCU_NM::I_LDCU_FLDoorAjarSW 1"); // 预期结果 Step Check I_LDCU_NM::I_LDCU_FLDoorAjarSW 1//Active
  g_HIL_Gen_Swc_Wait("100 ms"); // 测试步骤 Step Wait 100 ms
  g_HIL_Bus_Swc_Check("I_LDCU_BodySysSt1::I_LDCU_PowerMode 2 1 s"); // 预期结果 Step Check I_LDCU_BodySysSt1::I_LDCU_PowerMode 2 1 s//Remote ON
  g_HIL_Bus_Swc_Check("I_LDCU_BodySysSt2::I_LDCU_PowerONSource 3"); // 预期结果 Step Check I_LDCU_BodySysSt2::I_LDCU_PowerONSource 3//OTA/Remote Diag Req
  g_HIL_Bus_Swc_Set("C_CDCU_DiagnosticSt::C_CDCU_DiagnosticSt 0"); // 测试步骤 Step Set C_CDCU_DiagnosticSt::C_CDCU_DiagnosticSt 0//No diagnostic
  g_HIL_Clib_Swc_Clib_RemoteOFF(); // 测试步骤 Step Clib RemoteOFF
  g_HIL_Bus_Swc_Set("VTS::VT2848_3_Ch34::DigitalOutput 0"); // 测试步骤 Step Set J_DI_FLDoorAjarSW_LS 1//Close
}

testcase SYS_LDCU_Powermode_0038()
{
  TestDescription("退出远程诊断或OTA车辆下电-1");
  g_HIL_XCP_Swc_Set_XCP("CalC_tPwMdOTAPwrOnValid 10"); // 测试步骤 Step Set_XCP CalC_tPwMdOTAPwrOnValid 10
  g_HIL_Clib_Swc_Clib_RemoteON(); // 测试步骤 Step Clib RemoteON
  g_HIL_Bus_Swc_Check("I_LDCU_BodySysSt1::I_LDCU_PowerMode 2"); // 预期结果 Step Check I_LDCU_BodySysSt1::I_LDCU_PowerMode 2 //RemoteOn
  g_HIL_Clib_Swc_Clib_P(); // 测试步骤 Step Clib P
  g_HIL_Bus_Swc_Set("I_XPU_BodyCtrl::I_XPU_LDCU_CurMode 0"); // 测试步骤 Step Set I_XPU_BodyCtrl::I_XPU_LDCU_CurMode 0// 智能驾驶模式Invalid
  g_HIL_Bus_Swc_Check("I_LDCU_State::I_OTAPowerOnValid 1"); // 预期结果 Step Check I_LDCU_State::I_OTAPowerOnValid 1//VALID
  g_HIL_Bus_Swc_Set("C_CDCU_DiagnosticSt::C_CDCU_DiagnosticSt 0"); // 测试步骤 Step Set C_CDCU_DiagnosticSt::C_CDCU_DiagnosticSt 0
  g_HIL_Gen_Swc_Wait("10 s"); // 测试步骤 Step Wait 10 s
  g_HIL_Bus_Swc_Check("I_LDCU_State::I_OTAPowerOnValid 0 1 s"); // 预期结果 Step Check I_LDCU_State::I_OTAPowerOnValid 0 1 s//INVALID
  g_HIL_Bus_Swc_Check("I_LDCU_BodySysSt1::I_LDCU_PowerMode 0 2 s"); // 预期结果 Step Check I_LDCU_BodySysSt1::I_LDCU_PowerMode 0 2 s//OFF
  g_HIL_XCP_Swc_Set_XCP("CalC_tPwMdOTAPwrOnValid 60"); // 测试步骤 Step Set_XCP CalC_tPwMdOTAPwrOnValid 60
}

testcase SYS_LDCU_Powermode_0039()
{
  TestDescription("退出远程诊断或OTA车辆下电-2");
  g_HIL_Clib_Swc_Clib_RemoteON(); // 测试步骤 Step Clib RemoteON
  g_HIL_Bus_Swc_Check("I_LDCU_BodySysSt1::I_LDCU_PowerMode 2"); // 预期结果 Step Check I_LDCU_BodySysSt1::I_LDCU_PowerMode 2 //RemoteOn
  g_HIL_Clib_Swc_Clib_P(); // 测试步骤 Step Clib P
  g_HIL_Bus_Swc_Set("I_XPU_BodyCtrl::I_XPU_LDCU_CurMode 0"); // 测试步骤 Step Set I_XPU_BodyCtrl::I_XPU_LDCU_CurMode 0// 智能驾驶模式Invalid
  g_HIL_Bus_Swc_Check("I_LDCU_State::I_OTAPowerOnValid 1"); // 预期结果 Step Check I_LDCU_State::I_OTAPowerOnValid 1//VALID
  g_HIL_Gen_Swc_Wait("301 ms"); // 测试步骤 Step Wait 301 ms
  g_HIL_UDS_Swc_Set_UDS("SA_L1"); // 测试步骤 Step Set_UDS SA_L1
  g_HIL_UDS_Swc_Set_UDS("31 01 C1 E3 01"); // 测试步骤 Step Set_UDS 31 01 C1 E3 01//
  g_HIL_Gen_Swc_Wait("501 ms"); // 测试步骤 Step Wait 501 ms
  g_HIL_Bus_Swc_Check("I_LDCU_BodySysSt1::I_LDCU_PowerMode 0 2 s"); // 预期结果 Step Check I_LDCU_BodySysSt1::I_LDCU_PowerMode 0 2 s//OFF
  g_HIL_Bus_Swc_Set("C_CDCU_DiagnosticSt::C_CDCU_DiagnosticSt 0"); // 测试步骤 Step Set C_CDCU_DiagnosticSt::C_CDCU_DiagnosticSt 0
}

testcase SYS_LDCU_Powermode_0040()
{
  TestDescription("RemoteOn闭锁下电-1");
  g_HIL_Clib_Swc_Clib_RemoteON(); // 测试步骤 Step Clib RemoteON
  g_HIL_Bus_Swc_Check("I_LDCU_BodySysSt1::I_LDCU_PowerMode 2"); // 预期结果 Step Check I_LDCU_BodySysSt1::I_LDCU_PowerMode 2 //RemoteON
  g_HIL_Clib_Swc_Clib_P(); // 测试步骤 Step Clib P
  g_HIL_Bus_Swc_Set("C_CDCU_DiagnosticSt::C_CDCU_DiagnosticSt 0"); // 测试步骤 Step Set C_CDCU_DiagnosticSt::C_CDCU_DiagnosticSt 0//No diagnostic
  g_HIL_Clib_Swc_Clib_AllDoorClosed(); // 测试步骤 Step Clib AllDoorClosed
  g_HIL_Bus_Swc_Set("I_TBOX_WinRemoteCtrl::I_TBOX_LDCU_DoorLockReq 0"); // 测试步骤 Step Set I_TBOX_WinRemoteCtrl::I_TBOX_LDCU_DoorLockReq 0//No operation
  g_HIL_Gen_Swc_Wait("301 ms"); // 测试步骤 Step Wait 301 ms
  g_HIL_Bus_Swc_Set("I_TBOX_WinRemoteCtrl::I_TBOX_LDCU_DoorLockReq 1"); // 测试步骤 Step Set I_TBOX_WinRemoteCtrl::I_TBOX_LDCU_DoorLockReq 1//SDK Self Lock or 4G Door Lock or 4G Polling Lock
  g_HIL_Gen_Swc_Wait("301 ms"); // 测试步骤 Step Wait 301 ms
  g_HIL_Bus_Swc_Check("I_LDCU_BodySysSt2::I_LDCU_PowerOFFSource 1 1 s"); // 预期结果 Step Check I_LDCU_BodySysSt2::I_LDCU_PowerOFFSource 1 1 s//闭锁下电
  g_HIL_Bus_Swc_Set("I_TBOX_WinRemoteCtrl::I_TBOX_LDCU_DoorLockReq 0"); // 测试步骤 Step Set I_TBOX_WinRemoteCtrl::I_TBOX_LDCU_DoorLockReq 0//No operation
  g_HIL_Bus_Swc_Check("I_LDCU_BodySysSt1::I_LDCU_PowerMode 0"); // 预期结果 Step Check I_LDCU_BodySysSt1::I_LDCU_PowerMode 0//OFF
  g_HIL_Bus_Swc_Check("VTS::VT2848_2_Ch26::CurBit 0"); // 预期结果 Step Check J_DO_HS_KL15_BackUp Inactive
}

testcase SYS_LDCU_Powermode_0041()
{
  TestDescription("RemoteOn闭锁下电-2");
  g_HIL_Clib_Swc_Clib_RemoteON(); // 测试步骤 Step Clib RemoteON
  g_HIL_Bus_Swc_Check("I_LDCU_BodySysSt1::I_LDCU_PowerMode 2"); // 预期结果 Step Check I_LDCU_BodySysSt1::I_LDCU_PowerMode 2 //RemoteON
  g_HIL_Clib_Swc_Clib_P(); // 测试步骤 Step Clib P
  g_HIL_Bus_Swc_Set("C_CDCU_DiagnosticSt::C_CDCU_DiagnosticSt 1"); // 测试步骤 Step Set C_CDCU_DiagnosticSt::C_CDCU_DiagnosticSt 1//OBD-CAN
  g_HIL_Clib_Swc_Clib_AllDoorClosed(); // 测试步骤 Step Clib AllDoorClosed
  g_HIL_Bus_Swc_Set("I_TBOX_WinRemoteCtrl::I_TBOX_LDCU_DoorLockReq 0"); // 测试步骤 Step Set I_TBOX_WinRemoteCtrl::I_TBOX_LDCU_DoorLockReq 0//No operation
  g_HIL_Gen_Swc_Wait("301 ms"); // 测试步骤 Step Wait 301 ms
  g_HIL_Bus_Swc_Set("I_TBOX_WinRemoteCtrl::I_TBOX_LDCU_DoorLockReq 1"); // 测试步骤 Step Set I_TBOX_WinRemoteCtrl::I_TBOX_LDCU_DoorLockReq 1//SDK Self Lock or 4G Door Lock or 4G Polling Lock
  g_HIL_Gen_Swc_Wait("301 ms"); // 测试步骤 Step Wait 301 ms
  g_HIL_Bus_Swc_Check("I_LDCU_BodySysSt2::I_LDCU_PowerOFFSource 1 1 s"); // 预期结果 Step Check I_LDCU_BodySysSt2::I_LDCU_PowerOFFSource 1 1 s//闭锁下电
  g_HIL_Bus_Swc_Set("I_TBOX_WinRemoteCtrl::I_TBOX_LDCU_DoorLockReq 0"); // 测试步骤 Step Set I_TBOX_WinRemoteCtrl::I_TBOX_LDCU_DoorLockReq 0//No operation
  g_HIL_Bus_Swc_Check("I_LDCU_BodySysSt1::I_LDCU_PowerMode 0"); // 预期结果 Step Check I_LDCU_BodySysSt1::I_LDCU_PowerMode 0//OFF
  g_HIL_Bus_Swc_Set("C_CDCU_DiagnosticSt::C_CDCU_DiagnosticSt 0"); // 测试步骤 Step Set C_CDCU_DiagnosticSt::C_CDCU_DiagnosticSt 0//No diagnostic
  g_HIL_Bus_Swc_Check("VTS::VT2848_2_Ch26::CurBit 0"); // 预期结果 Step Check J_DO_HS_KL15_BackUp Inactive
}

testcase SYS_LDCU_Powermode_0042()
{
  TestDescription("RemoteOn闭锁下电-3");
  g_HIL_Clib_Swc_Clib_RemoteON(); // 测试步骤 Step Clib RemoteON
  g_HIL_Bus_Swc_Check("I_LDCU_BodySysSt1::I_LDCU_PowerMode 2"); // 预期结果 Step Check I_LDCU_BodySysSt1::I_LDCU_PowerMode 2 //RemoteON
  g_HIL_Clib_Swc_Clib_P(); // 测试步骤 Step Clib P
  g_HIL_Bus_Swc_Set("C_CDCU_DiagnosticSt::C_CDCU_DiagnosticSt 2"); // 测试步骤 Step Set C_CDCU_DiagnosticSt::C_CDCU_DiagnosticSt 2//OBD-Ethernet
  g_HIL_Clib_Swc_Clib_AllDoorClosed(); // 测试步骤 Step Clib AllDoorClosed
  g_HIL_Bus_Swc_Set("I_TBOX_WinRemoteCtrl::I_TBOX_LDCU_DoorLockReq 0"); // 测试步骤 Step Set I_TBOX_WinRemoteCtrl::I_TBOX_LDCU_DoorLockReq 0//No operation
  g_HIL_Gen_Swc_Wait("301 ms"); // 测试步骤 Step Wait 301 ms
  g_HIL_Bus_Swc_Set("I_TBOX_WinRemoteCtrl::I_TBOX_LDCU_DoorLockReq 1"); // 测试步骤 Step Set I_TBOX_WinRemoteCtrl::I_TBOX_LDCU_DoorLockReq 1//SDK Self Lock or 4G Door Lock or 4G Polling Lock
  g_HIL_Gen_Swc_Wait("301 ms"); // 测试步骤 Step Wait 301 ms
  g_HIL_Bus_Swc_Check("I_LDCU_BodySysSt2::I_LDCU_PowerOFFSource 1 1 s"); // 预期结果 Step Check I_LDCU_BodySysSt2::I_LDCU_PowerOFFSource 1 1 s//闭锁下电
  g_HIL_Bus_Swc_Set("I_TBOX_WinRemoteCtrl::I_TBOX_LDCU_DoorLockReq 0"); // 测试步骤 Step Set I_TBOX_WinRemoteCtrl::I_TBOX_LDCU_DoorLockReq 0//No operation
  g_HIL_Bus_Swc_Check("I_LDCU_BodySysSt1::I_LDCU_PowerMode 0"); // 预期结果 Step Check I_LDCU_BodySysSt1::I_LDCU_PowerMode 0//OFF
  g_HIL_Bus_Swc_Set("C_CDCU_DiagnosticSt::C_CDCU_DiagnosticSt 0"); // 测试步骤 Step Set C_CDCU_DiagnosticSt::C_CDCU_DiagnosticSt 0//No diagnostic
  g_HIL_Bus_Swc_Check("VTS::VT2848_2_Ch26::CurBit 0"); // 预期结果 Step Check J_DO_HS_KL15_BackUp Inactive
}

testcase SYS_LDCU_Powermode_0043()
{
  TestDescription("RemoteOn闭锁下电-4");
  g_HIL_Clib_Swc_Clib_RemoteON(); // 测试步骤 Step Clib RemoteON
  g_HIL_Bus_Swc_Check("I_LDCU_BodySysSt1::I_LDCU_PowerMode 2"); // 预期结果 Step Check I_LDCU_BodySysSt1::I_LDCU_PowerMode 2 //RemoteON
  g_HIL_Clib_Swc_Clib_P(); // 测试步骤 Step Clib P
  g_HIL_Bus_Swc_Set("C_CDCU_DiagnosticSt::C_CDCU_DiagnosticSt 0"); // 测试步骤 Step Set C_CDCU_DiagnosticSt::C_CDCU_DiagnosticSt 0//No diagnostic
  g_HIL_Clib_Swc_Clib_AllDoorClosed(); // 测试步骤 Step Clib AllDoorClosed
  g_HIL_Bus_Swc_Set("I_TBOX_WinRemoteCtrl::I_TBOX_LDCU_DoorLockReq 0"); // 测试步骤 Step Set I_TBOX_WinRemoteCtrl::I_TBOX_LDCU_DoorLockReq 0//No operation
  g_HIL_Gen_Swc_Wait("301 ms"); // 测试步骤 Step Wait 301 ms
  g_HIL_Bus_Swc_Set("I_TBOX_WinRemoteCtrl::I_TBOX_LDCU_DoorLockReq 5"); // 测试步骤 Step Set I_TBOX_WinRemoteCtrl::I_TBOX_LDCU_DoorLockReq 5//BLE polling lock
  g_HIL_Gen_Swc_Wait("301 ms"); // 测试步骤 Step Wait 301 ms
  g_HIL_Bus_Swc_Check("I_LDCU_BodySysSt2::I_LDCU_PowerOFFSource 1 1 s"); // 预期结果 Step Check I_LDCU_BodySysSt2::I_LDCU_PowerOFFSource 1 1 s//闭锁下电
  g_HIL_Bus_Swc_Set("I_TBOX_WinRemoteCtrl::I_TBOX_LDCU_DoorLockReq 0"); // 测试步骤 Step Set I_TBOX_WinRemoteCtrl::I_TBOX_LDCU_DoorLockReq 0//No operation
  g_HIL_Bus_Swc_Check("I_LDCU_BodySysSt1::I_LDCU_PowerMode 0"); // 预期结果 Step Check I_LDCU_BodySysSt1::I_LDCU_PowerMode 0//OFF
  g_HIL_Bus_Swc_Set("C_CDCU_DiagnosticSt::C_CDCU_DiagnosticSt 0"); // 测试步骤 Step Set C_CDCU_DiagnosticSt::C_CDCU_DiagnosticSt 0//No diagnostic
  g_HIL_Bus_Swc_Check("VTS::VT2848_2_Ch26::CurBit 0"); // 预期结果 Step Check J_DO_HS_KL15_BackUp Inactive
}

testcase SYS_LDCU_Powermode_0044()
{
  TestDescription("RemoteOn闭锁下电-5");
  g_HIL_Clib_Swc_Clib_RemoteON(); // 测试步骤 Step Clib RemoteON
  g_HIL_Bus_Swc_Check("I_LDCU_BodySysSt1::I_LDCU_PowerMode 2"); // 预期结果 Step Check I_LDCU_BodySysSt1::I_LDCU_PowerMode 2 //RemoteON
  g_HIL_Clib_Swc_Clib_P(); // 测试步骤 Step Clib P
  g_HIL_Bus_Swc_Set("C_CDCU_DiagnosticSt::C_CDCU_DiagnosticSt 1"); // 测试步骤 Step Set C_CDCU_DiagnosticSt::C_CDCU_DiagnosticSt 1//OBD-CAN
  g_HIL_Clib_Swc_Clib_AllDoorClosed(); // 测试步骤 Step Clib AllDoorClosed
  g_HIL_Bus_Swc_Set("I_TBOX_WinRemoteCtrl::I_TBOX_LDCU_DoorLockReq 0"); // 测试步骤 Step Set I_TBOX_WinRemoteCtrl::I_TBOX_LDCU_DoorLockReq 0//No operation
  g_HIL_Gen_Swc_Wait("301 ms"); // 测试步骤 Step Wait 301 ms
  g_HIL_Bus_Swc_Set("I_TBOX_WinRemoteCtrl::I_TBOX_LDCU_DoorLockReq 5"); // 测试步骤 Step Set I_TBOX_WinRemoteCtrl::I_TBOX_LDCU_DoorLockReq 5//BLE polling lock
  g_HIL_Gen_Swc_Wait("301 ms"); // 测试步骤 Step Wait 301 ms
  g_HIL_Bus_Swc_Check("I_LDCU_BodySysSt2::I_LDCU_PowerOFFSource 1 1 s"); // 预期结果 Step Check I_LDCU_BodySysSt2::I_LDCU_PowerOFFSource 1 1 s//闭锁下电
  g_HIL_Bus_Swc_Set("I_TBOX_WinRemoteCtrl::I_TBOX_LDCU_DoorLockReq 0"); // 测试步骤 Step Set I_TBOX_WinRemoteCtrl::I_TBOX_LDCU_DoorLockReq 0//No operation
  g_HIL_Bus_Swc_Check("I_LDCU_BodySysSt1::I_LDCU_PowerMode 0"); // 预期结果 Step Check I_LDCU_BodySysSt1::I_LDCU_PowerMode 0//OFF
  g_HIL_Bus_Swc_Set("C_CDCU_DiagnosticSt::C_CDCU_DiagnosticSt 0"); // 测试步骤 Step Set C_CDCU_DiagnosticSt::C_CDCU_DiagnosticSt 0//No diagnostic
  g_HIL_Bus_Swc_Check("VTS::VT2848_2_Ch26::CurBit 0"); // 预期结果 Step Check J_DO_HS_KL15_BackUp Inactive
}

testcase SYS_LDCU_Powermode_0045()
{
  TestDescription("RemoteOn闭锁下电-6");
  g_HIL_Clib_Swc_Clib_RemoteON(); // 测试步骤 Step Clib RemoteON
  g_HIL_Bus_Swc_Check("I_LDCU_BodySysSt1::I_LDCU_PowerMode 2"); // 预期结果 Step Check I_LDCU_BodySysSt1::I_LDCU_PowerMode 2 //RemoteON
  g_HIL_Clib_Swc_Clib_P(); // 测试步骤 Step Clib P
  g_HIL_Bus_Swc_Set("C_CDCU_DiagnosticSt::C_CDCU_DiagnosticSt 2"); // 测试步骤 Step Set C_CDCU_DiagnosticSt::C_CDCU_DiagnosticSt 2//OBD-Ethernet
  g_HIL_Clib_Swc_Clib_AllDoorClosed(); // 测试步骤 Step Clib AllDoorClosed
  g_HIL_Bus_Swc_Set("I_TBOX_WinRemoteCtrl::I_TBOX_LDCU_DoorLockReq 0"); // 测试步骤 Step Set I_TBOX_WinRemoteCtrl::I_TBOX_LDCU_DoorLockReq 0//No operation
  g_HIL_Gen_Swc_Wait("301 ms"); // 测试步骤 Step Wait 301 ms
  g_HIL_Bus_Swc_Set("I_TBOX_WinRemoteCtrl::I_TBOX_LDCU_DoorLockReq 5"); // 测试步骤 Step Set I_TBOX_WinRemoteCtrl::I_TBOX_LDCU_DoorLockReq 5//BLE polling lock
  g_HIL_Gen_Swc_Wait("301 ms"); // 测试步骤 Step Wait 301 ms
  g_HIL_Bus_Swc_Check("I_LDCU_BodySysSt2::I_LDCU_PowerOFFSource 1 1 s"); // 预期结果 Step Check I_LDCU_BodySysSt2::I_LDCU_PowerOFFSource 1 1 s//闭锁下电
  g_HIL_Bus_Swc_Set("I_TBOX_WinRemoteCtrl::I_TBOX_LDCU_DoorLockReq 0"); // 测试步骤 Step Set I_TBOX_WinRemoteCtrl::I_TBOX_LDCU_DoorLockReq 0//No operation
  g_HIL_Bus_Swc_Check("I_LDCU_BodySysSt1::I_LDCU_PowerMode 0"); // 预期结果 Step Check I_LDCU_BodySysSt1::I_LDCU_PowerMode 0//OFF
  g_HIL_Bus_Swc_Set("C_CDCU_DiagnosticSt::C_CDCU_DiagnosticSt 0"); // 测试步骤 Step Set C_CDCU_DiagnosticSt::C_CDCU_DiagnosticSt 0//No diagnostic
  g_HIL_Bus_Swc_Check("VTS::VT2848_2_Ch26::CurBit 0"); // 预期结果 Step Check J_DO_HS_KL15_BackUp Inactive
}

testcase SYS_LDCU_Powermode_0046()
{
  TestDescription("LocalON闭锁下电-1");
  g_HIL_Clib_Swc_Clib_LocalON(); // 测试步骤 Step Clib LocalON
  g_HIL_Bus_Swc_Check("I_LDCU_BodySysSt1::I_LDCU_PowerMode 1"); // 预期结果 Step Check I_LDCU_BodySysSt1::I_LDCU_PowerMode 1 //LocalON
  g_HIL_Clib_Swc_Clib_P(); // 测试步骤 Step Clib P
  g_HIL_Bus_Swc_Set("C_CDCU_DiagnosticSt::C_CDCU_DiagnosticSt 0"); // 测试步骤 Step Set C_CDCU_DiagnosticSt::C_CDCU_DiagnosticSt 0//No diagnostic
  g_HIL_Clib_Swc_Clib_AllDoorClosed(); // 测试步骤 Step Clib AllDoorClosed
  g_HIL_Bus_Swc_Set("I_TBOX_WinRemoteCtrl::I_TBOX_LDCU_DoorLockReq 0"); // 测试步骤 Step Set I_TBOX_WinRemoteCtrl::I_TBOX_LDCU_DoorLockReq 0//No operation
  g_HIL_Gen_Swc_Wait("301 ms"); // 测试步骤 Step Wait 301 ms
  g_HIL_Bus_Swc_Set("I_TBOX_WinRemoteCtrl::I_TBOX_LDCU_DoorLockReq 1"); // 测试步骤 Step Set I_TBOX_WinRemoteCtrl::I_TBOX_LDCU_DoorLockReq 1//SDK Self Lock or 4G Door Lock or 4G Polling Lock
  g_HIL_Gen_Swc_Wait("301 ms"); // 测试步骤 Step Wait 301 ms
  g_HIL_Bus_Swc_Check("I_LDCU_BodySysSt2::I_LDCU_PowerOFFSource 1 1 s"); // 预期结果 Step Check I_LDCU_BodySysSt2::I_LDCU_PowerOFFSource 1 1 s//闭锁下电
  g_HIL_Bus_Swc_Set("I_TBOX_WinRemoteCtrl::I_TBOX_LDCU_DoorLockReq 0"); // 测试步骤 Step Set I_TBOX_WinRemoteCtrl::I_TBOX_LDCU_DoorLockReq 0//No operation
  g_HIL_Bus_Swc_Check("I_LDCU_BodySysSt1::I_LDCU_PowerMode 0"); // 预期结果 Step Check I_LDCU_BodySysSt1::I_LDCU_PowerMode 0//OFF
  g_HIL_Bus_Swc_Check("VTS::VT2848_2_Ch26::CurBit 0"); // 预期结果 Step Check J_DO_HS_KL15_BackUp Inactive
}

testcase SYS_LDCU_Powermode_0047()
{
  TestDescription("LocalON闭锁下电-2");
  g_HIL_Clib_Swc_Clib_LocalON(); // 测试步骤 Step Clib LocalON
  g_HIL_Bus_Swc_Check("I_LDCU_BodySysSt1::I_LDCU_PowerMode 1"); // 预期结果 Step Check I_LDCU_BodySysSt1::I_LDCU_PowerMode 1 //LocalON
  g_HIL_Clib_Swc_Clib_P(); // 测试步骤 Step Clib P
  g_HIL_Bus_Swc_Set("C_CDCU_DiagnosticSt::C_CDCU_DiagnosticSt 1"); // 测试步骤 Step Set C_CDCU_DiagnosticSt::C_CDCU_DiagnosticSt 1//OBD-CAN
  g_HIL_Clib_Swc_Clib_AllDoorClosed(); // 测试步骤 Step Clib AllDoorClosed
  g_HIL_Bus_Swc_Set("I_TBOX_WinRemoteCtrl::I_TBOX_LDCU_DoorLockReq 0"); // 测试步骤 Step Set I_TBOX_WinRemoteCtrl::I_TBOX_LDCU_DoorLockReq 0//No operation
  g_HIL_Gen_Swc_Wait("301 ms"); // 测试步骤 Step Wait 301 ms
  g_HIL_Bus_Swc_Set("I_TBOX_WinRemoteCtrl::I_TBOX_LDCU_DoorLockReq 1"); // 测试步骤 Step Set I_TBOX_WinRemoteCtrl::I_TBOX_LDCU_DoorLockReq 1//SDK Self Lock or 4G Door Lock or 4G Polling Lock
  g_HIL_Gen_Swc_Wait("301 ms"); // 测试步骤 Step Wait 301 ms
  g_HIL_Bus_Swc_Check("I_LDCU_BodySysSt2::I_LDCU_PowerOFFSource 1 1 s"); // 预期结果 Step Check I_LDCU_BodySysSt2::I_LDCU_PowerOFFSource 1 1 s//闭锁下电
  g_HIL_Bus_Swc_Set("I_TBOX_WinRemoteCtrl::I_TBOX_LDCU_DoorLockReq 0"); // 测试步骤 Step Set I_TBOX_WinRemoteCtrl::I_TBOX_LDCU_DoorLockReq 0//No operation
  g_HIL_Bus_Swc_Check("I_LDCU_BodySysSt1::I_LDCU_PowerMode 0"); // 预期结果 Step Check I_LDCU_BodySysSt1::I_LDCU_PowerMode 0//OFF
  g_HIL_Bus_Swc_Set("C_CDCU_DiagnosticSt::C_CDCU_DiagnosticSt 0"); // 测试步骤 Step Set C_CDCU_DiagnosticSt::C_CDCU_DiagnosticSt 0//No diagnostic
  g_HIL_Bus_Swc_Check("VTS::VT2848_2_Ch26::CurBit 0"); // 预期结果 Step Check J_DO_HS_KL15_BackUp Inactive
}

testcase SYS_LDCU_Powermode_0048()
{
  TestDescription("LocalON闭锁下电-3");
  g_HIL_Clib_Swc_Clib_LocalON(); // 测试步骤 Step Clib LocalON
  g_HIL_Bus_Swc_Check("I_LDCU_BodySysSt1::I_LDCU_PowerMode 1"); // 预期结果 Step Check I_LDCU_BodySysSt1::I_LDCU_PowerMode 1 //LocalON
  g_HIL_Clib_Swc_Clib_P(); // 测试步骤 Step Clib P
  g_HIL_Bus_Swc_Set("C_CDCU_DiagnosticSt::C_CDCU_DiagnosticSt 2"); // 测试步骤 Step Set C_CDCU_DiagnosticSt::C_CDCU_DiagnosticSt 2//OBD-Ethernet
  g_HIL_Clib_Swc_Clib_AllDoorClosed(); // 测试步骤 Step Clib AllDoorClosed
  g_HIL_Bus_Swc_Set("I_TBOX_WinRemoteCtrl::I_TBOX_LDCU_DoorLockReq 0"); // 测试步骤 Step Set I_TBOX_WinRemoteCtrl::I_TBOX_LDCU_DoorLockReq 0//No operation
  g_HIL_Gen_Swc_Wait("301 ms"); // 测试步骤 Step Wait 301 ms
  g_HIL_Bus_Swc_Set("I_TBOX_WinRemoteCtrl::I_TBOX_LDCU_DoorLockReq 1"); // 测试步骤 Step Set I_TBOX_WinRemoteCtrl::I_TBOX_LDCU_DoorLockReq 1//SDK Self Lock or 4G Door Lock or 4G Polling Lock
  g_HIL_Gen_Swc_Wait("301 ms"); // 测试步骤 Step Wait 301 ms
  g_HIL_Bus_Swc_Check("I_LDCU_BodySysSt2::I_LDCU_PowerOFFSource 1 1 s"); // 预期结果 Step Check I_LDCU_BodySysSt2::I_LDCU_PowerOFFSource 1 1 s//闭锁下电
  g_HIL_Bus_Swc_Set("I_TBOX_WinRemoteCtrl::I_TBOX_LDCU_DoorLockReq 0"); // 测试步骤 Step Set I_TBOX_WinRemoteCtrl::I_TBOX_LDCU_DoorLockReq 0//No operation
  g_HIL_Bus_Swc_Check("I_LDCU_BodySysSt1::I_LDCU_PowerMode 0"); // 预期结果 Step Check I_LDCU_BodySysSt1::I_LDCU_PowerMode 0//OFF
  g_HIL_Bus_Swc_Set("C_CDCU_DiagnosticSt::C_CDCU_DiagnosticSt 0"); // 测试步骤 Step Set C_CDCU_DiagnosticSt::C_CDCU_DiagnosticSt 0//No diagnostic
  g_HIL_Bus_Swc_Check("VTS::VT2848_2_Ch26::CurBit 0"); // 预期结果 Step Check J_DO_HS_KL15_BackUp Inactive
}

testcase SYS_LDCU_Powermode_0049()
{
  TestDescription("LocalON闭锁下电-4");
  g_HIL_Clib_Swc_Clib_LocalON(); // 测试步骤 Step Clib LocalON
  g_HIL_Bus_Swc_Check("I_LDCU_BodySysSt1::I_LDCU_PowerMode 1"); // 预期结果 Step Check I_LDCU_BodySysSt1::I_LDCU_PowerMode 1 //LocalON
  g_HIL_Clib_Swc_Clib_P(); // 测试步骤 Step Clib P
  g_HIL_Bus_Swc_Set("C_CDCU_DiagnosticSt::C_CDCU_DiagnosticSt 0"); // 测试步骤 Step Set C_CDCU_DiagnosticSt::C_CDCU_DiagnosticSt 0//No diagnostic
  g_HIL_Clib_Swc_Clib_AllDoorClosed(); // 测试步骤 Step Clib AllDoorClosed
  g_HIL_Bus_Swc_Set("I_TBOX_WinRemoteCtrl::I_TBOX_LDCU_DoorLockReq 0"); // 测试步骤 Step Set I_TBOX_WinRemoteCtrl::I_TBOX_LDCU_DoorLockReq 0//No operation
  g_HIL_Gen_Swc_Wait("301 ms"); // 测试步骤 Step Wait 301 ms
  g_HIL_Bus_Swc_Set("I_TBOX_WinRemoteCtrl::I_TBOX_LDCU_DoorLockReq 5"); // 测试步骤 Step Set I_TBOX_WinRemoteCtrl::I_TBOX_LDCU_DoorLockReq 5//BLE polling lock
  g_HIL_Gen_Swc_Wait("301 ms"); // 测试步骤 Step Wait 301 ms
  g_HIL_Bus_Swc_Check("I_LDCU_BodySysSt2::I_LDCU_PowerOFFSource 1 1 s"); // 预期结果 Step Check I_LDCU_BodySysSt2::I_LDCU_PowerOFFSource 1 1 s//闭锁下电
  g_HIL_Bus_Swc_Set("I_TBOX_WinRemoteCtrl::I_TBOX_LDCU_DoorLockReq 0"); // 测试步骤 Step Set I_TBOX_WinRemoteCtrl::I_TBOX_LDCU_DoorLockReq 0//No operation
  g_HIL_Bus_Swc_Check("I_LDCU_BodySysSt1::I_LDCU_PowerMode 0"); // 预期结果 Step Check I_LDCU_BodySysSt1::I_LDCU_PowerMode 0//OFF
  g_HIL_Bus_Swc_Set("C_CDCU_DiagnosticSt::C_CDCU_DiagnosticSt 0"); // 测试步骤 Step Set C_CDCU_DiagnosticSt::C_CDCU_DiagnosticSt 0//No diagnostic
  g_HIL_Bus_Swc_Check("VTS::VT2848_2_Ch26::CurBit 0"); // 预期结果 Step Check J_DO_HS_KL15_BackUp Inactive
}

testcase SYS_LDCU_Powermode_0050()
{
  TestDescription("LocalON闭锁下电-5");
  g_HIL_Clib_Swc_Clib_LocalON(); // 测试步骤 Step Clib LocalON
  g_HIL_Bus_Swc_Check("I_LDCU_BodySysSt1::I_LDCU_PowerMode 1"); // 预期结果 Step Check I_LDCU_BodySysSt1::I_LDCU_PowerMode 1 //LocalON
  g_HIL_Clib_Swc_Clib_P(); // 测试步骤 Step Clib P
  g_HIL_Bus_Swc_Set("C_CDCU_DiagnosticSt::C_CDCU_DiagnosticSt 1"); // 测试步骤 Step Set C_CDCU_DiagnosticSt::C_CDCU_DiagnosticSt 1//OBD-CAN
  g_HIL_Clib_Swc_Clib_AllDoorClosed(); // 测试步骤 Step Clib AllDoorClosed
  g_HIL_Bus_Swc_Set("I_TBOX_WinRemoteCtrl::I_TBOX_LDCU_DoorLockReq 0"); // 测试步骤 Step Set I_TBOX_WinRemoteCtrl::I_TBOX_LDCU_DoorLockReq 0//No operation
  g_HIL_Gen_Swc_Wait("301 ms"); // 测试步骤 Step Wait 301 ms
  g_HIL_Bus_Swc_Set("I_TBOX_WinRemoteCtrl::I_TBOX_LDCU_DoorLockReq 5"); // 测试步骤 Step Set I_TBOX_WinRemoteCtrl::I_TBOX_LDCU_DoorLockReq 5//BLE polling lock
  g_HIL_Gen_Swc_Wait("301 ms"); // 测试步骤 Step Wait 301 ms
  g_HIL_Bus_Swc_Check("I_LDCU_BodySysSt2::I_LDCU_PowerOFFSource 1 1 s"); // 预期结果 Step Check I_LDCU_BodySysSt2::I_LDCU_PowerOFFSource 1 1 s//闭锁下电
  g_HIL_Bus_Swc_Set("I_TBOX_WinRemoteCtrl::I_TBOX_LDCU_DoorLockReq 0"); // 测试步骤 Step Set I_TBOX_WinRemoteCtrl::I_TBOX_LDCU_DoorLockReq 0//No operation
  g_HIL_Bus_Swc_Check("I_LDCU_BodySysSt1::I_LDCU_PowerMode 0"); // 预期结果 Step Check I_LDCU_BodySysSt1::I_LDCU_PowerMode 0//OFF
  g_HIL_Bus_Swc_Set("C_CDCU_DiagnosticSt::C_CDCU_DiagnosticSt 0"); // 测试步骤 Step Set C_CDCU_DiagnosticSt::C_CDCU_DiagnosticSt 0//No diagnostic
  g_HIL_Bus_Swc_Check("VTS::VT2848_2_Ch26::CurBit 0"); // 预期结果 Step Check J_DO_HS_KL15_BackUp Inactive
}

testcase SYS_LDCU_Powermode_0051()
{
  TestDescription("LocalON闭锁下电-6");
  g_HIL_Clib_Swc_Clib_LocalON(); // 测试步骤 Step Clib LocalON
  g_HIL_Bus_Swc_Check("I_LDCU_BodySysSt1::I_LDCU_PowerMode 1"); // 预期结果 Step Check I_LDCU_BodySysSt1::I_LDCU_PowerMode 1 //LocalON
  g_HIL_Clib_Swc_Clib_P(); // 测试步骤 Step Clib P
  g_HIL_Bus_Swc_Set("C_CDCU_DiagnosticSt::C_CDCU_DiagnosticSt 2"); // 测试步骤 Step Set C_CDCU_DiagnosticSt::C_CDCU_DiagnosticSt 2//OBD-Ethernet
  g_HIL_Clib_Swc_Clib_AllDoorClosed(); // 测试步骤 Step Clib AllDoorClosed
  g_HIL_Bus_Swc_Set("I_TBOX_WinRemoteCtrl::I_TBOX_LDCU_DoorLockReq 0"); // 测试步骤 Step Set I_TBOX_WinRemoteCtrl::I_TBOX_LDCU_DoorLockReq 0//No operation
  g_HIL_Gen_Swc_Wait("301 ms"); // 测试步骤 Step Wait 301 ms
  g_HIL_Bus_Swc_Set("I_TBOX_WinRemoteCtrl::I_TBOX_LDCU_DoorLockReq 5"); // 测试步骤 Step Set I_TBOX_WinRemoteCtrl::I_TBOX_LDCU_DoorLockReq 5//BLE polling lock
  g_HIL_Gen_Swc_Wait("301 ms"); // 测试步骤 Step Wait 301 ms
  g_HIL_Bus_Swc_Check("I_LDCU_BodySysSt2::I_LDCU_PowerOFFSource 1 1 s"); // 预期结果 Step Check I_LDCU_BodySysSt2::I_LDCU_PowerOFFSource 1 1 s//闭锁下电
  g_HIL_Bus_Swc_Set("I_TBOX_WinRemoteCtrl::I_TBOX_LDCU_DoorLockReq 0"); // 测试步骤 Step Set I_TBOX_WinRemoteCtrl::I_TBOX_LDCU_DoorLockReq 0//No operation
  g_HIL_Bus_Swc_Check("I_LDCU_BodySysSt1::I_LDCU_PowerMode 0"); // 预期结果 Step Check I_LDCU_BodySysSt1::I_LDCU_PowerMode 0//OFF
  g_HIL_Bus_Swc_Set("C_CDCU_DiagnosticSt::C_CDCU_DiagnosticSt 0"); // 测试步骤 Step Set C_CDCU_DiagnosticSt::C_CDCU_DiagnosticSt 0//No diagnostic
  g_HIL_Bus_Swc_Check("VTS::VT2848_2_Ch26::CurBit 0"); // 预期结果 Step Check J_DO_HS_KL15_BackUp Inactive
}

testcase SYS_LDCU_Powermode_0053()
{
  TestDescription("车内有合法钥匙时按启动按钮上电");
  g_HIL_Clib_Swc_Clib_RemoteON(); // 测试步骤 Step Clib RemoteON//
  g_HIL_Bus_Swc_Check("I_LDCU_BodySysSt1::I_LDCU_PowerMode 2"); // 预期结果 Step Check I_LDCU_BodySysSt1::I_LDCU_PowerMode 2//RemoteON
  g_HIL_Bus_Swc_Set("VTS::VT2848_4_Ch17::DigitalOutput 0"); // 测试步骤 Step Set J_DI_BrakeSw1_HS NotPressed
  g_HIL_Bus_Swc_Set("VTS::VT2848_4_Ch22::DigitalOutput 0"); // 测试步骤 Step Set J_DI_BrakeSw2_HS NotPressed
  g_HIL_Bus_Swc_Check("C_LDCU_SysSt::C_LDCU_BrkPedalSt 0"); // 预期结果 Step Check C_LDCU_SysSt::C_LDCU_BrkPedalSt 0//Not Pressed
  g_HIL_Bus_Swc_Check("C_LDCU_SysSt::C_LDCU_BrkPedalStVD 1"); // 预期结果 Step Check C_LDCU_SysSt::C_LDCU_BrkPedalStVD 1//valid
  g_HIL_Bus_Swc_Set("VTS::VT2848_4_Ch27::DigitalOutput 1"); // 测试步骤 Step Set J_DI_SSBPin4SW_LS 0
  g_HIL_Bus_Swc_Set("VTS::VT2848_4_Ch32::DigitalOutput 1"); // 测试步骤 Step Set J_DI_SSBPin6SW_LS 0
  g_HIL_Bus_Swc_Check("I_LDCU_BodySysSt2::I_LDCU_ZATButtonSwSt 1 1 s"); // 预期结果 Step Check I_LDCU_BodySysSt2::I_LDCU_ZATButtonSwSt 1 1 s//Active
  g_HIL_XCP_Swc_Set_XCP("CalVal_KeyValidSt 1"); // 测试步骤 Step Set_XCP CalVal_KeyValidSt 1
  g_HIL_XCP_Swc_Set_XCP("CalEn_KeyValidSt 80"); // 测试步骤 Step Set_XCP CalEn_KeyValidSt 80
  g_HIL_Bus_Swc_Check("I_LDCU_Debug::I_KeyValidSt 1 1 s"); // 预期结果 Step Check I_LDCU_Debug::I_KeyValidSt 1 1 s//valid
  g_HIL_Gen_Swc_Wait("2 s"); // 测试步骤 Step Wait 2 s
  g_HIL_Bus_Swc_Check("I_LDCU_BodySysSt2::I_LDCU_PowerONSource 5 1 s"); // 预期结果 Step Check I_LDCU_BodySysSt2::I_LDCU_PowerONSource 5 1 s//ZAT and Pedal Pressed
  g_HIL_Bus_Swc_Check("I_LDCU_BodySysSt1::I_LDCU_PowerMode 1"); // 预期结果 Step Check I_LDCU_BodySysSt1::I_LDCU_PowerMode 1//Local ON
  g_HIL_Bus_Swc_Set("VTS::VT2848_4_Ch27::DigitalOutput 0"); // 测试步骤 Step Set J_DI_SSBPin4SW_LS 1
  g_HIL_Bus_Swc_Check("VTS::VT2848_2_Ch26::CurBit 1"); // 预期结果 Step Check J_DO_HS_KL15_BackUp Active
  g_HIL_Bus_Swc_Set("VTS::VT2848_4_Ch32::DigitalOutput 0"); // 测试步骤 Step Set J_DI_SSBPin6SW_LS 1
  g_HIL_Bus_Swc_Check("I_LDCU_BodySysSt2::I_LDCU_ZATButtonSwSt 0 1 s"); // 预期结果 Step Check I_LDCU_BodySysSt2::I_LDCU_ZATButtonSwSt 0 1 s//NotActive
}

testcase SYS_LDCU_Powermode_0054()
{
  TestDescription("车内无人判定-1");
  g_HIL_Clib_Swc_Clib_LocalON(); // 测试步骤 Step Clib LocalON
  g_HIL_Bus_Swc_Check("I_LDCU_BodySysSt1::I_LDCU_PowerMode 1"); // 预期结果 Step Check I_LDCU_BodySysSt1::I_LDCU_PowerMode 1//Local on
  g_HIL_Clib_Swc_Clib_FourDoorClosed(); // 测试步骤 Step Clib FourDoorClosed//四门关闭
  g_HIL_Bus_Swc_Set("I_CDCU_AssistSysSwSt::I_DrvSeatOccupancySt 1"); // 测试步骤 Step Set I_CDCU_AssistSysSwSt::I_DrvSeatOccupancySt 1//主驾占位
  g_HIL_Bus_Swc_Set("I_CDCU_AssistSysSwSt::I_PsngrSeatOccupancySt 0"); // 测试步骤 Step Set I_CDCU_AssistSysSwSt::I_PsngrSeatOccupancySt 0//副驾不占位
  g_HIL_Bus_Swc_Set("I_CDCU_AssistSysSwSt::I_SecRowLtSeatOccupancySt 0"); // 测试步骤 Step Set I_CDCU_AssistSysSwSt::I_SecRowLtSeatOccupancySt 0//二排左侧不占位
  g_HIL_Bus_Swc_Set("I_CDCU_AssistSysSwSt::I_SecRowMidSeatOccupancySt 0"); // 测试步骤 Step Set I_CDCU_AssistSysSwSt::I_SecRowMidSeatOccupancySt 0//二排中间不占位
  g_HIL_Bus_Swc_Set("I_CDCU_AssistSysSwSt::I_SecRowRtSeatOccupancySt 0"); // 测试步骤 Step Set I_CDCU_AssistSysSwSt::I_SecRowRtSeatOccupancySt 0//二排右侧不占位
  g_HIL_Bus_Swc_Set("I_CDCU_AssistSysSwSt::I_TrdRowLtSeatOccupancySt 0"); // 测试步骤 Step Set I_CDCU_AssistSysSwSt::I_TrdRowLtSeatOccupancySt 0//三排左侧不占位
  g_HIL_Bus_Swc_Set("I_CDCU_AssistSysSwSt::I_TrdRowMidSeatOccupancySt 0"); // 测试步骤 Step Set I_CDCU_AssistSysSwSt::I_TrdRowMidSeatOccupancySt 0//三排中间不占位
  g_HIL_Bus_Swc_Set("I_CDCU_AssistSysSwSt::I_TrdRowRtSeatOccupancySt 0"); // 测试步骤 Step Set I_CDCU_AssistSysSwSt::I_TrdRowRtSeatOccupancySt 0//三排右侧不占位
  g_HIL_Gen_Swc_Wait("100 ms"); // 测试步骤 Step Wait 100 ms
  g_HIL_Bus_Swc_Set("VTS::VT2848_3_Ch34::DigitalOutput 1"); // 测试步骤 Step Set J_DI_FLDoorAjarSW_LS 0
  g_HIL_Bus_Swc_Check("I_LDCU_BodySysSt1::I_LDCU_DriverDoorAjarSt 1 1 s"); // 预期结果 Step Check I_LDCU_BodySysSt1::I_LDCU_DriverDoorAjarSt 1 1 s
  g_HIL_UDS_Swc_Set_UDS("22 31 0D"); // 测试步骤 Step Set_UDS 22 31 0D//车内有无人
  g_HIL_UDS_Swc_Check_UDS("62 31 0D 00"); // 预期结果 Step Check_UDS 62 31 0D 00//车内无人
  g_HIL_Bus_Swc_Set("VTS::VT2848_3_Ch34::DigitalOutput 0"); // 测试步骤 Step Set J_DI_FLDoorAjarSW_LS 1
  g_HIL_Bus_Swc_Check("I_LDCU_BodySysSt1::I_LDCU_DriverDoorAjarSt 0 1 s"); // 预期结果 Step Check I_LDCU_BodySysSt1::I_LDCU_DriverDoorAjarSt 0 1 s
  g_HIL_Bus_Swc_Set("I_CDCU_AssistSysSwSt::I_DrvSeatOccupancySt 0"); // 测试步骤 Step Set I_CDCU_AssistSysSwSt::I_DrvSeatOccupancySt 0//主驾不占位
}

testcase SYS_LDCU_Powermode_0055()
{
  TestDescription("车内无人判定-2");
  g_HIL_Clib_Swc_Clib_LocalON(); // 测试步骤 Step Clib LocalON
  g_HIL_Bus_Swc_Check("I_LDCU_BodySysSt1::I_LDCU_PowerMode 1"); // 预期结果 Step Check I_LDCU_BodySysSt1::I_LDCU_PowerMode 1//Local on
  g_HIL_Clib_Swc_Clib_FourDoorClosed(); // 测试步骤 Step Clib FourDoorClosed//四门关闭
  g_HIL_Bus_Swc_Set("I_CDCU_AssistSysSwSt::I_PsngrSeatOccupancySt 1"); // 测试步骤 Step Set I_CDCU_AssistSysSwSt::I_PsngrSeatOccupancySt 1//副驾占位
  g_HIL_Gen_Swc_Wait("100 ms"); // 测试步骤 Step Wait 100 ms
  g_HIL_Bus_Swc_Set("VTS::VT2848_3_Ch34::DigitalOutput 1"); // 测试步骤 Step Set J_DI_FLDoorAjarSW_LS 0
  g_HIL_Bus_Swc_Check("I_LDCU_BodySysSt1::I_LDCU_DriverDoorAjarSt 1 1 s"); // 预期结果 Step Check I_LDCU_BodySysSt1::I_LDCU_DriverDoorAjarSt 1 1 s
  g_HIL_UDS_Swc_Set_UDS("22 31 0D"); // 测试步骤 Step Set_UDS 22 31 0D//车内有无人
  g_HIL_UDS_Swc_Check_UDS("62 31 0D 00"); // 预期结果 Step Check_UDS 62 31 0D 00//车内无人
  g_HIL_Bus_Swc_Set("VTS::VT2848_3_Ch34::DigitalOutput 0"); // 测试步骤 Step Set J_DI_FLDoorAjarSW_LS 1
  g_HIL_Bus_Swc_Check("I_LDCU_BodySysSt1::I_LDCU_DriverDoorAjarSt 0 1 s"); // 预期结果 Step Check I_LDCU_BodySysSt1::I_LDCU_DriverDoorAjarSt 0 1 s
  g_HIL_Bus_Swc_Set("I_CDCU_AssistSysSwSt::I_PsngrSeatOccupancySt 0"); // 测试步骤 Step Set I_CDCU_AssistSysSwSt::I_PsngrSeatOccupancySt 0//副驾不占位
}

testcase SYS_LDCU_Powermode_0056()
{
  TestDescription("车内无人判定-3");
  g_HIL_Clib_Swc_Clib_LocalON(); // 测试步骤 Step Clib LocalON
  g_HIL_Bus_Swc_Check("I_LDCU_BodySysSt1::I_LDCU_PowerMode 1"); // 预期结果 Step Check I_LDCU_BodySysSt1::I_LDCU_PowerMode 1//Local on
  g_HIL_Clib_Swc_Clib_FourDoorClosed(); // 测试步骤 Step Clib FourDoorClosed//四门关闭
  g_HIL_Bus_Swc_Set("I_CDCU_AssistSysSwSt::I_SecRowLtSeatOccupancySt 1"); // 测试步骤 Step Set I_CDCU_AssistSysSwSt::I_SecRowLtSeatOccupancySt 1//二排左侧占位
  g_HIL_Gen_Swc_Wait("100 ms"); // 测试步骤 Step Wait 100 ms
  g_HIL_Bus_Swc_Set("VTS::VT2848_3_Ch34::DigitalOutput 1"); // 测试步骤 Step Set J_DI_FLDoorAjarSW_LS 0
  g_HIL_Bus_Swc_Check("I_LDCU_BodySysSt1::I_LDCU_DriverDoorAjarSt 1 1 s"); // 预期结果 Step Check I_LDCU_BodySysSt1::I_LDCU_DriverDoorAjarSt 1 1 s
  g_HIL_UDS_Swc_Set_UDS("22 31 0D"); // 测试步骤 Step Set_UDS 22 31 0D//车内有无人
  g_HIL_UDS_Swc_Check_UDS("62 31 0D 00"); // 预期结果 Step Check_UDS 62 31 0D 00//车内无人
  g_HIL_Bus_Swc_Set("VTS::VT2848_3_Ch34::DigitalOutput 0"); // 测试步骤 Step Set J_DI_FLDoorAjarSW_LS 1
  g_HIL_Bus_Swc_Check("I_LDCU_BodySysSt1::I_LDCU_DriverDoorAjarSt 0 1 s"); // 预期结果 Step Check I_LDCU_BodySysSt1::I_LDCU_DriverDoorAjarSt 0 1 s
  g_HIL_Bus_Swc_Set("I_CDCU_AssistSysSwSt::I_SecRowLtSeatOccupancySt 0"); // 测试步骤 Step Set I_CDCU_AssistSysSwSt::I_SecRowLtSeatOccupancySt 0//二排左侧不占位
}

testcase SYS_LDCU_Powermode_0057()
{
  TestDescription("车内无人判定-4");
  g_HIL_Clib_Swc_Clib_LocalON(); // 测试步骤 Step Clib LocalON
  g_HIL_Bus_Swc_Check("I_LDCU_BodySysSt1::I_LDCU_PowerMode 1"); // 预期结果 Step Check I_LDCU_BodySysSt1::I_LDCU_PowerMode 1//Local on
  g_HIL_Clib_Swc_Clib_FourDoorClosed(); // 测试步骤 Step Clib FourDoorClosed//四门关闭
  g_HIL_Bus_Swc_Set("I_CDCU_AssistSysSwSt::I_SecRowMidSeatOccupancySt 1"); // 测试步骤 Step Set I_CDCU_AssistSysSwSt::I_SecRowMidSeatOccupancySt 1//二排中间占位
  g_HIL_Gen_Swc_Wait("100 ms"); // 测试步骤 Step Wait 100 ms
  g_HIL_Bus_Swc_Set("VTS::VT2848_3_Ch34::DigitalOutput 1"); // 测试步骤 Step Set J_DI_FLDoorAjarSW_LS 0
  g_HIL_Bus_Swc_Check("I_LDCU_BodySysSt1::I_LDCU_DriverDoorAjarSt 1 1 s"); // 预期结果 Step Check I_LDCU_BodySysSt1::I_LDCU_DriverDoorAjarSt 1 1 s
  g_HIL_UDS_Swc_Set_UDS("22 31 0D"); // 测试步骤 Step Set_UDS 22 31 0D//车内有无人
  g_HIL_UDS_Swc_Check_UDS("62 31 0D 00"); // 预期结果 Step Check_UDS 62 31 0D 00//车内无人
  g_HIL_Bus_Swc_Set("VTS::VT2848_3_Ch34::DigitalOutput 0"); // 测试步骤 Step Set J_DI_FLDoorAjarSW_LS 1
  g_HIL_Bus_Swc_Check("I_LDCU_BodySysSt1::I_LDCU_DriverDoorAjarSt 0 1 s"); // 预期结果 Step Check I_LDCU_BodySysSt1::I_LDCU_DriverDoorAjarSt 0 1 s
  g_HIL_Bus_Swc_Set("I_CDCU_AssistSysSwSt::I_SecRowMidSeatOccupancySt 0"); // 测试步骤 Step Set I_CDCU_AssistSysSwSt::I_SecRowMidSeatOccupancySt 0//二排中间不占位
}

testcase SYS_LDCU_Powermode_0058()
{
  TestDescription("车内无人判定-5");
  g_HIL_Clib_Swc_Clib_LocalON(); // 测试步骤 Step Clib LocalON
  g_HIL_Bus_Swc_Check("I_LDCU_BodySysSt1::I_LDCU_PowerMode 1"); // 预期结果 Step Check I_LDCU_BodySysSt1::I_LDCU_PowerMode 1//Local on
  g_HIL_Clib_Swc_Clib_FourDoorClosed(); // 测试步骤 Step Clib FourDoorClosed//四门关闭
  g_HIL_Bus_Swc_Set("I_CDCU_AssistSysSwSt::I_SecRowRtSeatOccupancySt 1"); // 测试步骤 Step Set I_CDCU_AssistSysSwSt::I_SecRowRtSeatOccupancySt 1//二排右侧占位
  g_HIL_Gen_Swc_Wait("100 ms"); // 测试步骤 Step Wait 100 ms
  g_HIL_Bus_Swc_Set("VTS::VT2848_3_Ch34::DigitalOutput 1"); // 测试步骤 Step Set J_DI_FLDoorAjarSW_LS 0
  g_HIL_Bus_Swc_Check("I_LDCU_BodySysSt1::I_LDCU_DriverDoorAjarSt 1 1 s"); // 预期结果 Step Check I_LDCU_BodySysSt1::I_LDCU_DriverDoorAjarSt 1 1 s
  g_HIL_UDS_Swc_Set_UDS("22 31 0D"); // 测试步骤 Step Set_UDS 22 31 0D//车内有无人
  g_HIL_UDS_Swc_Check_UDS("62 31 0D 00"); // 预期结果 Step Check_UDS 62 31 0D 00//车内无人
  g_HIL_Bus_Swc_Set("VTS::VT2848_3_Ch34::DigitalOutput 0"); // 测试步骤 Step Set J_DI_FLDoorAjarSW_LS 1
  g_HIL_Bus_Swc_Check("I_LDCU_BodySysSt1::I_LDCU_DriverDoorAjarSt 0 1 s"); // 预期结果 Step Check I_LDCU_BodySysSt1::I_LDCU_DriverDoorAjarSt 0 1 s
  g_HIL_Bus_Swc_Set("I_CDCU_AssistSysSwSt::I_SecRowRtSeatOccupancySt 0"); // 测试步骤 Step Set I_CDCU_AssistSysSwSt::I_SecRowRtSeatOccupancySt 0//二排右侧不占位
}

testcase SYS_LDCU_Powermode_0059()
{
  TestDescription("车内无人判定-6");
  g_HIL_Clib_Swc_Clib_LocalON(); // 测试步骤 Step Clib LocalON
  g_HIL_Bus_Swc_Check("I_LDCU_BodySysSt1::I_LDCU_PowerMode 1"); // 预期结果 Step Check I_LDCU_BodySysSt1::I_LDCU_PowerMode 1//Local on
  g_HIL_Clib_Swc_Clib_FourDoorClosed(); // 测试步骤 Step Clib FourDoorClosed//四门关闭
  g_HIL_Bus_Swc_Set("I_CDCU_AssistSysSwSt::I_TrdRowLtSeatOccupancySt 1"); // 测试步骤 Step Set I_CDCU_AssistSysSwSt::I_TrdRowLtSeatOccupancySt 1//三排左侧占位
  g_HIL_Gen_Swc_Wait("100 ms"); // 测试步骤 Step Wait 100 ms
  g_HIL_Bus_Swc_Set("VTS::VT2848_3_Ch34::DigitalOutput 1"); // 测试步骤 Step Set J_DI_FLDoorAjarSW_LS 0
  g_HIL_Bus_Swc_Check("I_LDCU_BodySysSt1::I_LDCU_DriverDoorAjarSt 1 1 s"); // 预期结果 Step Check I_LDCU_BodySysSt1::I_LDCU_DriverDoorAjarSt 1 1 s
  g_HIL_UDS_Swc_Set_UDS("22 31 0D"); // 测试步骤 Step Set_UDS 22 31 0D//车内有无人
  g_HIL_UDS_Swc_Check_UDS("62 31 0D 00"); // 预期结果 Step Check_UDS 62 31 0D 00//车内无人
  g_HIL_Bus_Swc_Set("VTS::VT2848_3_Ch34::DigitalOutput 0"); // 测试步骤 Step Set J_DI_FLDoorAjarSW_LS 1
  g_HIL_Bus_Swc_Check("I_LDCU_BodySysSt1::I_LDCU_DriverDoorAjarSt 0 1 s"); // 预期结果 Step Check I_LDCU_BodySysSt1::I_LDCU_DriverDoorAjarSt 0 1 s
  g_HIL_Bus_Swc_Set("I_CDCU_AssistSysSwSt::I_TrdRowLtSeatOccupancySt 0"); // 测试步骤 Step Set I_CDCU_AssistSysSwSt::I_TrdRowLtSeatOccupancySt 0//三排左侧不占位
}

testcase SYS_LDCU_Powermode_0060()
{
  TestDescription("车内无人判定-7");
  g_HIL_Clib_Swc_Clib_LocalON(); // 测试步骤 Step Clib LocalON
  g_HIL_Bus_Swc_Check("I_LDCU_BodySysSt1::I_LDCU_PowerMode 1"); // 预期结果 Step Check I_LDCU_BodySysSt1::I_LDCU_PowerMode 1//Local on
  g_HIL_Clib_Swc_Clib_FourDoorClosed(); // 测试步骤 Step Clib FourDoorClosed//四门关闭
  g_HIL_Bus_Swc_Set("I_CDCU_AssistSysSwSt::I_TrdRowMidSeatOccupancySt 1"); // 测试步骤 Step Set I_CDCU_AssistSysSwSt::I_TrdRowMidSeatOccupancySt 1//三排中间占位
  g_HIL_Gen_Swc_Wait("100 ms"); // 测试步骤 Step Wait 100 ms
  g_HIL_Bus_Swc_Set("VTS::VT2848_3_Ch34::DigitalOutput 1"); // 测试步骤 Step Set J_DI_FLDoorAjarSW_LS 0
  g_HIL_Bus_Swc_Check("I_LDCU_BodySysSt1::I_LDCU_DriverDoorAjarSt 1 1 s"); // 预期结果 Step Check I_LDCU_BodySysSt1::I_LDCU_DriverDoorAjarSt 1 1 s
  g_HIL_UDS_Swc_Set_UDS("22 31 0D"); // 测试步骤 Step Set_UDS 22 31 0D//车内有无人
  g_HIL_UDS_Swc_Check_UDS("62 31 0D 00"); // 预期结果 Step Check_UDS 62 31 0D 00//车内无人
  g_HIL_Bus_Swc_Set("VTS::VT2848_3_Ch34::DigitalOutput 0"); // 测试步骤 Step Set J_DI_FLDoorAjarSW_LS 1
  g_HIL_Bus_Swc_Check("I_LDCU_BodySysSt1::I_LDCU_DriverDoorAjarSt 0 1 s"); // 预期结果 Step Check I_LDCU_BodySysSt1::I_LDCU_DriverDoorAjarSt 0 1 s
  g_HIL_Bus_Swc_Set("I_CDCU_AssistSysSwSt::I_TrdRowMidSeatOccupancySt 0"); // 测试步骤 Step Set I_CDCU_AssistSysSwSt::I_TrdRowMidSeatOccupancySt 0//三排中间不占位
}

testcase SYS_LDCU_Powermode_0061()
{
  TestDescription("车内无人判定-8");
  g_HIL_Clib_Swc_Clib_LocalON(); // 测试步骤 Step Clib LocalON
  g_HIL_Bus_Swc_Check("I_LDCU_BodySysSt1::I_LDCU_PowerMode 1"); // 预期结果 Step Check I_LDCU_BodySysSt1::I_LDCU_PowerMode 1//Local on
  g_HIL_Clib_Swc_Clib_FourDoorClosed(); // 测试步骤 Step Clib FourDoorClosed//四门关闭
  g_HIL_Bus_Swc_Set("I_CDCU_AssistSysSwSt::I_TrdRowRtSeatOccupancySt 1"); // 测试步骤 Step Set I_CDCU_AssistSysSwSt::I_TrdRowRtSeatOccupancySt 1//三排右侧占位
  g_HIL_Gen_Swc_Wait("100 ms"); // 测试步骤 Step Wait 100 ms
  g_HIL_Bus_Swc_Set("VTS::VT2848_3_Ch34::DigitalOutput 1"); // 测试步骤 Step Set J_DI_FLDoorAjarSW_LS 0
  g_HIL_Bus_Swc_Check("I_LDCU_BodySysSt1::I_LDCU_DriverDoorAjarSt 1 1 s"); // 预期结果 Step Check I_LDCU_BodySysSt1::I_LDCU_DriverDoorAjarSt 1 1 s
  g_HIL_UDS_Swc_Set_UDS("22 31 0D"); // 测试步骤 Step Set_UDS 22 31 0D//车内有无人
  g_HIL_UDS_Swc_Check_UDS("62 31 0D 00"); // 预期结果 Step Check_UDS 62 31 0D 00//车内无人
  g_HIL_Bus_Swc_Set("VTS::VT2848_3_Ch34::DigitalOutput 0"); // 测试步骤 Step Set J_DI_FLDoorAjarSW_LS 1
  g_HIL_Bus_Swc_Check("I_LDCU_BodySysSt1::I_LDCU_DriverDoorAjarSt 0 1 s"); // 预期结果 Step Check I_LDCU_BodySysSt1::I_LDCU_DriverDoorAjarSt 0 1 s
  g_HIL_Bus_Swc_Set("I_CDCU_AssistSysSwSt::I_TrdRowRtSeatOccupancySt 0"); // 测试步骤 Step Set I_CDCU_AssistSysSwSt::I_TrdRowRtSeatOccupancySt 0//三排右侧不占位
}

testcase SYS_LDCU_Powermode_0062()
{
  TestDescription("车内有人判定-1");
  g_HIL_Clib_Swc_Clib_LocalON(); // 测试步骤 Step Clib LocalON
  g_HIL_Bus_Swc_Check("I_LDCU_BodySysSt1::I_LDCU_PowerMode 1"); // 预期结果 Step Check I_LDCU_BodySysSt1::I_LDCU_PowerMode 1//Local on
  g_HIL_Clib_Swc_Clib_FourDoorClosed(); // 测试步骤 Step Clib FourDoorClosed//四门关闭
  g_HIL_Bus_Swc_Set("I_CDCU_AssistSysSwSt::I_DrvSeatOccupancySt 1"); // 测试步骤 Step Set I_CDCU_AssistSysSwSt::I_DrvSeatOccupancySt 1//主驾占位
  g_HIL_Bus_Swc_Set("I_CDCU_AssistSysSwSt::I_PsngrSeatOccupancySt 0"); // 测试步骤 Step Set I_CDCU_AssistSysSwSt::I_PsngrSeatOccupancySt 0//副驾不占位
  g_HIL_Bus_Swc_Set("I_CDCU_AssistSysSwSt::I_SecRowLtSeatOccupancySt 0"); // 测试步骤 Step Set I_CDCU_AssistSysSwSt::I_SecRowLtSeatOccupancySt 0//二排左侧不占位
  g_HIL_Bus_Swc_Set("I_CDCU_AssistSysSwSt::I_SecRowMidSeatOccupancySt 0"); // 测试步骤 Step Set I_CDCU_AssistSysSwSt::I_SecRowMidSeatOccupancySt 0//二排中间不占位
  g_HIL_Bus_Swc_Set("I_CDCU_AssistSysSwSt::I_SecRowRtSeatOccupancySt 0"); // 测试步骤 Step Set I_CDCU_AssistSysSwSt::I_SecRowRtSeatOccupancySt 0//二排右侧不占位
  g_HIL_Bus_Swc_Set("I_CDCU_AssistSysSwSt::I_TrdRowLtSeatOccupancySt 0"); // 测试步骤 Step Set I_CDCU_AssistSysSwSt::I_TrdRowLtSeatOccupancySt 0//三排左侧不占位
  g_HIL_Bus_Swc_Set("I_CDCU_AssistSysSwSt::I_TrdRowMidSeatOccupancySt 0"); // 测试步骤 Step Set I_CDCU_AssistSysSwSt::I_TrdRowMidSeatOccupancySt 0//三排中间不占位
  g_HIL_Bus_Swc_Set("I_CDCU_AssistSysSwSt::I_TrdRowRtSeatOccupancySt 0"); // 测试步骤 Step Set I_CDCU_AssistSysSwSt::I_TrdRowRtSeatOccupancySt 0//三排右侧不占位
  g_HIL_Gen_Swc_Wait("100 ms"); // 测试步骤 Step Wait 100 ms
  g_HIL_UDS_Swc_Set_UDS("22 31 0D"); // 测试步骤 Step Set_UDS 22 31 0D//车内有无人
  g_HIL_UDS_Swc_Check_UDS("62 31 0D 01"); // 预期结果 Step Check_UDS 62 31 0D 01//车内有人
  g_HIL_Bus_Swc_Set("I_CDCU_AssistSysSwSt::I_DrvSeatOccupancySt 0"); // 测试步骤 Step Set I_CDCU_AssistSysSwSt::I_DrvSeatOccupancySt 0//主驾不占位
}

testcase SYS_LDCU_Powermode_0063()
{
  TestDescription("车内有人判定-2");
  g_HIL_Clib_Swc_Clib_LocalON(); // 测试步骤 Step Clib LocalON
  g_HIL_Bus_Swc_Check("I_LDCU_BodySysSt1::I_LDCU_PowerMode 1"); // 预期结果 Step Check I_LDCU_BodySysSt1::I_LDCU_PowerMode 1//Local on
  g_HIL_Clib_Swc_Clib_FourDoorClosed(); // 测试步骤 Step Clib FourDoorClosed//四门关闭
  g_HIL_Bus_Swc_Set("I_CDCU_AssistSysSwSt::I_DrvSeatOccupancySt 0"); // 测试步骤 Step Set I_CDCU_AssistSysSwSt::I_DrvSeatOccupancySt 0//主驾不占位
  g_HIL_Bus_Swc_Set("I_CDCU_AssistSysSwSt::I_PsngrSeatOccupancySt 1"); // 测试步骤 Step Set I_CDCU_AssistSysSwSt::I_PsngrSeatOccupancySt 1//副驾占位
  g_HIL_Bus_Swc_Set("I_CDCU_AssistSysSwSt::I_SecRowLtSeatOccupancySt 0"); // 测试步骤 Step Set I_CDCU_AssistSysSwSt::I_SecRowLtSeatOccupancySt 0//二排左侧不占位
  g_HIL_Bus_Swc_Set("I_CDCU_AssistSysSwSt::I_SecRowMidSeatOccupancySt 0"); // 测试步骤 Step Set I_CDCU_AssistSysSwSt::I_SecRowMidSeatOccupancySt 0//二排中间不占位
  g_HIL_Bus_Swc_Set("I_CDCU_AssistSysSwSt::I_SecRowRtSeatOccupancySt 0"); // 测试步骤 Step Set I_CDCU_AssistSysSwSt::I_SecRowRtSeatOccupancySt 0//二排右侧不占位
  g_HIL_Bus_Swc_Set("I_CDCU_AssistSysSwSt::I_TrdRowLtSeatOccupancySt 0"); // 测试步骤 Step Set I_CDCU_AssistSysSwSt::I_TrdRowLtSeatOccupancySt 0//三排左侧不占位
  g_HIL_Bus_Swc_Set("I_CDCU_AssistSysSwSt::I_TrdRowMidSeatOccupancySt 0"); // 测试步骤 Step Set I_CDCU_AssistSysSwSt::I_TrdRowMidSeatOccupancySt 0//三排中间不占位
  g_HIL_Bus_Swc_Set("I_CDCU_AssistSysSwSt::I_TrdRowRtSeatOccupancySt 0"); // 测试步骤 Step Set I_CDCU_AssistSysSwSt::I_TrdRowRtSeatOccupancySt 0//三排右侧不占位
  g_HIL_Gen_Swc_Wait("100 ms"); // 测试步骤 Step Wait 100 ms
  g_HIL_UDS_Swc_Set_UDS("22 31 0D"); // 测试步骤 Step Set_UDS 22 31 0D//车内有无人
  g_HIL_UDS_Swc_Check_UDS("62 31 0D 01"); // 预期结果 Step Check_UDS 62 31 0D 01//车内有人
  g_HIL_Bus_Swc_Set("I_CDCU_AssistSysSwSt::I_PsngrSeatOccupancySt 0"); // 测试步骤 Step Set I_CDCU_AssistSysSwSt::I_PsngrSeatOccupancySt 0//副驾不占位
}

testcase SYS_LDCU_Powermode_0064()
{
  TestDescription("车内有人判定-3");
  g_HIL_Clib_Swc_Clib_LocalON(); // 测试步骤 Step Clib LocalON
  g_HIL_Bus_Swc_Check("I_LDCU_BodySysSt1::I_LDCU_PowerMode 1"); // 预期结果 Step Check I_LDCU_BodySysSt1::I_LDCU_PowerMode 1//Local on
  g_HIL_Clib_Swc_Clib_FourDoorClosed(); // 测试步骤 Step Clib FourDoorClosed//四门关闭
  g_HIL_Bus_Swc_Set("I_CDCU_AssistSysSwSt::I_DrvSeatOccupancySt 0"); // 测试步骤 Step Set I_CDCU_AssistSysSwSt::I_DrvSeatOccupancySt 0//主驾不占位
  g_HIL_Bus_Swc_Set("I_CDCU_AssistSysSwSt::I_PsngrSeatOccupancySt 0"); // 测试步骤 Step Set I_CDCU_AssistSysSwSt::I_PsngrSeatOccupancySt 0//副驾不占位
  g_HIL_Bus_Swc_Set("I_CDCU_AssistSysSwSt::I_SecRowLtSeatOccupancySt 1"); // 测试步骤 Step Set I_CDCU_AssistSysSwSt::I_SecRowLtSeatOccupancySt 1//二排左侧占位
  g_HIL_Bus_Swc_Set("I_CDCU_AssistSysSwSt::I_SecRowMidSeatOccupancySt 0"); // 测试步骤 Step Set I_CDCU_AssistSysSwSt::I_SecRowMidSeatOccupancySt 0//二排中间不占位
  g_HIL_Bus_Swc_Set("I_CDCU_AssistSysSwSt::I_SecRowRtSeatOccupancySt 0"); // 测试步骤 Step Set I_CDCU_AssistSysSwSt::I_SecRowRtSeatOccupancySt 0//二排右侧不占位
  g_HIL_Bus_Swc_Set("I_CDCU_AssistSysSwSt::I_TrdRowLtSeatOccupancySt 0"); // 测试步骤 Step Set I_CDCU_AssistSysSwSt::I_TrdRowLtSeatOccupancySt 0//三排左侧不占位
  g_HIL_Bus_Swc_Set("I_CDCU_AssistSysSwSt::I_TrdRowMidSeatOccupancySt 0"); // 测试步骤 Step Set I_CDCU_AssistSysSwSt::I_TrdRowMidSeatOccupancySt 0//三排中间不占位
  g_HIL_Bus_Swc_Set("I_CDCU_AssistSysSwSt::I_TrdRowRtSeatOccupancySt 0"); // 测试步骤 Step Set I_CDCU_AssistSysSwSt::I_TrdRowRtSeatOccupancySt 0//三排右侧不占位
  g_HIL_Gen_Swc_Wait("100 ms"); // 测试步骤 Step Wait 100 ms
  g_HIL_UDS_Swc_Set_UDS("22 31 0D"); // 测试步骤 Step Set_UDS 22 31 0D//车内有无人
  g_HIL_UDS_Swc_Check_UDS("62 31 0D 01"); // 预期结果 Step Check_UDS 62 31 0D 01//车内有人
  g_HIL_Bus_Swc_Set("I_CDCU_AssistSysSwSt::I_SecRowLtSeatOccupancySt 0"); // 测试步骤 Step Set I_CDCU_AssistSysSwSt::I_SecRowLtSeatOccupancySt 0//二排左侧不占位
}

testcase SYS_LDCU_Powermode_0065()
{
  TestDescription("车内有人判定-4");
  g_HIL_Clib_Swc_Clib_LocalON(); // 测试步骤 Step Clib LocalON
  g_HIL_Bus_Swc_Check("I_LDCU_BodySysSt1::I_LDCU_PowerMode 1"); // 预期结果 Step Check I_LDCU_BodySysSt1::I_LDCU_PowerMode 1//Local on
  g_HIL_Clib_Swc_Clib_FourDoorClosed(); // 测试步骤 Step Clib FourDoorClosed//四门关闭
  g_HIL_Bus_Swc_Set("I_CDCU_AssistSysSwSt::I_DrvSeatOccupancySt 0"); // 测试步骤 Step Set I_CDCU_AssistSysSwSt::I_DrvSeatOccupancySt 0//主驾不占位
  g_HIL_Bus_Swc_Set("I_CDCU_AssistSysSwSt::I_PsngrSeatOccupancySt 0"); // 测试步骤 Step Set I_CDCU_AssistSysSwSt::I_PsngrSeatOccupancySt 0//副驾不占位
  g_HIL_Bus_Swc_Set("I_CDCU_AssistSysSwSt::I_SecRowLtSeatOccupancySt 0"); // 测试步骤 Step Set I_CDCU_AssistSysSwSt::I_SecRowLtSeatOccupancySt 0//二排左侧不占位
  g_HIL_Bus_Swc_Set("I_CDCU_AssistSysSwSt::I_SecRowMidSeatOccupancySt 1"); // 测试步骤 Step Set I_CDCU_AssistSysSwSt::I_SecRowMidSeatOccupancySt 1//二排中间占位
  g_HIL_Bus_Swc_Set("I_CDCU_AssistSysSwSt::I_SecRowRtSeatOccupancySt 0"); // 测试步骤 Step Set I_CDCU_AssistSysSwSt::I_SecRowRtSeatOccupancySt 0//二排右侧不占位
  g_HIL_Bus_Swc_Set("I_CDCU_AssistSysSwSt::I_TrdRowLtSeatOccupancySt 0"); // 测试步骤 Step Set I_CDCU_AssistSysSwSt::I_TrdRowLtSeatOccupancySt 0//三排左侧不占位
  g_HIL_Bus_Swc_Set("I_CDCU_AssistSysSwSt::I_TrdRowMidSeatOccupancySt 0"); // 测试步骤 Step Set I_CDCU_AssistSysSwSt::I_TrdRowMidSeatOccupancySt 0//三排中间不占位
  g_HIL_Bus_Swc_Set("I_CDCU_AssistSysSwSt::I_TrdRowRtSeatOccupancySt 0"); // 测试步骤 Step Set I_CDCU_AssistSysSwSt::I_TrdRowRtSeatOccupancySt 0//三排右侧不占位
  g_HIL_Gen_Swc_Wait("100 ms"); // 测试步骤 Step Wait 100 ms
  g_HIL_UDS_Swc_Set_UDS("22 31 0D"); // 测试步骤 Step Set_UDS 22 31 0D//车内有无人
  g_HIL_UDS_Swc_Check_UDS("62 31 0D 01"); // 预期结果 Step Check_UDS 62 31 0D 01//车内有人
  g_HIL_Bus_Swc_Set("I_CDCU_AssistSysSwSt::I_SecRowMidSeatOccupancySt 0"); // 测试步骤 Step Set I_CDCU_AssistSysSwSt::I_SecRowMidSeatOccupancySt 0//二排中间不占位
}

testcase SYS_LDCU_Powermode_0066()
{
  TestDescription("车内有人判定-4");
  g_HIL_Clib_Swc_Clib_LocalON(); // 测试步骤 Step Clib LocalON
  g_HIL_Bus_Swc_Check("I_LDCU_BodySysSt1::I_LDCU_PowerMode 1"); // 预期结果 Step Check I_LDCU_BodySysSt1::I_LDCU_PowerMode 1//Local on
  g_HIL_Clib_Swc_Clib_FourDoorClosed(); // 测试步骤 Step Clib FourDoorClosed//四门关闭
  g_HIL_Bus_Swc_Set("I_CDCU_AssistSysSwSt::I_DrvSeatOccupancySt 0"); // 测试步骤 Step Set I_CDCU_AssistSysSwSt::I_DrvSeatOccupancySt 0//主驾不占位
  g_HIL_Bus_Swc_Set("I_CDCU_AssistSysSwSt::I_PsngrSeatOccupancySt 0"); // 测试步骤 Step Set I_CDCU_AssistSysSwSt::I_PsngrSeatOccupancySt 0//副驾不占位
  g_HIL_Bus_Swc_Set("I_CDCU_AssistSysSwSt::I_SecRowLtSeatOccupancySt 0"); // 测试步骤 Step Set I_CDCU_AssistSysSwSt::I_SecRowLtSeatOccupancySt 0//二排左侧不占位
  g_HIL_Bus_Swc_Set("I_CDCU_AssistSysSwSt::I_SecRowMidSeatOccupancySt 0"); // 测试步骤 Step Set I_CDCU_AssistSysSwSt::I_SecRowMidSeatOccupancySt 0//二排中间不占位
  g_HIL_Bus_Swc_Set("I_CDCU_AssistSysSwSt::I_SecRowRtSeatOccupancySt 1"); // 测试步骤 Step Set I_CDCU_AssistSysSwSt::I_SecRowRtSeatOccupancySt 1//二排右侧占位
  g_HIL_Bus_Swc_Set("I_CDCU_AssistSysSwSt::I_TrdRowLtSeatOccupancySt 0"); // 测试步骤 Step Set I_CDCU_AssistSysSwSt::I_TrdRowLtSeatOccupancySt 0//三排左侧不占位
  g_HIL_Bus_Swc_Set("I_CDCU_AssistSysSwSt::I_TrdRowMidSeatOccupancySt 0"); // 测试步骤 Step Set I_CDCU_AssistSysSwSt::I_TrdRowMidSeatOccupancySt 0//三排中间不占位
  g_HIL_Bus_Swc_Set("I_CDCU_AssistSysSwSt::I_TrdRowRtSeatOccupancySt 0"); // 测试步骤 Step Set I_CDCU_AssistSysSwSt::I_TrdRowRtSeatOccupancySt 0//三排右侧不占位
  g_HIL_Gen_Swc_Wait("100 ms"); // 测试步骤 Step Wait 100 ms
  g_HIL_UDS_Swc_Set_UDS("22 31 0D"); // 测试步骤 Step Set_UDS 22 31 0D//车内有无人
  g_HIL_UDS_Swc_Check_UDS("62 31 0D 01"); // 预期结果 Step Check_UDS 62 31 0D 01//车内有人
  g_HIL_Bus_Swc_Set("I_CDCU_AssistSysSwSt::I_SecRowRtSeatOccupancySt 0"); // 测试步骤 Step Set I_CDCU_AssistSysSwSt::I_SecRowRtSeatOccupancySt 0//二排右侧不占位
}

testcase SYS_LDCU_Powermode_0067()
{
  TestDescription("车内有人判定-5");
  g_HIL_Clib_Swc_Clib_LocalON(); // 测试步骤 Step Clib LocalON
  g_HIL_Bus_Swc_Check("I_LDCU_BodySysSt1::I_LDCU_PowerMode 1"); // 预期结果 Step Check I_LDCU_BodySysSt1::I_LDCU_PowerMode 1//Local on
  g_HIL_Clib_Swc_Clib_FourDoorClosed(); // 测试步骤 Step Clib FourDoorClosed//四门关闭
  g_HIL_Bus_Swc_Set("I_CDCU_AssistSysSwSt::I_DrvSeatOccupancySt 0"); // 测试步骤 Step Set I_CDCU_AssistSysSwSt::I_DrvSeatOccupancySt 0//主驾不占位
  g_HIL_Bus_Swc_Set("I_CDCU_AssistSysSwSt::I_PsngrSeatOccupancySt 0"); // 测试步骤 Step Set I_CDCU_AssistSysSwSt::I_PsngrSeatOccupancySt 0//副驾不占位
  g_HIL_Bus_Swc_Set("I_CDCU_AssistSysSwSt::I_SecRowLtSeatOccupancySt 0"); // 测试步骤 Step Set I_CDCU_AssistSysSwSt::I_SecRowLtSeatOccupancySt 0//二排左侧不占位
  g_HIL_Bus_Swc_Set("I_CDCU_AssistSysSwSt::I_SecRowMidSeatOccupancySt 0"); // 测试步骤 Step Set I_CDCU_AssistSysSwSt::I_SecRowMidSeatOccupancySt 0//二排中间不占位
  g_HIL_Bus_Swc_Set("I_CDCU_AssistSysSwSt::I_SecRowRtSeatOccupancySt 0"); // 测试步骤 Step Set I_CDCU_AssistSysSwSt::I_SecRowRtSeatOccupancySt 0//二排右侧不占位
  g_HIL_Bus_Swc_Set("I_CDCU_AssistSysSwSt::I_TrdRowLtSeatOccupancySt 1"); // 测试步骤 Step Set I_CDCU_AssistSysSwSt::I_TrdRowLtSeatOccupancySt 1//三排左侧占位
  g_HIL_Bus_Swc_Set("I_CDCU_AssistSysSwSt::I_TrdRowMidSeatOccupancySt 0"); // 测试步骤 Step Set I_CDCU_AssistSysSwSt::I_TrdRowMidSeatOccupancySt 0//三排中间不占位
  g_HIL_Bus_Swc_Set("I_CDCU_AssistSysSwSt::I_TrdRowRtSeatOccupancySt 0"); // 测试步骤 Step Set I_CDCU_AssistSysSwSt::I_TrdRowRtSeatOccupancySt 0//三排右侧不占位
  g_HIL_Gen_Swc_Wait("100 ms"); // 测试步骤 Step Wait 100 ms
  g_HIL_UDS_Swc_Set_UDS("22 31 0D"); // 测试步骤 Step Set_UDS 22 31 0D//车内有无人
  g_HIL_UDS_Swc_Check_UDS("62 31 0D 01"); // 预期结果 Step Check_UDS 62 31 0D 01//车内有人
  g_HIL_Bus_Swc_Set("I_CDCU_AssistSysSwSt::I_TrdRowLtSeatOccupancySt 0"); // 测试步骤 Step Set I_CDCU_AssistSysSwSt::I_TrdRowLtSeatOccupancySt 0//三排左侧不占位
}

testcase SYS_LDCU_Powermode_0068()
{
  TestDescription("车内有人判定-6");
  g_HIL_Clib_Swc_Clib_LocalON(); // 测试步骤 Step Clib LocalON
  g_HIL_Bus_Swc_Check("I_LDCU_BodySysSt1::I_LDCU_PowerMode 1"); // 预期结果 Step Check I_LDCU_BodySysSt1::I_LDCU_PowerMode 1//Local on
  g_HIL_Clib_Swc_Clib_FourDoorClosed(); // 测试步骤 Step Clib FourDoorClosed//四门关闭
  g_HIL_Bus_Swc_Set("I_CDCU_AssistSysSwSt::I_DrvSeatOccupancySt 0"); // 测试步骤 Step Set I_CDCU_AssistSysSwSt::I_DrvSeatOccupancySt 0//主驾不占位
  g_HIL_Bus_Swc_Set("I_CDCU_AssistSysSwSt::I_PsngrSeatOccupancySt 0"); // 测试步骤 Step Set I_CDCU_AssistSysSwSt::I_PsngrSeatOccupancySt 0//副驾不占位
  g_HIL_Bus_Swc_Set("I_CDCU_AssistSysSwSt::I_SecRowLtSeatOccupancySt 0"); // 测试步骤 Step Set I_CDCU_AssistSysSwSt::I_SecRowLtSeatOccupancySt 0//二排左侧不占位
  g_HIL_Bus_Swc_Set("I_CDCU_AssistSysSwSt::I_SecRowMidSeatOccupancySt 0"); // 测试步骤 Step Set I_CDCU_AssistSysSwSt::I_SecRowMidSeatOccupancySt 0//二排中间不占位
  g_HIL_Bus_Swc_Set("I_CDCU_AssistSysSwSt::I_SecRowRtSeatOccupancySt 0"); // 测试步骤 Step Set I_CDCU_AssistSysSwSt::I_SecRowRtSeatOccupancySt 0//二排右侧不占位
  g_HIL_Bus_Swc_Set("I_CDCU_AssistSysSwSt::I_TrdRowLtSeatOccupancySt 1"); // 测试步骤 Step Set I_CDCU_AssistSysSwSt::I_TrdRowLtSeatOccupancySt 1//三排左侧占位
  g_HIL_Bus_Swc_Set("I_CDCU_AssistSysSwSt::I_TrdRowMidSeatOccupancySt 0"); // 测试步骤 Step Set I_CDCU_AssistSysSwSt::I_TrdRowMidSeatOccupancySt 0//三排中间不占位
  g_HIL_Bus_Swc_Set("I_CDCU_AssistSysSwSt::I_TrdRowRtSeatOccupancySt 0"); // 测试步骤 Step Set I_CDCU_AssistSysSwSt::I_TrdRowRtSeatOccupancySt 0//三排右侧不占位
  g_HIL_Gen_Swc_Wait("100 ms"); // 测试步骤 Step Wait 100 ms
  g_HIL_UDS_Swc_Set_UDS("22 31 0D"); // 测试步骤 Step Set_UDS 22 31 0D//车内有无人
  g_HIL_UDS_Swc_Check_UDS("62 31 0D 01"); // 预期结果 Step Check_UDS 62 31 0D 01//车内有人
  g_HIL_Bus_Swc_Set("I_CDCU_AssistSysSwSt::I_TrdRowLtSeatOccupancySt 0"); // 测试步骤 Step Set I_CDCU_AssistSysSwSt::I_TrdRowLtSeatOccupancySt 0//三排左侧不占位
}

testcase SYS_LDCU_Powermode_0069()
{
  TestDescription("车内有人判定-7");
  g_HIL_Clib_Swc_Clib_LocalON(); // 测试步骤 Step Clib LocalON
  g_HIL_Bus_Swc_Check("I_LDCU_BodySysSt1::I_LDCU_PowerMode 1"); // 预期结果 Step Check I_LDCU_BodySysSt1::I_LDCU_PowerMode 1//Local on
  g_HIL_Clib_Swc_Clib_FourDoorClosed(); // 测试步骤 Step Clib FourDoorClosed//四门关闭
  g_HIL_Bus_Swc_Set("I_CDCU_AssistSysSwSt::I_DrvSeatOccupancySt 0"); // 测试步骤 Step Set I_CDCU_AssistSysSwSt::I_DrvSeatOccupancySt 0//主驾不占位
  g_HIL_Bus_Swc_Set("I_CDCU_AssistSysSwSt::I_PsngrSeatOccupancySt 0"); // 测试步骤 Step Set I_CDCU_AssistSysSwSt::I_PsngrSeatOccupancySt 0//副驾不占位
  g_HIL_Bus_Swc_Set("I_CDCU_AssistSysSwSt::I_SecRowLtSeatOccupancySt 0"); // 测试步骤 Step Set I_CDCU_AssistSysSwSt::I_SecRowLtSeatOccupancySt 0//二排左侧不占位
  g_HIL_Bus_Swc_Set("I_CDCU_AssistSysSwSt::I_SecRowMidSeatOccupancySt 0"); // 测试步骤 Step Set I_CDCU_AssistSysSwSt::I_SecRowMidSeatOccupancySt 0//二排中间不占位
  g_HIL_Bus_Swc_Set("I_CDCU_AssistSysSwSt::I_SecRowRtSeatOccupancySt 0"); // 测试步骤 Step Set I_CDCU_AssistSysSwSt::I_SecRowRtSeatOccupancySt 0//二排右侧不占位
  g_HIL_Bus_Swc_Set("I_CDCU_AssistSysSwSt::I_TrdRowLtSeatOccupancySt 0"); // 测试步骤 Step Set I_CDCU_AssistSysSwSt::I_TrdRowLtSeatOccupancySt 0//三排左侧不占位
  g_HIL_Bus_Swc_Set("I_CDCU_AssistSysSwSt::I_TrdRowMidSeatOccupancySt 1"); // 测试步骤 Step Set I_CDCU_AssistSysSwSt::I_TrdRowMidSeatOccupancySt 1//三排中间占位
  g_HIL_Bus_Swc_Set("I_CDCU_AssistSysSwSt::I_TrdRowRtSeatOccupancySt 0"); // 测试步骤 Step Set I_CDCU_AssistSysSwSt::I_TrdRowRtSeatOccupancySt 0//三排右侧不占位
  g_HIL_Gen_Swc_Wait("100 ms"); // 测试步骤 Step Wait 100 ms
  g_HIL_UDS_Swc_Set_UDS("22 31 0D"); // 测试步骤 Step Set_UDS 22 31 0D//车内有无人
  g_HIL_UDS_Swc_Check_UDS("62 31 0D 01"); // 预期结果 Step Check_UDS 62 31 0D 01//车内有人
  g_HIL_Bus_Swc_Set("I_CDCU_AssistSysSwSt::I_TrdRowMidSeatOccupancySt 0"); // 测试步骤 Step Set I_CDCU_AssistSysSwSt::I_TrdRowMidSeatOccupancySt 0//三排中间不占位
}

testcase SYS_LDCU_Powermode_0070()
{
  TestDescription("车内有人判定-8");
  g_HIL_Clib_Swc_Clib_LocalON(); // 测试步骤 Step Clib LocalON
  g_HIL_Bus_Swc_Check("I_LDCU_BodySysSt1::I_LDCU_PowerMode 1"); // 预期结果 Step Check I_LDCU_BodySysSt1::I_LDCU_PowerMode 1//Local on
  g_HIL_Clib_Swc_Clib_FourDoorClosed(); // 测试步骤 Step Clib FourDoorClosed//四门关闭
  g_HIL_Bus_Swc_Set("I_CDCU_AssistSysSwSt::I_DrvSeatOccupancySt 0"); // 测试步骤 Step Set I_CDCU_AssistSysSwSt::I_DrvSeatOccupancySt 0//主驾不占位
  g_HIL_Bus_Swc_Set("I_CDCU_AssistSysSwSt::I_PsngrSeatOccupancySt 0"); // 测试步骤 Step Set I_CDCU_AssistSysSwSt::I_PsngrSeatOccupancySt 0//副驾不占位
  g_HIL_Bus_Swc_Set("I_CDCU_AssistSysSwSt::I_SecRowLtSeatOccupancySt 0"); // 测试步骤 Step Set I_CDCU_AssistSysSwSt::I_SecRowLtSeatOccupancySt 0//二排左侧不占位
  g_HIL_Bus_Swc_Set("I_CDCU_AssistSysSwSt::I_SecRowMidSeatOccupancySt 0"); // 测试步骤 Step Set I_CDCU_AssistSysSwSt::I_SecRowMidSeatOccupancySt 0//二排中间不占位
  g_HIL_Bus_Swc_Set("I_CDCU_AssistSysSwSt::I_SecRowRtSeatOccupancySt 0"); // 测试步骤 Step Set I_CDCU_AssistSysSwSt::I_SecRowRtSeatOccupancySt 0//二排右侧不占位
  g_HIL_Bus_Swc_Set("I_CDCU_AssistSysSwSt::I_TrdRowLtSeatOccupancySt 0"); // 测试步骤 Step Set I_CDCU_AssistSysSwSt::I_TrdRowLtSeatOccupancySt 0//三排左侧不占位
  g_HIL_Bus_Swc_Set("I_CDCU_AssistSysSwSt::I_TrdRowMidSeatOccupancySt 0"); // 测试步骤 Step Set I_CDCU_AssistSysSwSt::I_TrdRowMidSeatOccupancySt 0//三排中间不占位
  g_HIL_Bus_Swc_Set("I_CDCU_AssistSysSwSt::I_TrdRowRtSeatOccupancySt 1"); // 测试步骤 Step Set I_CDCU_AssistSysSwSt::I_TrdRowRtSeatOccupancySt 1//三排右侧占位
  g_HIL_Gen_Swc_Wait("100 ms"); // 测试步骤 Step Wait 100 ms
  g_HIL_UDS_Swc_Set_UDS("22 31 0D"); // 测试步骤 Step Set_UDS 22 31 0D//车内有无人
  g_HIL_UDS_Swc_Check_UDS("62 31 0D 01"); // 预期结果 Step Check_UDS 62 31 0D 01//车内有人
  g_HIL_Bus_Swc_Set("I_CDCU_AssistSysSwSt::I_TrdRowRtSeatOccupancySt 0"); // 测试步骤 Step Set I_CDCU_AssistSysSwSt::I_TrdRowRtSeatOccupancySt 0//三排右侧不占位
}

testcase SYS_LDCU_Powermode_0071()
{
  TestDescription("车内有无人Debug诊断");
  g_HIL_Clib_Swc_Clib_LocalON(); // 测试步骤 Step Clib LocalON
  g_HIL_Bus_Swc_Check("I_LDCU_BodySysSt1::I_LDCU_PowerMode 1"); // 预期结果 Step Check I_LDCU_BodySysSt1::I_LDCU_PowerMode 1//Local on
  g_HIL_Clib_Swc_Clib_FourDoorClosed(); // 测试步骤 Step Clib FourDoorClosed//四门关闭
  g_HIL_Bus_Swc_Set("I_TBOX_TimeInfo::I_TBOX_CDCU_RTCDate_Month 2"); // 测试步骤 Step Set I_TBOX_TimeInfo::I_TBOX_CDCU_RTCDate_Month 2//月
  g_HIL_Bus_Swc_Set("I_TBOX_TimeInfo::I_TBOX_CDCU_RTCDate_Day 3"); // 测试步骤 Step Set I_TBOX_TimeInfo::I_TBOX_CDCU_RTCDate_Day 3//日
  g_HIL_Bus_Swc_Set("I_TBOX_TimeInfo::I_TBOX_CDCU_RTCDate_Hour 4"); // 测试步骤 Step Set I_TBOX_TimeInfo::I_TBOX_CDCU_RTCDate_Hour 4//时
  g_HIL_Bus_Swc_Set("I_TBOX_TimeInfo::I_TBOX_CDCU_RTCDate_Minute 5"); // 测试步骤 Step Set I_TBOX_TimeInfo::I_TBOX_CDCU_RTCDate_Minute 5//分
  g_HIL_Bus_Swc_Set("I_CDCU_AssistSysSwSt::I_SecRowRtSeatOccupancySt 1"); // 测试步骤 Step Set I_CDCU_AssistSysSwSt::I_SecRowRtSeatOccupancySt 1//二排右侧占位
  g_HIL_Bus_Swc_Set("I_RDCU_BodySysSt1::I_RDCU_RRDoorAjarSt 1"); // 测试步骤 Step Set I_RDCU_BodySysSt1::I_RDCU_RRDoorAjarSt 1//右后门开关打开
  g_HIL_Gen_Swc_Wait("1500 ms"); // 测试步骤 Step Wait 1500 ms
  g_HIL_UDS_Swc_Set_UDS("22 31 0D"); // 测试步骤 Step Set_UDS 22 31 0D//车内有无人
  g_HIL_UDS_Swc_Check_UDS("62 31 0D 00"); // 预期结果 Step Check_UDS 62 31 0D 00//车内无人
  g_HIL_Bus_Swc_Set("I_RDCU_BodySysSt1::I_RDCU_RRDoorAjarSt 0"); // 测试步骤 Step Set I_RDCU_BodySysSt1::I_RDCU_RRDoorAjarSt 0//右后门开关打开
  g_HIL_Gen_Swc_Wait("100 ms"); // 测试步骤 Step Wait 100 ms
  g_HIL_Bus_Swc_Set("I_CDCU_AssistSysSwSt::I_SecRowRtSeatOccupancySt 0"); // 测试步骤 Step Set I_CDCU_AssistSysSwSt::I_SecRowRtSeatOccupancySt 0//二排右侧不占位
  g_HIL_Gen_Swc_Wait("30 ms"); // 测试步骤 Step Wait 30 ms
  g_HIL_UDS_Swc_Set_UDS("22 31 0D"); // 测试步骤 Step Set_UDS 22 31 0D//车内有无人
  g_HIL_UDS_Swc_Check_UDS("62 31 0D 01"); // 预期结果 Step Check_UDS 62 31 0D 01//车内有人
  g_HIL_UDS_Swc_Set_UDS("22 31 0E"); // 测试步骤 Step Set_UDS 22 31 0E//有人时间
  g_HIL_UDS_Swc_Check_UDS("62 31 0E 02 03 04 05"); // 预期结果 Step Check_UDS 62 31 0E 02 03 04 05//车内有人时间
}

testcase SYS_LDCU_Powermode_0072()
{
  TestDescription("延时自动下电开关设置-1");
  g_HIL_Clib_Swc_Clib_LocalON(); // 测试步骤 Step Clib LocalON
  g_HIL_Bus_Swc_Check("I_LDCU_BodySysSt1::I_LDCU_PowerMode 1"); // 预期结果 Step Check I_LDCU_BodySysSt1::I_LDCU_PowerMode 1//Local on
  g_HIL_Bus_Swc_Set("I_CDCU_LDCU_Ctrl::I_CDCU_AutoPoweroffConfig 1"); // 测试步骤 Step Set I_CDCU_LDCU_Ctrl::I_CDCU_AutoPoweroffConfig 1//自动下电功能INACTIVE
  g_HIL_Gen_Swc_Wait("301 ms"); // 测试步骤 Step Wait 301 ms
  g_HIL_Bus_Swc_Check("I_LDCU_BodySysSt3::I_LDCU_AutoPoweroffCfgSt 0"); // 预期结果 Step Check I_LDCU_BodySysSt3::I_LDCU_AutoPoweroffCfgSt 0//Not active
  g_HIL_Bus_Swc_Set("I_CDCU_LDCU_Ctrl::I_CDCU_AutoPoweroffConfig 2"); // 测试步骤 Step Set I_CDCU_LDCU_Ctrl::I_CDCU_AutoPoweroffConfig 2//自动下电功能ACTIVE
  g_HIL_Gen_Swc_Wait("301 ms"); // 测试步骤 Step Wait 301 ms
  g_HIL_Bus_Swc_Check("I_LDCU_BodySysSt3::I_LDCU_AutoPoweroffCfgSt 1"); // 预期结果 Step Check I_LDCU_BodySysSt3::I_LDCU_AutoPoweroffCfgSt 1//active
  g_HIL_Clib_Swc_Clib_OFF(); // 测试步骤 Step Clib OFF
  g_HIL_Bus_Swc_Check("I_LDCU_BodySysSt3::I_LDCU_AutoPoweroffCfgSt 1"); // 预期结果 Step Check I_LDCU_BodySysSt3::I_LDCU_AutoPoweroffCfgSt 1//active
}

testcase SYS_LDCU_Powermode_0073()
{
  TestDescription("延时自动下电开关设置-2");
  g_HIL_Clib_Swc_Clib_LocalON(); // 测试步骤 Step Clib LocalON
  g_HIL_Bus_Swc_Check("I_LDCU_BodySysSt3::I_LDCU_AutoPoweroffCfgSt 1"); // 预期结果 Step Check I_LDCU_BodySysSt3::I_LDCU_AutoPoweroffCfgSt 1//active
  g_HIL_Bus_Swc_Set("I_CDCU_LDCU_Ctrl::I_CDCU_AutoPoweroffConfig 2"); // 测试步骤 Step Set I_CDCU_LDCU_Ctrl::I_CDCU_AutoPoweroffConfig 2//自动下电功能ACTIVE
  g_HIL_Gen_Swc_Wait("301 ms"); // 测试步骤 Step Wait 301 ms
  g_HIL_Bus_Swc_Check("I_LDCU_BodySysSt3::I_LDCU_AutoPoweroffCfgSt 1"); // 预期结果 Step Check I_LDCU_BodySysSt3::I_LDCU_AutoPoweroffCfgSt 1//active
  g_HIL_Bus_Swc_Set("I_CDCU_LDCU_Ctrl::I_CDCU_AutoPoweroffConfig 1"); // 测试步骤 Step Set I_CDCU_LDCU_Ctrl::I_CDCU_AutoPoweroffConfig 1//自动下电功能INACTIVE
  g_HIL_Gen_Swc_Wait("301 ms"); // 测试步骤 Step Wait 301 ms
  g_HIL_Bus_Swc_Check("I_LDCU_BodySysSt3::I_LDCU_AutoPoweroffCfgSt 0"); // 预期结果 Step Check I_LDCU_BodySysSt3::I_LDCU_AutoPoweroffCfgSt 0//Not active
  g_HIL_Clib_Swc_Clib_OFF(); // 测试步骤 Step Clib OFF
  g_HIL_Bus_Swc_Check("I_LDCU_BodySysSt3::I_LDCU_AutoPoweroffCfgSt 0"); // 预期结果 Step Check I_LDCU_BodySysSt3::I_LDCU_AutoPoweroffCfgSt 0//Not active
}

testcase SYS_LDCU_Powermode_0074()
{
  TestDescription("延时自动下电功能激活与退出-1");
  g_HIL_XCP_Swc_Set_XCP("CalEn_Vcu_MO_Motor_laeuft 1"); // 测试步骤 Step Set_XCP CalEn_Vcu_MO_Motor_laeuft 1
  g_HIL_XCP_Swc_Set_XCP("CalVal_Vcu_MO_Motor_laeuft 0"); // 测试步骤 Step Set_XCP CalVal_Vcu_MO_Motor_laeuft 0
  g_HIL_Bus_Swc_Check("C_Motor_14::C_MO_Motor_laeuft 0"); // 预期结果 Step Check C_Motor_14::C_MO_Motor_laeuft 0//Motor_laeuft_nicht
  g_HIL_Clib_Swc_Clib_LocalON(); // 测试步骤 Step Clib LocalON
  g_HIL_Bus_Swc_Check("I_LDCU_BodySysSt1::I_LDCU_PowerMode 1"); // 预期结果 Step Check I_LDCU_BodySysSt1::I_LDCU_PowerMode 1//Local on
  g_HIL_Bus_Swc_Set("I_CDCU_LDCU_Ctrl::I_CDCU_AutoPoweroffConfig 0"); // 测试步骤 Step Set I_CDCU_LDCU_Ctrl::I_CDCU_AutoPoweroffConfig 0
  g_HIL_Gen_Swc_Wait("301 ms"); // 测试步骤 Step Wait 301 ms
  g_HIL_Bus_Swc_Set("I_CDCU_LDCU_Ctrl::I_CDCU_AutoPoweroffConfig 1"); // 测试步骤 Step Set I_CDCU_LDCU_Ctrl::I_CDCU_AutoPoweroffConfig 1//自动下电功能INACTIVE
  g_HIL_Gen_Swc_Wait("301 ms"); // 测试步骤 Step Wait 301 ms
  g_HIL_Bus_Swc_Check("I_LDCU_BodySysSt3::I_LDCU_AutoPoweroffCfgSt 0"); // 预期结果 Step Check I_LDCU_BodySysSt3::I_LDCU_AutoPoweroffCfgSt 0//inactive
  g_HIL_Bus_Swc_Set("C_CDCU_DiagnosticSt::C_CDCU_DiagnosticSt 0"); // 测试步骤 Step Set C_CDCU_DiagnosticSt::C_CDCU_DiagnosticSt 0
  g_HIL_Bus_Swc_Set("C_IPB_SpdInfoF::C_IPB_VehSpd 0"); // 测试步骤 Step Set C_IPB_SpdInfoF::C_IPB_VehSpd 0//车速小于3Km
  g_HIL_Bus_Swc_Set("C_IPB_SpdInfoF::C_IPB_VehSpdVD 1"); // 测试步骤 Step Set C_IPB_SpdInfoF::C_IPB_VehSpdVD 1//车速有效
  g_HIL_Clib_Swc_Clib_P(); // 测试步骤 Step Clib P
  g_HIL_Bus_Swc_Set("I_XPU_BodyCtrl::I_XPU_LDCU_CurMode 0"); // 测试步骤 Step Set I_XPU_BodyCtrl::I_XPU_LDCU_CurMode 0// 智能驾驶模式Invalid
  g_HIL_Bus_Swc_Set("I_CDCU_LDCU_BodyCtrl::I_CDCU_AutoPowerOffDisableReq 0"); // 测试步骤 Step Set I_CDCU_LDCU_BodyCtrl::I_CDCU_AutoPowerOffDisableReq 0//No Command
  g_HIL_Bus_Swc_Set("I_CDCU_LDCU_Ctrl::I_CDCU_AutoPoweroffConfig 0"); // 测试步骤 Step Set I_CDCU_LDCU_Ctrl::I_CDCU_AutoPoweroffConfig 0
  g_HIL_Gen_Swc_Wait("301 ms"); // 测试步骤 Step Wait 301 ms
  g_HIL_Bus_Swc_Set("I_CDCU_LDCU_Ctrl::I_CDCU_AutoPoweroffConfig 2"); // 测试步骤 Step Set I_CDCU_LDCU_Ctrl::I_CDCU_AutoPoweroffConfig 2//自动下电功能ACTIVE
  g_HIL_Gen_Swc_Wait("301 ms"); // 测试步骤 Step Wait 301 ms
  g_HIL_Bus_Swc_Check("I_LDCU_BodySysSt3::I_LDCU_AutoPoweroffCfgSt 1"); // 预期结果 Step Check I_LDCU_BodySysSt3::I_LDCU_AutoPoweroffCfgSt 1//active
  g_HIL_Bus_Swc_Set("I_CDCU_LDCU_Ctrl::I_CDCU_AutoPoweroffConfig 0"); // 测试步骤 Step Set I_CDCU_LDCU_Ctrl::I_CDCU_AutoPoweroffConfig 0
  g_HIL_Bus_Swc_Check("I_LDCU_BodySysSt3::I_LDCU_AutoPowerOffFuncSt 1"); // 预期结果 Step Check I_LDCU_BodySysSt3::I_LDCU_AutoPowerOffFuncSt 1//30min Count Down Started(T1计时）
  g_HIL_Bus_Swc_Set("C_CDCU_DiagnosticSt::C_CDCU_DiagnosticSt 4"); // 测试步骤 Step Set C_CDCU_DiagnosticSt::C_CDCU_DiagnosticSt 4
  g_HIL_Gen_Swc_Wait("1000 ms"); // 测试步骤 Step Wait 1000 ms//CDCU_DiagnosticSt周期为1s
  g_HIL_Gen_Swc_Wait("301 ms"); // 测试步骤 Step Wait 301 ms
  g_HIL_Bus_Swc_Check("I_LDCU_BodySysSt3::I_LDCU_AutoPowerOffFuncSt 0"); // 预期结果 Step Check I_LDCU_BodySysSt3::I_LDCU_AutoPowerOffFuncSt 0//inactive
  g_HIL_Bus_Swc_Set("C_CDCU_DiagnosticSt::C_CDCU_DiagnosticSt 0"); // 测试步骤 Step Set C_CDCU_DiagnosticSt::C_CDCU_DiagnosticSt 0
}

testcase SYS_LDCU_Powermode_0075()
{
  TestDescription("延时自动下电功能激活与退出-2");
  g_HIL_XCP_Swc_Set_XCP("CalEn_Vcu_MO_Motor_laeuft 1"); // 测试步骤 Step Set_XCP CalEn_Vcu_MO_Motor_laeuft 1
  g_HIL_XCP_Swc_Set_XCP("CalVal_Vcu_MO_Motor_laeuft 0"); // 测试步骤 Step Set_XCP CalVal_Vcu_MO_Motor_laeuft 0
  g_HIL_Bus_Swc_Check("C_Motor_14::C_MO_Motor_laeuft 0"); // 预期结果 Step Check C_Motor_14::C_MO_Motor_laeuft 0//Motor_laeuft_nicht
  g_HIL_Clib_Swc_Clib_LocalON(); // 测试步骤 Step Clib LocalON
  g_HIL_Bus_Swc_Check("I_LDCU_BodySysSt1::I_LDCU_PowerMode 1"); // 预期结果 Step Check I_LDCU_BodySysSt1::I_LDCU_PowerMode 1//Local on
  g_HIL_Bus_Swc_Set("I_CDCU_LDCU_Ctrl::I_CDCU_AutoPoweroffConfig 0"); // 测试步骤 Step Set I_CDCU_LDCU_Ctrl::I_CDCU_AutoPoweroffConfig 0
  g_HIL_Gen_Swc_Wait("301 ms"); // 测试步骤 Step Wait 301 ms
  g_HIL_Bus_Swc_Set("I_CDCU_LDCU_Ctrl::I_CDCU_AutoPoweroffConfig 1"); // 测试步骤 Step Set I_CDCU_LDCU_Ctrl::I_CDCU_AutoPoweroffConfig 1//自动下电功能INACTIVE
  g_HIL_Gen_Swc_Wait("301 ms"); // 测试步骤 Step Wait 301 ms
  g_HIL_Bus_Swc_Check("I_LDCU_BodySysSt3::I_LDCU_AutoPoweroffCfgSt 0"); // 预期结果 Step Check I_LDCU_BodySysSt3::I_LDCU_AutoPoweroffCfgSt 0//inactive
  g_HIL_Bus_Swc_Set("C_CDCU_DiagnosticSt::C_CDCU_DiagnosticSt 0"); // 测试步骤 Step Set C_CDCU_DiagnosticSt::C_CDCU_DiagnosticSt 0
  g_HIL_Bus_Swc_Set("C_IPB_SpdInfoF::C_IPB_VehSpd 0"); // 测试步骤 Step Set C_IPB_SpdInfoF::C_IPB_VehSpd 0//车速小于3Km
  g_HIL_Bus_Swc_Set("C_IPB_SpdInfoF::C_IPB_VehSpdVD 1"); // 测试步骤 Step Set C_IPB_SpdInfoF::C_IPB_VehSpdVD 1//车速有效
  g_HIL_Clib_Swc_Clib_P(); // 测试步骤 Step Clib P
  g_HIL_Bus_Swc_Set("I_XPU_BodyCtrl::I_XPU_LDCU_CurMode 0"); // 测试步骤 Step Set I_XPU_BodyCtrl::I_XPU_LDCU_CurMode 0// 智能驾驶模式Invalid
  g_HIL_Bus_Swc_Set("I_CDCU_LDCU_BodyCtrl::I_CDCU_AutoPowerOffDisableReq 0"); // 测试步骤 Step Set I_CDCU_LDCU_BodyCtrl::I_CDCU_AutoPowerOffDisableReq 0//No Command
  g_HIL_Bus_Swc_Set("I_CDCU_LDCU_Ctrl::I_CDCU_AutoPoweroffConfig 0"); // 测试步骤 Step Set I_CDCU_LDCU_Ctrl::I_CDCU_AutoPoweroffConfig 0
  g_HIL_Gen_Swc_Wait("301 ms"); // 测试步骤 Step Wait 301 ms
  g_HIL_Bus_Swc_Set("I_CDCU_LDCU_Ctrl::I_CDCU_AutoPoweroffConfig 2"); // 测试步骤 Step Set I_CDCU_LDCU_Ctrl::I_CDCU_AutoPoweroffConfig 2//自动下电功能ACTIVE
  g_HIL_Gen_Swc_Wait("301 ms"); // 测试步骤 Step Wait 301 ms
  g_HIL_Bus_Swc_Check("I_LDCU_BodySysSt3::I_LDCU_AutoPoweroffCfgSt 1"); // 预期结果 Step Check I_LDCU_BodySysSt3::I_LDCU_AutoPoweroffCfgSt 1//active
  g_HIL_Bus_Swc_Set("I_CDCU_LDCU_Ctrl::I_CDCU_AutoPoweroffConfig 0"); // 测试步骤 Step Set I_CDCU_LDCU_Ctrl::I_CDCU_AutoPoweroffConfig 0
  g_HIL_Bus_Swc_Check("I_LDCU_BodySysSt3::I_LDCU_AutoPowerOffFuncSt 1"); // 预期结果 Step Check I_LDCU_BodySysSt3::I_LDCU_AutoPowerOffFuncSt 1//30min Count Down Started(T1计时）
  g_HIL_Bus_Swc_Set("C_CDCU_DiagnosticSt::C_CDCU_DiagnosticSt 5"); // 测试步骤 Step Set C_CDCU_DiagnosticSt::C_CDCU_DiagnosticSt 5//Normal OTA
  g_HIL_Gen_Swc_Wait("1000 ms"); // 测试步骤 Step Wait 1000 ms//CDCU_DiagnosticSt周期为1s
  g_HIL_Gen_Swc_Wait("301 ms"); // 测试步骤 Step Wait 301 ms
  g_HIL_Bus_Swc_Check("I_LDCU_BodySysSt3::I_LDCU_AutoPowerOffFuncSt 0"); // 预期结果 Step Check I_LDCU_BodySysSt3::I_LDCU_AutoPowerOffFuncSt 0//inactive
  g_HIL_Bus_Swc_Set("C_CDCU_DiagnosticSt::C_CDCU_DiagnosticSt 0"); // 测试步骤 Step Set C_CDCU_DiagnosticSt::C_CDCU_DiagnosticSt 0
}

testcase SYS_LDCU_Powermode_0076()
{
  TestDescription("延时自动下电功能激活与退出-3");
  g_HIL_XCP_Swc_Set_XCP("CalEn_Vcu_MO_Motor_laeuft 1"); // 测试步骤 Step Set_XCP CalEn_Vcu_MO_Motor_laeuft 1
  g_HIL_XCP_Swc_Set_XCP("CalVal_Vcu_MO_Motor_laeuft 0"); // 测试步骤 Step Set_XCP CalVal_Vcu_MO_Motor_laeuft 0
  g_HIL_Bus_Swc_Check("C_Motor_14::C_MO_Motor_laeuft 0"); // 预期结果 Step Check C_Motor_14::C_MO_Motor_laeuft 0//Motor_laeuft_nicht
  g_HIL_Clib_Swc_Clib_LocalON(); // 测试步骤 Step Clib LocalON
  g_HIL_Bus_Swc_Check("I_LDCU_BodySysSt1::I_LDCU_PowerMode 1"); // 预期结果 Step Check I_LDCU_BodySysSt1::I_LDCU_PowerMode 1//Local on
  g_HIL_Bus_Swc_Set("I_CDCU_LDCU_Ctrl::I_CDCU_AutoPoweroffConfig 0"); // 测试步骤 Step Set I_CDCU_LDCU_Ctrl::I_CDCU_AutoPoweroffConfig 0
  g_HIL_Gen_Swc_Wait("301 ms"); // 测试步骤 Step Wait 301 ms
  g_HIL_Bus_Swc_Set("I_CDCU_LDCU_Ctrl::I_CDCU_AutoPoweroffConfig 1"); // 测试步骤 Step Set I_CDCU_LDCU_Ctrl::I_CDCU_AutoPoweroffConfig 1//自动下电功能INACTIVE
  g_HIL_Gen_Swc_Wait("301 ms"); // 测试步骤 Step Wait 301 ms
  g_HIL_Bus_Swc_Check("I_LDCU_BodySysSt3::I_LDCU_AutoPoweroffCfgSt 0"); // 预期结果 Step Check I_LDCU_BodySysSt3::I_LDCU_AutoPoweroffCfgSt 0//inactive
  g_HIL_Bus_Swc_Set("C_CDCU_DiagnosticSt::C_CDCU_DiagnosticSt 0"); // 测试步骤 Step Set C_CDCU_DiagnosticSt::C_CDCU_DiagnosticSt 0
  g_HIL_Bus_Swc_Set("C_IPB_SpdInfoF::C_IPB_VehSpd 0"); // 测试步骤 Step Set C_IPB_SpdInfoF::C_IPB_VehSpd 0//车速小于3Km
  g_HIL_Bus_Swc_Set("C_IPB_SpdInfoF::C_IPB_VehSpdVD 1"); // 测试步骤 Step Set C_IPB_SpdInfoF::C_IPB_VehSpdVD 1//车速有效
  g_HIL_Clib_Swc_Clib_P(); // 测试步骤 Step Clib P
  g_HIL_Bus_Swc_Set("I_XPU_BodyCtrl::I_XPU_LDCU_CurMode 0"); // 测试步骤 Step Set I_XPU_BodyCtrl::I_XPU_LDCU_CurMode 0// 智能驾驶模式Invalid
  g_HIL_Bus_Swc_Set("I_CDCU_LDCU_BodyCtrl::I_CDCU_AutoPowerOffDisableReq 0"); // 测试步骤 Step Set I_CDCU_LDCU_BodyCtrl::I_CDCU_AutoPowerOffDisableReq 0//No Command
  g_HIL_Bus_Swc_Set("I_CDCU_LDCU_Ctrl::I_CDCU_AutoPoweroffConfig 0"); // 测试步骤 Step Set I_CDCU_LDCU_Ctrl::I_CDCU_AutoPoweroffConfig 0
  g_HIL_Gen_Swc_Wait("301 ms"); // 测试步骤 Step Wait 301 ms
  g_HIL_Bus_Swc_Set("I_CDCU_LDCU_Ctrl::I_CDCU_AutoPoweroffConfig 2"); // 测试步骤 Step Set I_CDCU_LDCU_Ctrl::I_CDCU_AutoPoweroffConfig 2//自动下电功能ACTIVE
  g_HIL_Gen_Swc_Wait("301 ms"); // 测试步骤 Step Wait 301 ms
  g_HIL_Bus_Swc_Check("I_LDCU_BodySysSt3::I_LDCU_AutoPoweroffCfgSt 1"); // 预期结果 Step Check I_LDCU_BodySysSt3::I_LDCU_AutoPoweroffCfgSt 1//active
  g_HIL_Bus_Swc_Set("I_CDCU_LDCU_Ctrl::I_CDCU_AutoPoweroffConfig 0"); // 测试步骤 Step Set I_CDCU_LDCU_Ctrl::I_CDCU_AutoPoweroffConfig 0
  g_HIL_Bus_Swc_Check("I_LDCU_BodySysSt3::I_LDCU_AutoPowerOffFuncSt 1"); // 预期结果 Step Check I_LDCU_BodySysSt3::I_LDCU_AutoPowerOffFuncSt 1//30min Count Down Started(T1计时）
  g_HIL_Bus_Swc_Set("C_CDCU_DiagnosticSt::C_CDCU_DiagnosticSt 6"); // 测试步骤 Step Set C_CDCU_DiagnosticSt::C_CDCU_DiagnosticSt 6//Remote Diag
  g_HIL_Gen_Swc_Wait("1000 ms"); // 测试步骤 Step Wait 1000 ms//CDCU_DiagnosticSt周期为1s
  g_HIL_Gen_Swc_Wait("301 ms"); // 测试步骤 Step Wait 301 ms
  g_HIL_Bus_Swc_Check("I_LDCU_BodySysSt3::I_LDCU_AutoPowerOffFuncSt 0"); // 预期结果 Step Check I_LDCU_BodySysSt3::I_LDCU_AutoPowerOffFuncSt 0//inactive
  g_HIL_Bus_Swc_Set("C_CDCU_DiagnosticSt::C_CDCU_DiagnosticSt 0"); // 测试步骤 Step Set C_CDCU_DiagnosticSt::C_CDCU_DiagnosticSt 0
}

testcase SYS_LDCU_Powermode_0077()
{
  TestDescription("延时自动下电功能激活与退出-4");
  g_HIL_XCP_Swc_Set_XCP("CalEn_Vcu_MO_Motor_laeuft 1"); // 测试步骤 Step Set_XCP CalEn_Vcu_MO_Motor_laeuft 1
  g_HIL_XCP_Swc_Set_XCP("CalVal_Vcu_MO_Motor_laeuft 0"); // 测试步骤 Step Set_XCP CalVal_Vcu_MO_Motor_laeuft 0
  g_HIL_Bus_Swc_Check("C_Motor_14::C_MO_Motor_laeuft 0"); // 预期结果 Step Check C_Motor_14::C_MO_Motor_laeuft 0//Motor_laeuft_nicht
  g_HIL_Clib_Swc_Clib_LocalON(); // 测试步骤 Step Clib LocalON
  g_HIL_Bus_Swc_Check("I_LDCU_BodySysSt1::I_LDCU_PowerMode 1"); // 预期结果 Step Check I_LDCU_BodySysSt1::I_LDCU_PowerMode 1//Local on
  g_HIL_Bus_Swc_Set("I_CDCU_LDCU_Ctrl::I_CDCU_AutoPoweroffConfig 0"); // 测试步骤 Step Set I_CDCU_LDCU_Ctrl::I_CDCU_AutoPoweroffConfig 0
  g_HIL_Gen_Swc_Wait("301 ms"); // 测试步骤 Step Wait 301 ms
  g_HIL_Bus_Swc_Set("I_CDCU_LDCU_Ctrl::I_CDCU_AutoPoweroffConfig 1"); // 测试步骤 Step Set I_CDCU_LDCU_Ctrl::I_CDCU_AutoPoweroffConfig 1//自动下电功能INACTIVE
  g_HIL_Gen_Swc_Wait("301 ms"); // 测试步骤 Step Wait 301 ms
  g_HIL_Bus_Swc_Check("I_LDCU_BodySysSt3::I_LDCU_AutoPoweroffCfgSt 0"); // 预期结果 Step Check I_LDCU_BodySysSt3::I_LDCU_AutoPoweroffCfgSt 0//inactive
  g_HIL_Bus_Swc_Set("C_CDCU_DiagnosticSt::C_CDCU_DiagnosticSt 0"); // 测试步骤 Step Set C_CDCU_DiagnosticSt::C_CDCU_DiagnosticSt 0
  g_HIL_Bus_Swc_Set("C_IPB_SpdInfoF::C_IPB_VehSpd 0"); // 测试步骤 Step Set C_IPB_SpdInfoF::C_IPB_VehSpd 0//车速小于3Km
  g_HIL_Bus_Swc_Set("C_IPB_SpdInfoF::C_IPB_VehSpdVD 1"); // 测试步骤 Step Set C_IPB_SpdInfoF::C_IPB_VehSpdVD 1//车速有效
  g_HIL_Clib_Swc_Clib_P(); // 测试步骤 Step Clib P
  g_HIL_Bus_Swc_Set("I_XPU_BodyCtrl::I_XPU_LDCU_CurMode 0"); // 测试步骤 Step Set I_XPU_BodyCtrl::I_XPU_LDCU_CurMode 0// 智能驾驶模式Invalid
  g_HIL_Bus_Swc_Set("I_CDCU_LDCU_BodyCtrl::I_CDCU_AutoPowerOffDisableReq 0"); // 测试步骤 Step Set I_CDCU_LDCU_BodyCtrl::I_CDCU_AutoPowerOffDisableReq 0//No Command
  g_HIL_Bus_Swc_Set("I_CDCU_LDCU_Ctrl::I_CDCU_AutoPoweroffConfig 0"); // 测试步骤 Step Set I_CDCU_LDCU_Ctrl::I_CDCU_AutoPoweroffConfig 0
  g_HIL_Gen_Swc_Wait("301 ms"); // 测试步骤 Step Wait 301 ms
  g_HIL_Bus_Swc_Set("I_CDCU_LDCU_Ctrl::I_CDCU_AutoPoweroffConfig 2"); // 测试步骤 Step Set I_CDCU_LDCU_Ctrl::I_CDCU_AutoPoweroffConfig 2//自动下电功能ACTIVE
  g_HIL_Gen_Swc_Wait("301 ms"); // 测试步骤 Step Wait 301 ms
  g_HIL_Bus_Swc_Check("I_LDCU_BodySysSt3::I_LDCU_AutoPoweroffCfgSt 1"); // 预期结果 Step Check I_LDCU_BodySysSt3::I_LDCU_AutoPoweroffCfgSt 1//active
  g_HIL_Bus_Swc_Set("I_CDCU_LDCU_Ctrl::I_CDCU_AutoPoweroffConfig 0"); // 测试步骤 Step Set I_CDCU_LDCU_Ctrl::I_CDCU_AutoPoweroffConfig 0
  g_HIL_Bus_Swc_Check("I_LDCU_BodySysSt3::I_LDCU_AutoPowerOffFuncSt 1"); // 预期结果 Step Check I_LDCU_BodySysSt3::I_LDCU_AutoPowerOffFuncSt 1//30min Count Down Started(T1计时）
  g_HIL_Bus_Swc_Set("C_IPB_SpdInfoF::C_IPB_VehSpd 3"); // 测试步骤 Step Set C_IPB_SpdInfoF::C_IPB_VehSpd 3//车速3
  g_HIL_Gen_Swc_Wait("101 ms"); // 测试步骤 Step Wait 101 ms
  g_HIL_Bus_Swc_Check("I_LDCU_BodySysSt3::I_LDCU_AutoPowerOffFuncSt 3"); // 预期结果 Step Check I_LDCU_BodySysSt3::I_LDCU_AutoPowerOffFuncSt 3//Count Down Canceled（持续300ms）
  g_HIL_Bus_Swc_Set("C_IPB_SpdInfoF::C_IPB_VehSpd 0"); // 测试步骤 Step Set C_IPB_SpdInfoF::C_IPB_VehSpd 0//车速小于3Km
  g_HIL_Bus_Swc_Check("I_LDCU_BodySysSt3::I_LDCU_AutoPowerOffFuncSt 0"); // 预期结果 Step Check I_LDCU_BodySysSt3::I_LDCU_AutoPowerOffFuncSt 0//inactive
}

testcase SYS_LDCU_Powermode_0078()
{
  TestDescription("延时自动下电功能激活与退出-5");
  g_HIL_XCP_Swc_Set_XCP("CalEn_Vcu_MO_Motor_laeuft 1"); // 测试步骤 Step Set_XCP CalEn_Vcu_MO_Motor_laeuft 1
  g_HIL_XCP_Swc_Set_XCP("CalVal_Vcu_MO_Motor_laeuft 0"); // 测试步骤 Step Set_XCP CalVal_Vcu_MO_Motor_laeuft 0
  g_HIL_Bus_Swc_Check("C_Motor_14::C_MO_Motor_laeuft 0"); // 预期结果 Step Check C_Motor_14::C_MO_Motor_laeuft 0//Motor_laeuft_nicht
  g_HIL_Clib_Swc_Clib_LocalON(); // 测试步骤 Step Clib LocalON
  g_HIL_Bus_Swc_Check("I_LDCU_BodySysSt1::I_LDCU_PowerMode 1"); // 预期结果 Step Check I_LDCU_BodySysSt1::I_LDCU_PowerMode 1//Local on
  g_HIL_Bus_Swc_Set("I_CDCU_LDCU_Ctrl::I_CDCU_AutoPoweroffConfig 0"); // 测试步骤 Step Set I_CDCU_LDCU_Ctrl::I_CDCU_AutoPoweroffConfig 0
  g_HIL_Gen_Swc_Wait("301 ms"); // 测试步骤 Step Wait 301 ms
  g_HIL_Bus_Swc_Set("I_CDCU_LDCU_Ctrl::I_CDCU_AutoPoweroffConfig 1"); // 测试步骤 Step Set I_CDCU_LDCU_Ctrl::I_CDCU_AutoPoweroffConfig 1//自动下电功能INACTIVE
  g_HIL_Gen_Swc_Wait("301 ms"); // 测试步骤 Step Wait 301 ms
  g_HIL_Bus_Swc_Check("I_LDCU_BodySysSt3::I_LDCU_AutoPoweroffCfgSt 0"); // 预期结果 Step Check I_LDCU_BodySysSt3::I_LDCU_AutoPoweroffCfgSt 0//inactive
  g_HIL_Bus_Swc_Set("C_CDCU_DiagnosticSt::C_CDCU_DiagnosticSt 0"); // 测试步骤 Step Set C_CDCU_DiagnosticSt::C_CDCU_DiagnosticSt 0
  g_HIL_Bus_Swc_Set("C_IPB_SpdInfoF::C_IPB_VehSpd 0"); // 测试步骤 Step Set C_IPB_SpdInfoF::C_IPB_VehSpd 0//车速小于3Km
  g_HIL_Bus_Swc_Set("C_IPB_SpdInfoF::C_IPB_VehSpdVD 1"); // 测试步骤 Step Set C_IPB_SpdInfoF::C_IPB_VehSpdVD 1//车速有效
  g_HIL_Clib_Swc_Clib_P(); // 测试步骤 Step Clib P
  g_HIL_Bus_Swc_Set("I_XPU_BodyCtrl::I_XPU_LDCU_CurMode 0"); // 测试步骤 Step Set I_XPU_BodyCtrl::I_XPU_LDCU_CurMode 0// 智能驾驶模式Invalid
  g_HIL_Bus_Swc_Set("I_CDCU_LDCU_BodyCtrl::I_CDCU_AutoPowerOffDisableReq 0"); // 测试步骤 Step Set I_CDCU_LDCU_BodyCtrl::I_CDCU_AutoPowerOffDisableReq 0//No Command
  g_HIL_Bus_Swc_Set("I_CDCU_LDCU_Ctrl::I_CDCU_AutoPoweroffConfig 0"); // 测试步骤 Step Set I_CDCU_LDCU_Ctrl::I_CDCU_AutoPoweroffConfig 0
  g_HIL_Gen_Swc_Wait("301 ms"); // 测试步骤 Step Wait 301 ms
  g_HIL_Bus_Swc_Set("I_CDCU_LDCU_Ctrl::I_CDCU_AutoPoweroffConfig 2"); // 测试步骤 Step Set I_CDCU_LDCU_Ctrl::I_CDCU_AutoPoweroffConfig 2//自动下电功能ACTIVE
  g_HIL_Gen_Swc_Wait("301 ms"); // 测试步骤 Step Wait 301 ms
  g_HIL_Bus_Swc_Check("I_LDCU_BodySysSt3::I_LDCU_AutoPoweroffCfgSt 1"); // 预期结果 Step Check I_LDCU_BodySysSt3::I_LDCU_AutoPoweroffCfgSt 1//active
  g_HIL_Bus_Swc_Set("I_CDCU_LDCU_Ctrl::I_CDCU_AutoPoweroffConfig 0"); // 测试步骤 Step Set I_CDCU_LDCU_Ctrl::I_CDCU_AutoPoweroffConfig 0
  g_HIL_Bus_Swc_Check("I_LDCU_BodySysSt3::I_LDCU_AutoPowerOffFuncSt 1"); // 预期结果 Step Check I_LDCU_BodySysSt3::I_LDCU_AutoPowerOffFuncSt 1//30min Count Down Started(T1计时）
  g_HIL_Bus_Swc_Set("C_IPB_SpdInfoF::C_IPB_VehSpdVD 0"); // 测试步骤 Step Set C_IPB_SpdInfoF::C_IPB_VehSpdVD 0//车速无效
  g_HIL_Gen_Swc_Wait("101 ms"); // 测试步骤 Step Wait 101 ms
  g_HIL_Bus_Swc_Check("I_LDCU_BodySysSt3::I_LDCU_AutoPowerOffFuncSt 3"); // 预期结果 Step Check I_LDCU_BodySysSt3::I_LDCU_AutoPowerOffFuncSt 3//Count Down Canceled（持续300ms）
  g_HIL_Bus_Swc_Set("C_IPB_SpdInfoF::C_IPB_VehSpdVD 1"); // 测试步骤 Step Set C_IPB_SpdInfoF::C_IPB_VehSpdVD 1//车速有效
  g_HIL_Bus_Swc_Check("I_LDCU_BodySysSt3::I_LDCU_AutoPowerOffFuncSt 0"); // 预期结果 Step Check I_LDCU_BodySysSt3::I_LDCU_AutoPowerOffFuncSt 0//inactive
}

testcase SYS_LDCU_Powermode_0079()
{
  TestDescription("延时自动下电功能激活与退出-6");
  g_HIL_XCP_Swc_Set_XCP("CalEn_Vcu_MO_Motor_laeuft 1"); // 测试步骤 Step Set_XCP CalEn_Vcu_MO_Motor_laeuft 1
  g_HIL_XCP_Swc_Set_XCP("CalVal_Vcu_MO_Motor_laeuft 0"); // 测试步骤 Step Set_XCP CalVal_Vcu_MO_Motor_laeuft 0
  g_HIL_Bus_Swc_Check("C_Motor_14::C_MO_Motor_laeuft 0"); // 预期结果 Step Check C_Motor_14::C_MO_Motor_laeuft 0//Motor_laeuft_nicht
  g_HIL_Clib_Swc_Clib_LocalON(); // 测试步骤 Step Clib LocalON
  g_HIL_Bus_Swc_Check("I_LDCU_BodySysSt1::I_LDCU_PowerMode 1"); // 预期结果 Step Check I_LDCU_BodySysSt1::I_LDCU_PowerMode 1//Local on
  g_HIL_Bus_Swc_Set("I_CDCU_LDCU_Ctrl::I_CDCU_AutoPoweroffConfig 0"); // 测试步骤 Step Set I_CDCU_LDCU_Ctrl::I_CDCU_AutoPoweroffConfig 0
  g_HIL_Gen_Swc_Wait("301 ms"); // 测试步骤 Step Wait 301 ms
  g_HIL_Bus_Swc_Set("I_CDCU_LDCU_Ctrl::I_CDCU_AutoPoweroffConfig 1"); // 测试步骤 Step Set I_CDCU_LDCU_Ctrl::I_CDCU_AutoPoweroffConfig 1//自动下电功能INACTIVE
  g_HIL_Gen_Swc_Wait("301 ms"); // 测试步骤 Step Wait 301 ms
  g_HIL_Bus_Swc_Check("I_LDCU_BodySysSt3::I_LDCU_AutoPoweroffCfgSt 0"); // 预期结果 Step Check I_LDCU_BodySysSt3::I_LDCU_AutoPoweroffCfgSt 0//inactive
  g_HIL_Bus_Swc_Set("C_CDCU_DiagnosticSt::C_CDCU_DiagnosticSt 0"); // 测试步骤 Step Set C_CDCU_DiagnosticSt::C_CDCU_DiagnosticSt 0
  g_HIL_Bus_Swc_Set("C_IPB_SpdInfoF::C_IPB_VehSpd 0"); // 测试步骤 Step Set C_IPB_SpdInfoF::C_IPB_VehSpd 0//车速小于3Km
  g_HIL_Bus_Swc_Set("C_IPB_SpdInfoF::C_IPB_VehSpdVD 1"); // 测试步骤 Step Set C_IPB_SpdInfoF::C_IPB_VehSpdVD 1//车速有效
  g_HIL_Clib_Swc_Clib_P(); // 测试步骤 Step Clib P
  g_HIL_Bus_Swc_Set("I_XPU_BodyCtrl::I_XPU_LDCU_CurMode 0"); // 测试步骤 Step Set I_XPU_BodyCtrl::I_XPU_LDCU_CurMode 0// 智能驾驶模式Invalid
  g_HIL_Bus_Swc_Set("I_CDCU_LDCU_BodyCtrl::I_CDCU_AutoPowerOffDisableReq 0"); // 测试步骤 Step Set I_CDCU_LDCU_BodyCtrl::I_CDCU_AutoPowerOffDisableReq 0//No Command
  g_HIL_Bus_Swc_Set("I_CDCU_LDCU_Ctrl::I_CDCU_AutoPoweroffConfig 0"); // 测试步骤 Step Set I_CDCU_LDCU_Ctrl::I_CDCU_AutoPoweroffConfig 0
  g_HIL_Gen_Swc_Wait("301 ms"); // 测试步骤 Step Wait 301 ms
  g_HIL_Bus_Swc_Set("I_CDCU_LDCU_Ctrl::I_CDCU_AutoPoweroffConfig 2"); // 测试步骤 Step Set I_CDCU_LDCU_Ctrl::I_CDCU_AutoPoweroffConfig 2//自动下电功能ACTIVE
  g_HIL_Gen_Swc_Wait("301 ms"); // 测试步骤 Step Wait 301 ms
  g_HIL_Bus_Swc_Check("I_LDCU_BodySysSt3::I_LDCU_AutoPoweroffCfgSt 1"); // 预期结果 Step Check I_LDCU_BodySysSt3::I_LDCU_AutoPoweroffCfgSt 1//active
  g_HIL_Bus_Swc_Set("I_CDCU_LDCU_Ctrl::I_CDCU_AutoPoweroffConfig 0"); // 测试步骤 Step Set I_CDCU_LDCU_Ctrl::I_CDCU_AutoPoweroffConfig 0
  g_HIL_Bus_Swc_Check("I_LDCU_BodySysSt3::I_LDCU_AutoPowerOffFuncSt 1"); // 预期结果 Step Check I_LDCU_BodySysSt3::I_LDCU_AutoPowerOffFuncSt 1//30min Count Down Started(T1计时）
  g_HIL_Clib_Swc_Clib_R(); // 测试步骤 Step Clib R
  g_HIL_Gen_Swc_Wait("101 ms"); // 测试步骤 Step Wait 101 ms
  g_HIL_Bus_Swc_Check("I_LDCU_BodySysSt3::I_LDCU_AutoPowerOffFuncSt 3"); // 预期结果 Step Check I_LDCU_BodySysSt3::I_LDCU_AutoPowerOffFuncSt 3//Count Down Canceled（持续300ms）
  g_HIL_Clib_Swc_Clib_P(); // 测试步骤 Step Clib P
}

testcase SYS_LDCU_Powermode_0080()
{
  TestDescription("延时自动下电功能激活与退出-7");
  g_HIL_XCP_Swc_Set_XCP("CalEn_Vcu_MO_Motor_laeuft 1"); // 测试步骤 Step Set_XCP CalEn_Vcu_MO_Motor_laeuft 1
  g_HIL_XCP_Swc_Set_XCP("CalVal_Vcu_MO_Motor_laeuft 0"); // 测试步骤 Step Set_XCP CalVal_Vcu_MO_Motor_laeuft 0
  g_HIL_Bus_Swc_Check("C_Motor_14::C_MO_Motor_laeuft 0"); // 预期结果 Step Check C_Motor_14::C_MO_Motor_laeuft 0//Motor_laeuft_nicht
  g_HIL_Clib_Swc_Clib_LocalON(); // 测试步骤 Step Clib LocalON
  g_HIL_Bus_Swc_Check("I_LDCU_BodySysSt1::I_LDCU_PowerMode 1"); // 预期结果 Step Check I_LDCU_BodySysSt1::I_LDCU_PowerMode 1//Local on
  g_HIL_Bus_Swc_Set("I_CDCU_LDCU_Ctrl::I_CDCU_AutoPoweroffConfig 0"); // 测试步骤 Step Set I_CDCU_LDCU_Ctrl::I_CDCU_AutoPoweroffConfig 0
  g_HIL_Gen_Swc_Wait("301 ms"); // 测试步骤 Step Wait 301 ms
  g_HIL_Bus_Swc_Set("I_CDCU_LDCU_Ctrl::I_CDCU_AutoPoweroffConfig 1"); // 测试步骤 Step Set I_CDCU_LDCU_Ctrl::I_CDCU_AutoPoweroffConfig 1//自动下电功能INACTIVE
  g_HIL_Gen_Swc_Wait("301 ms"); // 测试步骤 Step Wait 301 ms
  g_HIL_Bus_Swc_Check("I_LDCU_BodySysSt3::I_LDCU_AutoPoweroffCfgSt 0"); // 预期结果 Step Check I_LDCU_BodySysSt3::I_LDCU_AutoPoweroffCfgSt 0//inactive
  g_HIL_Bus_Swc_Set("C_CDCU_DiagnosticSt::C_CDCU_DiagnosticSt 0"); // 测试步骤 Step Set C_CDCU_DiagnosticSt::C_CDCU_DiagnosticSt 0
  g_HIL_Bus_Swc_Set("C_IPB_SpdInfoF::C_IPB_VehSpd 0"); // 测试步骤 Step Set C_IPB_SpdInfoF::C_IPB_VehSpd 0//车速小于3Km
  g_HIL_Bus_Swc_Set("C_IPB_SpdInfoF::C_IPB_VehSpdVD 1"); // 测试步骤 Step Set C_IPB_SpdInfoF::C_IPB_VehSpdVD 1//车速有效
  g_HIL_Clib_Swc_Clib_P(); // 测试步骤 Step Clib P
  g_HIL_Bus_Swc_Set("I_XPU_BodyCtrl::I_XPU_LDCU_CurMode 0"); // 测试步骤 Step Set I_XPU_BodyCtrl::I_XPU_LDCU_CurMode 0// 智能驾驶模式Invalid
  g_HIL_Bus_Swc_Set("I_CDCU_LDCU_BodyCtrl::I_CDCU_AutoPowerOffDisableReq 0"); // 测试步骤 Step Set I_CDCU_LDCU_BodyCtrl::I_CDCU_AutoPowerOffDisableReq 0//No Command
  g_HIL_Bus_Swc_Set("I_CDCU_LDCU_Ctrl::I_CDCU_AutoPoweroffConfig 0"); // 测试步骤 Step Set I_CDCU_LDCU_Ctrl::I_CDCU_AutoPoweroffConfig 0
  g_HIL_Gen_Swc_Wait("301 ms"); // 测试步骤 Step Wait 301 ms
  g_HIL_Bus_Swc_Set("I_CDCU_LDCU_Ctrl::I_CDCU_AutoPoweroffConfig 2"); // 测试步骤 Step Set I_CDCU_LDCU_Ctrl::I_CDCU_AutoPoweroffConfig 2//自动下电功能ACTIVE
  g_HIL_Gen_Swc_Wait("301 ms"); // 测试步骤 Step Wait 301 ms
  g_HIL_Bus_Swc_Check("I_LDCU_BodySysSt3::I_LDCU_AutoPoweroffCfgSt 1"); // 预期结果 Step Check I_LDCU_BodySysSt3::I_LDCU_AutoPoweroffCfgSt 1//active
  g_HIL_Bus_Swc_Set("I_CDCU_LDCU_Ctrl::I_CDCU_AutoPoweroffConfig 0"); // 测试步骤 Step Set I_CDCU_LDCU_Ctrl::I_CDCU_AutoPoweroffConfig 0
  g_HIL_Bus_Swc_Check("I_LDCU_BodySysSt3::I_LDCU_AutoPowerOffFuncSt 1"); // 预期结果 Step Check I_LDCU_BodySysSt3::I_LDCU_AutoPowerOffFuncSt 1//30min Count Down Started(T1计时）
  g_HIL_Clib_Swc_Clib_N(); // 测试步骤 Step Clib N
  g_HIL_Gen_Swc_Wait("101 ms"); // 测试步骤 Step Wait 101 ms
  g_HIL_Bus_Swc_Check("I_LDCU_BodySysSt3::I_LDCU_AutoPowerOffFuncSt 3"); // 预期结果 Step Check I_LDCU_BodySysSt3::I_LDCU_AutoPowerOffFuncSt 3//Count Down Canceled（持续300ms）
  g_HIL_Clib_Swc_Clib_P(); // 测试步骤 Step Clib P
}

testcase SYS_LDCU_Powermode_0081()
{
  TestDescription("延时自动下电功能激活与退出-8");
  g_HIL_XCP_Swc_Set_XCP("CalEn_Vcu_MO_Motor_laeuft 1"); // 测试步骤 Step Set_XCP CalEn_Vcu_MO_Motor_laeuft 1
  g_HIL_XCP_Swc_Set_XCP("CalVal_Vcu_MO_Motor_laeuft 0"); // 测试步骤 Step Set_XCP CalVal_Vcu_MO_Motor_laeuft 0
  g_HIL_Bus_Swc_Check("C_Motor_14::C_MO_Motor_laeuft 0"); // 预期结果 Step Check C_Motor_14::C_MO_Motor_laeuft 0//Motor_laeuft_nicht
  g_HIL_Clib_Swc_Clib_LocalON(); // 测试步骤 Step Clib LocalON
  g_HIL_Bus_Swc_Check("I_LDCU_BodySysSt1::I_LDCU_PowerMode 1"); // 预期结果 Step Check I_LDCU_BodySysSt1::I_LDCU_PowerMode 1//Local on
  g_HIL_Bus_Swc_Set("I_CDCU_LDCU_Ctrl::I_CDCU_AutoPoweroffConfig 0"); // 测试步骤 Step Set I_CDCU_LDCU_Ctrl::I_CDCU_AutoPoweroffConfig 0
  g_HIL_Gen_Swc_Wait("301 ms"); // 测试步骤 Step Wait 301 ms
  g_HIL_Bus_Swc_Set("I_CDCU_LDCU_Ctrl::I_CDCU_AutoPoweroffConfig 1"); // 测试步骤 Step Set I_CDCU_LDCU_Ctrl::I_CDCU_AutoPoweroffConfig 1//自动下电功能INACTIVE
  g_HIL_Gen_Swc_Wait("301 ms"); // 测试步骤 Step Wait 301 ms
  g_HIL_Bus_Swc_Check("I_LDCU_BodySysSt3::I_LDCU_AutoPoweroffCfgSt 0"); // 预期结果 Step Check I_LDCU_BodySysSt3::I_LDCU_AutoPoweroffCfgSt 0//inactive
  g_HIL_Bus_Swc_Set("C_CDCU_DiagnosticSt::C_CDCU_DiagnosticSt 0"); // 测试步骤 Step Set C_CDCU_DiagnosticSt::C_CDCU_DiagnosticSt 0
  g_HIL_Bus_Swc_Set("C_IPB_SpdInfoF::C_IPB_VehSpd 0"); // 测试步骤 Step Set C_IPB_SpdInfoF::C_IPB_VehSpd 0//车速小于3Km
  g_HIL_Bus_Swc_Set("C_IPB_SpdInfoF::C_IPB_VehSpdVD 1"); // 测试步骤 Step Set C_IPB_SpdInfoF::C_IPB_VehSpdVD 1//车速有效
  g_HIL_Clib_Swc_Clib_P(); // 测试步骤 Step Clib P
  g_HIL_Bus_Swc_Set("I_XPU_BodyCtrl::I_XPU_LDCU_CurMode 0"); // 测试步骤 Step Set I_XPU_BodyCtrl::I_XPU_LDCU_CurMode 0// 智能驾驶模式Invalid
  g_HIL_Bus_Swc_Set("I_CDCU_LDCU_BodyCtrl::I_CDCU_AutoPowerOffDisableReq 0"); // 测试步骤 Step Set I_CDCU_LDCU_BodyCtrl::I_CDCU_AutoPowerOffDisableReq 0//No Command
  g_HIL_Bus_Swc_Set("I_CDCU_LDCU_Ctrl::I_CDCU_AutoPoweroffConfig 0"); // 测试步骤 Step Set I_CDCU_LDCU_Ctrl::I_CDCU_AutoPoweroffConfig 0
  g_HIL_Gen_Swc_Wait("301 ms"); // 测试步骤 Step Wait 301 ms
  g_HIL_Bus_Swc_Set("I_CDCU_LDCU_Ctrl::I_CDCU_AutoPoweroffConfig 2"); // 测试步骤 Step Set I_CDCU_LDCU_Ctrl::I_CDCU_AutoPoweroffConfig 2//自动下电功能ACTIVE
  g_HIL_Gen_Swc_Wait("301 ms"); // 测试步骤 Step Wait 301 ms
  g_HIL_Bus_Swc_Check("I_LDCU_BodySysSt3::I_LDCU_AutoPoweroffCfgSt 1"); // 预期结果 Step Check I_LDCU_BodySysSt3::I_LDCU_AutoPoweroffCfgSt 1//active
  g_HIL_Bus_Swc_Set("I_CDCU_LDCU_Ctrl::I_CDCU_AutoPoweroffConfig 0"); // 测试步骤 Step Set I_CDCU_LDCU_Ctrl::I_CDCU_AutoPoweroffConfig 0
  g_HIL_Bus_Swc_Check("I_LDCU_BodySysSt3::I_LDCU_AutoPowerOffFuncSt 1"); // 预期结果 Step Check I_LDCU_BodySysSt3::I_LDCU_AutoPowerOffFuncSt 1//30min Count Down Started(T1计时）
  g_HIL_Clib_Swc_Clib_D(); // 测试步骤 Step Clib D
  g_HIL_Gen_Swc_Wait("101 ms"); // 测试步骤 Step Wait 101 ms
  g_HIL_Bus_Swc_Check("I_LDCU_BodySysSt3::I_LDCU_AutoPowerOffFuncSt 3"); // 预期结果 Step Check I_LDCU_BodySysSt3::I_LDCU_AutoPowerOffFuncSt 3//Count Down Canceled（持续300ms）
  g_HIL_Clib_Swc_Clib_P(); // 测试步骤 Step Clib P
}

testcase SYS_LDCU_Powermode_0082()
{
  TestDescription("延时自动下电功能激活与退出-9");
  g_HIL_XCP_Swc_Set_XCP("CalEn_Vcu_MO_Motor_laeuft 1"); // 测试步骤 Step Set_XCP CalEn_Vcu_MO_Motor_laeuft 1
  g_HIL_XCP_Swc_Set_XCP("CalVal_Vcu_MO_Motor_laeuft 0"); // 测试步骤 Step Set_XCP CalVal_Vcu_MO_Motor_laeuft 0
  g_HIL_Bus_Swc_Check("C_Motor_14::C_MO_Motor_laeuft 0"); // 预期结果 Step Check C_Motor_14::C_MO_Motor_laeuft 0//Motor_laeuft_nicht
  g_HIL_Clib_Swc_Clib_LocalON(); // 测试步骤 Step Clib LocalON
  g_HIL_Bus_Swc_Check("I_LDCU_BodySysSt1::I_LDCU_PowerMode 1"); // 预期结果 Step Check I_LDCU_BodySysSt1::I_LDCU_PowerMode 1//Local on
  g_HIL_Bus_Swc_Set("I_CDCU_LDCU_Ctrl::I_CDCU_AutoPoweroffConfig 0"); // 测试步骤 Step Set I_CDCU_LDCU_Ctrl::I_CDCU_AutoPoweroffConfig 0
  g_HIL_Gen_Swc_Wait("301 ms"); // 测试步骤 Step Wait 301 ms
  g_HIL_Bus_Swc_Set("I_CDCU_LDCU_Ctrl::I_CDCU_AutoPoweroffConfig 1"); // 测试步骤 Step Set I_CDCU_LDCU_Ctrl::I_CDCU_AutoPoweroffConfig 1//自动下电功能INACTIVE
  g_HIL_Gen_Swc_Wait("301 ms"); // 测试步骤 Step Wait 301 ms
  g_HIL_Bus_Swc_Check("I_LDCU_BodySysSt3::I_LDCU_AutoPoweroffCfgSt 0"); // 预期结果 Step Check I_LDCU_BodySysSt3::I_LDCU_AutoPoweroffCfgSt 0//inactive
  g_HIL_Bus_Swc_Set("C_CDCU_DiagnosticSt::C_CDCU_DiagnosticSt 0"); // 测试步骤 Step Set C_CDCU_DiagnosticSt::C_CDCU_DiagnosticSt 0
  g_HIL_Bus_Swc_Set("C_IPB_SpdInfoF::C_IPB_VehSpd 0"); // 测试步骤 Step Set C_IPB_SpdInfoF::C_IPB_VehSpd 0//车速小于3Km
  g_HIL_Bus_Swc_Set("C_IPB_SpdInfoF::C_IPB_VehSpdVD 1"); // 测试步骤 Step Set C_IPB_SpdInfoF::C_IPB_VehSpdVD 1//车速有效
  g_HIL_Clib_Swc_Clib_P(); // 测试步骤 Step Clib P
  g_HIL_Bus_Swc_Set("I_XPU_BodyCtrl::I_XPU_LDCU_CurMode 0"); // 测试步骤 Step Set I_XPU_BodyCtrl::I_XPU_LDCU_CurMode 0// 智能驾驶模式Invalid
  g_HIL_Bus_Swc_Set("I_CDCU_LDCU_BodyCtrl::I_CDCU_AutoPowerOffDisableReq 0"); // 测试步骤 Step Set I_CDCU_LDCU_BodyCtrl::I_CDCU_AutoPowerOffDisableReq 0//No Command
  g_HIL_Bus_Swc_Set("I_CDCU_LDCU_Ctrl::I_CDCU_AutoPoweroffConfig 0"); // 测试步骤 Step Set I_CDCU_LDCU_Ctrl::I_CDCU_AutoPoweroffConfig 0
  g_HIL_Gen_Swc_Wait("301 ms"); // 测试步骤 Step Wait 301 ms
  g_HIL_Bus_Swc_Set("I_CDCU_LDCU_Ctrl::I_CDCU_AutoPoweroffConfig 2"); // 测试步骤 Step Set I_CDCU_LDCU_Ctrl::I_CDCU_AutoPoweroffConfig 2//自动下电功能ACTIVE
  g_HIL_Gen_Swc_Wait("301 ms"); // 测试步骤 Step Wait 301 ms
  g_HIL_Bus_Swc_Check("I_LDCU_BodySysSt3::I_LDCU_AutoPoweroffCfgSt 1"); // 预期结果 Step Check I_LDCU_BodySysSt3::I_LDCU_AutoPoweroffCfgSt 1//active
  g_HIL_Bus_Swc_Set("I_CDCU_LDCU_Ctrl::I_CDCU_AutoPoweroffConfig 0"); // 测试步骤 Step Set I_CDCU_LDCU_Ctrl::I_CDCU_AutoPoweroffConfig 0
  g_HIL_Bus_Swc_Check("I_LDCU_BodySysSt3::I_LDCU_AutoPowerOffFuncSt 1"); // 预期结果 Step Check I_LDCU_BodySysSt3::I_LDCU_AutoPowerOffFuncSt 1//30min Count Down Started(T1计时）
  g_HIL_Bus_Swc_Set("I_XPU_BodyCtrl::I_XPU_LDCU_CurMode 1"); // 测试步骤 Step Set I_XPU_BodyCtrl::I_XPU_LDCU_CurMode 1
  g_HIL_Gen_Swc_Wait("101 ms"); // 测试步骤 Step Wait 101 ms
  g_HIL_Bus_Swc_Check("I_LDCU_BodySysSt3::I_LDCU_AutoPowerOffFuncSt 3"); // 预期结果 Step Check I_LDCU_BodySysSt3::I_LDCU_AutoPowerOffFuncSt 3//Count Down Canceled（持续300ms）
  g_HIL_Bus_Swc_Set("I_XPU_BodyCtrl::I_XPU_LDCU_CurMode 0"); // 测试步骤 Step Set I_XPU_BodyCtrl::I_XPU_LDCU_CurMode 0// 智能驾驶模式Invalid
}

testcase SYS_LDCU_Powermode_0083()
{
  TestDescription("延时自动下电功能激活与退出-10");
  g_HIL_XCP_Swc_Set_XCP("CalEn_Vcu_MO_Motor_laeuft 1"); // 测试步骤 Step Set_XCP CalEn_Vcu_MO_Motor_laeuft 1
  g_HIL_XCP_Swc_Set_XCP("CalVal_Vcu_MO_Motor_laeuft 0"); // 测试步骤 Step Set_XCP CalVal_Vcu_MO_Motor_laeuft 0
  g_HIL_Bus_Swc_Check("C_Motor_14::C_MO_Motor_laeuft 0"); // 预期结果 Step Check C_Motor_14::C_MO_Motor_laeuft 0//Motor_laeuft_nicht
  g_HIL_Clib_Swc_Clib_LocalON(); // 测试步骤 Step Clib LocalON
  g_HIL_Bus_Swc_Check("I_LDCU_BodySysSt1::I_LDCU_PowerMode 1"); // 预期结果 Step Check I_LDCU_BodySysSt1::I_LDCU_PowerMode 1//Local on
  g_HIL_Bus_Swc_Set("I_CDCU_LDCU_Ctrl::I_CDCU_AutoPoweroffConfig 0"); // 测试步骤 Step Set I_CDCU_LDCU_Ctrl::I_CDCU_AutoPoweroffConfig 0
  g_HIL_Gen_Swc_Wait("301 ms"); // 测试步骤 Step Wait 301 ms
  g_HIL_Bus_Swc_Set("I_CDCU_LDCU_Ctrl::I_CDCU_AutoPoweroffConfig 1"); // 测试步骤 Step Set I_CDCU_LDCU_Ctrl::I_CDCU_AutoPoweroffConfig 1//自动下电功能INACTIVE
  g_HIL_Gen_Swc_Wait("301 ms"); // 测试步骤 Step Wait 301 ms
  g_HIL_Bus_Swc_Check("I_LDCU_BodySysSt3::I_LDCU_AutoPoweroffCfgSt 0"); // 预期结果 Step Check I_LDCU_BodySysSt3::I_LDCU_AutoPoweroffCfgSt 0//inactive
  g_HIL_Bus_Swc_Set("C_CDCU_DiagnosticSt::C_CDCU_DiagnosticSt 0"); // 测试步骤 Step Set C_CDCU_DiagnosticSt::C_CDCU_DiagnosticSt 0
  g_HIL_Bus_Swc_Set("C_IPB_SpdInfoF::C_IPB_VehSpd 0"); // 测试步骤 Step Set C_IPB_SpdInfoF::C_IPB_VehSpd 0//车速小于3Km
  g_HIL_Bus_Swc_Set("C_IPB_SpdInfoF::C_IPB_VehSpdVD 1"); // 测试步骤 Step Set C_IPB_SpdInfoF::C_IPB_VehSpdVD 1//车速有效
  g_HIL_Clib_Swc_Clib_P(); // 测试步骤 Step Clib P
  g_HIL_Bus_Swc_Set("I_XPU_BodyCtrl::I_XPU_LDCU_CurMode 0"); // 测试步骤 Step Set I_XPU_BodyCtrl::I_XPU_LDCU_CurMode 0// 智能驾驶模式Invalid
  g_HIL_Bus_Swc_Set("I_CDCU_LDCU_BodyCtrl::I_CDCU_AutoPowerOffDisableReq 0"); // 测试步骤 Step Set I_CDCU_LDCU_BodyCtrl::I_CDCU_AutoPowerOffDisableReq 0//No Command
  g_HIL_Bus_Swc_Set("I_CDCU_LDCU_Ctrl::I_CDCU_AutoPoweroffConfig 0"); // 测试步骤 Step Set I_CDCU_LDCU_Ctrl::I_CDCU_AutoPoweroffConfig 0
  g_HIL_Gen_Swc_Wait("301 ms"); // 测试步骤 Step Wait 301 ms
  g_HIL_Bus_Swc_Set("I_CDCU_LDCU_Ctrl::I_CDCU_AutoPoweroffConfig 2"); // 测试步骤 Step Set I_CDCU_LDCU_Ctrl::I_CDCU_AutoPoweroffConfig 2//自动下电功能ACTIVE
  g_HIL_Gen_Swc_Wait("301 ms"); // 测试步骤 Step Wait 301 ms
  g_HIL_Bus_Swc_Check("I_LDCU_BodySysSt3::I_LDCU_AutoPoweroffCfgSt 1"); // 预期结果 Step Check I_LDCU_BodySysSt3::I_LDCU_AutoPoweroffCfgSt 1//active
  g_HIL_Bus_Swc_Set("I_CDCU_LDCU_Ctrl::I_CDCU_AutoPoweroffConfig 0"); // 测试步骤 Step Set I_CDCU_LDCU_Ctrl::I_CDCU_AutoPoweroffConfig 0
  g_HIL_Bus_Swc_Check("I_LDCU_BodySysSt3::I_LDCU_AutoPowerOffFuncSt 1"); // 预期结果 Step Check I_LDCU_BodySysSt3::I_LDCU_AutoPowerOffFuncSt 1//30min Count Down Started(T1计时）
  g_HIL_Bus_Swc_Set("I_XPU_BodyCtrl::I_XPU_LDCU_CurMode 2"); // 测试步骤 Step Set I_XPU_BodyCtrl::I_XPU_LDCU_CurMode 2
  g_HIL_Gen_Swc_Wait("101 ms"); // 测试步骤 Step Wait 101 ms
  g_HIL_Bus_Swc_Check("I_LDCU_BodySysSt3::I_LDCU_AutoPowerOffFuncSt 3"); // 预期结果 Step Check I_LDCU_BodySysSt3::I_LDCU_AutoPowerOffFuncSt 3//Count Down Canceled（持续300ms）
  g_HIL_Bus_Swc_Set("I_XPU_BodyCtrl::I_XPU_LDCU_CurMode 0"); // 测试步骤 Step Set I_XPU_BodyCtrl::I_XPU_LDCU_CurMode 0// 智能驾驶模式Invalid
}

testcase SYS_LDCU_Powermode_0084()
{
  TestDescription("延时自动下电功能激活与退出-11");
  g_HIL_XCP_Swc_Set_XCP("CalEn_Vcu_MO_Motor_laeuft 1"); // 测试步骤 Step Set_XCP CalEn_Vcu_MO_Motor_laeuft 1
  g_HIL_XCP_Swc_Set_XCP("CalVal_Vcu_MO_Motor_laeuft 0"); // 测试步骤 Step Set_XCP CalVal_Vcu_MO_Motor_laeuft 0
  g_HIL_Bus_Swc_Check("C_Motor_14::C_MO_Motor_laeuft 0"); // 预期结果 Step Check C_Motor_14::C_MO_Motor_laeuft 0//Motor_laeuft_nicht
  g_HIL_Clib_Swc_Clib_LocalON(); // 测试步骤 Step Clib LocalON
  g_HIL_Bus_Swc_Check("I_LDCU_BodySysSt1::I_LDCU_PowerMode 1"); // 预期结果 Step Check I_LDCU_BodySysSt1::I_LDCU_PowerMode 1//Local on
  g_HIL_Bus_Swc_Set("I_CDCU_LDCU_Ctrl::I_CDCU_AutoPoweroffConfig 0"); // 测试步骤 Step Set I_CDCU_LDCU_Ctrl::I_CDCU_AutoPoweroffConfig 0
  g_HIL_Gen_Swc_Wait("301 ms"); // 测试步骤 Step Wait 301 ms
  g_HIL_Bus_Swc_Set("I_CDCU_LDCU_Ctrl::I_CDCU_AutoPoweroffConfig 1"); // 测试步骤 Step Set I_CDCU_LDCU_Ctrl::I_CDCU_AutoPoweroffConfig 1//自动下电功能INACTIVE
  g_HIL_Gen_Swc_Wait("301 ms"); // 测试步骤 Step Wait 301 ms
  g_HIL_Bus_Swc_Check("I_LDCU_BodySysSt3::I_LDCU_AutoPoweroffCfgSt 0"); // 预期结果 Step Check I_LDCU_BodySysSt3::I_LDCU_AutoPoweroffCfgSt 0//inactive
  g_HIL_Bus_Swc_Set("C_CDCU_DiagnosticSt::C_CDCU_DiagnosticSt 0"); // 测试步骤 Step Set C_CDCU_DiagnosticSt::C_CDCU_DiagnosticSt 0
  g_HIL_Bus_Swc_Set("C_IPB_SpdInfoF::C_IPB_VehSpd 0"); // 测试步骤 Step Set C_IPB_SpdInfoF::C_IPB_VehSpd 0//车速小于3Km
  g_HIL_Bus_Swc_Set("C_IPB_SpdInfoF::C_IPB_VehSpdVD 1"); // 测试步骤 Step Set C_IPB_SpdInfoF::C_IPB_VehSpdVD 1//车速有效
  g_HIL_Clib_Swc_Clib_P(); // 测试步骤 Step Clib P
  g_HIL_Bus_Swc_Set("I_XPU_BodyCtrl::I_XPU_LDCU_CurMode 0"); // 测试步骤 Step Set I_XPU_BodyCtrl::I_XPU_LDCU_CurMode 0// 智能驾驶模式Invalid
  g_HIL_Bus_Swc_Set("I_CDCU_LDCU_BodyCtrl::I_CDCU_AutoPowerOffDisableReq 0"); // 测试步骤 Step Set I_CDCU_LDCU_BodyCtrl::I_CDCU_AutoPowerOffDisableReq 0//No Command
  g_HIL_Bus_Swc_Set("I_CDCU_LDCU_Ctrl::I_CDCU_AutoPoweroffConfig 0"); // 测试步骤 Step Set I_CDCU_LDCU_Ctrl::I_CDCU_AutoPoweroffConfig 0
  g_HIL_Gen_Swc_Wait("301 ms"); // 测试步骤 Step Wait 301 ms
  g_HIL_Bus_Swc_Set("I_CDCU_LDCU_Ctrl::I_CDCU_AutoPoweroffConfig 2"); // 测试步骤 Step Set I_CDCU_LDCU_Ctrl::I_CDCU_AutoPoweroffConfig 2//自动下电功能ACTIVE
  g_HIL_Gen_Swc_Wait("301 ms"); // 测试步骤 Step Wait 301 ms
  g_HIL_Bus_Swc_Check("I_LDCU_BodySysSt3::I_LDCU_AutoPoweroffCfgSt 1"); // 预期结果 Step Check I_LDCU_BodySysSt3::I_LDCU_AutoPoweroffCfgSt 1//active
  g_HIL_Bus_Swc_Set("I_CDCU_LDCU_Ctrl::I_CDCU_AutoPoweroffConfig 0"); // 测试步骤 Step Set I_CDCU_LDCU_Ctrl::I_CDCU_AutoPoweroffConfig 0
  g_HIL_Bus_Swc_Check("I_LDCU_BodySysSt3::I_LDCU_AutoPowerOffFuncSt 1"); // 预期结果 Step Check I_LDCU_BodySysSt3::I_LDCU_AutoPowerOffFuncSt 1//30min Count Down Started(T1计时）
  g_HIL_Bus_Swc_Set("I_XPU_BodyCtrl::I_XPU_LDCU_CurMode 0"); // 测试步骤 Step Set I_XPU_BodyCtrl::I_XPU_LDCU_CurMode 0// 智能驾驶模式Invalid
  g_HIL_Gen_Swc_Wait("101 ms"); // 测试步骤 Step Wait 101 ms
  g_HIL_Bus_Swc_Check("I_LDCU_BodySysSt3::I_LDCU_AutoPowerOffFuncSt 3"); // 预期结果 Step Check I_LDCU_BodySysSt3::I_LDCU_AutoPowerOffFuncSt 3//Count Down Canceled（持续300ms）
}

testcase SYS_LDCU_Powermode_0085()
{
  TestDescription("延时自动下电功能激活与退出-12");
  g_HIL_XCP_Swc_Set_XCP("CalEn_Vcu_MO_Motor_laeuft 1"); // 测试步骤 Step Set_XCP CalEn_Vcu_MO_Motor_laeuft 1
  g_HIL_XCP_Swc_Set_XCP("CalVal_Vcu_MO_Motor_laeuft 0"); // 测试步骤 Step Set_XCP CalVal_Vcu_MO_Motor_laeuft 0
  g_HIL_Bus_Swc_Check("C_Motor_14::C_MO_Motor_laeuft 0"); // 预期结果 Step Check C_Motor_14::C_MO_Motor_laeuft 0//Motor_laeuft_nicht
  g_HIL_Clib_Swc_Clib_LocalON(); // 测试步骤 Step Clib LocalON
  g_HIL_Bus_Swc_Check("I_LDCU_BodySysSt1::I_LDCU_PowerMode 1"); // 预期结果 Step Check I_LDCU_BodySysSt1::I_LDCU_PowerMode 1//Local on
  g_HIL_Bus_Swc_Set("I_CDCU_LDCU_Ctrl::I_CDCU_AutoPoweroffConfig 0"); // 测试步骤 Step Set I_CDCU_LDCU_Ctrl::I_CDCU_AutoPoweroffConfig 0
  g_HIL_Gen_Swc_Wait("301 ms"); // 测试步骤 Step Wait 301 ms
  g_HIL_Bus_Swc_Set("I_CDCU_LDCU_Ctrl::I_CDCU_AutoPoweroffConfig 1"); // 测试步骤 Step Set I_CDCU_LDCU_Ctrl::I_CDCU_AutoPoweroffConfig 1//自动下电功能INACTIVE
  g_HIL_Gen_Swc_Wait("301 ms"); // 测试步骤 Step Wait 301 ms
  g_HIL_Bus_Swc_Check("I_LDCU_BodySysSt3::I_LDCU_AutoPoweroffCfgSt 0"); // 预期结果 Step Check I_LDCU_BodySysSt3::I_LDCU_AutoPoweroffCfgSt 0//inactive
  g_HIL_Bus_Swc_Set("C_CDCU_DiagnosticSt::C_CDCU_DiagnosticSt 0"); // 测试步骤 Step Set C_CDCU_DiagnosticSt::C_CDCU_DiagnosticSt 0
  g_HIL_Bus_Swc_Set("C_IPB_SpdInfoF::C_IPB_VehSpd 0"); // 测试步骤 Step Set C_IPB_SpdInfoF::C_IPB_VehSpd 0//车速小于3Km
  g_HIL_Bus_Swc_Set("C_IPB_SpdInfoF::C_IPB_VehSpdVD 1"); // 测试步骤 Step Set C_IPB_SpdInfoF::C_IPB_VehSpdVD 1//车速有效
  g_HIL_Clib_Swc_Clib_P(); // 测试步骤 Step Clib P
  g_HIL_Bus_Swc_Set("I_XPU_BodyCtrl::I_XPU_LDCU_CurMode 0"); // 测试步骤 Step Set I_XPU_BodyCtrl::I_XPU_LDCU_CurMode 0// 智能驾驶模式Invalid
  g_HIL_Bus_Swc_Set("I_CDCU_LDCU_BodyCtrl::I_CDCU_AutoPowerOffDisableReq 0"); // 测试步骤 Step Set I_CDCU_LDCU_BodyCtrl::I_CDCU_AutoPowerOffDisableReq 0//No Command
  g_HIL_Bus_Swc_Set("I_CDCU_LDCU_Ctrl::I_CDCU_AutoPoweroffConfig 0"); // 测试步骤 Step Set I_CDCU_LDCU_Ctrl::I_CDCU_AutoPoweroffConfig 0
  g_HIL_Gen_Swc_Wait("301 ms"); // 测试步骤 Step Wait 301 ms
  g_HIL_Bus_Swc_Set("I_CDCU_LDCU_Ctrl::I_CDCU_AutoPoweroffConfig 2"); // 测试步骤 Step Set I_CDCU_LDCU_Ctrl::I_CDCU_AutoPoweroffConfig 2//自动下电功能ACTIVE
  g_HIL_Gen_Swc_Wait("301 ms"); // 测试步骤 Step Wait 301 ms
  g_HIL_Bus_Swc_Check("I_LDCU_BodySysSt3::I_LDCU_AutoPoweroffCfgSt 1"); // 预期结果 Step Check I_LDCU_BodySysSt3::I_LDCU_AutoPoweroffCfgSt 1//active
  g_HIL_Bus_Swc_Set("I_CDCU_LDCU_Ctrl::I_CDCU_AutoPoweroffConfig 0"); // 测试步骤 Step Set I_CDCU_LDCU_Ctrl::I_CDCU_AutoPoweroffConfig 0
  g_HIL_Bus_Swc_Check("I_LDCU_BodySysSt3::I_LDCU_AutoPowerOffFuncSt 1"); // 预期结果 Step Check I_LDCU_BodySysSt3::I_LDCU_AutoPowerOffFuncSt 1//30min Count Down Started(T1计时）
  g_HIL_Bus_Swc_Set("I_CDCU_LDCU_BodyCtrl::I_CDCU_AutoPowerOffDisableReq 1"); // 测试步骤 Step Set I_CDCU_LDCU_BodyCtrl::I_CDCU_AutoPowerOffDisableReq 1//
  g_HIL_Gen_Swc_Wait("101 ms"); // 测试步骤 Step Wait 101 ms
  g_HIL_Bus_Swc_Check("I_LDCU_BodySysSt3::I_LDCU_AutoPowerOffFuncSt 3"); // 预期结果 Step Check I_LDCU_BodySysSt3::I_LDCU_AutoPowerOffFuncSt 3//Count Down Canceled（持续300ms）
  g_HIL_Bus_Swc_Set("I_CDCU_LDCU_BodyCtrl::I_CDCU_AutoPowerOffDisableReq 0"); // 测试步骤 Step Set I_CDCU_LDCU_BodyCtrl::I_CDCU_AutoPowerOffDisableReq 0//No Command
}

testcase SYS_LDCU_Powermode_0086()
{
  TestDescription("延时自动下电功能激活与退出-13");
  g_HIL_XCP_Swc_Set_XCP("CalEn_Vcu_MO_Motor_laeuft 1"); // 测试步骤 Step Set_XCP CalEn_Vcu_MO_Motor_laeuft 1
  g_HIL_XCP_Swc_Set_XCP("CalVal_Vcu_MO_Motor_laeuft 0"); // 测试步骤 Step Set_XCP CalVal_Vcu_MO_Motor_laeuft 0
  g_HIL_Bus_Swc_Check("C_Motor_14::C_MO_Motor_laeuft 0"); // 预期结果 Step Check C_Motor_14::C_MO_Motor_laeuft 0//Motor_laeuft_nicht
  g_HIL_Clib_Swc_Clib_LocalON(); // 测试步骤 Step Clib LocalON
  g_HIL_Bus_Swc_Check("I_LDCU_BodySysSt1::I_LDCU_PowerMode 1"); // 预期结果 Step Check I_LDCU_BodySysSt1::I_LDCU_PowerMode 1//Local on
  g_HIL_Bus_Swc_Set("I_CDCU_LDCU_Ctrl::I_CDCU_AutoPoweroffConfig 0"); // 测试步骤 Step Set I_CDCU_LDCU_Ctrl::I_CDCU_AutoPoweroffConfig 0
  g_HIL_Gen_Swc_Wait("301 ms"); // 测试步骤 Step Wait 301 ms
  g_HIL_Bus_Swc_Set("I_CDCU_LDCU_Ctrl::I_CDCU_AutoPoweroffConfig 1"); // 测试步骤 Step Set I_CDCU_LDCU_Ctrl::I_CDCU_AutoPoweroffConfig 1//自动下电功能INACTIVE
  g_HIL_Gen_Swc_Wait("301 ms"); // 测试步骤 Step Wait 301 ms
  g_HIL_Bus_Swc_Check("I_LDCU_BodySysSt3::I_LDCU_AutoPoweroffCfgSt 0"); // 预期结果 Step Check I_LDCU_BodySysSt3::I_LDCU_AutoPoweroffCfgSt 0//inactive
  g_HIL_Bus_Swc_Set("C_CDCU_DiagnosticSt::C_CDCU_DiagnosticSt 0"); // 测试步骤 Step Set C_CDCU_DiagnosticSt::C_CDCU_DiagnosticSt 0
  g_HIL_Bus_Swc_Set("C_IPB_SpdInfoF::C_IPB_VehSpd 0"); // 测试步骤 Step Set C_IPB_SpdInfoF::C_IPB_VehSpd 0//车速小于3Km
  g_HIL_Bus_Swc_Set("C_IPB_SpdInfoF::C_IPB_VehSpdVD 1"); // 测试步骤 Step Set C_IPB_SpdInfoF::C_IPB_VehSpdVD 1//车速有效
  g_HIL_Clib_Swc_Clib_P(); // 测试步骤 Step Clib P
  g_HIL_Bus_Swc_Set("I_XPU_BodyCtrl::I_XPU_LDCU_CurMode 0"); // 测试步骤 Step Set I_XPU_BodyCtrl::I_XPU_LDCU_CurMode 0// 智能驾驶模式Invalid
  g_HIL_Bus_Swc_Set("I_CDCU_LDCU_BodyCtrl::I_CDCU_AutoPowerOffDisableReq 0"); // 测试步骤 Step Set I_CDCU_LDCU_BodyCtrl::I_CDCU_AutoPowerOffDisableReq 0//No Command
  g_HIL_Bus_Swc_Set("I_CDCU_LDCU_Ctrl::I_CDCU_AutoPoweroffConfig 0"); // 测试步骤 Step Set I_CDCU_LDCU_Ctrl::I_CDCU_AutoPoweroffConfig 0
  g_HIL_Gen_Swc_Wait("301 ms"); // 测试步骤 Step Wait 301 ms
  g_HIL_Bus_Swc_Set("I_CDCU_LDCU_Ctrl::I_CDCU_AutoPoweroffConfig 2"); // 测试步骤 Step Set I_CDCU_LDCU_Ctrl::I_CDCU_AutoPoweroffConfig 2//自动下电功能ACTIVE
  g_HIL_Gen_Swc_Wait("301 ms"); // 测试步骤 Step Wait 301 ms
  g_HIL_Bus_Swc_Check("I_LDCU_BodySysSt3::I_LDCU_AutoPoweroffCfgSt 1"); // 预期结果 Step Check I_LDCU_BodySysSt3::I_LDCU_AutoPoweroffCfgSt 1//active
  g_HIL_Bus_Swc_Set("I_CDCU_LDCU_Ctrl::I_CDCU_AutoPoweroffConfig 0"); // 测试步骤 Step Set I_CDCU_LDCU_Ctrl::I_CDCU_AutoPoweroffConfig 0
  g_HIL_Bus_Swc_Check("I_LDCU_BodySysSt3::I_LDCU_AutoPowerOffFuncSt 1"); // 预期结果 Step Check I_LDCU_BodySysSt3::I_LDCU_AutoPowerOffFuncSt 1//30min Count Down Started(T1计时）
  g_HIL_Bus_Swc_Set("VTS::VT2848_3_Ch34::DigitalOutput 1"); // 测试步骤 Step Set J_DI_FLDoorAjarSW_LS 0
  g_HIL_Bus_Swc_Check("I_LDCU_BodySysSt1::I_LDCU_PowerMode 0"); // 预期结果 Step Check I_LDCU_BodySysSt1::I_LDCU_PowerMode 0//OFF
  g_HIL_Gen_Swc_Wait("101 ms"); // 测试步骤 Step Wait 101 ms
  g_HIL_Bus_Swc_Check("I_LDCU_BodySysSt3::I_LDCU_AutoPowerOffFuncSt 3"); // 预期结果 Step Check I_LDCU_BodySysSt3::I_LDCU_AutoPowerOffFuncSt 3//Count Down Canceled（持续300ms）
  g_HIL_Bus_Swc_Set("VTS::VT2848_3_Ch34::DigitalOutput 0"); // 测试步骤 Step Set J_DI_FLDoorAjarSW_LS 1
  g_HIL_Bus_Swc_Check("I_LDCU_BodySysSt1::I_LDCU_DriverDoorAjarSt 0 1 s"); // 预期结果 Step Check I_LDCU_BodySysSt1::I_LDCU_DriverDoorAjarSt 0 1 s
}

testcase SYS_LDCU_Powermode_0087()
{
  TestDescription("延时自动下电功能激活与退出-14");
  g_HIL_XCP_Swc_Set_XCP("CalEn_Vcu_MO_Motor_laeuft 1"); // 测试步骤 Step Set_XCP CalEn_Vcu_MO_Motor_laeuft 1
  g_HIL_XCP_Swc_Set_XCP("CalVal_Vcu_MO_Motor_laeuft 0"); // 测试步骤 Step Set_XCP CalVal_Vcu_MO_Motor_laeuft 0
  g_HIL_Bus_Swc_Check("C_Motor_14::C_MO_Motor_laeuft 0"); // 预期结果 Step Check C_Motor_14::C_MO_Motor_laeuft 0//Motor_laeuft_nicht
  g_HIL_Clib_Swc_Clib_LocalON(); // 测试步骤 Step Clib LocalON
  g_HIL_Bus_Swc_Check("I_LDCU_BodySysSt1::I_LDCU_PowerMode 1"); // 预期结果 Step Check I_LDCU_BodySysSt1::I_LDCU_PowerMode 1//Local on
  g_HIL_Bus_Swc_Set("I_CDCU_LDCU_Ctrl::I_CDCU_AutoPoweroffConfig 0"); // 测试步骤 Step Set I_CDCU_LDCU_Ctrl::I_CDCU_AutoPoweroffConfig 0
  g_HIL_Gen_Swc_Wait("301 ms"); // 测试步骤 Step Wait 301 ms
  g_HIL_Bus_Swc_Set("I_CDCU_LDCU_Ctrl::I_CDCU_AutoPoweroffConfig 1"); // 测试步骤 Step Set I_CDCU_LDCU_Ctrl::I_CDCU_AutoPoweroffConfig 1//自动下电功能INACTIVE
  g_HIL_Gen_Swc_Wait("301 ms"); // 测试步骤 Step Wait 301 ms
  g_HIL_Bus_Swc_Check("I_LDCU_BodySysSt3::I_LDCU_AutoPoweroffCfgSt 0"); // 预期结果 Step Check I_LDCU_BodySysSt3::I_LDCU_AutoPoweroffCfgSt 0//inactive
  g_HIL_Bus_Swc_Set("C_CDCU_DiagnosticSt::C_CDCU_DiagnosticSt 0"); // 测试步骤 Step Set C_CDCU_DiagnosticSt::C_CDCU_DiagnosticSt 0
  g_HIL_Bus_Swc_Set("C_IPB_SpdInfoF::C_IPB_VehSpd 0"); // 测试步骤 Step Set C_IPB_SpdInfoF::C_IPB_VehSpd 0//车速小于3Km
  g_HIL_Bus_Swc_Set("C_IPB_SpdInfoF::C_IPB_VehSpdVD 1"); // 测试步骤 Step Set C_IPB_SpdInfoF::C_IPB_VehSpdVD 1//车速有效
  g_HIL_Clib_Swc_Clib_P(); // 测试步骤 Step Clib P
  g_HIL_Bus_Swc_Set("I_XPU_BodyCtrl::I_XPU_LDCU_CurMode 0"); // 测试步骤 Step Set I_XPU_BodyCtrl::I_XPU_LDCU_CurMode 0// 智能驾驶模式Invalid
  g_HIL_Bus_Swc_Set("I_CDCU_LDCU_BodyCtrl::I_CDCU_AutoPowerOffDisableReq 0"); // 测试步骤 Step Set I_CDCU_LDCU_BodyCtrl::I_CDCU_AutoPowerOffDisableReq 0//No Command
  g_HIL_Bus_Swc_Set("I_CDCU_LDCU_Ctrl::I_CDCU_AutoPoweroffConfig 0"); // 测试步骤 Step Set I_CDCU_LDCU_Ctrl::I_CDCU_AutoPoweroffConfig 0
  g_HIL_Gen_Swc_Wait("301 ms"); // 测试步骤 Step Wait 301 ms
  g_HIL_Bus_Swc_Set("I_CDCU_LDCU_Ctrl::I_CDCU_AutoPoweroffConfig 2"); // 测试步骤 Step Set I_CDCU_LDCU_Ctrl::I_CDCU_AutoPoweroffConfig 2//自动下电功能ACTIVE
  g_HIL_Gen_Swc_Wait("301 ms"); // 测试步骤 Step Wait 301 ms
  g_HIL_Bus_Swc_Check("I_LDCU_BodySysSt3::I_LDCU_AutoPoweroffCfgSt 1"); // 预期结果 Step Check I_LDCU_BodySysSt3::I_LDCU_AutoPoweroffCfgSt 1//active
  g_HIL_Bus_Swc_Set("I_CDCU_LDCU_Ctrl::I_CDCU_AutoPoweroffConfig 0"); // 测试步骤 Step Set I_CDCU_LDCU_Ctrl::I_CDCU_AutoPoweroffConfig 0
  g_HIL_Bus_Swc_Check("I_LDCU_BodySysSt3::I_LDCU_AutoPowerOffFuncSt 1"); // 预期结果 Step Check I_LDCU_BodySysSt3::I_LDCU_AutoPowerOffFuncSt 1//30min Count Down Started(T1计时）
  g_HIL_XCP_Swc_Set_XCP("CalVal_Vcu_MO_Motor_laeuft 1"); // 测试步骤 Step Set_XCP CalVal_Vcu_MO_Motor_laeuft 1//
  g_HIL_Gen_Swc_Wait("101 ms"); // 测试步骤 Step Wait 101 ms
  g_HIL_Bus_Swc_Check("I_LDCU_BodySysSt3::I_LDCU_AutoPowerOffFuncSt 3"); // 预期结果 Step Check I_LDCU_BodySysSt3::I_LDCU_AutoPowerOffFuncSt 3//Count Down Canceled（持续300ms）
  g_HIL_XCP_Swc_Set_XCP("CalVal_Vcu_MO_Motor_laeuft 0"); // 测试步骤 Step Set_XCP CalVal_Vcu_MO_Motor_laeuft 0//Motor_laeuft_nicht
  g_HIL_Bus_Swc_Check("C_Motor_14::C_MO_Motor_laeuft 0"); // 预期结果 Step Check C_Motor_14::C_MO_Motor_laeuft 0//Motor_laeuft_nicht
}

testcase SYS_LDCU_Powermode_0088()
{
  TestDescription("延时自动下电功能激活与退出-15");
  g_HIL_XCP_Swc_Set_XCP("CalEn_Vcu_MO_Motor_laeuft 1"); // 测试步骤 Step Set_XCP CalEn_Vcu_MO_Motor_laeuft 1
  g_HIL_XCP_Swc_Set_XCP("CalVal_Vcu_MO_Motor_laeuft 0"); // 测试步骤 Step Set_XCP CalVal_Vcu_MO_Motor_laeuft 0
  g_HIL_Bus_Swc_Check("C_Motor_14::C_MO_Motor_laeuft 0"); // 预期结果 Step Check C_Motor_14::C_MO_Motor_laeuft 0//Motor_laeuft_nicht
  g_HIL_Clib_Swc_Clib_RemoteON(); // 测试步骤 Step Clib RemoteON
  g_HIL_Bus_Swc_Check("I_LDCU_BodySysSt1::I_LDCU_PowerMode 2"); // 预期结果 Step Check I_LDCU_BodySysSt1::I_LDCU_PowerMode 2//RemoteON
  g_HIL_Bus_Swc_Set("I_CDCU_LDCU_Ctrl::I_CDCU_AutoPoweroffConfig 0"); // 测试步骤 Step Set I_CDCU_LDCU_Ctrl::I_CDCU_AutoPoweroffConfig 0
  g_HIL_Gen_Swc_Wait("301 ms"); // 测试步骤 Step Wait 301 ms
  g_HIL_Bus_Swc_Set("I_CDCU_LDCU_Ctrl::I_CDCU_AutoPoweroffConfig 1"); // 测试步骤 Step Set I_CDCU_LDCU_Ctrl::I_CDCU_AutoPoweroffConfig 1//自动下电功能INACTIVE
  g_HIL_Gen_Swc_Wait("301 ms"); // 测试步骤 Step Wait 301 ms
  g_HIL_Bus_Swc_Check("I_LDCU_BodySysSt3::I_LDCU_AutoPoweroffCfgSt 0"); // 预期结果 Step Check I_LDCU_BodySysSt3::I_LDCU_AutoPoweroffCfgSt 0//inactive
  g_HIL_Bus_Swc_Set("C_CDCU_DiagnosticSt::C_CDCU_DiagnosticSt 0"); // 测试步骤 Step Set C_CDCU_DiagnosticSt::C_CDCU_DiagnosticSt 0
  g_HIL_Bus_Swc_Set("C_IPB_SpdInfoF::C_IPB_VehSpd 0"); // 测试步骤 Step Set C_IPB_SpdInfoF::C_IPB_VehSpd 0//车速小于3Km
  g_HIL_Bus_Swc_Set("C_IPB_SpdInfoF::C_IPB_VehSpdVD 1"); // 测试步骤 Step Set C_IPB_SpdInfoF::C_IPB_VehSpdVD 1//车速有效
  g_HIL_Clib_Swc_Clib_P(); // 测试步骤 Step Clib P
  g_HIL_Bus_Swc_Set("I_XPU_BodyCtrl::I_XPU_LDCU_CurMode 0"); // 测试步骤 Step Set I_XPU_BodyCtrl::I_XPU_LDCU_CurMode 0// 智能驾驶模式Invalid
  g_HIL_Bus_Swc_Set("I_CDCU_LDCU_BodyCtrl::I_CDCU_AutoPowerOffDisableReq 0"); // 测试步骤 Step Set I_CDCU_LDCU_BodyCtrl::I_CDCU_AutoPowerOffDisableReq 0//No Command
  g_HIL_Bus_Swc_Set("I_CDCU_LDCU_Ctrl::I_CDCU_AutoPoweroffConfig 0"); // 测试步骤 Step Set I_CDCU_LDCU_Ctrl::I_CDCU_AutoPoweroffConfig 0
  g_HIL_Gen_Swc_Wait("301 ms"); // 测试步骤 Step Wait 301 ms
  g_HIL_Bus_Swc_Set("I_CDCU_LDCU_Ctrl::I_CDCU_AutoPoweroffConfig 2"); // 测试步骤 Step Set I_CDCU_LDCU_Ctrl::I_CDCU_AutoPoweroffConfig 2//自动下电功能ACTIVE
  g_HIL_Gen_Swc_Wait("301 ms"); // 测试步骤 Step Wait 301 ms
  g_HIL_Bus_Swc_Check("I_LDCU_BodySysSt3::I_LDCU_AutoPoweroffCfgSt 1"); // 预期结果 Step Check I_LDCU_BodySysSt3::I_LDCU_AutoPoweroffCfgSt 1//active
  g_HIL_Bus_Swc_Set("I_CDCU_LDCU_Ctrl::I_CDCU_AutoPoweroffConfig 0"); // 测试步骤 Step Set I_CDCU_LDCU_Ctrl::I_CDCU_AutoPoweroffConfig 0
  g_HIL_Bus_Swc_Check("I_LDCU_BodySysSt3::I_LDCU_AutoPowerOffFuncSt 1"); // 预期结果 Step Check I_LDCU_BodySysSt3::I_LDCU_AutoPowerOffFuncSt 1//30min Count Down Started(T1计时）
  g_HIL_Bus_Swc_Set("C_CDCU_DiagnosticSt::C_CDCU_DiagnosticSt 4"); // 测试步骤 Step Set C_CDCU_DiagnosticSt::C_CDCU_DiagnosticSt 4
  g_HIL_Gen_Swc_Wait("1000 ms"); // 测试步骤 Step Wait 1000 ms//CDCU_DiagnosticSt周期为1s
  g_HIL_Gen_Swc_Wait("301 ms"); // 测试步骤 Step Wait 301 ms
  g_HIL_Bus_Swc_Check("I_LDCU_BodySysSt3::I_LDCU_AutoPowerOffFuncSt 0"); // 预期结果 Step Check I_LDCU_BodySysSt3::I_LDCU_AutoPowerOffFuncSt 0//inactive
  g_HIL_Bus_Swc_Set("C_CDCU_DiagnosticSt::C_CDCU_DiagnosticSt 0"); // 测试步骤 Step Set C_CDCU_DiagnosticSt::C_CDCU_DiagnosticSt 0
}

testcase SYS_LDCU_Powermode_0089()
{
  TestDescription("延时自动下电功能激活与退出-16");
  g_HIL_XCP_Swc_Set_XCP("CalEn_Vcu_MO_Motor_laeuft 1"); // 测试步骤 Step Set_XCP CalEn_Vcu_MO_Motor_laeuft 1
  g_HIL_XCP_Swc_Set_XCP("CalVal_Vcu_MO_Motor_laeuft 0"); // 测试步骤 Step Set_XCP CalVal_Vcu_MO_Motor_laeuft 0
  g_HIL_Bus_Swc_Check("C_Motor_14::C_MO_Motor_laeuft 0"); // 预期结果 Step Check C_Motor_14::C_MO_Motor_laeuft 0//Motor_laeuft_nicht
  g_HIL_Clib_Swc_Clib_RemoteON(); // 测试步骤 Step Clib RemoteON
  g_HIL_Bus_Swc_Check("I_LDCU_BodySysSt1::I_LDCU_PowerMode 2"); // 预期结果 Step Check I_LDCU_BodySysSt1::I_LDCU_PowerMode 2//RemoteON
  g_HIL_Bus_Swc_Set("I_CDCU_LDCU_Ctrl::I_CDCU_AutoPoweroffConfig 0"); // 测试步骤 Step Set I_CDCU_LDCU_Ctrl::I_CDCU_AutoPoweroffConfig 0
  g_HIL_Gen_Swc_Wait("301 ms"); // 测试步骤 Step Wait 301 ms
  g_HIL_Bus_Swc_Set("I_CDCU_LDCU_Ctrl::I_CDCU_AutoPoweroffConfig 1"); // 测试步骤 Step Set I_CDCU_LDCU_Ctrl::I_CDCU_AutoPoweroffConfig 1//自动下电功能INACTIVE
  g_HIL_Gen_Swc_Wait("301 ms"); // 测试步骤 Step Wait 301 ms
  g_HIL_Bus_Swc_Check("I_LDCU_BodySysSt3::I_LDCU_AutoPoweroffCfgSt 0"); // 预期结果 Step Check I_LDCU_BodySysSt3::I_LDCU_AutoPoweroffCfgSt 0//inactive
  g_HIL_Bus_Swc_Set("C_CDCU_DiagnosticSt::C_CDCU_DiagnosticSt 0"); // 测试步骤 Step Set C_CDCU_DiagnosticSt::C_CDCU_DiagnosticSt 0
  g_HIL_Bus_Swc_Set("C_IPB_SpdInfoF::C_IPB_VehSpd 0"); // 测试步骤 Step Set C_IPB_SpdInfoF::C_IPB_VehSpd 0//车速小于3Km
  g_HIL_Bus_Swc_Set("C_IPB_SpdInfoF::C_IPB_VehSpdVD 1"); // 测试步骤 Step Set C_IPB_SpdInfoF::C_IPB_VehSpdVD 1//车速有效
  g_HIL_Clib_Swc_Clib_P(); // 测试步骤 Step Clib P
  g_HIL_Bus_Swc_Set("I_XPU_BodyCtrl::I_XPU_LDCU_CurMode 0"); // 测试步骤 Step Set I_XPU_BodyCtrl::I_XPU_LDCU_CurMode 0// 智能驾驶模式Invalid
  g_HIL_Bus_Swc_Set("I_CDCU_LDCU_BodyCtrl::I_CDCU_AutoPowerOffDisableReq 0"); // 测试步骤 Step Set I_CDCU_LDCU_BodyCtrl::I_CDCU_AutoPowerOffDisableReq 0//No Command
  g_HIL_Bus_Swc_Set("I_CDCU_LDCU_Ctrl::I_CDCU_AutoPoweroffConfig 0"); // 测试步骤 Step Set I_CDCU_LDCU_Ctrl::I_CDCU_AutoPoweroffConfig 0
  g_HIL_Gen_Swc_Wait("301 ms"); // 测试步骤 Step Wait 301 ms
  g_HIL_Bus_Swc_Set("I_CDCU_LDCU_Ctrl::I_CDCU_AutoPoweroffConfig 2"); // 测试步骤 Step Set I_CDCU_LDCU_Ctrl::I_CDCU_AutoPoweroffConfig 2//自动下电功能ACTIVE
  g_HIL_Gen_Swc_Wait("301 ms"); // 测试步骤 Step Wait 301 ms
  g_HIL_Bus_Swc_Check("I_LDCU_BodySysSt3::I_LDCU_AutoPoweroffCfgSt 1"); // 预期结果 Step Check I_LDCU_BodySysSt3::I_LDCU_AutoPoweroffCfgSt 1//active
  g_HIL_Bus_Swc_Set("I_CDCU_LDCU_Ctrl::I_CDCU_AutoPoweroffConfig 0"); // 测试步骤 Step Set I_CDCU_LDCU_Ctrl::I_CDCU_AutoPoweroffConfig 0
  g_HIL_Bus_Swc_Check("I_LDCU_BodySysSt3::I_LDCU_AutoPowerOffFuncSt 1"); // 预期结果 Step Check I_LDCU_BodySysSt3::I_LDCU_AutoPowerOffFuncSt 1//30min Count Down Started(T1计时）
  g_HIL_Bus_Swc_Set("C_CDCU_DiagnosticSt::C_CDCU_DiagnosticSt 5"); // 测试步骤 Step Set C_CDCU_DiagnosticSt::C_CDCU_DiagnosticSt 5//Normal OTA
  g_HIL_Gen_Swc_Wait("1000 ms"); // 测试步骤 Step Wait 1000 ms//CDCU_DiagnosticSt周期为1s
  g_HIL_Gen_Swc_Wait("301 ms"); // 测试步骤 Step Wait 301 ms
  g_HIL_Bus_Swc_Check("I_LDCU_BodySysSt3::I_LDCU_AutoPowerOffFuncSt 0"); // 预期结果 Step Check I_LDCU_BodySysSt3::I_LDCU_AutoPowerOffFuncSt 0//inactive
  g_HIL_Bus_Swc_Set("C_CDCU_DiagnosticSt::C_CDCU_DiagnosticSt 0"); // 测试步骤 Step Set C_CDCU_DiagnosticSt::C_CDCU_DiagnosticSt 0
}

testcase SYS_LDCU_Powermode_0090()
{
  TestDescription("延时自动下电功能激活与退出-17");
  g_HIL_XCP_Swc_Set_XCP("CalEn_Vcu_MO_Motor_laeuft 1"); // 测试步骤 Step Set_XCP CalEn_Vcu_MO_Motor_laeuft 1
  g_HIL_XCP_Swc_Set_XCP("CalVal_Vcu_MO_Motor_laeuft 0"); // 测试步骤 Step Set_XCP CalVal_Vcu_MO_Motor_laeuft 0
  g_HIL_Bus_Swc_Check("C_Motor_14::C_MO_Motor_laeuft 0"); // 预期结果 Step Check C_Motor_14::C_MO_Motor_laeuft 0//Motor_laeuft_nicht
  g_HIL_Clib_Swc_Clib_RemoteON(); // 测试步骤 Step Clib RemoteON
  g_HIL_Bus_Swc_Check("I_LDCU_BodySysSt1::I_LDCU_PowerMode 2"); // 预期结果 Step Check I_LDCU_BodySysSt1::I_LDCU_PowerMode 2//RemoteON
  g_HIL_Bus_Swc_Set("I_CDCU_LDCU_Ctrl::I_CDCU_AutoPoweroffConfig 0"); // 测试步骤 Step Set I_CDCU_LDCU_Ctrl::I_CDCU_AutoPoweroffConfig 0
  g_HIL_Gen_Swc_Wait("301 ms"); // 测试步骤 Step Wait 301 ms
  g_HIL_Bus_Swc_Set("I_CDCU_LDCU_Ctrl::I_CDCU_AutoPoweroffConfig 1"); // 测试步骤 Step Set I_CDCU_LDCU_Ctrl::I_CDCU_AutoPoweroffConfig 1//自动下电功能INACTIVE
  g_HIL_Gen_Swc_Wait("301 ms"); // 测试步骤 Step Wait 301 ms
  g_HIL_Bus_Swc_Check("I_LDCU_BodySysSt3::I_LDCU_AutoPoweroffCfgSt 0"); // 预期结果 Step Check I_LDCU_BodySysSt3::I_LDCU_AutoPoweroffCfgSt 0//inactive
  g_HIL_Bus_Swc_Set("C_CDCU_DiagnosticSt::C_CDCU_DiagnosticSt 0"); // 测试步骤 Step Set C_CDCU_DiagnosticSt::C_CDCU_DiagnosticSt 0
  g_HIL_Bus_Swc_Set("C_IPB_SpdInfoF::C_IPB_VehSpd 0"); // 测试步骤 Step Set C_IPB_SpdInfoF::C_IPB_VehSpd 0//车速小于3Km
  g_HIL_Bus_Swc_Set("C_IPB_SpdInfoF::C_IPB_VehSpdVD 1"); // 测试步骤 Step Set C_IPB_SpdInfoF::C_IPB_VehSpdVD 1//车速有效
  g_HIL_Clib_Swc_Clib_P(); // 测试步骤 Step Clib P
  g_HIL_Bus_Swc_Set("I_XPU_BodyCtrl::I_XPU_LDCU_CurMode 0"); // 测试步骤 Step Set I_XPU_BodyCtrl::I_XPU_LDCU_CurMode 0// 智能驾驶模式Invalid
  g_HIL_Bus_Swc_Set("I_CDCU_LDCU_BodyCtrl::I_CDCU_AutoPowerOffDisableReq 0"); // 测试步骤 Step Set I_CDCU_LDCU_BodyCtrl::I_CDCU_AutoPowerOffDisableReq 0//No Command
  g_HIL_Bus_Swc_Set("I_CDCU_LDCU_Ctrl::I_CDCU_AutoPoweroffConfig 0"); // 测试步骤 Step Set I_CDCU_LDCU_Ctrl::I_CDCU_AutoPoweroffConfig 0
  g_HIL_Gen_Swc_Wait("301 ms"); // 测试步骤 Step Wait 301 ms
  g_HIL_Bus_Swc_Set("I_CDCU_LDCU_Ctrl::I_CDCU_AutoPoweroffConfig 2"); // 测试步骤 Step Set I_CDCU_LDCU_Ctrl::I_CDCU_AutoPoweroffConfig 2//自动下电功能ACTIVE
  g_HIL_Gen_Swc_Wait("301 ms"); // 测试步骤 Step Wait 301 ms
  g_HIL_Bus_Swc_Check("I_LDCU_BodySysSt3::I_LDCU_AutoPoweroffCfgSt 1"); // 预期结果 Step Check I_LDCU_BodySysSt3::I_LDCU_AutoPoweroffCfgSt 1//active
  g_HIL_Bus_Swc_Set("I_CDCU_LDCU_Ctrl::I_CDCU_AutoPoweroffConfig 0"); // 测试步骤 Step Set I_CDCU_LDCU_Ctrl::I_CDCU_AutoPoweroffConfig 0
  g_HIL_Bus_Swc_Check("I_LDCU_BodySysSt3::I_LDCU_AutoPowerOffFuncSt 1"); // 预期结果 Step Check I_LDCU_BodySysSt3::I_LDCU_AutoPowerOffFuncSt 1//30min Count Down Started(T1计时）
  g_HIL_Bus_Swc_Set("C_CDCU_DiagnosticSt::C_CDCU_DiagnosticSt 6"); // 测试步骤 Step Set C_CDCU_DiagnosticSt::C_CDCU_DiagnosticSt 6//Remote Diag
  g_HIL_Gen_Swc_Wait("1000 ms"); // 测试步骤 Step Wait 1000 ms//CDCU_DiagnosticSt周期为1s
  g_HIL_Gen_Swc_Wait("301 ms"); // 测试步骤 Step Wait 301 ms
  g_HIL_Bus_Swc_Check("I_LDCU_BodySysSt3::I_LDCU_AutoPowerOffFuncSt 0"); // 预期结果 Step Check I_LDCU_BodySysSt3::I_LDCU_AutoPowerOffFuncSt 0//inactive
  g_HIL_Bus_Swc_Set("C_CDCU_DiagnosticSt::C_CDCU_DiagnosticSt 0"); // 测试步骤 Step Set C_CDCU_DiagnosticSt::C_CDCU_DiagnosticSt 0
}

testcase SYS_LDCU_Powermode_0091()
{
  TestDescription("延时自动下电功能激活与退出-18");
  g_HIL_XCP_Swc_Set_XCP("CalEn_Vcu_MO_Motor_laeuft 1"); // 测试步骤 Step Set_XCP CalEn_Vcu_MO_Motor_laeuft 1
  g_HIL_XCP_Swc_Set_XCP("CalVal_Vcu_MO_Motor_laeuft 0"); // 测试步骤 Step Set_XCP CalVal_Vcu_MO_Motor_laeuft 0
  g_HIL_Bus_Swc_Check("C_Motor_14::C_MO_Motor_laeuft 0"); // 预期结果 Step Check C_Motor_14::C_MO_Motor_laeuft 0//Motor_laeuft_nicht
  g_HIL_Clib_Swc_Clib_RemoteON(); // 测试步骤 Step Clib RemoteON
  g_HIL_Bus_Swc_Check("I_LDCU_BodySysSt1::I_LDCU_PowerMode 2"); // 预期结果 Step Check I_LDCU_BodySysSt1::I_LDCU_PowerMode 2//RemoteON
  g_HIL_Bus_Swc_Set("I_CDCU_LDCU_Ctrl::I_CDCU_AutoPoweroffConfig 0"); // 测试步骤 Step Set I_CDCU_LDCU_Ctrl::I_CDCU_AutoPoweroffConfig 0
  g_HIL_Gen_Swc_Wait("301 ms"); // 测试步骤 Step Wait 301 ms
  g_HIL_Bus_Swc_Set("I_CDCU_LDCU_Ctrl::I_CDCU_AutoPoweroffConfig 1"); // 测试步骤 Step Set I_CDCU_LDCU_Ctrl::I_CDCU_AutoPoweroffConfig 1//自动下电功能INACTIVE
  g_HIL_Gen_Swc_Wait("301 ms"); // 测试步骤 Step Wait 301 ms
  g_HIL_Bus_Swc_Check("I_LDCU_BodySysSt3::I_LDCU_AutoPoweroffCfgSt 0"); // 预期结果 Step Check I_LDCU_BodySysSt3::I_LDCU_AutoPoweroffCfgSt 0//inactive
  g_HIL_Bus_Swc_Set("C_CDCU_DiagnosticSt::C_CDCU_DiagnosticSt 0"); // 测试步骤 Step Set C_CDCU_DiagnosticSt::C_CDCU_DiagnosticSt 0
  g_HIL_Bus_Swc_Set("C_IPB_SpdInfoF::C_IPB_VehSpd 0"); // 测试步骤 Step Set C_IPB_SpdInfoF::C_IPB_VehSpd 0//车速小于3Km
  g_HIL_Bus_Swc_Set("C_IPB_SpdInfoF::C_IPB_VehSpdVD 1"); // 测试步骤 Step Set C_IPB_SpdInfoF::C_IPB_VehSpdVD 1//车速有效
  g_HIL_Clib_Swc_Clib_P(); // 测试步骤 Step Clib P
  g_HIL_Bus_Swc_Set("I_XPU_BodyCtrl::I_XPU_LDCU_CurMode 0"); // 测试步骤 Step Set I_XPU_BodyCtrl::I_XPU_LDCU_CurMode 0// 智能驾驶模式Invalid
  g_HIL_Bus_Swc_Set("I_CDCU_LDCU_BodyCtrl::I_CDCU_AutoPowerOffDisableReq 0"); // 测试步骤 Step Set I_CDCU_LDCU_BodyCtrl::I_CDCU_AutoPowerOffDisableReq 0//No Command
  g_HIL_Bus_Swc_Set("I_CDCU_LDCU_Ctrl::I_CDCU_AutoPoweroffConfig 0"); // 测试步骤 Step Set I_CDCU_LDCU_Ctrl::I_CDCU_AutoPoweroffConfig 0
  g_HIL_Gen_Swc_Wait("301 ms"); // 测试步骤 Step Wait 301 ms
  g_HIL_Bus_Swc_Set("I_CDCU_LDCU_Ctrl::I_CDCU_AutoPoweroffConfig 2"); // 测试步骤 Step Set I_CDCU_LDCU_Ctrl::I_CDCU_AutoPoweroffConfig 2//自动下电功能ACTIVE
  g_HIL_Gen_Swc_Wait("301 ms"); // 测试步骤 Step Wait 301 ms
  g_HIL_Bus_Swc_Check("I_LDCU_BodySysSt3::I_LDCU_AutoPoweroffCfgSt 1"); // 预期结果 Step Check I_LDCU_BodySysSt3::I_LDCU_AutoPoweroffCfgSt 1//active
  g_HIL_Bus_Swc_Set("I_CDCU_LDCU_Ctrl::I_CDCU_AutoPoweroffConfig 0"); // 测试步骤 Step Set I_CDCU_LDCU_Ctrl::I_CDCU_AutoPoweroffConfig 0
  g_HIL_Bus_Swc_Check("I_LDCU_BodySysSt3::I_LDCU_AutoPowerOffFuncSt 1"); // 预期结果 Step Check I_LDCU_BodySysSt3::I_LDCU_AutoPowerOffFuncSt 1//30min Count Down Started(T1计时）
  g_HIL_Bus_Swc_Set("C_IPB_SpdInfoF::C_IPB_VehSpd 3"); // 测试步骤 Step Set C_IPB_SpdInfoF::C_IPB_VehSpd 3//车速3
  g_HIL_Gen_Swc_Wait("101 ms"); // 测试步骤 Step Wait 101 ms
  g_HIL_Bus_Swc_Check("I_LDCU_BodySysSt3::I_LDCU_AutoPowerOffFuncSt 3"); // 预期结果 Step Check I_LDCU_BodySysSt3::I_LDCU_AutoPowerOffFuncSt 3//Count Down Canceled（持续300ms）
  g_HIL_Bus_Swc_Set("C_IPB_SpdInfoF::C_IPB_VehSpd 0"); // 测试步骤 Step Set C_IPB_SpdInfoF::C_IPB_VehSpd 0//车速小于3Km
  g_HIL_Bus_Swc_Check("I_LDCU_BodySysSt3::I_LDCU_AutoPowerOffFuncSt 0"); // 预期结果 Step Check I_LDCU_BodySysSt3::I_LDCU_AutoPowerOffFuncSt 0//inactive
}

testcase SYS_LDCU_Powermode_0092()
{
  TestDescription("延时自动下电功能激活与退出-19");
  g_HIL_XCP_Swc_Set_XCP("CalEn_Vcu_MO_Motor_laeuft 1"); // 测试步骤 Step Set_XCP CalEn_Vcu_MO_Motor_laeuft 1
  g_HIL_XCP_Swc_Set_XCP("CalVal_Vcu_MO_Motor_laeuft 0"); // 测试步骤 Step Set_XCP CalVal_Vcu_MO_Motor_laeuft 0
  g_HIL_Bus_Swc_Check("C_Motor_14::C_MO_Motor_laeuft 0"); // 预期结果 Step Check C_Motor_14::C_MO_Motor_laeuft 0//Motor_laeuft_nicht
  g_HIL_Clib_Swc_Clib_RemoteON(); // 测试步骤 Step Clib RemoteON
  g_HIL_Bus_Swc_Check("I_LDCU_BodySysSt1::I_LDCU_PowerMode 2"); // 预期结果 Step Check I_LDCU_BodySysSt1::I_LDCU_PowerMode 2//RemoteON
  g_HIL_Bus_Swc_Set("I_CDCU_LDCU_Ctrl::I_CDCU_AutoPoweroffConfig 0"); // 测试步骤 Step Set I_CDCU_LDCU_Ctrl::I_CDCU_AutoPoweroffConfig 0
  g_HIL_Gen_Swc_Wait("301 ms"); // 测试步骤 Step Wait 301 ms
  g_HIL_Bus_Swc_Set("I_CDCU_LDCU_Ctrl::I_CDCU_AutoPoweroffConfig 1"); // 测试步骤 Step Set I_CDCU_LDCU_Ctrl::I_CDCU_AutoPoweroffConfig 1//自动下电功能INACTIVE
  g_HIL_Gen_Swc_Wait("301 ms"); // 测试步骤 Step Wait 301 ms
  g_HIL_Bus_Swc_Check("I_LDCU_BodySysSt3::I_LDCU_AutoPoweroffCfgSt 0"); // 预期结果 Step Check I_LDCU_BodySysSt3::I_LDCU_AutoPoweroffCfgSt 0//inactive
  g_HIL_Bus_Swc_Set("C_CDCU_DiagnosticSt::C_CDCU_DiagnosticSt 0"); // 测试步骤 Step Set C_CDCU_DiagnosticSt::C_CDCU_DiagnosticSt 0
  g_HIL_Bus_Swc_Set("C_IPB_SpdInfoF::C_IPB_VehSpd 0"); // 测试步骤 Step Set C_IPB_SpdInfoF::C_IPB_VehSpd 0//车速小于3Km
  g_HIL_Bus_Swc_Set("C_IPB_SpdInfoF::C_IPB_VehSpdVD 1"); // 测试步骤 Step Set C_IPB_SpdInfoF::C_IPB_VehSpdVD 1//车速有效
  g_HIL_Clib_Swc_Clib_P(); // 测试步骤 Step Clib P
  g_HIL_Bus_Swc_Set("I_XPU_BodyCtrl::I_XPU_LDCU_CurMode 0"); // 测试步骤 Step Set I_XPU_BodyCtrl::I_XPU_LDCU_CurMode 0// 智能驾驶模式Invalid
  g_HIL_Bus_Swc_Set("I_CDCU_LDCU_BodyCtrl::I_CDCU_AutoPowerOffDisableReq 0"); // 测试步骤 Step Set I_CDCU_LDCU_BodyCtrl::I_CDCU_AutoPowerOffDisableReq 0//No Command
  g_HIL_Bus_Swc_Set("I_CDCU_LDCU_Ctrl::I_CDCU_AutoPoweroffConfig 0"); // 测试步骤 Step Set I_CDCU_LDCU_Ctrl::I_CDCU_AutoPoweroffConfig 0
  g_HIL_Gen_Swc_Wait("301 ms"); // 测试步骤 Step Wait 301 ms
  g_HIL_Bus_Swc_Set("I_CDCU_LDCU_Ctrl::I_CDCU_AutoPoweroffConfig 2"); // 测试步骤 Step Set I_CDCU_LDCU_Ctrl::I_CDCU_AutoPoweroffConfig 2//自动下电功能ACTIVE
  g_HIL_Gen_Swc_Wait("301 ms"); // 测试步骤 Step Wait 301 ms
  g_HIL_Bus_Swc_Check("I_LDCU_BodySysSt3::I_LDCU_AutoPoweroffCfgSt 1"); // 预期结果 Step Check I_LDCU_BodySysSt3::I_LDCU_AutoPoweroffCfgSt 1//active
  g_HIL_Bus_Swc_Set("I_CDCU_LDCU_Ctrl::I_CDCU_AutoPoweroffConfig 0"); // 测试步骤 Step Set I_CDCU_LDCU_Ctrl::I_CDCU_AutoPoweroffConfig 0
  g_HIL_Bus_Swc_Check("I_LDCU_BodySysSt3::I_LDCU_AutoPowerOffFuncSt 1"); // 预期结果 Step Check I_LDCU_BodySysSt3::I_LDCU_AutoPowerOffFuncSt 1//30min Count Down Started(T1计时）
  g_HIL_Bus_Swc_Set("C_IPB_SpdInfoF::C_IPB_VehSpdVD 0"); // 测试步骤 Step Set C_IPB_SpdInfoF::C_IPB_VehSpdVD 0//车速无效
  g_HIL_Gen_Swc_Wait("101 ms"); // 测试步骤 Step Wait 101 ms
  g_HIL_Bus_Swc_Check("I_LDCU_BodySysSt3::I_LDCU_AutoPowerOffFuncSt 3"); // 预期结果 Step Check I_LDCU_BodySysSt3::I_LDCU_AutoPowerOffFuncSt 3//Count Down Canceled（持续300ms）
  g_HIL_Bus_Swc_Set("C_IPB_SpdInfoF::C_IPB_VehSpdVD 1"); // 测试步骤 Step Set C_IPB_SpdInfoF::C_IPB_VehSpdVD 1//车速有效
  g_HIL_Bus_Swc_Check("I_LDCU_BodySysSt3::I_LDCU_AutoPowerOffFuncSt 0"); // 预期结果 Step Check I_LDCU_BodySysSt3::I_LDCU_AutoPowerOffFuncSt 0//inactive
}

testcase SYS_LDCU_Powermode_0093()
{
  TestDescription("延时自动下电功能激活与退出-20");
  g_HIL_XCP_Swc_Set_XCP("CalEn_Vcu_MO_Motor_laeuft 1"); // 测试步骤 Step Set_XCP CalEn_Vcu_MO_Motor_laeuft 1
  g_HIL_XCP_Swc_Set_XCP("CalVal_Vcu_MO_Motor_laeuft 0"); // 测试步骤 Step Set_XCP CalVal_Vcu_MO_Motor_laeuft 0
  g_HIL_Bus_Swc_Check("C_Motor_14::C_MO_Motor_laeuft 0"); // 预期结果 Step Check C_Motor_14::C_MO_Motor_laeuft 0//Motor_laeuft_nicht
  g_HIL_Clib_Swc_Clib_RemoteON(); // 测试步骤 Step Clib RemoteON
  g_HIL_Bus_Swc_Check("I_LDCU_BodySysSt1::I_LDCU_PowerMode 2"); // 预期结果 Step Check I_LDCU_BodySysSt1::I_LDCU_PowerMode 2//RemoteON
  g_HIL_Bus_Swc_Set("I_CDCU_LDCU_Ctrl::I_CDCU_AutoPoweroffConfig 0"); // 测试步骤 Step Set I_CDCU_LDCU_Ctrl::I_CDCU_AutoPoweroffConfig 0
  g_HIL_Gen_Swc_Wait("301 ms"); // 测试步骤 Step Wait 301 ms
  g_HIL_Bus_Swc_Set("I_CDCU_LDCU_Ctrl::I_CDCU_AutoPoweroffConfig 1"); // 测试步骤 Step Set I_CDCU_LDCU_Ctrl::I_CDCU_AutoPoweroffConfig 1//自动下电功能INACTIVE
  g_HIL_Gen_Swc_Wait("301 ms"); // 测试步骤 Step Wait 301 ms
  g_HIL_Bus_Swc_Check("I_LDCU_BodySysSt3::I_LDCU_AutoPoweroffCfgSt 0"); // 预期结果 Step Check I_LDCU_BodySysSt3::I_LDCU_AutoPoweroffCfgSt 0//inactive
  g_HIL_Bus_Swc_Set("C_CDCU_DiagnosticSt::C_CDCU_DiagnosticSt 0"); // 测试步骤 Step Set C_CDCU_DiagnosticSt::C_CDCU_DiagnosticSt 0
  g_HIL_Bus_Swc_Set("C_IPB_SpdInfoF::C_IPB_VehSpd 0"); // 测试步骤 Step Set C_IPB_SpdInfoF::C_IPB_VehSpd 0//车速小于3Km
  g_HIL_Bus_Swc_Set("C_IPB_SpdInfoF::C_IPB_VehSpdVD 1"); // 测试步骤 Step Set C_IPB_SpdInfoF::C_IPB_VehSpdVD 1//车速有效
  g_HIL_Clib_Swc_Clib_P(); // 测试步骤 Step Clib P
  g_HIL_Bus_Swc_Set("I_XPU_BodyCtrl::I_XPU_LDCU_CurMode 0"); // 测试步骤 Step Set I_XPU_BodyCtrl::I_XPU_LDCU_CurMode 0// 智能驾驶模式Invalid
  g_HIL_Bus_Swc_Set("I_CDCU_LDCU_BodyCtrl::I_CDCU_AutoPowerOffDisableReq 0"); // 测试步骤 Step Set I_CDCU_LDCU_BodyCtrl::I_CDCU_AutoPowerOffDisableReq 0//No Command
  g_HIL_Bus_Swc_Set("I_CDCU_LDCU_Ctrl::I_CDCU_AutoPoweroffConfig 0"); // 测试步骤 Step Set I_CDCU_LDCU_Ctrl::I_CDCU_AutoPoweroffConfig 0
  g_HIL_Gen_Swc_Wait("301 ms"); // 测试步骤 Step Wait 301 ms
  g_HIL_Bus_Swc_Set("I_CDCU_LDCU_Ctrl::I_CDCU_AutoPoweroffConfig 2"); // 测试步骤 Step Set I_CDCU_LDCU_Ctrl::I_CDCU_AutoPoweroffConfig 2//自动下电功能ACTIVE
  g_HIL_Gen_Swc_Wait("301 ms"); // 测试步骤 Step Wait 301 ms
  g_HIL_Bus_Swc_Check("I_LDCU_BodySysSt3::I_LDCU_AutoPoweroffCfgSt 1"); // 预期结果 Step Check I_LDCU_BodySysSt3::I_LDCU_AutoPoweroffCfgSt 1//active
  g_HIL_Bus_Swc_Set("I_CDCU_LDCU_Ctrl::I_CDCU_AutoPoweroffConfig 0"); // 测试步骤 Step Set I_CDCU_LDCU_Ctrl::I_CDCU_AutoPoweroffConfig 0
  g_HIL_Bus_Swc_Check("I_LDCU_BodySysSt3::I_LDCU_AutoPowerOffFuncSt 1"); // 预期结果 Step Check I_LDCU_BodySysSt3::I_LDCU_AutoPowerOffFuncSt 1//30min Count Down Started(T1计时）
  g_HIL_Clib_Swc_Clib_R(); // 测试步骤 Step Clib R
  g_HIL_Gen_Swc_Wait("101 ms"); // 测试步骤 Step Wait 101 ms
  g_HIL_Bus_Swc_Check("I_LDCU_BodySysSt3::I_LDCU_AutoPowerOffFuncSt 3"); // 预期结果 Step Check I_LDCU_BodySysSt3::I_LDCU_AutoPowerOffFuncSt 3//Count Down Canceled（持续300ms）
  g_HIL_Clib_Swc_Clib_P(); // 测试步骤 Step Clib P
}

testcase SYS_LDCU_Powermode_0094()
{
  TestDescription("延时自动下电功能激活与退出-21");
  g_HIL_XCP_Swc_Set_XCP("CalEn_Vcu_MO_Motor_laeuft 1"); // 测试步骤 Step Set_XCP CalEn_Vcu_MO_Motor_laeuft 1
  g_HIL_XCP_Swc_Set_XCP("CalVal_Vcu_MO_Motor_laeuft 0"); // 测试步骤 Step Set_XCP CalVal_Vcu_MO_Motor_laeuft 0
  g_HIL_Bus_Swc_Check("C_Motor_14::C_MO_Motor_laeuft 0"); // 预期结果 Step Check C_Motor_14::C_MO_Motor_laeuft 0//Motor_laeuft_nicht
  g_HIL_Clib_Swc_Clib_RemoteON(); // 测试步骤 Step Clib RemoteON
  g_HIL_Bus_Swc_Check("I_LDCU_BodySysSt1::I_LDCU_PowerMode 2"); // 预期结果 Step Check I_LDCU_BodySysSt1::I_LDCU_PowerMode 2//RemoteON
  g_HIL_Bus_Swc_Set("I_CDCU_LDCU_Ctrl::I_CDCU_AutoPoweroffConfig 0"); // 测试步骤 Step Set I_CDCU_LDCU_Ctrl::I_CDCU_AutoPoweroffConfig 0
  g_HIL_Gen_Swc_Wait("301 ms"); // 测试步骤 Step Wait 301 ms
  g_HIL_Bus_Swc_Set("I_CDCU_LDCU_Ctrl::I_CDCU_AutoPoweroffConfig 1"); // 测试步骤 Step Set I_CDCU_LDCU_Ctrl::I_CDCU_AutoPoweroffConfig 1//自动下电功能INACTIVE
  g_HIL_Gen_Swc_Wait("301 ms"); // 测试步骤 Step Wait 301 ms
  g_HIL_Bus_Swc_Check("I_LDCU_BodySysSt3::I_LDCU_AutoPoweroffCfgSt 0"); // 预期结果 Step Check I_LDCU_BodySysSt3::I_LDCU_AutoPoweroffCfgSt 0//inactive
  g_HIL_Bus_Swc_Set("C_CDCU_DiagnosticSt::C_CDCU_DiagnosticSt 0"); // 测试步骤 Step Set C_CDCU_DiagnosticSt::C_CDCU_DiagnosticSt 0
  g_HIL_Bus_Swc_Set("C_IPB_SpdInfoF::C_IPB_VehSpd 0"); // 测试步骤 Step Set C_IPB_SpdInfoF::C_IPB_VehSpd 0//车速小于3Km
  g_HIL_Bus_Swc_Set("C_IPB_SpdInfoF::C_IPB_VehSpdVD 1"); // 测试步骤 Step Set C_IPB_SpdInfoF::C_IPB_VehSpdVD 1//车速有效
  g_HIL_Clib_Swc_Clib_P(); // 测试步骤 Step Clib P
  g_HIL_Bus_Swc_Set("I_XPU_BodyCtrl::I_XPU_LDCU_CurMode 0"); // 测试步骤 Step Set I_XPU_BodyCtrl::I_XPU_LDCU_CurMode 0// 智能驾驶模式Invalid
  g_HIL_Bus_Swc_Set("I_CDCU_LDCU_BodyCtrl::I_CDCU_AutoPowerOffDisableReq 0"); // 测试步骤 Step Set I_CDCU_LDCU_BodyCtrl::I_CDCU_AutoPowerOffDisableReq 0//No Command
  g_HIL_Bus_Swc_Set("I_CDCU_LDCU_Ctrl::I_CDCU_AutoPoweroffConfig 0"); // 测试步骤 Step Set I_CDCU_LDCU_Ctrl::I_CDCU_AutoPoweroffConfig 0
  g_HIL_Gen_Swc_Wait("301 ms"); // 测试步骤 Step Wait 301 ms
  g_HIL_Bus_Swc_Set("I_CDCU_LDCU_Ctrl::I_CDCU_AutoPoweroffConfig 2"); // 测试步骤 Step Set I_CDCU_LDCU_Ctrl::I_CDCU_AutoPoweroffConfig 2//自动下电功能ACTIVE
  g_HIL_Gen_Swc_Wait("301 ms"); // 测试步骤 Step Wait 301 ms
  g_HIL_Bus_Swc_Check("I_LDCU_BodySysSt3::I_LDCU_AutoPoweroffCfgSt 1"); // 预期结果 Step Check I_LDCU_BodySysSt3::I_LDCU_AutoPoweroffCfgSt 1//active
  g_HIL_Bus_Swc_Set("I_CDCU_LDCU_Ctrl::I_CDCU_AutoPoweroffConfig 0"); // 测试步骤 Step Set I_CDCU_LDCU_Ctrl::I_CDCU_AutoPoweroffConfig 0
  g_HIL_Bus_Swc_Check("I_LDCU_BodySysSt3::I_LDCU_AutoPowerOffFuncSt 1"); // 预期结果 Step Check I_LDCU_BodySysSt3::I_LDCU_AutoPowerOffFuncSt 1//30min Count Down Started(T1计时）
  g_HIL_Clib_Swc_Clib_N(); // 测试步骤 Step Clib N
  g_HIL_Gen_Swc_Wait("101 ms"); // 测试步骤 Step Wait 101 ms
  g_HIL_Bus_Swc_Check("I_LDCU_BodySysSt3::I_LDCU_AutoPowerOffFuncSt 3"); // 预期结果 Step Check I_LDCU_BodySysSt3::I_LDCU_AutoPowerOffFuncSt 3//Count Down Canceled（持续300ms）
  g_HIL_Clib_Swc_Clib_P(); // 测试步骤 Step Clib P
}

testcase SYS_LDCU_Powermode_0095()
{
  TestDescription("延时自动下电功能激活与退出-22");
  g_HIL_XCP_Swc_Set_XCP("CalEn_Vcu_MO_Motor_laeuft 1"); // 测试步骤 Step Set_XCP CalEn_Vcu_MO_Motor_laeuft 1
  g_HIL_XCP_Swc_Set_XCP("CalVal_Vcu_MO_Motor_laeuft 0"); // 测试步骤 Step Set_XCP CalVal_Vcu_MO_Motor_laeuft 0
  g_HIL_Bus_Swc_Check("C_Motor_14::C_MO_Motor_laeuft 0"); // 预期结果 Step Check C_Motor_14::C_MO_Motor_laeuft 0//Motor_laeuft_nicht
  g_HIL_Clib_Swc_Clib_RemoteON(); // 测试步骤 Step Clib RemoteON
  g_HIL_Bus_Swc_Check("I_LDCU_BodySysSt1::I_LDCU_PowerMode 2"); // 预期结果 Step Check I_LDCU_BodySysSt1::I_LDCU_PowerMode 2//RemoteON
  g_HIL_Bus_Swc_Set("I_CDCU_LDCU_Ctrl::I_CDCU_AutoPoweroffConfig 0"); // 测试步骤 Step Set I_CDCU_LDCU_Ctrl::I_CDCU_AutoPoweroffConfig 0
  g_HIL_Gen_Swc_Wait("301 ms"); // 测试步骤 Step Wait 301 ms
  g_HIL_Bus_Swc_Set("I_CDCU_LDCU_Ctrl::I_CDCU_AutoPoweroffConfig 1"); // 测试步骤 Step Set I_CDCU_LDCU_Ctrl::I_CDCU_AutoPoweroffConfig 1//自动下电功能INACTIVE
  g_HIL_Gen_Swc_Wait("301 ms"); // 测试步骤 Step Wait 301 ms
  g_HIL_Bus_Swc_Check("I_LDCU_BodySysSt3::I_LDCU_AutoPoweroffCfgSt 0"); // 预期结果 Step Check I_LDCU_BodySysSt3::I_LDCU_AutoPoweroffCfgSt 0//inactive
  g_HIL_Bus_Swc_Set("C_CDCU_DiagnosticSt::C_CDCU_DiagnosticSt 0"); // 测试步骤 Step Set C_CDCU_DiagnosticSt::C_CDCU_DiagnosticSt 0
  g_HIL_Bus_Swc_Set("C_IPB_SpdInfoF::C_IPB_VehSpd 0"); // 测试步骤 Step Set C_IPB_SpdInfoF::C_IPB_VehSpd 0//车速小于3Km
  g_HIL_Bus_Swc_Set("C_IPB_SpdInfoF::C_IPB_VehSpdVD 1"); // 测试步骤 Step Set C_IPB_SpdInfoF::C_IPB_VehSpdVD 1//车速有效
  g_HIL_Clib_Swc_Clib_P(); // 测试步骤 Step Clib P
  g_HIL_Bus_Swc_Set("I_XPU_BodyCtrl::I_XPU_LDCU_CurMode 0"); // 测试步骤 Step Set I_XPU_BodyCtrl::I_XPU_LDCU_CurMode 0// 智能驾驶模式Invalid
  g_HIL_Bus_Swc_Set("I_CDCU_LDCU_BodyCtrl::I_CDCU_AutoPowerOffDisableReq 0"); // 测试步骤 Step Set I_CDCU_LDCU_BodyCtrl::I_CDCU_AutoPowerOffDisableReq 0//No Command
  g_HIL_Bus_Swc_Set("I_CDCU_LDCU_Ctrl::I_CDCU_AutoPoweroffConfig 0"); // 测试步骤 Step Set I_CDCU_LDCU_Ctrl::I_CDCU_AutoPoweroffConfig 0
  g_HIL_Gen_Swc_Wait("301 ms"); // 测试步骤 Step Wait 301 ms
  g_HIL_Bus_Swc_Set("I_CDCU_LDCU_Ctrl::I_CDCU_AutoPoweroffConfig 2"); // 测试步骤 Step Set I_CDCU_LDCU_Ctrl::I_CDCU_AutoPoweroffConfig 2//自动下电功能ACTIVE
  g_HIL_Gen_Swc_Wait("301 ms"); // 测试步骤 Step Wait 301 ms
  g_HIL_Bus_Swc_Check("I_LDCU_BodySysSt3::I_LDCU_AutoPoweroffCfgSt 1"); // 预期结果 Step Check I_LDCU_BodySysSt3::I_LDCU_AutoPoweroffCfgSt 1//active
  g_HIL_Bus_Swc_Set("I_CDCU_LDCU_Ctrl::I_CDCU_AutoPoweroffConfig 0"); // 测试步骤 Step Set I_CDCU_LDCU_Ctrl::I_CDCU_AutoPoweroffConfig 0
  g_HIL_Bus_Swc_Check("I_LDCU_BodySysSt3::I_LDCU_AutoPowerOffFuncSt 1"); // 预期结果 Step Check I_LDCU_BodySysSt3::I_LDCU_AutoPowerOffFuncSt 1//30min Count Down Started(T1计时）
  g_HIL_Clib_Swc_Clib_D(); // 测试步骤 Step Clib D
  g_HIL_Gen_Swc_Wait("101 ms"); // 测试步骤 Step Wait 101 ms
  g_HIL_Bus_Swc_Check("I_LDCU_BodySysSt3::I_LDCU_AutoPowerOffFuncSt 3"); // 预期结果 Step Check I_LDCU_BodySysSt3::I_LDCU_AutoPowerOffFuncSt 3//Count Down Canceled（持续300ms）
  g_HIL_Clib_Swc_Clib_P(); // 测试步骤 Step Clib P
}

testcase SYS_LDCU_Powermode_0096()
{
  TestDescription("延时自动下电功能激活与退出-23");
  g_HIL_XCP_Swc_Set_XCP("CalEn_Vcu_MO_Motor_laeuft 1"); // 测试步骤 Step Set_XCP CalEn_Vcu_MO_Motor_laeuft 1
  g_HIL_XCP_Swc_Set_XCP("CalVal_Vcu_MO_Motor_laeuft 0"); // 测试步骤 Step Set_XCP CalVal_Vcu_MO_Motor_laeuft 0
  g_HIL_Bus_Swc_Check("C_Motor_14::C_MO_Motor_laeuft 0"); // 预期结果 Step Check C_Motor_14::C_MO_Motor_laeuft 0//Motor_laeuft_nicht
  g_HIL_Clib_Swc_Clib_RemoteON(); // 测试步骤 Step Clib RemoteON
  g_HIL_Bus_Swc_Check("I_LDCU_BodySysSt1::I_LDCU_PowerMode 2"); // 预期结果 Step Check I_LDCU_BodySysSt1::I_LDCU_PowerMode 2//RemoteON
  g_HIL_Bus_Swc_Set("I_CDCU_LDCU_Ctrl::I_CDCU_AutoPoweroffConfig 0"); // 测试步骤 Step Set I_CDCU_LDCU_Ctrl::I_CDCU_AutoPoweroffConfig 0
  g_HIL_Gen_Swc_Wait("301 ms"); // 测试步骤 Step Wait 301 ms
  g_HIL_Bus_Swc_Set("I_CDCU_LDCU_Ctrl::I_CDCU_AutoPoweroffConfig 1"); // 测试步骤 Step Set I_CDCU_LDCU_Ctrl::I_CDCU_AutoPoweroffConfig 1//自动下电功能INACTIVE
  g_HIL_Gen_Swc_Wait("301 ms"); // 测试步骤 Step Wait 301 ms
  g_HIL_Bus_Swc_Check("I_LDCU_BodySysSt3::I_LDCU_AutoPoweroffCfgSt 0"); // 预期结果 Step Check I_LDCU_BodySysSt3::I_LDCU_AutoPoweroffCfgSt 0//inactive
  g_HIL_Bus_Swc_Set("C_CDCU_DiagnosticSt::C_CDCU_DiagnosticSt 0"); // 测试步骤 Step Set C_CDCU_DiagnosticSt::C_CDCU_DiagnosticSt 0
  g_HIL_Bus_Swc_Set("C_IPB_SpdInfoF::C_IPB_VehSpd 0"); // 测试步骤 Step Set C_IPB_SpdInfoF::C_IPB_VehSpd 0//车速小于3Km
  g_HIL_Bus_Swc_Set("C_IPB_SpdInfoF::C_IPB_VehSpdVD 1"); // 测试步骤 Step Set C_IPB_SpdInfoF::C_IPB_VehSpdVD 1//车速有效
  g_HIL_Clib_Swc_Clib_P(); // 测试步骤 Step Clib P
  g_HIL_Bus_Swc_Set("I_XPU_BodyCtrl::I_XPU_LDCU_CurMode 0"); // 测试步骤 Step Set I_XPU_BodyCtrl::I_XPU_LDCU_CurMode 0// 智能驾驶模式Invalid
  g_HIL_Bus_Swc_Set("I_CDCU_LDCU_BodyCtrl::I_CDCU_AutoPowerOffDisableReq 0"); // 测试步骤 Step Set I_CDCU_LDCU_BodyCtrl::I_CDCU_AutoPowerOffDisableReq 0//No Command
  g_HIL_Bus_Swc_Set("I_CDCU_LDCU_Ctrl::I_CDCU_AutoPoweroffConfig 0"); // 测试步骤 Step Set I_CDCU_LDCU_Ctrl::I_CDCU_AutoPoweroffConfig 0
  g_HIL_Gen_Swc_Wait("301 ms"); // 测试步骤 Step Wait 301 ms
  g_HIL_Bus_Swc_Set("I_CDCU_LDCU_Ctrl::I_CDCU_AutoPoweroffConfig 2"); // 测试步骤 Step Set I_CDCU_LDCU_Ctrl::I_CDCU_AutoPoweroffConfig 2//自动下电功能ACTIVE
  g_HIL_Gen_Swc_Wait("301 ms"); // 测试步骤 Step Wait 301 ms
  g_HIL_Bus_Swc_Check("I_LDCU_BodySysSt3::I_LDCU_AutoPoweroffCfgSt 1"); // 预期结果 Step Check I_LDCU_BodySysSt3::I_LDCU_AutoPoweroffCfgSt 1//active
  g_HIL_Bus_Swc_Set("I_CDCU_LDCU_Ctrl::I_CDCU_AutoPoweroffConfig 0"); // 测试步骤 Step Set I_CDCU_LDCU_Ctrl::I_CDCU_AutoPoweroffConfig 0
  g_HIL_Bus_Swc_Check("I_LDCU_BodySysSt3::I_LDCU_AutoPowerOffFuncSt 1"); // 预期结果 Step Check I_LDCU_BodySysSt3::I_LDCU_AutoPowerOffFuncSt 1//30min Count Down Started(T1计时）
  g_HIL_Bus_Swc_Set("I_XPU_BodyCtrl::I_XPU_LDCU_CurMode 1"); // 测试步骤 Step Set I_XPU_BodyCtrl::I_XPU_LDCU_CurMode 1
  g_HIL_Gen_Swc_Wait("101 ms"); // 测试步骤 Step Wait 101 ms
  g_HIL_Bus_Swc_Check("I_LDCU_BodySysSt3::I_LDCU_AutoPowerOffFuncSt 3"); // 预期结果 Step Check I_LDCU_BodySysSt3::I_LDCU_AutoPowerOffFuncSt 3//Count Down Canceled（持续300ms）
  g_HIL_Bus_Swc_Set("I_XPU_BodyCtrl::I_XPU_LDCU_CurMode 0"); // 测试步骤 Step Set I_XPU_BodyCtrl::I_XPU_LDCU_CurMode 0// 智能驾驶模式Invalid
}

testcase SYS_LDCU_Powermode_0097()
{
  TestDescription("延时自动下电功能激活与退出-24");
  g_HIL_XCP_Swc_Set_XCP("CalEn_Vcu_MO_Motor_laeuft 1"); // 测试步骤 Step Set_XCP CalEn_Vcu_MO_Motor_laeuft 1
  g_HIL_XCP_Swc_Set_XCP("CalVal_Vcu_MO_Motor_laeuft 0"); // 测试步骤 Step Set_XCP CalVal_Vcu_MO_Motor_laeuft 0
  g_HIL_Bus_Swc_Check("C_Motor_14::C_MO_Motor_laeuft 0"); // 预期结果 Step Check C_Motor_14::C_MO_Motor_laeuft 0//Motor_laeuft_nicht
  g_HIL_Clib_Swc_Clib_RemoteON(); // 测试步骤 Step Clib RemoteON
  g_HIL_Bus_Swc_Check("I_LDCU_BodySysSt1::I_LDCU_PowerMode 2"); // 预期结果 Step Check I_LDCU_BodySysSt1::I_LDCU_PowerMode 2//RemoteON
  g_HIL_Bus_Swc_Set("I_CDCU_LDCU_Ctrl::I_CDCU_AutoPoweroffConfig 0"); // 测试步骤 Step Set I_CDCU_LDCU_Ctrl::I_CDCU_AutoPoweroffConfig 0
  g_HIL_Gen_Swc_Wait("301 ms"); // 测试步骤 Step Wait 301 ms
  g_HIL_Bus_Swc_Set("I_CDCU_LDCU_Ctrl::I_CDCU_AutoPoweroffConfig 1"); // 测试步骤 Step Set I_CDCU_LDCU_Ctrl::I_CDCU_AutoPoweroffConfig 1//自动下电功能INACTIVE
  g_HIL_Gen_Swc_Wait("301 ms"); // 测试步骤 Step Wait 301 ms
  g_HIL_Bus_Swc_Check("I_LDCU_BodySysSt3::I_LDCU_AutoPoweroffCfgSt 0"); // 预期结果 Step Check I_LDCU_BodySysSt3::I_LDCU_AutoPoweroffCfgSt 0//inactive
  g_HIL_Bus_Swc_Set("C_CDCU_DiagnosticSt::C_CDCU_DiagnosticSt 0"); // 测试步骤 Step Set C_CDCU_DiagnosticSt::C_CDCU_DiagnosticSt 0
  g_HIL_Bus_Swc_Set("C_IPB_SpdInfoF::C_IPB_VehSpd 0"); // 测试步骤 Step Set C_IPB_SpdInfoF::C_IPB_VehSpd 0//车速小于3Km
  g_HIL_Bus_Swc_Set("C_IPB_SpdInfoF::C_IPB_VehSpdVD 1"); // 测试步骤 Step Set C_IPB_SpdInfoF::C_IPB_VehSpdVD 1//车速有效
  g_HIL_Clib_Swc_Clib_P(); // 测试步骤 Step Clib P
  g_HIL_Bus_Swc_Set("I_XPU_BodyCtrl::I_XPU_LDCU_CurMode 0"); // 测试步骤 Step Set I_XPU_BodyCtrl::I_XPU_LDCU_CurMode 0// 智能驾驶模式Invalid
  g_HIL_Bus_Swc_Set("I_CDCU_LDCU_BodyCtrl::I_CDCU_AutoPowerOffDisableReq 0"); // 测试步骤 Step Set I_CDCU_LDCU_BodyCtrl::I_CDCU_AutoPowerOffDisableReq 0//No Command
  g_HIL_Bus_Swc_Set("I_CDCU_LDCU_Ctrl::I_CDCU_AutoPoweroffConfig 0"); // 测试步骤 Step Set I_CDCU_LDCU_Ctrl::I_CDCU_AutoPoweroffConfig 0
  g_HIL_Gen_Swc_Wait("301 ms"); // 测试步骤 Step Wait 301 ms
  g_HIL_Bus_Swc_Set("I_CDCU_LDCU_Ctrl::I_CDCU_AutoPoweroffConfig 2"); // 测试步骤 Step Set I_CDCU_LDCU_Ctrl::I_CDCU_AutoPoweroffConfig 2//自动下电功能ACTIVE
  g_HIL_Gen_Swc_Wait("301 ms"); // 测试步骤 Step Wait 301 ms
  g_HIL_Bus_Swc_Check("I_LDCU_BodySysSt3::I_LDCU_AutoPoweroffCfgSt 1"); // 预期结果 Step Check I_LDCU_BodySysSt3::I_LDCU_AutoPoweroffCfgSt 1//active
  g_HIL_Bus_Swc_Set("I_CDCU_LDCU_Ctrl::I_CDCU_AutoPoweroffConfig 0"); // 测试步骤 Step Set I_CDCU_LDCU_Ctrl::I_CDCU_AutoPoweroffConfig 0
  g_HIL_Bus_Swc_Check("I_LDCU_BodySysSt3::I_LDCU_AutoPowerOffFuncSt 1"); // 预期结果 Step Check I_LDCU_BodySysSt3::I_LDCU_AutoPowerOffFuncSt 1//30min Count Down Started(T1计时）
  g_HIL_Bus_Swc_Set("I_XPU_BodyCtrl::I_XPU_LDCU_CurMode 2"); // 测试步骤 Step Set I_XPU_BodyCtrl::I_XPU_LDCU_CurMode 2
  g_HIL_Gen_Swc_Wait("101 ms"); // 测试步骤 Step Wait 101 ms
  g_HIL_Bus_Swc_Check("I_LDCU_BodySysSt3::I_LDCU_AutoPowerOffFuncSt 3"); // 预期结果 Step Check I_LDCU_BodySysSt3::I_LDCU_AutoPowerOffFuncSt 3//Count Down Canceled（持续300ms）
  g_HIL_Bus_Swc_Set("I_XPU_BodyCtrl::I_XPU_LDCU_CurMode 0"); // 测试步骤 Step Set I_XPU_BodyCtrl::I_XPU_LDCU_CurMode 0// 智能驾驶模式Invalid
}

testcase SYS_LDCU_Powermode_0098()
{
  TestDescription("延时自动下电功能激活与退出-25");
  g_HIL_XCP_Swc_Set_XCP("CalEn_Vcu_MO_Motor_laeuft 1"); // 测试步骤 Step Set_XCP CalEn_Vcu_MO_Motor_laeuft 1
  g_HIL_XCP_Swc_Set_XCP("CalVal_Vcu_MO_Motor_laeuft 0"); // 测试步骤 Step Set_XCP CalVal_Vcu_MO_Motor_laeuft 0
  g_HIL_Bus_Swc_Check("C_Motor_14::C_MO_Motor_laeuft 0"); // 预期结果 Step Check C_Motor_14::C_MO_Motor_laeuft 0//Motor_laeuft_nicht
  g_HIL_Clib_Swc_Clib_RemoteON(); // 测试步骤 Step Clib RemoteON
  g_HIL_Bus_Swc_Check("I_LDCU_BodySysSt1::I_LDCU_PowerMode 2"); // 预期结果 Step Check I_LDCU_BodySysSt1::I_LDCU_PowerMode 2//RemoteON
  g_HIL_Bus_Swc_Set("I_CDCU_LDCU_Ctrl::I_CDCU_AutoPoweroffConfig 0"); // 测试步骤 Step Set I_CDCU_LDCU_Ctrl::I_CDCU_AutoPoweroffConfig 0
  g_HIL_Gen_Swc_Wait("301 ms"); // 测试步骤 Step Wait 301 ms
  g_HIL_Bus_Swc_Set("I_CDCU_LDCU_Ctrl::I_CDCU_AutoPoweroffConfig 1"); // 测试步骤 Step Set I_CDCU_LDCU_Ctrl::I_CDCU_AutoPoweroffConfig 1//自动下电功能INACTIVE
  g_HIL_Gen_Swc_Wait("301 ms"); // 测试步骤 Step Wait 301 ms
  g_HIL_Bus_Swc_Check("I_LDCU_BodySysSt3::I_LDCU_AutoPoweroffCfgSt 0"); // 预期结果 Step Check I_LDCU_BodySysSt3::I_LDCU_AutoPoweroffCfgSt 0//inactive
  g_HIL_Bus_Swc_Set("C_CDCU_DiagnosticSt::C_CDCU_DiagnosticSt 0"); // 测试步骤 Step Set C_CDCU_DiagnosticSt::C_CDCU_DiagnosticSt 0
  g_HIL_Bus_Swc_Set("C_IPB_SpdInfoF::C_IPB_VehSpd 0"); // 测试步骤 Step Set C_IPB_SpdInfoF::C_IPB_VehSpd 0//车速小于3Km
  g_HIL_Bus_Swc_Set("C_IPB_SpdInfoF::C_IPB_VehSpdVD 1"); // 测试步骤 Step Set C_IPB_SpdInfoF::C_IPB_VehSpdVD 1//车速有效
  g_HIL_Clib_Swc_Clib_P(); // 测试步骤 Step Clib P
  g_HIL_Bus_Swc_Set("I_XPU_BodyCtrl::I_XPU_LDCU_CurMode 0"); // 测试步骤 Step Set I_XPU_BodyCtrl::I_XPU_LDCU_CurMode 0// 智能驾驶模式Invalid
  g_HIL_Bus_Swc_Set("I_CDCU_LDCU_BodyCtrl::I_CDCU_AutoPowerOffDisableReq 0"); // 测试步骤 Step Set I_CDCU_LDCU_BodyCtrl::I_CDCU_AutoPowerOffDisableReq 0//No Command
  g_HIL_Bus_Swc_Set("I_CDCU_LDCU_Ctrl::I_CDCU_AutoPoweroffConfig 0"); // 测试步骤 Step Set I_CDCU_LDCU_Ctrl::I_CDCU_AutoPoweroffConfig 0
  g_HIL_Gen_Swc_Wait("301 ms"); // 测试步骤 Step Wait 301 ms
  g_HIL_Bus_Swc_Set("I_CDCU_LDCU_Ctrl::I_CDCU_AutoPoweroffConfig 2"); // 测试步骤 Step Set I_CDCU_LDCU_Ctrl::I_CDCU_AutoPoweroffConfig 2//自动下电功能ACTIVE
  g_HIL_Gen_Swc_Wait("301 ms"); // 测试步骤 Step Wait 301 ms
  g_HIL_Bus_Swc_Check("I_LDCU_BodySysSt3::I_LDCU_AutoPoweroffCfgSt 1"); // 预期结果 Step Check I_LDCU_BodySysSt3::I_LDCU_AutoPoweroffCfgSt 1//active
  g_HIL_Bus_Swc_Set("I_CDCU_LDCU_Ctrl::I_CDCU_AutoPoweroffConfig 0"); // 测试步骤 Step Set I_CDCU_LDCU_Ctrl::I_CDCU_AutoPoweroffConfig 0
  g_HIL_Bus_Swc_Check("I_LDCU_BodySysSt3::I_LDCU_AutoPowerOffFuncSt 1"); // 预期结果 Step Check I_LDCU_BodySysSt3::I_LDCU_AutoPowerOffFuncSt 1//30min Count Down Started(T1计时）
  g_HIL_Bus_Swc_Set("I_XPU_BodyCtrl::I_XPU_LDCU_CurMode 0"); // 测试步骤 Step Set I_XPU_BodyCtrl::I_XPU_LDCU_CurMode 0// 智能驾驶模式Invalid
  g_HIL_Gen_Swc_Wait("101 ms"); // 测试步骤 Step Wait 101 ms
  g_HIL_Bus_Swc_Check("I_LDCU_BodySysSt3::I_LDCU_AutoPowerOffFuncSt 3"); // 预期结果 Step Check I_LDCU_BodySysSt3::I_LDCU_AutoPowerOffFuncSt 3//Count Down Canceled（持续300ms）
}

testcase SYS_LDCU_Powermode_0099()
{
  TestDescription("延时自动下电功能激活与退出-26");
  g_HIL_XCP_Swc_Set_XCP("CalEn_Vcu_MO_Motor_laeuft 1"); // 测试步骤 Step Set_XCP CalEn_Vcu_MO_Motor_laeuft 1
  g_HIL_XCP_Swc_Set_XCP("CalVal_Vcu_MO_Motor_laeuft 0"); // 测试步骤 Step Set_XCP CalVal_Vcu_MO_Motor_laeuft 0
  g_HIL_Bus_Swc_Check("C_Motor_14::C_MO_Motor_laeuft 0"); // 预期结果 Step Check C_Motor_14::C_MO_Motor_laeuft 0//Motor_laeuft_nicht
  g_HIL_Clib_Swc_Clib_RemoteON(); // 测试步骤 Step Clib RemoteON
  g_HIL_Bus_Swc_Check("I_LDCU_BodySysSt1::I_LDCU_PowerMode 2"); // 预期结果 Step Check I_LDCU_BodySysSt1::I_LDCU_PowerMode 2//RemoteON
  g_HIL_Bus_Swc_Set("I_CDCU_LDCU_Ctrl::I_CDCU_AutoPoweroffConfig 0"); // 测试步骤 Step Set I_CDCU_LDCU_Ctrl::I_CDCU_AutoPoweroffConfig 0
  g_HIL_Gen_Swc_Wait("301 ms"); // 测试步骤 Step Wait 301 ms
  g_HIL_Bus_Swc_Set("I_CDCU_LDCU_Ctrl::I_CDCU_AutoPoweroffConfig 1"); // 测试步骤 Step Set I_CDCU_LDCU_Ctrl::I_CDCU_AutoPoweroffConfig 1//自动下电功能INACTIVE
  g_HIL_Gen_Swc_Wait("301 ms"); // 测试步骤 Step Wait 301 ms
  g_HIL_Bus_Swc_Check("I_LDCU_BodySysSt3::I_LDCU_AutoPoweroffCfgSt 0"); // 预期结果 Step Check I_LDCU_BodySysSt3::I_LDCU_AutoPoweroffCfgSt 0//inactive
  g_HIL_Bus_Swc_Set("C_CDCU_DiagnosticSt::C_CDCU_DiagnosticSt 0"); // 测试步骤 Step Set C_CDCU_DiagnosticSt::C_CDCU_DiagnosticSt 0
  g_HIL_Bus_Swc_Set("C_IPB_SpdInfoF::C_IPB_VehSpd 0"); // 测试步骤 Step Set C_IPB_SpdInfoF::C_IPB_VehSpd 0//车速小于3Km
  g_HIL_Bus_Swc_Set("C_IPB_SpdInfoF::C_IPB_VehSpdVD 1"); // 测试步骤 Step Set C_IPB_SpdInfoF::C_IPB_VehSpdVD 1//车速有效
  g_HIL_Clib_Swc_Clib_P(); // 测试步骤 Step Clib P
  g_HIL_Bus_Swc_Set("I_XPU_BodyCtrl::I_XPU_LDCU_CurMode 0"); // 测试步骤 Step Set I_XPU_BodyCtrl::I_XPU_LDCU_CurMode 0// 智能驾驶模式Invalid
  g_HIL_Bus_Swc_Set("I_CDCU_LDCU_BodyCtrl::I_CDCU_AutoPowerOffDisableReq 0"); // 测试步骤 Step Set I_CDCU_LDCU_BodyCtrl::I_CDCU_AutoPowerOffDisableReq 0//No Command
  g_HIL_Bus_Swc_Set("I_CDCU_LDCU_Ctrl::I_CDCU_AutoPoweroffConfig 0"); // 测试步骤 Step Set I_CDCU_LDCU_Ctrl::I_CDCU_AutoPoweroffConfig 0
  g_HIL_Gen_Swc_Wait("301 ms"); // 测试步骤 Step Wait 301 ms
  g_HIL_Bus_Swc_Set("I_CDCU_LDCU_Ctrl::I_CDCU_AutoPoweroffConfig 2"); // 测试步骤 Step Set I_CDCU_LDCU_Ctrl::I_CDCU_AutoPoweroffConfig 2//自动下电功能ACTIVE
  g_HIL_Gen_Swc_Wait("301 ms"); // 测试步骤 Step Wait 301 ms
  g_HIL_Bus_Swc_Check("I_LDCU_BodySysSt3::I_LDCU_AutoPoweroffCfgSt 1"); // 预期结果 Step Check I_LDCU_BodySysSt3::I_LDCU_AutoPoweroffCfgSt 1//active
  g_HIL_Bus_Swc_Set("I_CDCU_LDCU_Ctrl::I_CDCU_AutoPoweroffConfig 0"); // 测试步骤 Step Set I_CDCU_LDCU_Ctrl::I_CDCU_AutoPoweroffConfig 0
  g_HIL_Bus_Swc_Check("I_LDCU_BodySysSt3::I_LDCU_AutoPowerOffFuncSt 1"); // 预期结果 Step Check I_LDCU_BodySysSt3::I_LDCU_AutoPowerOffFuncSt 1//30min Count Down Started(T1计时）
  g_HIL_Bus_Swc_Set("I_CDCU_LDCU_BodyCtrl::I_CDCU_AutoPowerOffDisableReq 1"); // 测试步骤 Step Set I_CDCU_LDCU_BodyCtrl::I_CDCU_AutoPowerOffDisableReq 1//
  g_HIL_Gen_Swc_Wait("101 ms"); // 测试步骤 Step Wait 101 ms
  g_HIL_Bus_Swc_Check("I_LDCU_BodySysSt3::I_LDCU_AutoPowerOffFuncSt 3"); // 预期结果 Step Check I_LDCU_BodySysSt3::I_LDCU_AutoPowerOffFuncSt 3//Count Down Canceled（持续300ms）
  g_HIL_Bus_Swc_Set("I_CDCU_LDCU_BodyCtrl::I_CDCU_AutoPowerOffDisableReq 0"); // 测试步骤 Step Set I_CDCU_LDCU_BodyCtrl::I_CDCU_AutoPowerOffDisableReq 0//No Command
}

testcase SYS_LDCU_Powermode_0100()
{
  TestDescription("延时自动下电功能激活与退出-27");
  g_HIL_XCP_Swc_Set_XCP("CalEn_Vcu_MO_Motor_laeuft 1"); // 测试步骤 Step Set_XCP CalEn_Vcu_MO_Motor_laeuft 1
  g_HIL_XCP_Swc_Set_XCP("CalVal_Vcu_MO_Motor_laeuft 0"); // 测试步骤 Step Set_XCP CalVal_Vcu_MO_Motor_laeuft 0
  g_HIL_Bus_Swc_Check("C_Motor_14::C_MO_Motor_laeuft 0"); // 预期结果 Step Check C_Motor_14::C_MO_Motor_laeuft 0//Motor_laeuft_nicht
  g_HIL_Clib_Swc_Clib_RemoteON(); // 测试步骤 Step Clib RemoteON
  g_HIL_Bus_Swc_Check("I_LDCU_BodySysSt1::I_LDCU_PowerMode 2"); // 预期结果 Step Check I_LDCU_BodySysSt1::I_LDCU_PowerMode 2//RemoteON
  g_HIL_Bus_Swc_Set("I_CDCU_LDCU_Ctrl::I_CDCU_AutoPoweroffConfig 0"); // 测试步骤 Step Set I_CDCU_LDCU_Ctrl::I_CDCU_AutoPoweroffConfig 0
  g_HIL_Gen_Swc_Wait("301 ms"); // 测试步骤 Step Wait 301 ms
  g_HIL_Bus_Swc_Set("I_CDCU_LDCU_Ctrl::I_CDCU_AutoPoweroffConfig 1"); // 测试步骤 Step Set I_CDCU_LDCU_Ctrl::I_CDCU_AutoPoweroffConfig 1//自动下电功能INACTIVE
  g_HIL_Gen_Swc_Wait("301 ms"); // 测试步骤 Step Wait 301 ms
  g_HIL_Bus_Swc_Check("I_LDCU_BodySysSt3::I_LDCU_AutoPoweroffCfgSt 0"); // 预期结果 Step Check I_LDCU_BodySysSt3::I_LDCU_AutoPoweroffCfgSt 0//inactive
  g_HIL_Bus_Swc_Set("C_CDCU_DiagnosticSt::C_CDCU_DiagnosticSt 0"); // 测试步骤 Step Set C_CDCU_DiagnosticSt::C_CDCU_DiagnosticSt 0
  g_HIL_Bus_Swc_Set("C_IPB_SpdInfoF::C_IPB_VehSpd 0"); // 测试步骤 Step Set C_IPB_SpdInfoF::C_IPB_VehSpd 0//车速小于3Km
  g_HIL_Bus_Swc_Set("C_IPB_SpdInfoF::C_IPB_VehSpdVD 1"); // 测试步骤 Step Set C_IPB_SpdInfoF::C_IPB_VehSpdVD 1//车速有效
  g_HIL_Clib_Swc_Clib_P(); // 测试步骤 Step Clib P
  g_HIL_Bus_Swc_Set("I_XPU_BodyCtrl::I_XPU_LDCU_CurMode 0"); // 测试步骤 Step Set I_XPU_BodyCtrl::I_XPU_LDCU_CurMode 0// 智能驾驶模式Invalid
  g_HIL_Bus_Swc_Set("I_CDCU_LDCU_BodyCtrl::I_CDCU_AutoPowerOffDisableReq 0"); // 测试步骤 Step Set I_CDCU_LDCU_BodyCtrl::I_CDCU_AutoPowerOffDisableReq 0//No Command
  g_HIL_Bus_Swc_Set("I_CDCU_LDCU_Ctrl::I_CDCU_AutoPoweroffConfig 0"); // 测试步骤 Step Set I_CDCU_LDCU_Ctrl::I_CDCU_AutoPoweroffConfig 0
  g_HIL_Gen_Swc_Wait("301 ms"); // 测试步骤 Step Wait 301 ms
  g_HIL_Bus_Swc_Set("I_CDCU_LDCU_Ctrl::I_CDCU_AutoPoweroffConfig 2"); // 测试步骤 Step Set I_CDCU_LDCU_Ctrl::I_CDCU_AutoPoweroffConfig 2//自动下电功能ACTIVE
  g_HIL_Gen_Swc_Wait("301 ms"); // 测试步骤 Step Wait 301 ms
  g_HIL_Bus_Swc_Check("I_LDCU_BodySysSt3::I_LDCU_AutoPoweroffCfgSt 1"); // 预期结果 Step Check I_LDCU_BodySysSt3::I_LDCU_AutoPoweroffCfgSt 1//active
  g_HIL_Bus_Swc_Set("I_CDCU_LDCU_Ctrl::I_CDCU_AutoPoweroffConfig 0"); // 测试步骤 Step Set I_CDCU_LDCU_Ctrl::I_CDCU_AutoPoweroffConfig 0
  g_HIL_Bus_Swc_Check("I_LDCU_BodySysSt3::I_LDCU_AutoPowerOffFuncSt 1"); // 预期结果 Step Check I_LDCU_BodySysSt3::I_LDCU_AutoPowerOffFuncSt 1//30min Count Down Started(T1计时）
  g_HIL_Bus_Swc_Set("VTS::VT2848_3_Ch34::DigitalOutput 1"); // 测试步骤 Step Set J_DI_FLDoorAjarSW_LS 0
  g_HIL_Bus_Swc_Check("I_LDCU_BodySysSt1::I_LDCU_PowerMode 0"); // 预期结果 Step Check I_LDCU_BodySysSt1::I_LDCU_PowerMode 0//OFF
  g_HIL_Gen_Swc_Wait("101 ms"); // 测试步骤 Step Wait 101 ms
  g_HIL_Bus_Swc_Check("I_LDCU_BodySysSt3::I_LDCU_AutoPowerOffFuncSt 3"); // 预期结果 Step Check I_LDCU_BodySysSt3::I_LDCU_AutoPowerOffFuncSt 3//Count Down Canceled（持续300ms）
  g_HIL_Bus_Swc_Set("VTS::VT2848_3_Ch34::DigitalOutput 0"); // 测试步骤 Step Set J_DI_FLDoorAjarSW_LS 1
  g_HIL_Bus_Swc_Check("I_LDCU_BodySysSt1::I_LDCU_DriverDoorAjarSt 0 1 s"); // 预期结果 Step Check I_LDCU_BodySysSt1::I_LDCU_DriverDoorAjarSt 0 1 s
}

testcase SYS_LDCU_Powermode_0101()
{
  TestDescription("延时自动下电功能激活与退出-28");
  g_HIL_XCP_Swc_Set_XCP("CalEn_Vcu_MO_Motor_laeuft 1"); // 测试步骤 Step Set_XCP CalEn_Vcu_MO_Motor_laeuft 1
  g_HIL_XCP_Swc_Set_XCP("CalVal_Vcu_MO_Motor_laeuft 0"); // 测试步骤 Step Set_XCP CalVal_Vcu_MO_Motor_laeuft 0
  g_HIL_Bus_Swc_Check("C_Motor_14::C_MO_Motor_laeuft 0"); // 预期结果 Step Check C_Motor_14::C_MO_Motor_laeuft 0//Motor_laeuft_nicht
  g_HIL_Clib_Swc_Clib_RemoteON(); // 测试步骤 Step Clib RemoteON
  g_HIL_Bus_Swc_Check("I_LDCU_BodySysSt1::I_LDCU_PowerMode 2"); // 预期结果 Step Check I_LDCU_BodySysSt1::I_LDCU_PowerMode 2//RemoteON
  g_HIL_Bus_Swc_Set("I_CDCU_LDCU_Ctrl::I_CDCU_AutoPoweroffConfig 0"); // 测试步骤 Step Set I_CDCU_LDCU_Ctrl::I_CDCU_AutoPoweroffConfig 0
  g_HIL_Gen_Swc_Wait("301 ms"); // 测试步骤 Step Wait 301 ms
  g_HIL_Bus_Swc_Set("I_CDCU_LDCU_Ctrl::I_CDCU_AutoPoweroffConfig 1"); // 测试步骤 Step Set I_CDCU_LDCU_Ctrl::I_CDCU_AutoPoweroffConfig 1//自动下电功能INACTIVE
  g_HIL_Gen_Swc_Wait("301 ms"); // 测试步骤 Step Wait 301 ms
  g_HIL_Bus_Swc_Check("I_LDCU_BodySysSt3::I_LDCU_AutoPoweroffCfgSt 0"); // 预期结果 Step Check I_LDCU_BodySysSt3::I_LDCU_AutoPoweroffCfgSt 0//inactive
  g_HIL_Bus_Swc_Set("C_CDCU_DiagnosticSt::C_CDCU_DiagnosticSt 0"); // 测试步骤 Step Set C_CDCU_DiagnosticSt::C_CDCU_DiagnosticSt 0
  g_HIL_Bus_Swc_Set("C_IPB_SpdInfoF::C_IPB_VehSpd 0"); // 测试步骤 Step Set C_IPB_SpdInfoF::C_IPB_VehSpd 0//车速小于3Km
  g_HIL_Bus_Swc_Set("C_IPB_SpdInfoF::C_IPB_VehSpdVD 1"); // 测试步骤 Step Set C_IPB_SpdInfoF::C_IPB_VehSpdVD 1//车速有效
  g_HIL_Clib_Swc_Clib_P(); // 测试步骤 Step Clib P
  g_HIL_Bus_Swc_Set("I_XPU_BodyCtrl::I_XPU_LDCU_CurMode 0"); // 测试步骤 Step Set I_XPU_BodyCtrl::I_XPU_LDCU_CurMode 0// 智能驾驶模式Invalid
  g_HIL_Bus_Swc_Set("I_CDCU_LDCU_BodyCtrl::I_CDCU_AutoPowerOffDisableReq 0"); // 测试步骤 Step Set I_CDCU_LDCU_BodyCtrl::I_CDCU_AutoPowerOffDisableReq 0//No Command
  g_HIL_Bus_Swc_Set("I_CDCU_LDCU_Ctrl::I_CDCU_AutoPoweroffConfig 0"); // 测试步骤 Step Set I_CDCU_LDCU_Ctrl::I_CDCU_AutoPoweroffConfig 0
  g_HIL_Gen_Swc_Wait("301 ms"); // 测试步骤 Step Wait 301 ms
  g_HIL_Bus_Swc_Set("I_CDCU_LDCU_Ctrl::I_CDCU_AutoPoweroffConfig 2"); // 测试步骤 Step Set I_CDCU_LDCU_Ctrl::I_CDCU_AutoPoweroffConfig 2//自动下电功能ACTIVE
  g_HIL_Gen_Swc_Wait("301 ms"); // 测试步骤 Step Wait 301 ms
  g_HIL_Bus_Swc_Check("I_LDCU_BodySysSt3::I_LDCU_AutoPoweroffCfgSt 1"); // 预期结果 Step Check I_LDCU_BodySysSt3::I_LDCU_AutoPoweroffCfgSt 1//active
  g_HIL_Bus_Swc_Set("I_CDCU_LDCU_Ctrl::I_CDCU_AutoPoweroffConfig 0"); // 测试步骤 Step Set I_CDCU_LDCU_Ctrl::I_CDCU_AutoPoweroffConfig 0
  g_HIL_Bus_Swc_Check("I_LDCU_BodySysSt3::I_LDCU_AutoPowerOffFuncSt 1"); // 预期结果 Step Check I_LDCU_BodySysSt3::I_LDCU_AutoPowerOffFuncSt 1//30min Count Down Started(T1计时）
  g_HIL_XCP_Swc_Set_XCP("CalVal_Vcu_MO_Motor_laeuft 1"); // 测试步骤 Step Set_XCP CalVal_Vcu_MO_Motor_laeuft 1//
  g_HIL_Gen_Swc_Wait("101 ms"); // 测试步骤 Step Wait 101 ms
  g_HIL_Bus_Swc_Check("I_LDCU_BodySysSt3::I_LDCU_AutoPowerOffFuncSt 3"); // 预期结果 Step Check I_LDCU_BodySysSt3::I_LDCU_AutoPowerOffFuncSt 3//Count Down Canceled（持续300ms）
  g_HIL_XCP_Swc_Set_XCP("CalVal_Vcu_MO_Motor_laeuft 0"); // 测试步骤 Step Set_XCP CalVal_Vcu_MO_Motor_laeuft 0//Motor_laeuft_nicht
  g_HIL_Bus_Swc_Check("C_Motor_14::C_MO_Motor_laeuft 0"); // 预期结果 Step Check C_Motor_14::C_MO_Motor_laeuft 0//Motor_laeuft_nicht
}

testcase SYS_LDCU_Powermode_0102()
{
  TestDescription("延时自动下电功能激活与退出-29");
  g_HIL_XCP_Swc_Set_XCP("CalEn_Vcu_MO_Motor_laeuft 1"); // 测试步骤 Step Set_XCP CalEn_Vcu_MO_Motor_laeuft 1
  g_HIL_XCP_Swc_Set_XCP("CalVal_Vcu_MO_Motor_laeuft 0"); // 测试步骤 Step Set_XCP CalVal_Vcu_MO_Motor_laeuft 0
  g_HIL_Bus_Swc_Check("C_Motor_14::C_MO_Motor_laeuft 0"); // 预期结果 Step Check C_Motor_14::C_MO_Motor_laeuft 0//Motor_laeuft_nicht
  g_HIL_Clib_Swc_Clib_Convenience(); // 测试步骤 Step Clib Convenience
  g_HIL_Bus_Swc_Check("I_LDCU_BodySysSt1::I_LDCU_PowerMode 3"); // 预期结果 Step Check I_LDCU_BodySysSt1::I_LDCU_PowerMode 3//Convenience
  g_HIL_Bus_Swc_Set("I_CDCU_LDCU_Ctrl::I_CDCU_AutoPoweroffConfig 0"); // 测试步骤 Step Set I_CDCU_LDCU_Ctrl::I_CDCU_AutoPoweroffConfig 0
  g_HIL_Gen_Swc_Wait("301 ms"); // 测试步骤 Step Wait 301 ms
  g_HIL_Bus_Swc_Set("I_CDCU_LDCU_Ctrl::I_CDCU_AutoPoweroffConfig 1"); // 测试步骤 Step Set I_CDCU_LDCU_Ctrl::I_CDCU_AutoPoweroffConfig 1//自动下电功能INACTIVE
  g_HIL_Gen_Swc_Wait("301 ms"); // 测试步骤 Step Wait 301 ms
  g_HIL_Bus_Swc_Check("I_LDCU_BodySysSt3::I_LDCU_AutoPoweroffCfgSt 0"); // 预期结果 Step Check I_LDCU_BodySysSt3::I_LDCU_AutoPoweroffCfgSt 0//inactive
  g_HIL_Bus_Swc_Set("C_CDCU_DiagnosticSt::C_CDCU_DiagnosticSt 0"); // 测试步骤 Step Set C_CDCU_DiagnosticSt::C_CDCU_DiagnosticSt 0
  g_HIL_Bus_Swc_Set("C_IPB_SpdInfoF::C_IPB_VehSpd 0"); // 测试步骤 Step Set C_IPB_SpdInfoF::C_IPB_VehSpd 0//车速小于3Km
  g_HIL_Bus_Swc_Set("C_IPB_SpdInfoF::C_IPB_VehSpdVD 1"); // 测试步骤 Step Set C_IPB_SpdInfoF::C_IPB_VehSpdVD 1//车速有效
  g_HIL_Clib_Swc_Clib_P(); // 测试步骤 Step Clib P
  g_HIL_Bus_Swc_Set("I_XPU_BodyCtrl::I_XPU_LDCU_CurMode 0"); // 测试步骤 Step Set I_XPU_BodyCtrl::I_XPU_LDCU_CurMode 0// 智能驾驶模式Invalid
  g_HIL_Bus_Swc_Set("I_CDCU_LDCU_BodyCtrl::I_CDCU_AutoPowerOffDisableReq 0"); // 测试步骤 Step Set I_CDCU_LDCU_BodyCtrl::I_CDCU_AutoPowerOffDisableReq 0//No Command
  g_HIL_Bus_Swc_Set("I_CDCU_LDCU_Ctrl::I_CDCU_AutoPoweroffConfig 0"); // 测试步骤 Step Set I_CDCU_LDCU_Ctrl::I_CDCU_AutoPoweroffConfig 0
  g_HIL_Gen_Swc_Wait("301 ms"); // 测试步骤 Step Wait 301 ms
  g_HIL_Bus_Swc_Set("I_CDCU_LDCU_Ctrl::I_CDCU_AutoPoweroffConfig 2"); // 测试步骤 Step Set I_CDCU_LDCU_Ctrl::I_CDCU_AutoPoweroffConfig 2//自动下电功能ACTIVE
  g_HIL_Gen_Swc_Wait("301 ms"); // 测试步骤 Step Wait 301 ms
  g_HIL_Bus_Swc_Check("I_LDCU_BodySysSt3::I_LDCU_AutoPoweroffCfgSt 1"); // 预期结果 Step Check I_LDCU_BodySysSt3::I_LDCU_AutoPoweroffCfgSt 1//active
  g_HIL_Bus_Swc_Set("I_CDCU_LDCU_Ctrl::I_CDCU_AutoPoweroffConfig 0"); // 测试步骤 Step Set I_CDCU_LDCU_Ctrl::I_CDCU_AutoPoweroffConfig 0
  g_HIL_Bus_Swc_Check("I_LDCU_BodySysSt3::I_LDCU_AutoPowerOffFuncSt 1"); // 预期结果 Step Check I_LDCU_BodySysSt3::I_LDCU_AutoPowerOffFuncSt 1//30min Count Down Started(T1计时）
  g_HIL_Bus_Swc_Set("C_CDCU_DiagnosticSt::C_CDCU_DiagnosticSt 4"); // 测试步骤 Step Set C_CDCU_DiagnosticSt::C_CDCU_DiagnosticSt 4
  g_HIL_Gen_Swc_Wait("1000 ms"); // 测试步骤 Step Wait 1000 ms//CDCU_DiagnosticSt周期为1s
  g_HIL_Gen_Swc_Wait("301 ms"); // 测试步骤 Step Wait 301 ms
  g_HIL_Bus_Swc_Check("I_LDCU_BodySysSt3::I_LDCU_AutoPowerOffFuncSt 0"); // 预期结果 Step Check I_LDCU_BodySysSt3::I_LDCU_AutoPowerOffFuncSt 0//inactive
  g_HIL_Bus_Swc_Set("C_CDCU_DiagnosticSt::C_CDCU_DiagnosticSt 0"); // 测试步骤 Step Set C_CDCU_DiagnosticSt::C_CDCU_DiagnosticSt 0
}

testcase SYS_LDCU_Powermode_0103()
{
  TestDescription("延时自动下电功能激活与退出-30");
  g_HIL_XCP_Swc_Set_XCP("CalEn_Vcu_MO_Motor_laeuft 1"); // 测试步骤 Step Set_XCP CalEn_Vcu_MO_Motor_laeuft 1
  g_HIL_XCP_Swc_Set_XCP("CalVal_Vcu_MO_Motor_laeuft 0"); // 测试步骤 Step Set_XCP CalVal_Vcu_MO_Motor_laeuft 0
  g_HIL_Bus_Swc_Check("C_Motor_14::C_MO_Motor_laeuft 0"); // 预期结果 Step Check C_Motor_14::C_MO_Motor_laeuft 0//Motor_laeuft_nicht
  g_HIL_Clib_Swc_Clib_Convenience(); // 测试步骤 Step Clib Convenience
  g_HIL_Bus_Swc_Check("I_LDCU_BodySysSt1::I_LDCU_PowerMode 3"); // 预期结果 Step Check I_LDCU_BodySysSt1::I_LDCU_PowerMode 3//Convenience
  g_HIL_Bus_Swc_Set("I_CDCU_LDCU_Ctrl::I_CDCU_AutoPoweroffConfig 0"); // 测试步骤 Step Set I_CDCU_LDCU_Ctrl::I_CDCU_AutoPoweroffConfig 0
  g_HIL_Gen_Swc_Wait("301 ms"); // 测试步骤 Step Wait 301 ms
  g_HIL_Bus_Swc_Set("I_CDCU_LDCU_Ctrl::I_CDCU_AutoPoweroffConfig 1"); // 测试步骤 Step Set I_CDCU_LDCU_Ctrl::I_CDCU_AutoPoweroffConfig 1//自动下电功能INACTIVE
  g_HIL_Gen_Swc_Wait("301 ms"); // 测试步骤 Step Wait 301 ms
  g_HIL_Bus_Swc_Check("I_LDCU_BodySysSt3::I_LDCU_AutoPoweroffCfgSt 0"); // 预期结果 Step Check I_LDCU_BodySysSt3::I_LDCU_AutoPoweroffCfgSt 0//inactive
  g_HIL_Bus_Swc_Set("C_CDCU_DiagnosticSt::C_CDCU_DiagnosticSt 0"); // 测试步骤 Step Set C_CDCU_DiagnosticSt::C_CDCU_DiagnosticSt 0
  g_HIL_Bus_Swc_Set("C_IPB_SpdInfoF::C_IPB_VehSpd 0"); // 测试步骤 Step Set C_IPB_SpdInfoF::C_IPB_VehSpd 0//车速小于3Km
  g_HIL_Bus_Swc_Set("C_IPB_SpdInfoF::C_IPB_VehSpdVD 1"); // 测试步骤 Step Set C_IPB_SpdInfoF::C_IPB_VehSpdVD 1//车速有效
  g_HIL_Clib_Swc_Clib_P(); // 测试步骤 Step Clib P
  g_HIL_Bus_Swc_Set("I_XPU_BodyCtrl::I_XPU_LDCU_CurMode 0"); // 测试步骤 Step Set I_XPU_BodyCtrl::I_XPU_LDCU_CurMode 0// 智能驾驶模式Invalid
  g_HIL_Bus_Swc_Set("I_CDCU_LDCU_BodyCtrl::I_CDCU_AutoPowerOffDisableReq 0"); // 测试步骤 Step Set I_CDCU_LDCU_BodyCtrl::I_CDCU_AutoPowerOffDisableReq 0//No Command
  g_HIL_Bus_Swc_Set("I_CDCU_LDCU_Ctrl::I_CDCU_AutoPoweroffConfig 0"); // 测试步骤 Step Set I_CDCU_LDCU_Ctrl::I_CDCU_AutoPoweroffConfig 0
  g_HIL_Gen_Swc_Wait("301 ms"); // 测试步骤 Step Wait 301 ms
  g_HIL_Bus_Swc_Set("I_CDCU_LDCU_Ctrl::I_CDCU_AutoPoweroffConfig 2"); // 测试步骤 Step Set I_CDCU_LDCU_Ctrl::I_CDCU_AutoPoweroffConfig 2//自动下电功能ACTIVE
  g_HIL_Gen_Swc_Wait("301 ms"); // 测试步骤 Step Wait 301 ms
  g_HIL_Bus_Swc_Check("I_LDCU_BodySysSt3::I_LDCU_AutoPoweroffCfgSt 1"); // 预期结果 Step Check I_LDCU_BodySysSt3::I_LDCU_AutoPoweroffCfgSt 1//active
  g_HIL_Bus_Swc_Set("I_CDCU_LDCU_Ctrl::I_CDCU_AutoPoweroffConfig 0"); // 测试步骤 Step Set I_CDCU_LDCU_Ctrl::I_CDCU_AutoPoweroffConfig 0
  g_HIL_Bus_Swc_Check("I_LDCU_BodySysSt3::I_LDCU_AutoPowerOffFuncSt 1"); // 预期结果 Step Check I_LDCU_BodySysSt3::I_LDCU_AutoPowerOffFuncSt 1//30min Count Down Started(T1计时）
  g_HIL_Bus_Swc_Set("C_CDCU_DiagnosticSt::C_CDCU_DiagnosticSt 5"); // 测试步骤 Step Set C_CDCU_DiagnosticSt::C_CDCU_DiagnosticSt 5//Normal OTA
  g_HIL_Gen_Swc_Wait("1000 ms"); // 测试步骤 Step Wait 1000 ms//CDCU_DiagnosticSt周期为1s
  g_HIL_Gen_Swc_Wait("301 ms"); // 测试步骤 Step Wait 301 ms
  g_HIL_Bus_Swc_Check("I_LDCU_BodySysSt3::I_LDCU_AutoPowerOffFuncSt 0"); // 预期结果 Step Check I_LDCU_BodySysSt3::I_LDCU_AutoPowerOffFuncSt 0//inactive
  g_HIL_Bus_Swc_Set("C_CDCU_DiagnosticSt::C_CDCU_DiagnosticSt 0"); // 测试步骤 Step Set C_CDCU_DiagnosticSt::C_CDCU_DiagnosticSt 0
}

testcase SYS_LDCU_Powermode_0104()
{
  TestDescription("延时自动下电功能激活与退出-31");
  g_HIL_XCP_Swc_Set_XCP("CalEn_Vcu_MO_Motor_laeuft 1"); // 测试步骤 Step Set_XCP CalEn_Vcu_MO_Motor_laeuft 1
  g_HIL_XCP_Swc_Set_XCP("CalVal_Vcu_MO_Motor_laeuft 0"); // 测试步骤 Step Set_XCP CalVal_Vcu_MO_Motor_laeuft 0
  g_HIL_Bus_Swc_Check("C_Motor_14::C_MO_Motor_laeuft 0"); // 预期结果 Step Check C_Motor_14::C_MO_Motor_laeuft 0//Motor_laeuft_nicht
  g_HIL_Clib_Swc_Clib_Convenience(); // 测试步骤 Step Clib Convenience
  g_HIL_Bus_Swc_Check("I_LDCU_BodySysSt1::I_LDCU_PowerMode 3"); // 预期结果 Step Check I_LDCU_BodySysSt1::I_LDCU_PowerMode 3//Convenience
  g_HIL_Bus_Swc_Set("I_CDCU_LDCU_Ctrl::I_CDCU_AutoPoweroffConfig 0"); // 测试步骤 Step Set I_CDCU_LDCU_Ctrl::I_CDCU_AutoPoweroffConfig 0
  g_HIL_Gen_Swc_Wait("301 ms"); // 测试步骤 Step Wait 301 ms
  g_HIL_Bus_Swc_Set("I_CDCU_LDCU_Ctrl::I_CDCU_AutoPoweroffConfig 1"); // 测试步骤 Step Set I_CDCU_LDCU_Ctrl::I_CDCU_AutoPoweroffConfig 1//自动下电功能INACTIVE
  g_HIL_Gen_Swc_Wait("301 ms"); // 测试步骤 Step Wait 301 ms
  g_HIL_Bus_Swc_Check("I_LDCU_BodySysSt3::I_LDCU_AutoPoweroffCfgSt 0"); // 预期结果 Step Check I_LDCU_BodySysSt3::I_LDCU_AutoPoweroffCfgSt 0//inactive
  g_HIL_Bus_Swc_Set("C_CDCU_DiagnosticSt::C_CDCU_DiagnosticSt 0"); // 测试步骤 Step Set C_CDCU_DiagnosticSt::C_CDCU_DiagnosticSt 0
  g_HIL_Bus_Swc_Set("C_IPB_SpdInfoF::C_IPB_VehSpd 0"); // 测试步骤 Step Set C_IPB_SpdInfoF::C_IPB_VehSpd 0//车速小于3Km
  g_HIL_Bus_Swc_Set("C_IPB_SpdInfoF::C_IPB_VehSpdVD 1"); // 测试步骤 Step Set C_IPB_SpdInfoF::C_IPB_VehSpdVD 1//车速有效
  g_HIL_Clib_Swc_Clib_P(); // 测试步骤 Step Clib P
  g_HIL_Bus_Swc_Set("I_XPU_BodyCtrl::I_XPU_LDCU_CurMode 0"); // 测试步骤 Step Set I_XPU_BodyCtrl::I_XPU_LDCU_CurMode 0// 智能驾驶模式Invalid
  g_HIL_Bus_Swc_Set("I_CDCU_LDCU_BodyCtrl::I_CDCU_AutoPowerOffDisableReq 0"); // 测试步骤 Step Set I_CDCU_LDCU_BodyCtrl::I_CDCU_AutoPowerOffDisableReq 0//No Command
  g_HIL_Bus_Swc_Set("I_CDCU_LDCU_Ctrl::I_CDCU_AutoPoweroffConfig 0"); // 测试步骤 Step Set I_CDCU_LDCU_Ctrl::I_CDCU_AutoPoweroffConfig 0
  g_HIL_Gen_Swc_Wait("301 ms"); // 测试步骤 Step Wait 301 ms
  g_HIL_Bus_Swc_Check("C_Motor_14::C_MO_Motor_laeuft 0"); // 预期结果 Step Check C_Motor_14::C_MO_Motor_laeuft 0//Motor_laeuft_nicht
  g_HIL_Bus_Swc_Set("I_CDCU_LDCU_Ctrl::I_CDCU_AutoPoweroffConfig 2"); // 测试步骤 Step Set I_CDCU_LDCU_Ctrl::I_CDCU_AutoPoweroffConfig 2//自动下电功能ACTIVE
  g_HIL_Gen_Swc_Wait("301 ms"); // 测试步骤 Step Wait 301 ms
  g_HIL_Bus_Swc_Check("I_LDCU_BodySysSt3::I_LDCU_AutoPoweroffCfgSt 1"); // 预期结果 Step Check I_LDCU_BodySysSt3::I_LDCU_AutoPoweroffCfgSt 1//active
  g_HIL_Bus_Swc_Set("I_CDCU_LDCU_Ctrl::I_CDCU_AutoPoweroffConfig 0"); // 测试步骤 Step Set I_CDCU_LDCU_Ctrl::I_CDCU_AutoPoweroffConfig 0
  g_HIL_Bus_Swc_Check("I_LDCU_BodySysSt3::I_LDCU_AutoPowerOffFuncSt 1"); // 预期结果 Step Check I_LDCU_BodySysSt3::I_LDCU_AutoPowerOffFuncSt 1//30min Count Down Started(T1计时）
  g_HIL_Bus_Swc_Set("C_CDCU_DiagnosticSt::C_CDCU_DiagnosticSt 6"); // 测试步骤 Step Set C_CDCU_DiagnosticSt::C_CDCU_DiagnosticSt 6//Remote Diag
  g_HIL_Gen_Swc_Wait("1000 ms"); // 测试步骤 Step Wait 1000 ms//CDCU_DiagnosticSt周期为1s
  g_HIL_Gen_Swc_Wait("301 ms"); // 测试步骤 Step Wait 301 ms
  g_HIL_Bus_Swc_Check("I_LDCU_BodySysSt3::I_LDCU_AutoPowerOffFuncSt 0"); // 预期结果 Step Check I_LDCU_BodySysSt3::I_LDCU_AutoPowerOffFuncSt 0//inactive
  g_HIL_Bus_Swc_Set("C_CDCU_DiagnosticSt::C_CDCU_DiagnosticSt 0"); // 测试步骤 Step Set C_CDCU_DiagnosticSt::C_CDCU_DiagnosticSt 0
}

testcase SYS_LDCU_Powermode_0105()
{
  TestDescription("延时自动下电功能激活与退出-32");
  g_HIL_XCP_Swc_Set_XCP("CalEn_Vcu_MO_Motor_laeuft 1"); // 测试步骤 Step Set_XCP CalEn_Vcu_MO_Motor_laeuft 1
  g_HIL_XCP_Swc_Set_XCP("CalVal_Vcu_MO_Motor_laeuft 0"); // 测试步骤 Step Set_XCP CalVal_Vcu_MO_Motor_laeuft 0
  g_HIL_Bus_Swc_Check("C_Motor_14::C_MO_Motor_laeuft 0"); // 预期结果 Step Check C_Motor_14::C_MO_Motor_laeuft 0//Motor_laeuft_nicht
  g_HIL_Clib_Swc_Clib_Convenience(); // 测试步骤 Step Clib Convenience
  g_HIL_Bus_Swc_Check("I_LDCU_BodySysSt1::I_LDCU_PowerMode 3"); // 预期结果 Step Check I_LDCU_BodySysSt1::I_LDCU_PowerMode 3//Convenience
  g_HIL_Bus_Swc_Set("I_CDCU_LDCU_Ctrl::I_CDCU_AutoPoweroffConfig 0"); // 测试步骤 Step Set I_CDCU_LDCU_Ctrl::I_CDCU_AutoPoweroffConfig 0
  g_HIL_Gen_Swc_Wait("301 ms"); // 测试步骤 Step Wait 301 ms
  g_HIL_Bus_Swc_Set("I_CDCU_LDCU_Ctrl::I_CDCU_AutoPoweroffConfig 1"); // 测试步骤 Step Set I_CDCU_LDCU_Ctrl::I_CDCU_AutoPoweroffConfig 1//自动下电功能INACTIVE
  g_HIL_Gen_Swc_Wait("301 ms"); // 测试步骤 Step Wait 301 ms
  g_HIL_Bus_Swc_Check("I_LDCU_BodySysSt3::I_LDCU_AutoPoweroffCfgSt 0"); // 预期结果 Step Check I_LDCU_BodySysSt3::I_LDCU_AutoPoweroffCfgSt 0//inactive
  g_HIL_Bus_Swc_Set("C_CDCU_DiagnosticSt::C_CDCU_DiagnosticSt 0"); // 测试步骤 Step Set C_CDCU_DiagnosticSt::C_CDCU_DiagnosticSt 0
  g_HIL_Bus_Swc_Set("C_IPB_SpdInfoF::C_IPB_VehSpd 0"); // 测试步骤 Step Set C_IPB_SpdInfoF::C_IPB_VehSpd 0//车速小于3Km
  g_HIL_Bus_Swc_Set("C_IPB_SpdInfoF::C_IPB_VehSpdVD 1"); // 测试步骤 Step Set C_IPB_SpdInfoF::C_IPB_VehSpdVD 1//车速有效
  g_HIL_Clib_Swc_Clib_P(); // 测试步骤 Step Clib P
  g_HIL_Bus_Swc_Set("I_XPU_BodyCtrl::I_XPU_LDCU_CurMode 0"); // 测试步骤 Step Set I_XPU_BodyCtrl::I_XPU_LDCU_CurMode 0// 智能驾驶模式Invalid
  g_HIL_Bus_Swc_Set("I_CDCU_LDCU_BodyCtrl::I_CDCU_AutoPowerOffDisableReq 0"); // 测试步骤 Step Set I_CDCU_LDCU_BodyCtrl::I_CDCU_AutoPowerOffDisableReq 0//No Command
  g_HIL_Bus_Swc_Set("I_CDCU_LDCU_Ctrl::I_CDCU_AutoPoweroffConfig 0"); // 测试步骤 Step Set I_CDCU_LDCU_Ctrl::I_CDCU_AutoPoweroffConfig 0
  g_HIL_Gen_Swc_Wait("301 ms"); // 测试步骤 Step Wait 301 ms
  g_HIL_Bus_Swc_Set("I_CDCU_LDCU_Ctrl::I_CDCU_AutoPoweroffConfig 2"); // 测试步骤 Step Set I_CDCU_LDCU_Ctrl::I_CDCU_AutoPoweroffConfig 2//自动下电功能ACTIVE
  g_HIL_Gen_Swc_Wait("301 ms"); // 测试步骤 Step Wait 301 ms
  g_HIL_Bus_Swc_Check("I_LDCU_BodySysSt3::I_LDCU_AutoPoweroffCfgSt 1"); // 预期结果 Step Check I_LDCU_BodySysSt3::I_LDCU_AutoPoweroffCfgSt 1//active
  g_HIL_Bus_Swc_Set("I_CDCU_LDCU_Ctrl::I_CDCU_AutoPoweroffConfig 0"); // 测试步骤 Step Set I_CDCU_LDCU_Ctrl::I_CDCU_AutoPoweroffConfig 0
  g_HIL_Bus_Swc_Check("I_LDCU_BodySysSt3::I_LDCU_AutoPowerOffFuncSt 1"); // 预期结果 Step Check I_LDCU_BodySysSt3::I_LDCU_AutoPowerOffFuncSt 1//30min Count Down Started(T1计时）
  g_HIL_Bus_Swc_Set("C_IPB_SpdInfoF::C_IPB_VehSpd 3"); // 测试步骤 Step Set C_IPB_SpdInfoF::C_IPB_VehSpd 3//车速3
  g_HIL_Gen_Swc_Wait("101 ms"); // 测试步骤 Step Wait 101 ms
  g_HIL_Bus_Swc_Check("I_LDCU_BodySysSt3::I_LDCU_AutoPowerOffFuncSt 3"); // 预期结果 Step Check I_LDCU_BodySysSt3::I_LDCU_AutoPowerOffFuncSt 3//Count Down Canceled（持续300ms）
  g_HIL_Bus_Swc_Set("C_IPB_SpdInfoF::C_IPB_VehSpd 0"); // 测试步骤 Step Set C_IPB_SpdInfoF::C_IPB_VehSpd 0//车速小于3Km
  g_HIL_Bus_Swc_Check("I_LDCU_BodySysSt3::I_LDCU_AutoPowerOffFuncSt 0"); // 预期结果 Step Check I_LDCU_BodySysSt3::I_LDCU_AutoPowerOffFuncSt 0//inactive
}

testcase SYS_LDCU_Powermode_0106()
{
  TestDescription("延时自动下电功能激活与退出-33");
  g_HIL_XCP_Swc_Set_XCP("CalEn_Vcu_MO_Motor_laeuft 1"); // 测试步骤 Step Set_XCP CalEn_Vcu_MO_Motor_laeuft 1
  g_HIL_XCP_Swc_Set_XCP("CalVal_Vcu_MO_Motor_laeuft 0"); // 测试步骤 Step Set_XCP CalVal_Vcu_MO_Motor_laeuft 0
  g_HIL_Bus_Swc_Check("C_Motor_14::C_MO_Motor_laeuft 0"); // 预期结果 Step Check C_Motor_14::C_MO_Motor_laeuft 0//Motor_laeuft_nicht
  g_HIL_Clib_Swc_Clib_Convenience(); // 测试步骤 Step Clib Convenience
  g_HIL_Bus_Swc_Check("I_LDCU_BodySysSt1::I_LDCU_PowerMode 3"); // 预期结果 Step Check I_LDCU_BodySysSt1::I_LDCU_PowerMode 3//Convenience
  g_HIL_Bus_Swc_Set("I_CDCU_LDCU_Ctrl::I_CDCU_AutoPoweroffConfig 0"); // 测试步骤 Step Set I_CDCU_LDCU_Ctrl::I_CDCU_AutoPoweroffConfig 0
  g_HIL_Gen_Swc_Wait("301 ms"); // 测试步骤 Step Wait 301 ms
  g_HIL_Bus_Swc_Set("I_CDCU_LDCU_Ctrl::I_CDCU_AutoPoweroffConfig 1"); // 测试步骤 Step Set I_CDCU_LDCU_Ctrl::I_CDCU_AutoPoweroffConfig 1//自动下电功能INACTIVE
  g_HIL_Gen_Swc_Wait("301 ms"); // 测试步骤 Step Wait 301 ms
  g_HIL_Bus_Swc_Check("I_LDCU_BodySysSt3::I_LDCU_AutoPoweroffCfgSt 0"); // 预期结果 Step Check I_LDCU_BodySysSt3::I_LDCU_AutoPoweroffCfgSt 0//inactive
  g_HIL_Bus_Swc_Set("C_CDCU_DiagnosticSt::C_CDCU_DiagnosticSt 0"); // 测试步骤 Step Set C_CDCU_DiagnosticSt::C_CDCU_DiagnosticSt 0
  g_HIL_Bus_Swc_Set("C_IPB_SpdInfoF::C_IPB_VehSpd 0"); // 测试步骤 Step Set C_IPB_SpdInfoF::C_IPB_VehSpd 0//车速小于3Km
  g_HIL_Bus_Swc_Set("C_IPB_SpdInfoF::C_IPB_VehSpdVD 1"); // 测试步骤 Step Set C_IPB_SpdInfoF::C_IPB_VehSpdVD 1//车速有效
  g_HIL_Clib_Swc_Clib_P(); // 测试步骤 Step Clib P
  g_HIL_Bus_Swc_Set("I_XPU_BodyCtrl::I_XPU_LDCU_CurMode 0"); // 测试步骤 Step Set I_XPU_BodyCtrl::I_XPU_LDCU_CurMode 0// 智能驾驶模式Invalid
  g_HIL_Bus_Swc_Set("I_CDCU_LDCU_BodyCtrl::I_CDCU_AutoPowerOffDisableReq 0"); // 测试步骤 Step Set I_CDCU_LDCU_BodyCtrl::I_CDCU_AutoPowerOffDisableReq 0//No Command
  g_HIL_Bus_Swc_Set("I_CDCU_LDCU_Ctrl::I_CDCU_AutoPoweroffConfig 0"); // 测试步骤 Step Set I_CDCU_LDCU_Ctrl::I_CDCU_AutoPoweroffConfig 0
  g_HIL_Gen_Swc_Wait("301 ms"); // 测试步骤 Step Wait 301 ms
  g_HIL_Bus_Swc_Set("I_CDCU_LDCU_Ctrl::I_CDCU_AutoPoweroffConfig 2"); // 测试步骤 Step Set I_CDCU_LDCU_Ctrl::I_CDCU_AutoPoweroffConfig 2//自动下电功能ACTIVE
  g_HIL_Gen_Swc_Wait("301 ms"); // 测试步骤 Step Wait 301 ms
  g_HIL_Bus_Swc_Check("I_LDCU_BodySysSt3::I_LDCU_AutoPoweroffCfgSt 1"); // 预期结果 Step Check I_LDCU_BodySysSt3::I_LDCU_AutoPoweroffCfgSt 1//active
  g_HIL_Bus_Swc_Set("I_CDCU_LDCU_Ctrl::I_CDCU_AutoPoweroffConfig 0"); // 测试步骤 Step Set I_CDCU_LDCU_Ctrl::I_CDCU_AutoPoweroffConfig 0
  g_HIL_Bus_Swc_Check("I_LDCU_BodySysSt3::I_LDCU_AutoPowerOffFuncSt 1"); // 预期结果 Step Check I_LDCU_BodySysSt3::I_LDCU_AutoPowerOffFuncSt 1//30min Count Down Started(T1计时）
  g_HIL_Bus_Swc_Set("C_IPB_SpdInfoF::C_IPB_VehSpdVD 0"); // 测试步骤 Step Set C_IPB_SpdInfoF::C_IPB_VehSpdVD 0//车速无效
  g_HIL_Gen_Swc_Wait("101 ms"); // 测试步骤 Step Wait 101 ms
  g_HIL_Bus_Swc_Check("I_LDCU_BodySysSt3::I_LDCU_AutoPowerOffFuncSt 3"); // 预期结果 Step Check I_LDCU_BodySysSt3::I_LDCU_AutoPowerOffFuncSt 3//Count Down Canceled（持续300ms）
  g_HIL_Bus_Swc_Set("C_IPB_SpdInfoF::C_IPB_VehSpdVD 1"); // 测试步骤 Step Set C_IPB_SpdInfoF::C_IPB_VehSpdVD 1//车速有效
  g_HIL_Bus_Swc_Check("I_LDCU_BodySysSt3::I_LDCU_AutoPowerOffFuncSt 0"); // 预期结果 Step Check I_LDCU_BodySysSt3::I_LDCU_AutoPowerOffFuncSt 0//inactive
}

testcase SYS_LDCU_Powermode_0107()
{
  TestDescription("延时自动下电功能激活与退出-34");
  g_HIL_XCP_Swc_Set_XCP("CalEn_Vcu_MO_Motor_laeuft 1"); // 测试步骤 Step Set_XCP CalEn_Vcu_MO_Motor_laeuft 1
  g_HIL_XCP_Swc_Set_XCP("CalVal_Vcu_MO_Motor_laeuft 0"); // 测试步骤 Step Set_XCP CalVal_Vcu_MO_Motor_laeuft 0
  g_HIL_Bus_Swc_Check("C_Motor_14::C_MO_Motor_laeuft 0"); // 预期结果 Step Check C_Motor_14::C_MO_Motor_laeuft 0//Motor_laeuft_nicht
  g_HIL_Clib_Swc_Clib_Convenience(); // 测试步骤 Step Clib Convenience
  g_HIL_Bus_Swc_Check("I_LDCU_BodySysSt1::I_LDCU_PowerMode 3"); // 预期结果 Step Check I_LDCU_BodySysSt1::I_LDCU_PowerMode 3//Convenience
  g_HIL_Bus_Swc_Set("I_CDCU_LDCU_Ctrl::I_CDCU_AutoPoweroffConfig 0"); // 测试步骤 Step Set I_CDCU_LDCU_Ctrl::I_CDCU_AutoPoweroffConfig 0
  g_HIL_Gen_Swc_Wait("301 ms"); // 测试步骤 Step Wait 301 ms
  g_HIL_Bus_Swc_Set("I_CDCU_LDCU_Ctrl::I_CDCU_AutoPoweroffConfig 1"); // 测试步骤 Step Set I_CDCU_LDCU_Ctrl::I_CDCU_AutoPoweroffConfig 1//自动下电功能INACTIVE
  g_HIL_Gen_Swc_Wait("301 ms"); // 测试步骤 Step Wait 301 ms
  g_HIL_Bus_Swc_Check("I_LDCU_BodySysSt3::I_LDCU_AutoPoweroffCfgSt 0"); // 预期结果 Step Check I_LDCU_BodySysSt3::I_LDCU_AutoPoweroffCfgSt 0//inactive
  g_HIL_Bus_Swc_Set("C_CDCU_DiagnosticSt::C_CDCU_DiagnosticSt 0"); // 测试步骤 Step Set C_CDCU_DiagnosticSt::C_CDCU_DiagnosticSt 0
  g_HIL_Bus_Swc_Set("C_IPB_SpdInfoF::C_IPB_VehSpd 0"); // 测试步骤 Step Set C_IPB_SpdInfoF::C_IPB_VehSpd 0//车速小于3Km
  g_HIL_Bus_Swc_Set("C_IPB_SpdInfoF::C_IPB_VehSpdVD 1"); // 测试步骤 Step Set C_IPB_SpdInfoF::C_IPB_VehSpdVD 1//车速有效
  g_HIL_Clib_Swc_Clib_P(); // 测试步骤 Step Clib P
  g_HIL_Bus_Swc_Set("I_XPU_BodyCtrl::I_XPU_LDCU_CurMode 0"); // 测试步骤 Step Set I_XPU_BodyCtrl::I_XPU_LDCU_CurMode 0// 智能驾驶模式Invalid
  g_HIL_Bus_Swc_Set("I_CDCU_LDCU_BodyCtrl::I_CDCU_AutoPowerOffDisableReq 0"); // 测试步骤 Step Set I_CDCU_LDCU_BodyCtrl::I_CDCU_AutoPowerOffDisableReq 0//No Command
  g_HIL_Bus_Swc_Set("I_CDCU_LDCU_Ctrl::I_CDCU_AutoPoweroffConfig 0"); // 测试步骤 Step Set I_CDCU_LDCU_Ctrl::I_CDCU_AutoPoweroffConfig 0
  g_HIL_Gen_Swc_Wait("301 ms"); // 测试步骤 Step Wait 301 ms
  g_HIL_Bus_Swc_Set("I_CDCU_LDCU_Ctrl::I_CDCU_AutoPoweroffConfig 2"); // 测试步骤 Step Set I_CDCU_LDCU_Ctrl::I_CDCU_AutoPoweroffConfig 2//自动下电功能ACTIVE
  g_HIL_Gen_Swc_Wait("301 ms"); // 测试步骤 Step Wait 301 ms
  g_HIL_Bus_Swc_Check("I_LDCU_BodySysSt3::I_LDCU_AutoPoweroffCfgSt 1"); // 预期结果 Step Check I_LDCU_BodySysSt3::I_LDCU_AutoPoweroffCfgSt 1//active
  g_HIL_Bus_Swc_Set("I_CDCU_LDCU_Ctrl::I_CDCU_AutoPoweroffConfig 0"); // 测试步骤 Step Set I_CDCU_LDCU_Ctrl::I_CDCU_AutoPoweroffConfig 0
  g_HIL_Bus_Swc_Check("I_LDCU_BodySysSt3::I_LDCU_AutoPowerOffFuncSt 1"); // 预期结果 Step Check I_LDCU_BodySysSt3::I_LDCU_AutoPowerOffFuncSt 1//30min Count Down Started(T1计时）
  g_HIL_Clib_Swc_Clib_R(); // 测试步骤 Step Clib R
  g_HIL_Gen_Swc_Wait("101 ms"); // 测试步骤 Step Wait 101 ms
  g_HIL_Bus_Swc_Check("I_LDCU_BodySysSt3::I_LDCU_AutoPowerOffFuncSt 3"); // 预期结果 Step Check I_LDCU_BodySysSt3::I_LDCU_AutoPowerOffFuncSt 3//Count Down Canceled（持续300ms）
  g_HIL_Clib_Swc_Clib_P(); // 测试步骤 Step Clib P
}

testcase SYS_LDCU_Powermode_0108()
{
  TestDescription("延时自动下电功能激活与退出-35");
  g_HIL_XCP_Swc_Set_XCP("CalEn_Vcu_MO_Motor_laeuft 1"); // 测试步骤 Step Set_XCP CalEn_Vcu_MO_Motor_laeuft 1
  g_HIL_XCP_Swc_Set_XCP("CalVal_Vcu_MO_Motor_laeuft 0"); // 测试步骤 Step Set_XCP CalVal_Vcu_MO_Motor_laeuft 0
  g_HIL_Bus_Swc_Check("C_Motor_14::C_MO_Motor_laeuft 0"); // 预期结果 Step Check C_Motor_14::C_MO_Motor_laeuft 0//Motor_laeuft_nicht
  g_HIL_Clib_Swc_Clib_Convenience(); // 测试步骤 Step Clib Convenience
  g_HIL_Bus_Swc_Check("I_LDCU_BodySysSt1::I_LDCU_PowerMode 3"); // 预期结果 Step Check I_LDCU_BodySysSt1::I_LDCU_PowerMode 3//Convenience
  g_HIL_Bus_Swc_Set("I_CDCU_LDCU_Ctrl::I_CDCU_AutoPoweroffConfig 0"); // 测试步骤 Step Set I_CDCU_LDCU_Ctrl::I_CDCU_AutoPoweroffConfig 0
  g_HIL_Gen_Swc_Wait("301 ms"); // 测试步骤 Step Wait 301 ms
  g_HIL_Bus_Swc_Set("I_CDCU_LDCU_Ctrl::I_CDCU_AutoPoweroffConfig 1"); // 测试步骤 Step Set I_CDCU_LDCU_Ctrl::I_CDCU_AutoPoweroffConfig 1//自动下电功能INACTIVE
  g_HIL_Gen_Swc_Wait("301 ms"); // 测试步骤 Step Wait 301 ms
  g_HIL_Bus_Swc_Check("I_LDCU_BodySysSt3::I_LDCU_AutoPoweroffCfgSt 0"); // 预期结果 Step Check I_LDCU_BodySysSt3::I_LDCU_AutoPoweroffCfgSt 0//inactive
  g_HIL_Bus_Swc_Set("C_CDCU_DiagnosticSt::C_CDCU_DiagnosticSt 0"); // 测试步骤 Step Set C_CDCU_DiagnosticSt::C_CDCU_DiagnosticSt 0
  g_HIL_Bus_Swc_Set("C_IPB_SpdInfoF::C_IPB_VehSpd 0"); // 测试步骤 Step Set C_IPB_SpdInfoF::C_IPB_VehSpd 0//车速小于3Km
  g_HIL_Bus_Swc_Set("C_IPB_SpdInfoF::C_IPB_VehSpdVD 1"); // 测试步骤 Step Set C_IPB_SpdInfoF::C_IPB_VehSpdVD 1//车速有效
  g_HIL_Clib_Swc_Clib_P(); // 测试步骤 Step Clib P
  g_HIL_Bus_Swc_Set("I_XPU_BodyCtrl::I_XPU_LDCU_CurMode 0"); // 测试步骤 Step Set I_XPU_BodyCtrl::I_XPU_LDCU_CurMode 0// 智能驾驶模式Invalid
  g_HIL_Bus_Swc_Set("I_CDCU_LDCU_BodyCtrl::I_CDCU_AutoPowerOffDisableReq 0"); // 测试步骤 Step Set I_CDCU_LDCU_BodyCtrl::I_CDCU_AutoPowerOffDisableReq 0//No Command
  g_HIL_Bus_Swc_Set("I_CDCU_LDCU_Ctrl::I_CDCU_AutoPoweroffConfig 0"); // 测试步骤 Step Set I_CDCU_LDCU_Ctrl::I_CDCU_AutoPoweroffConfig 0
  g_HIL_Gen_Swc_Wait("301 ms"); // 测试步骤 Step Wait 301 ms
  g_HIL_Bus_Swc_Set("I_CDCU_LDCU_Ctrl::I_CDCU_AutoPoweroffConfig 2"); // 测试步骤 Step Set I_CDCU_LDCU_Ctrl::I_CDCU_AutoPoweroffConfig 2//自动下电功能ACTIVE
  g_HIL_Gen_Swc_Wait("301 ms"); // 测试步骤 Step Wait 301 ms
  g_HIL_Bus_Swc_Check("I_LDCU_BodySysSt3::I_LDCU_AutoPoweroffCfgSt 1"); // 预期结果 Step Check I_LDCU_BodySysSt3::I_LDCU_AutoPoweroffCfgSt 1//active
  g_HIL_Bus_Swc_Set("I_CDCU_LDCU_Ctrl::I_CDCU_AutoPoweroffConfig 0"); // 测试步骤 Step Set I_CDCU_LDCU_Ctrl::I_CDCU_AutoPoweroffConfig 0
  g_HIL_Bus_Swc_Check("I_LDCU_BodySysSt3::I_LDCU_AutoPowerOffFuncSt 1"); // 预期结果 Step Check I_LDCU_BodySysSt3::I_LDCU_AutoPowerOffFuncSt 1//30min Count Down Started(T1计时）
  g_HIL_Clib_Swc_Clib_N(); // 测试步骤 Step Clib N
  g_HIL_Gen_Swc_Wait("101 ms"); // 测试步骤 Step Wait 101 ms
  g_HIL_Bus_Swc_Check("I_LDCU_BodySysSt3::I_LDCU_AutoPowerOffFuncSt 3"); // 预期结果 Step Check I_LDCU_BodySysSt3::I_LDCU_AutoPowerOffFuncSt 3//Count Down Canceled（持续300ms）
  g_HIL_Clib_Swc_Clib_P(); // 测试步骤 Step Clib P
}

testcase SYS_LDCU_Powermode_0109()
{
  TestDescription("延时自动下电功能激活与退出-36");
  g_HIL_XCP_Swc_Set_XCP("CalEn_Vcu_MO_Motor_laeuft 1"); // 测试步骤 Step Set_XCP CalEn_Vcu_MO_Motor_laeuft 1
  g_HIL_XCP_Swc_Set_XCP("CalVal_Vcu_MO_Motor_laeuft 0"); // 测试步骤 Step Set_XCP CalVal_Vcu_MO_Motor_laeuft 0
  g_HIL_Bus_Swc_Check("C_Motor_14::C_MO_Motor_laeuft 0"); // 预期结果 Step Check C_Motor_14::C_MO_Motor_laeuft 0//Motor_laeuft_nicht
  g_HIL_Clib_Swc_Clib_Convenience(); // 测试步骤 Step Clib Convenience
  g_HIL_Bus_Swc_Check("I_LDCU_BodySysSt1::I_LDCU_PowerMode 3"); // 预期结果 Step Check I_LDCU_BodySysSt1::I_LDCU_PowerMode 3//Convenience
  g_HIL_Bus_Swc_Set("I_CDCU_LDCU_Ctrl::I_CDCU_AutoPoweroffConfig 0"); // 测试步骤 Step Set I_CDCU_LDCU_Ctrl::I_CDCU_AutoPoweroffConfig 0
  g_HIL_Gen_Swc_Wait("301 ms"); // 测试步骤 Step Wait 301 ms
  g_HIL_Bus_Swc_Set("I_CDCU_LDCU_Ctrl::I_CDCU_AutoPoweroffConfig 1"); // 测试步骤 Step Set I_CDCU_LDCU_Ctrl::I_CDCU_AutoPoweroffConfig 1//自动下电功能INACTIVE
  g_HIL_Gen_Swc_Wait("301 ms"); // 测试步骤 Step Wait 301 ms
  g_HIL_Bus_Swc_Check("I_LDCU_BodySysSt3::I_LDCU_AutoPoweroffCfgSt 0"); // 预期结果 Step Check I_LDCU_BodySysSt3::I_LDCU_AutoPoweroffCfgSt 0//inactive
  g_HIL_Bus_Swc_Set("C_CDCU_DiagnosticSt::C_CDCU_DiagnosticSt 0"); // 测试步骤 Step Set C_CDCU_DiagnosticSt::C_CDCU_DiagnosticSt 0
  g_HIL_Bus_Swc_Set("C_IPB_SpdInfoF::C_IPB_VehSpd 0"); // 测试步骤 Step Set C_IPB_SpdInfoF::C_IPB_VehSpd 0//车速小于3Km
  g_HIL_Bus_Swc_Set("C_IPB_SpdInfoF::C_IPB_VehSpdVD 1"); // 测试步骤 Step Set C_IPB_SpdInfoF::C_IPB_VehSpdVD 1//车速有效
  g_HIL_Clib_Swc_Clib_P(); // 测试步骤 Step Clib P
  g_HIL_Bus_Swc_Set("I_XPU_BodyCtrl::I_XPU_LDCU_CurMode 0"); // 测试步骤 Step Set I_XPU_BodyCtrl::I_XPU_LDCU_CurMode 0// 智能驾驶模式Invalid
  g_HIL_Bus_Swc_Set("I_CDCU_LDCU_BodyCtrl::I_CDCU_AutoPowerOffDisableReq 0"); // 测试步骤 Step Set I_CDCU_LDCU_BodyCtrl::I_CDCU_AutoPowerOffDisableReq 0//No Command
  g_HIL_Bus_Swc_Set("I_CDCU_LDCU_Ctrl::I_CDCU_AutoPoweroffConfig 0"); // 测试步骤 Step Set I_CDCU_LDCU_Ctrl::I_CDCU_AutoPoweroffConfig 0
  g_HIL_Gen_Swc_Wait("301 ms"); // 测试步骤 Step Wait 301 ms
  g_HIL_Bus_Swc_Set("I_CDCU_LDCU_Ctrl::I_CDCU_AutoPoweroffConfig 2"); // 测试步骤 Step Set I_CDCU_LDCU_Ctrl::I_CDCU_AutoPoweroffConfig 2//自动下电功能ACTIVE
  g_HIL_Gen_Swc_Wait("301 ms"); // 测试步骤 Step Wait 301 ms
  g_HIL_Bus_Swc_Check("I_LDCU_BodySysSt3::I_LDCU_AutoPoweroffCfgSt 1"); // 预期结果 Step Check I_LDCU_BodySysSt3::I_LDCU_AutoPoweroffCfgSt 1//active
  g_HIL_Bus_Swc_Set("I_CDCU_LDCU_Ctrl::I_CDCU_AutoPoweroffConfig 0"); // 测试步骤 Step Set I_CDCU_LDCU_Ctrl::I_CDCU_AutoPoweroffConfig 0
  g_HIL_Bus_Swc_Check("I_LDCU_BodySysSt3::I_LDCU_AutoPowerOffFuncSt 1"); // 预期结果 Step Check I_LDCU_BodySysSt3::I_LDCU_AutoPowerOffFuncSt 1//30min Count Down Started(T1计时）
  g_HIL_Clib_Swc_Clib_D(); // 测试步骤 Step Clib D
  g_HIL_Gen_Swc_Wait("101 ms"); // 测试步骤 Step Wait 101 ms
  g_HIL_Bus_Swc_Check("I_LDCU_BodySysSt3::I_LDCU_AutoPowerOffFuncSt 3"); // 预期结果 Step Check I_LDCU_BodySysSt3::I_LDCU_AutoPowerOffFuncSt 3//Count Down Canceled（持续300ms）
  g_HIL_Clib_Swc_Clib_P(); // 测试步骤 Step Clib P
}

testcase SYS_LDCU_Powermode_0110()
{
  TestDescription("延时自动下电功能激活与退出-37");
  g_HIL_XCP_Swc_Set_XCP("CalEn_Vcu_MO_Motor_laeuft 1"); // 测试步骤 Step Set_XCP CalEn_Vcu_MO_Motor_laeuft 1
  g_HIL_XCP_Swc_Set_XCP("CalVal_Vcu_MO_Motor_laeuft 0"); // 测试步骤 Step Set_XCP CalVal_Vcu_MO_Motor_laeuft 0
  g_HIL_Bus_Swc_Check("C_Motor_14::C_MO_Motor_laeuft 0"); // 预期结果 Step Check C_Motor_14::C_MO_Motor_laeuft 0//Motor_laeuft_nicht
  g_HIL_Clib_Swc_Clib_Convenience(); // 测试步骤 Step Clib Convenience
  g_HIL_Bus_Swc_Check("I_LDCU_BodySysSt1::I_LDCU_PowerMode 3"); // 预期结果 Step Check I_LDCU_BodySysSt1::I_LDCU_PowerMode 3//Convenience
  g_HIL_Bus_Swc_Set("I_CDCU_LDCU_Ctrl::I_CDCU_AutoPoweroffConfig 0"); // 测试步骤 Step Set I_CDCU_LDCU_Ctrl::I_CDCU_AutoPoweroffConfig 0
  g_HIL_Gen_Swc_Wait("301 ms"); // 测试步骤 Step Wait 301 ms
  g_HIL_Bus_Swc_Set("I_CDCU_LDCU_Ctrl::I_CDCU_AutoPoweroffConfig 1"); // 测试步骤 Step Set I_CDCU_LDCU_Ctrl::I_CDCU_AutoPoweroffConfig 1//自动下电功能INACTIVE
  g_HIL_Gen_Swc_Wait("301 ms"); // 测试步骤 Step Wait 301 ms
  g_HIL_Bus_Swc_Check("I_LDCU_BodySysSt3::I_LDCU_AutoPoweroffCfgSt 0"); // 预期结果 Step Check I_LDCU_BodySysSt3::I_LDCU_AutoPoweroffCfgSt 0//inactive
  g_HIL_Bus_Swc_Set("C_CDCU_DiagnosticSt::C_CDCU_DiagnosticSt 0"); // 测试步骤 Step Set C_CDCU_DiagnosticSt::C_CDCU_DiagnosticSt 0
  g_HIL_Bus_Swc_Set("C_IPB_SpdInfoF::C_IPB_VehSpd 0"); // 测试步骤 Step Set C_IPB_SpdInfoF::C_IPB_VehSpd 0//车速小于3Km
  g_HIL_Bus_Swc_Set("C_IPB_SpdInfoF::C_IPB_VehSpdVD 1"); // 测试步骤 Step Set C_IPB_SpdInfoF::C_IPB_VehSpdVD 1//车速有效
  g_HIL_Clib_Swc_Clib_P(); // 测试步骤 Step Clib P
  g_HIL_Bus_Swc_Set("I_XPU_BodyCtrl::I_XPU_LDCU_CurMode 0"); // 测试步骤 Step Set I_XPU_BodyCtrl::I_XPU_LDCU_CurMode 0// 智能驾驶模式Invalid
  g_HIL_Bus_Swc_Set("I_CDCU_LDCU_BodyCtrl::I_CDCU_AutoPowerOffDisableReq 0"); // 测试步骤 Step Set I_CDCU_LDCU_BodyCtrl::I_CDCU_AutoPowerOffDisableReq 0//No Command
  g_HIL_Bus_Swc_Set("I_CDCU_LDCU_Ctrl::I_CDCU_AutoPoweroffConfig 0"); // 测试步骤 Step Set I_CDCU_LDCU_Ctrl::I_CDCU_AutoPoweroffConfig 0
  g_HIL_Gen_Swc_Wait("301 ms"); // 测试步骤 Step Wait 301 ms
  g_HIL_Bus_Swc_Set("I_CDCU_LDCU_Ctrl::I_CDCU_AutoPoweroffConfig 2"); // 测试步骤 Step Set I_CDCU_LDCU_Ctrl::I_CDCU_AutoPoweroffConfig 2//自动下电功能ACTIVE
  g_HIL_Gen_Swc_Wait("301 ms"); // 测试步骤 Step Wait 301 ms
  g_HIL_Bus_Swc_Check("I_LDCU_BodySysSt3::I_LDCU_AutoPoweroffCfgSt 1"); // 预期结果 Step Check I_LDCU_BodySysSt3::I_LDCU_AutoPoweroffCfgSt 1//active
  g_HIL_Bus_Swc_Set("I_CDCU_LDCU_Ctrl::I_CDCU_AutoPoweroffConfig 0"); // 测试步骤 Step Set I_CDCU_LDCU_Ctrl::I_CDCU_AutoPoweroffConfig 0
  g_HIL_Bus_Swc_Check("I_LDCU_BodySysSt3::I_LDCU_AutoPowerOffFuncSt 1"); // 预期结果 Step Check I_LDCU_BodySysSt3::I_LDCU_AutoPowerOffFuncSt 1//30min Count Down Started(T1计时）
  g_HIL_Bus_Swc_Set("I_XPU_BodyCtrl::I_XPU_LDCU_CurMode 1"); // 测试步骤 Step Set I_XPU_BodyCtrl::I_XPU_LDCU_CurMode 1
  g_HIL_Gen_Swc_Wait("101 ms"); // 测试步骤 Step Wait 101 ms
  g_HIL_Bus_Swc_Check("I_LDCU_BodySysSt3::I_LDCU_AutoPowerOffFuncSt 3"); // 预期结果 Step Check I_LDCU_BodySysSt3::I_LDCU_AutoPowerOffFuncSt 3//Count Down Canceled（持续300ms）
  g_HIL_Bus_Swc_Set("I_XPU_BodyCtrl::I_XPU_LDCU_CurMode 0"); // 测试步骤 Step Set I_XPU_BodyCtrl::I_XPU_LDCU_CurMode 0// 智能驾驶模式Invalid
}

testcase SYS_LDCU_Powermode_0111()
{
  TestDescription("延时自动下电功能激活与退出-38");
  g_HIL_XCP_Swc_Set_XCP("CalEn_Vcu_MO_Motor_laeuft 1"); // 测试步骤 Step Set_XCP CalEn_Vcu_MO_Motor_laeuft 1
  g_HIL_XCP_Swc_Set_XCP("CalVal_Vcu_MO_Motor_laeuft 0"); // 测试步骤 Step Set_XCP CalVal_Vcu_MO_Motor_laeuft 0
  g_HIL_Bus_Swc_Check("C_Motor_14::C_MO_Motor_laeuft 0"); // 预期结果 Step Check C_Motor_14::C_MO_Motor_laeuft 0//Motor_laeuft_nicht
  g_HIL_Clib_Swc_Clib_Convenience(); // 测试步骤 Step Clib Convenience
  g_HIL_Bus_Swc_Check("I_LDCU_BodySysSt1::I_LDCU_PowerMode 3"); // 预期结果 Step Check I_LDCU_BodySysSt1::I_LDCU_PowerMode 3//Convenience
  g_HIL_Bus_Swc_Set("I_CDCU_LDCU_Ctrl::I_CDCU_AutoPoweroffConfig 0"); // 测试步骤 Step Set I_CDCU_LDCU_Ctrl::I_CDCU_AutoPoweroffConfig 0
  g_HIL_Gen_Swc_Wait("301 ms"); // 测试步骤 Step Wait 301 ms
  g_HIL_Bus_Swc_Set("I_CDCU_LDCU_Ctrl::I_CDCU_AutoPoweroffConfig 1"); // 测试步骤 Step Set I_CDCU_LDCU_Ctrl::I_CDCU_AutoPoweroffConfig 1//自动下电功能INACTIVE
  g_HIL_Gen_Swc_Wait("301 ms"); // 测试步骤 Step Wait 301 ms
  g_HIL_Bus_Swc_Check("I_LDCU_BodySysSt3::I_LDCU_AutoPoweroffCfgSt 0"); // 预期结果 Step Check I_LDCU_BodySysSt3::I_LDCU_AutoPoweroffCfgSt 0//inactive
  g_HIL_Bus_Swc_Set("C_CDCU_DiagnosticSt::C_CDCU_DiagnosticSt 0"); // 测试步骤 Step Set C_CDCU_DiagnosticSt::C_CDCU_DiagnosticSt 0
  g_HIL_Bus_Swc_Set("C_IPB_SpdInfoF::C_IPB_VehSpd 0"); // 测试步骤 Step Set C_IPB_SpdInfoF::C_IPB_VehSpd 0//车速小于3Km
  g_HIL_Bus_Swc_Set("C_IPB_SpdInfoF::C_IPB_VehSpdVD 1"); // 测试步骤 Step Set C_IPB_SpdInfoF::C_IPB_VehSpdVD 1//车速有效
  g_HIL_Clib_Swc_Clib_P(); // 测试步骤 Step Clib P
  g_HIL_Bus_Swc_Set("I_XPU_BodyCtrl::I_XPU_LDCU_CurMode 0"); // 测试步骤 Step Set I_XPU_BodyCtrl::I_XPU_LDCU_CurMode 0// 智能驾驶模式Invalid
  g_HIL_Bus_Swc_Set("I_CDCU_LDCU_BodyCtrl::I_CDCU_AutoPowerOffDisableReq 0"); // 测试步骤 Step Set I_CDCU_LDCU_BodyCtrl::I_CDCU_AutoPowerOffDisableReq 0//No Command
  g_HIL_Bus_Swc_Set("I_CDCU_LDCU_Ctrl::I_CDCU_AutoPoweroffConfig 0"); // 测试步骤 Step Set I_CDCU_LDCU_Ctrl::I_CDCU_AutoPoweroffConfig 0
  g_HIL_Gen_Swc_Wait("301 ms"); // 测试步骤 Step Wait 301 ms
  g_HIL_Bus_Swc_Set("I_CDCU_LDCU_Ctrl::I_CDCU_AutoPoweroffConfig 2"); // 测试步骤 Step Set I_CDCU_LDCU_Ctrl::I_CDCU_AutoPoweroffConfig 2//自动下电功能ACTIVE
  g_HIL_Gen_Swc_Wait("301 ms"); // 测试步骤 Step Wait 301 ms
  g_HIL_Bus_Swc_Check("I_LDCU_BodySysSt3::I_LDCU_AutoPoweroffCfgSt 1"); // 预期结果 Step Check I_LDCU_BodySysSt3::I_LDCU_AutoPoweroffCfgSt 1//active
  g_HIL_Bus_Swc_Set("I_CDCU_LDCU_Ctrl::I_CDCU_AutoPoweroffConfig 0"); // 测试步骤 Step Set I_CDCU_LDCU_Ctrl::I_CDCU_AutoPoweroffConfig 0
  g_HIL_Bus_Swc_Check("I_LDCU_BodySysSt3::I_LDCU_AutoPowerOffFuncSt 1"); // 预期结果 Step Check I_LDCU_BodySysSt3::I_LDCU_AutoPowerOffFuncSt 1//30min Count Down Started(T1计时）
  g_HIL_Bus_Swc_Set("I_XPU_BodyCtrl::I_XPU_LDCU_CurMode 2"); // 测试步骤 Step Set I_XPU_BodyCtrl::I_XPU_LDCU_CurMode 2
  g_HIL_Gen_Swc_Wait("101 ms"); // 测试步骤 Step Wait 101 ms
  g_HIL_Bus_Swc_Check("I_LDCU_BodySysSt3::I_LDCU_AutoPowerOffFuncSt 3"); // 预期结果 Step Check I_LDCU_BodySysSt3::I_LDCU_AutoPowerOffFuncSt 3//Count Down Canceled（持续300ms）
  g_HIL_Bus_Swc_Set("I_XPU_BodyCtrl::I_XPU_LDCU_CurMode 0"); // 测试步骤 Step Set I_XPU_BodyCtrl::I_XPU_LDCU_CurMode 0// 智能驾驶模式Invalid
}

testcase SYS_LDCU_Powermode_0112()
{
  TestDescription("延时自动下电功能激活与退出-39");
  g_HIL_XCP_Swc_Set_XCP("CalEn_Vcu_MO_Motor_laeuft 1"); // 测试步骤 Step Set_XCP CalEn_Vcu_MO_Motor_laeuft 1
  g_HIL_XCP_Swc_Set_XCP("CalVal_Vcu_MO_Motor_laeuft 0"); // 测试步骤 Step Set_XCP CalVal_Vcu_MO_Motor_laeuft 0
  g_HIL_Bus_Swc_Check("C_Motor_14::C_MO_Motor_laeuft 0"); // 预期结果 Step Check C_Motor_14::C_MO_Motor_laeuft 0//Motor_laeuft_nicht
  g_HIL_Clib_Swc_Clib_Convenience(); // 测试步骤 Step Clib Convenience
  g_HIL_Bus_Swc_Check("I_LDCU_BodySysSt1::I_LDCU_PowerMode 3"); // 预期结果 Step Check I_LDCU_BodySysSt1::I_LDCU_PowerMode 3//Convenience
  g_HIL_Bus_Swc_Set("I_CDCU_LDCU_Ctrl::I_CDCU_AutoPoweroffConfig 0"); // 测试步骤 Step Set I_CDCU_LDCU_Ctrl::I_CDCU_AutoPoweroffConfig 0
  g_HIL_Gen_Swc_Wait("301 ms"); // 测试步骤 Step Wait 301 ms
  g_HIL_Bus_Swc_Set("I_CDCU_LDCU_Ctrl::I_CDCU_AutoPoweroffConfig 1"); // 测试步骤 Step Set I_CDCU_LDCU_Ctrl::I_CDCU_AutoPoweroffConfig 1//自动下电功能INACTIVE
  g_HIL_Gen_Swc_Wait("301 ms"); // 测试步骤 Step Wait 301 ms
  g_HIL_Bus_Swc_Check("I_LDCU_BodySysSt3::I_LDCU_AutoPoweroffCfgSt 0"); // 预期结果 Step Check I_LDCU_BodySysSt3::I_LDCU_AutoPoweroffCfgSt 0//inactive
  g_HIL_Bus_Swc_Set("C_CDCU_DiagnosticSt::C_CDCU_DiagnosticSt 0"); // 测试步骤 Step Set C_CDCU_DiagnosticSt::C_CDCU_DiagnosticSt 0
  g_HIL_Bus_Swc_Set("C_IPB_SpdInfoF::C_IPB_VehSpd 0"); // 测试步骤 Step Set C_IPB_SpdInfoF::C_IPB_VehSpd 0//车速小于3Km
  g_HIL_Bus_Swc_Set("C_IPB_SpdInfoF::C_IPB_VehSpdVD 1"); // 测试步骤 Step Set C_IPB_SpdInfoF::C_IPB_VehSpdVD 1//车速有效
  g_HIL_Clib_Swc_Clib_P(); // 测试步骤 Step Clib P
  g_HIL_Bus_Swc_Set("I_XPU_BodyCtrl::I_XPU_LDCU_CurMode 0"); // 测试步骤 Step Set I_XPU_BodyCtrl::I_XPU_LDCU_CurMode 0// 智能驾驶模式Invalid
  g_HIL_Bus_Swc_Set("I_CDCU_LDCU_BodyCtrl::I_CDCU_AutoPowerOffDisableReq 0"); // 测试步骤 Step Set I_CDCU_LDCU_BodyCtrl::I_CDCU_AutoPowerOffDisableReq 0//No Command
  g_HIL_Bus_Swc_Set("I_CDCU_LDCU_Ctrl::I_CDCU_AutoPoweroffConfig 0"); // 测试步骤 Step Set I_CDCU_LDCU_Ctrl::I_CDCU_AutoPoweroffConfig 0
  g_HIL_Gen_Swc_Wait("301 ms"); // 测试步骤 Step Wait 301 ms
  g_HIL_Bus_Swc_Set("I_CDCU_LDCU_Ctrl::I_CDCU_AutoPoweroffConfig 2"); // 测试步骤 Step Set I_CDCU_LDCU_Ctrl::I_CDCU_AutoPoweroffConfig 2//自动下电功能ACTIVE
  g_HIL_Gen_Swc_Wait("301 ms"); // 测试步骤 Step Wait 301 ms
  g_HIL_Bus_Swc_Check("I_LDCU_BodySysSt3::I_LDCU_AutoPoweroffCfgSt 1"); // 预期结果 Step Check I_LDCU_BodySysSt3::I_LDCU_AutoPoweroffCfgSt 1//active
  g_HIL_Bus_Swc_Set("I_CDCU_LDCU_Ctrl::I_CDCU_AutoPoweroffConfig 0"); // 测试步骤 Step Set I_CDCU_LDCU_Ctrl::I_CDCU_AutoPoweroffConfig 0
  g_HIL_Bus_Swc_Check("I_LDCU_BodySysSt3::I_LDCU_AutoPowerOffFuncSt 1"); // 预期结果 Step Check I_LDCU_BodySysSt3::I_LDCU_AutoPowerOffFuncSt 1//30min Count Down Started(T1计时）
  g_HIL_Bus_Swc_Set("I_XPU_BodyCtrl::I_XPU_LDCU_CurMode 0"); // 测试步骤 Step Set I_XPU_BodyCtrl::I_XPU_LDCU_CurMode 0// 智能驾驶模式Invalid
  g_HIL_Gen_Swc_Wait("101 ms"); // 测试步骤 Step Wait 101 ms
  g_HIL_Bus_Swc_Check("I_LDCU_BodySysSt3::I_LDCU_AutoPowerOffFuncSt 3"); // 预期结果 Step Check I_LDCU_BodySysSt3::I_LDCU_AutoPowerOffFuncSt 3//Count Down Canceled（持续300ms）
}

testcase SYS_LDCU_Powermode_0113()
{
  TestDescription("延时自动下电功能激活与退出-40");
  g_HIL_XCP_Swc_Set_XCP("CalEn_Vcu_MO_Motor_laeuft 1"); // 测试步骤 Step Set_XCP CalEn_Vcu_MO_Motor_laeuft 1
  g_HIL_XCP_Swc_Set_XCP("CalVal_Vcu_MO_Motor_laeuft 0"); // 测试步骤 Step Set_XCP CalVal_Vcu_MO_Motor_laeuft 0
  g_HIL_Bus_Swc_Check("C_Motor_14::C_MO_Motor_laeuft 0"); // 预期结果 Step Check C_Motor_14::C_MO_Motor_laeuft 0//Motor_laeuft_nicht
  g_HIL_Clib_Swc_Clib_Convenience(); // 测试步骤 Step Clib Convenience
  g_HIL_Bus_Swc_Check("I_LDCU_BodySysSt1::I_LDCU_PowerMode 3"); // 预期结果 Step Check I_LDCU_BodySysSt1::I_LDCU_PowerMode 3//Convenience
  g_HIL_Bus_Swc_Set("I_CDCU_LDCU_Ctrl::I_CDCU_AutoPoweroffConfig 0"); // 测试步骤 Step Set I_CDCU_LDCU_Ctrl::I_CDCU_AutoPoweroffConfig 0
  g_HIL_Gen_Swc_Wait("301 ms"); // 测试步骤 Step Wait 301 ms
  g_HIL_Bus_Swc_Set("I_CDCU_LDCU_Ctrl::I_CDCU_AutoPoweroffConfig 1"); // 测试步骤 Step Set I_CDCU_LDCU_Ctrl::I_CDCU_AutoPoweroffConfig 1//自动下电功能INACTIVE
  g_HIL_Gen_Swc_Wait("301 ms"); // 测试步骤 Step Wait 301 ms
  g_HIL_Bus_Swc_Check("I_LDCU_BodySysSt3::I_LDCU_AutoPoweroffCfgSt 0"); // 预期结果 Step Check I_LDCU_BodySysSt3::I_LDCU_AutoPoweroffCfgSt 0//inactive
  g_HIL_Bus_Swc_Set("C_CDCU_DiagnosticSt::C_CDCU_DiagnosticSt 0"); // 测试步骤 Step Set C_CDCU_DiagnosticSt::C_CDCU_DiagnosticSt 0
  g_HIL_Bus_Swc_Set("C_IPB_SpdInfoF::C_IPB_VehSpd 0"); // 测试步骤 Step Set C_IPB_SpdInfoF::C_IPB_VehSpd 0//车速小于3Km
  g_HIL_Bus_Swc_Set("C_IPB_SpdInfoF::C_IPB_VehSpdVD 1"); // 测试步骤 Step Set C_IPB_SpdInfoF::C_IPB_VehSpdVD 1//车速有效
  g_HIL_Clib_Swc_Clib_P(); // 测试步骤 Step Clib P
  g_HIL_Bus_Swc_Set("I_XPU_BodyCtrl::I_XPU_LDCU_CurMode 0"); // 测试步骤 Step Set I_XPU_BodyCtrl::I_XPU_LDCU_CurMode 0// 智能驾驶模式Invalid
  g_HIL_Bus_Swc_Set("I_CDCU_LDCU_BodyCtrl::I_CDCU_AutoPowerOffDisableReq 0"); // 测试步骤 Step Set I_CDCU_LDCU_BodyCtrl::I_CDCU_AutoPowerOffDisableReq 0//No Command
  g_HIL_Bus_Swc_Set("I_CDCU_LDCU_Ctrl::I_CDCU_AutoPoweroffConfig 0"); // 测试步骤 Step Set I_CDCU_LDCU_Ctrl::I_CDCU_AutoPoweroffConfig 0
  g_HIL_Gen_Swc_Wait("301 ms"); // 测试步骤 Step Wait 301 ms
  g_HIL_Bus_Swc_Set("I_CDCU_LDCU_Ctrl::I_CDCU_AutoPoweroffConfig 2"); // 测试步骤 Step Set I_CDCU_LDCU_Ctrl::I_CDCU_AutoPoweroffConfig 2//自动下电功能ACTIVE
  g_HIL_Gen_Swc_Wait("301 ms"); // 测试步骤 Step Wait 301 ms
  g_HIL_Bus_Swc_Check("I_LDCU_BodySysSt3::I_LDCU_AutoPoweroffCfgSt 1"); // 预期结果 Step Check I_LDCU_BodySysSt3::I_LDCU_AutoPoweroffCfgSt 1//active
  g_HIL_Bus_Swc_Set("I_CDCU_LDCU_Ctrl::I_CDCU_AutoPoweroffConfig 0"); // 测试步骤 Step Set I_CDCU_LDCU_Ctrl::I_CDCU_AutoPoweroffConfig 0
  g_HIL_Bus_Swc_Check("I_LDCU_BodySysSt3::I_LDCU_AutoPowerOffFuncSt 1"); // 预期结果 Step Check I_LDCU_BodySysSt3::I_LDCU_AutoPowerOffFuncSt 1//30min Count Down Started(T1计时）
  g_HIL_Bus_Swc_Set("I_CDCU_LDCU_BodyCtrl::I_CDCU_AutoPowerOffDisableReq 1"); // 测试步骤 Step Set I_CDCU_LDCU_BodyCtrl::I_CDCU_AutoPowerOffDisableReq 1//
  g_HIL_Gen_Swc_Wait("101 ms"); // 测试步骤 Step Wait 101 ms
  g_HIL_Bus_Swc_Check("I_LDCU_BodySysSt3::I_LDCU_AutoPowerOffFuncSt 3"); // 预期结果 Step Check I_LDCU_BodySysSt3::I_LDCU_AutoPowerOffFuncSt 3//Count Down Canceled（持续300ms）
  g_HIL_Bus_Swc_Set("I_CDCU_LDCU_BodyCtrl::I_CDCU_AutoPowerOffDisableReq 0"); // 测试步骤 Step Set I_CDCU_LDCU_BodyCtrl::I_CDCU_AutoPowerOffDisableReq 0//No Command
}

testcase SYS_LDCU_Powermode_0114()
{
  TestDescription("延时自动下电功能激活与退出-41");
  g_HIL_XCP_Swc_Set_XCP("CalEn_Vcu_MO_Motor_laeuft 1"); // 测试步骤 Step Set_XCP CalEn_Vcu_MO_Motor_laeuft 1
  g_HIL_XCP_Swc_Set_XCP("CalVal_Vcu_MO_Motor_laeuft 0"); // 测试步骤 Step Set_XCP CalVal_Vcu_MO_Motor_laeuft 0
  g_HIL_Bus_Swc_Check("C_Motor_14::C_MO_Motor_laeuft 0"); // 预期结果 Step Check C_Motor_14::C_MO_Motor_laeuft 0//Motor_laeuft_nicht
  g_HIL_Clib_Swc_Clib_Convenience(); // 测试步骤 Step Clib Convenience
  g_HIL_Bus_Swc_Check("I_LDCU_BodySysSt1::I_LDCU_PowerMode 3"); // 预期结果 Step Check I_LDCU_BodySysSt1::I_LDCU_PowerMode 3//Convenience
  g_HIL_Bus_Swc_Set("I_CDCU_LDCU_Ctrl::I_CDCU_AutoPoweroffConfig 0"); // 测试步骤 Step Set I_CDCU_LDCU_Ctrl::I_CDCU_AutoPoweroffConfig 0
  g_HIL_Gen_Swc_Wait("301 ms"); // 测试步骤 Step Wait 301 ms
  g_HIL_Bus_Swc_Set("I_CDCU_LDCU_Ctrl::I_CDCU_AutoPoweroffConfig 1"); // 测试步骤 Step Set I_CDCU_LDCU_Ctrl::I_CDCU_AutoPoweroffConfig 1//自动下电功能INACTIVE
  g_HIL_Gen_Swc_Wait("301 ms"); // 测试步骤 Step Wait 301 ms
  g_HIL_Bus_Swc_Check("I_LDCU_BodySysSt3::I_LDCU_AutoPoweroffCfgSt 0"); // 预期结果 Step Check I_LDCU_BodySysSt3::I_LDCU_AutoPoweroffCfgSt 0//inactive
  g_HIL_Bus_Swc_Set("C_CDCU_DiagnosticSt::C_CDCU_DiagnosticSt 0"); // 测试步骤 Step Set C_CDCU_DiagnosticSt::C_CDCU_DiagnosticSt 0
  g_HIL_Bus_Swc_Set("C_IPB_SpdInfoF::C_IPB_VehSpd 0"); // 测试步骤 Step Set C_IPB_SpdInfoF::C_IPB_VehSpd 0//车速小于3Km
  g_HIL_Bus_Swc_Set("C_IPB_SpdInfoF::C_IPB_VehSpdVD 1"); // 测试步骤 Step Set C_IPB_SpdInfoF::C_IPB_VehSpdVD 1//车速有效
  g_HIL_Clib_Swc_Clib_P(); // 测试步骤 Step Clib P
  g_HIL_Bus_Swc_Set("I_XPU_BodyCtrl::I_XPU_LDCU_CurMode 0"); // 测试步骤 Step Set I_XPU_BodyCtrl::I_XPU_LDCU_CurMode 0// 智能驾驶模式Invalid
  g_HIL_Bus_Swc_Set("I_CDCU_LDCU_BodyCtrl::I_CDCU_AutoPowerOffDisableReq 0"); // 测试步骤 Step Set I_CDCU_LDCU_BodyCtrl::I_CDCU_AutoPowerOffDisableReq 0//No Command
  g_HIL_Bus_Swc_Set("I_CDCU_LDCU_Ctrl::I_CDCU_AutoPoweroffConfig 0"); // 测试步骤 Step Set I_CDCU_LDCU_Ctrl::I_CDCU_AutoPoweroffConfig 0
  g_HIL_Gen_Swc_Wait("301 ms"); // 测试步骤 Step Wait 301 ms
  g_HIL_Bus_Swc_Set("I_CDCU_LDCU_Ctrl::I_CDCU_AutoPoweroffConfig 2"); // 测试步骤 Step Set I_CDCU_LDCU_Ctrl::I_CDCU_AutoPoweroffConfig 2//自动下电功能ACTIVE
  g_HIL_Gen_Swc_Wait("301 ms"); // 测试步骤 Step Wait 301 ms
  g_HIL_Bus_Swc_Check("I_LDCU_BodySysSt3::I_LDCU_AutoPoweroffCfgSt 1"); // 预期结果 Step Check I_LDCU_BodySysSt3::I_LDCU_AutoPoweroffCfgSt 1//active
  g_HIL_Bus_Swc_Set("I_CDCU_LDCU_Ctrl::I_CDCU_AutoPoweroffConfig 0"); // 测试步骤 Step Set I_CDCU_LDCU_Ctrl::I_CDCU_AutoPoweroffConfig 0
  g_HIL_Bus_Swc_Check("I_LDCU_BodySysSt3::I_LDCU_AutoPowerOffFuncSt 1"); // 预期结果 Step Check I_LDCU_BodySysSt3::I_LDCU_AutoPowerOffFuncSt 1//30min Count Down Started(T1计时）
  g_HIL_Bus_Swc_Set("VTS::VT2848_3_Ch34::DigitalOutput 1"); // 测试步骤 Step Set J_DI_FLDoorAjarSW_LS 0
  g_HIL_Bus_Swc_Check("I_LDCU_BodySysSt1::I_LDCU_PowerMode 0"); // 预期结果 Step Check I_LDCU_BodySysSt1::I_LDCU_PowerMode 0//OFF
  g_HIL_Gen_Swc_Wait("101 ms"); // 测试步骤 Step Wait 101 ms
  g_HIL_Bus_Swc_Check("I_LDCU_BodySysSt3::I_LDCU_AutoPowerOffFuncSt 3"); // 预期结果 Step Check I_LDCU_BodySysSt3::I_LDCU_AutoPowerOffFuncSt 3//Count Down Canceled（持续300ms）
  g_HIL_Bus_Swc_Set("VTS::VT2848_3_Ch34::DigitalOutput 0"); // 测试步骤 Step Set J_DI_FLDoorAjarSW_LS 1
  g_HIL_Bus_Swc_Check("I_LDCU_BodySysSt1::I_LDCU_DriverDoorAjarSt 0 1 s"); // 预期结果 Step Check I_LDCU_BodySysSt1::I_LDCU_DriverDoorAjarSt 0 1 s
}

testcase SYS_LDCU_Powermode_0115()
{
  TestDescription("延时自动下电功能激活与退出-42");
  g_HIL_XCP_Swc_Set_XCP("CalEn_Vcu_MO_Motor_laeuft 1"); // 测试步骤 Step Set_XCP CalEn_Vcu_MO_Motor_laeuft 1
  g_HIL_XCP_Swc_Set_XCP("CalVal_Vcu_MO_Motor_laeuft 0"); // 测试步骤 Step Set_XCP CalVal_Vcu_MO_Motor_laeuft 0
  g_HIL_Bus_Swc_Check("C_Motor_14::C_MO_Motor_laeuft 0"); // 预期结果 Step Check C_Motor_14::C_MO_Motor_laeuft 0//Motor_laeuft_nicht
  g_HIL_Clib_Swc_Clib_Convenience(); // 测试步骤 Step Clib Convenience
  g_HIL_Bus_Swc_Check("I_LDCU_BodySysSt1::I_LDCU_PowerMode 3"); // 预期结果 Step Check I_LDCU_BodySysSt1::I_LDCU_PowerMode 3//Convenience
  g_HIL_Bus_Swc_Set("I_CDCU_LDCU_Ctrl::I_CDCU_AutoPoweroffConfig 0"); // 测试步骤 Step Set I_CDCU_LDCU_Ctrl::I_CDCU_AutoPoweroffConfig 0
  g_HIL_Gen_Swc_Wait("301 ms"); // 测试步骤 Step Wait 301 ms
  g_HIL_Bus_Swc_Set("I_CDCU_LDCU_Ctrl::I_CDCU_AutoPoweroffConfig 1"); // 测试步骤 Step Set I_CDCU_LDCU_Ctrl::I_CDCU_AutoPoweroffConfig 1//自动下电功能INACTIVE
  g_HIL_Gen_Swc_Wait("301 ms"); // 测试步骤 Step Wait 301 ms
  g_HIL_Bus_Swc_Check("I_LDCU_BodySysSt3::I_LDCU_AutoPoweroffCfgSt 0"); // 预期结果 Step Check I_LDCU_BodySysSt3::I_LDCU_AutoPoweroffCfgSt 0//inactive
  g_HIL_Bus_Swc_Set("C_CDCU_DiagnosticSt::C_CDCU_DiagnosticSt 0"); // 测试步骤 Step Set C_CDCU_DiagnosticSt::C_CDCU_DiagnosticSt 0
  g_HIL_Bus_Swc_Set("C_IPB_SpdInfoF::C_IPB_VehSpd 0"); // 测试步骤 Step Set C_IPB_SpdInfoF::C_IPB_VehSpd 0//车速小于3Km
  g_HIL_Bus_Swc_Set("C_IPB_SpdInfoF::C_IPB_VehSpdVD 1"); // 测试步骤 Step Set C_IPB_SpdInfoF::C_IPB_VehSpdVD 1//车速有效
  g_HIL_Clib_Swc_Clib_P(); // 测试步骤 Step Clib P
  g_HIL_Bus_Swc_Set("I_XPU_BodyCtrl::I_XPU_LDCU_CurMode 0"); // 测试步骤 Step Set I_XPU_BodyCtrl::I_XPU_LDCU_CurMode 0// 智能驾驶模式Invalid
  g_HIL_Bus_Swc_Set("I_CDCU_LDCU_BodyCtrl::I_CDCU_AutoPowerOffDisableReq 0"); // 测试步骤 Step Set I_CDCU_LDCU_BodyCtrl::I_CDCU_AutoPowerOffDisableReq 0//No Command
  g_HIL_Bus_Swc_Set("I_CDCU_LDCU_Ctrl::I_CDCU_AutoPoweroffConfig 0"); // 测试步骤 Step Set I_CDCU_LDCU_Ctrl::I_CDCU_AutoPoweroffConfig 0
  g_HIL_Gen_Swc_Wait("301 ms"); // 测试步骤 Step Wait 301 ms
  g_HIL_Bus_Swc_Set("I_CDCU_LDCU_Ctrl::I_CDCU_AutoPoweroffConfig 2"); // 测试步骤 Step Set I_CDCU_LDCU_Ctrl::I_CDCU_AutoPoweroffConfig 2//自动下电功能ACTIVE
  g_HIL_Gen_Swc_Wait("301 ms"); // 测试步骤 Step Wait 301 ms
  g_HIL_Bus_Swc_Check("I_LDCU_BodySysSt3::I_LDCU_AutoPoweroffCfgSt 1"); // 预期结果 Step Check I_LDCU_BodySysSt3::I_LDCU_AutoPoweroffCfgSt 1//active
  g_HIL_Bus_Swc_Set("I_CDCU_LDCU_Ctrl::I_CDCU_AutoPoweroffConfig 0"); // 测试步骤 Step Set I_CDCU_LDCU_Ctrl::I_CDCU_AutoPoweroffConfig 0
  g_HIL_Bus_Swc_Check("I_LDCU_BodySysSt3::I_LDCU_AutoPowerOffFuncSt 1"); // 预期结果 Step Check I_LDCU_BodySysSt3::I_LDCU_AutoPowerOffFuncSt 1//30min Count Down Started(T1计时）
  g_HIL_XCP_Swc_Set_XCP("CalVal_Vcu_MO_Motor_laeuft 1"); // 测试步骤 Step Set_XCP CalVal_Vcu_MO_Motor_laeuft 1//Motor_laeuft_nicht
  g_HIL_Gen_Swc_Wait("101 ms"); // 测试步骤 Step Wait 101 ms
  g_HIL_Bus_Swc_Check("I_LDCU_BodySysSt3::I_LDCU_AutoPowerOffFuncSt 3"); // 预期结果 Step Check I_LDCU_BodySysSt3::I_LDCU_AutoPowerOffFuncSt 3//Count Down Canceled（持续300ms）
  g_HIL_XCP_Swc_Set_XCP("CalVal_Vcu_MO_Motor_laeuft 0"); // 测试步骤 Step Set_XCP CalVal_Vcu_MO_Motor_laeuft 0//Motor_laeuft_nicht
  g_HIL_Bus_Swc_Check("C_Motor_14::C_MO_Motor_laeuft 0"); // 预期结果 Step Check C_Motor_14::C_MO_Motor_laeuft 0//Motor_laeuft_nicht
}

testcase SYS_LDCU_Powermode_0116()
{
  TestDescription("延时自动下电功能执行-1");
  g_HIL_XCP_Swc_Set_XCP("CalEn_Vcu_MO_Motor_laeuft 1"); // 测试步骤 Step Set_XCP CalEn_Vcu_MO_Motor_laeuft 1
  g_HIL_XCP_Swc_Set_XCP("CalVal_Vcu_MO_Motor_laeuft 0"); // 测试步骤 Step Set_XCP CalVal_Vcu_MO_Motor_laeuft 0
  g_HIL_Bus_Swc_Check("C_Motor_14::C_MO_Motor_laeuft 0"); // 预期结果 Step Check C_Motor_14::C_MO_Motor_laeuft 0//Motor_laeuft_nicht
  g_HIL_XCP_Swc_Set_XCP("CalC_tPwMdLocalAutoPwrOff1 40"); // 测试步骤 Step Set_XCP CalC_tPwMdLocalAutoPwrOff1 40
  g_HIL_XCP_Swc_Set_XCP("CalC_tPwMdLocalAutoPwrOff2 30"); // 测试步骤 Step Set_XCP CalC_tPwMdLocalAutoPwrOff2 30
  g_HIL_Clib_Swc_Clib_LocalON(); // 测试步骤 Step Clib LocalON
  g_HIL_Bus_Swc_Check("I_LDCU_BodySysSt1::I_LDCU_PowerMode 1"); // 预期结果 Step Check I_LDCU_BodySysSt1::I_LDCU_PowerMode 1//Local ON
  g_HIL_Bus_Swc_Set("I_CDCU_LDCU_Ctrl::I_CDCU_AutoPoweroffConfig 0"); // 测试步骤 Step Set I_CDCU_LDCU_Ctrl::I_CDCU_AutoPoweroffConfig 0
  g_HIL_Gen_Swc_Wait("301 ms"); // 测试步骤 Step Wait 301 ms
  g_HIL_Bus_Swc_Set("I_CDCU_LDCU_Ctrl::I_CDCU_AutoPoweroffConfig 1"); // 测试步骤 Step Set I_CDCU_LDCU_Ctrl::I_CDCU_AutoPoweroffConfig 1//自动下电功能INACTIVE
  g_HIL_Gen_Swc_Wait("301 ms"); // 测试步骤 Step Wait 301 ms
  g_HIL_Bus_Swc_Check("I_LDCU_BodySysSt3::I_LDCU_AutoPoweroffCfgSt 0"); // 预期结果 Step Check I_LDCU_BodySysSt3::I_LDCU_AutoPoweroffCfgSt 0//inactive
  g_HIL_Bus_Swc_Set("C_CDCU_DiagnosticSt::C_CDCU_DiagnosticSt 0"); // 测试步骤 Step Set C_CDCU_DiagnosticSt::C_CDCU_DiagnosticSt 0
  g_HIL_Bus_Swc_Set("C_IPB_SpdInfoF::C_IPB_VehSpd 0"); // 测试步骤 Step Set C_IPB_SpdInfoF::C_IPB_VehSpd 0//车速小于3Km
  g_HIL_Bus_Swc_Set("C_IPB_SpdInfoF::C_IPB_VehSpdVD 1"); // 测试步骤 Step Set C_IPB_SpdInfoF::C_IPB_VehSpdVD 1//车速有效
  g_HIL_Clib_Swc_Clib_P(); // 测试步骤 Step Clib P
  g_HIL_Bus_Swc_Set("I_XPU_BodyCtrl::I_XPU_LDCU_CurMode 0"); // 测试步骤 Step Set I_XPU_BodyCtrl::I_XPU_LDCU_CurMode 0// 智能驾驶模式Invalid
  g_HIL_Bus_Swc_Set("I_CDCU_LDCU_BodyCtrl::I_CDCU_AutoPowerOffDisableReq 0"); // 测试步骤 Step Set I_CDCU_LDCU_BodyCtrl::I_CDCU_AutoPowerOffDisableReq 0//No Command
  g_HIL_Bus_Swc_Set("I_CDCU_LDCU_Ctrl::I_CDCU_AutoPoweroffConfig 0"); // 测试步骤 Step Set I_CDCU_LDCU_Ctrl::I_CDCU_AutoPoweroffConfig 0
  g_HIL_Gen_Swc_Wait("301 ms"); // 测试步骤 Step Wait 301 ms
  g_HIL_Bus_Swc_Set("I_CDCU_LDCU_Ctrl::I_CDCU_AutoPoweroffConfig 2"); // 测试步骤 Step Set I_CDCU_LDCU_Ctrl::I_CDCU_AutoPoweroffConfig 2//自动下电功能ACTIVE
  g_HIL_Bus_Swc_Check("I_LDCU_BodySysSt3::I_LDCU_AutoPoweroffCfgSt 1"); // 预期结果 Step Check I_LDCU_BodySysSt3::I_LDCU_AutoPoweroffCfgSt 1//active
  g_HIL_Bus_Swc_Check("I_LDCU_BodySysSt3::I_LDCU_AutoPowerOffFuncSt 1"); // 预期结果 Step Check I_LDCU_BodySysSt3::I_LDCU_AutoPowerOffFuncSt 1//30min Count Down Started(T1计时）
  g_HIL_Gen_Swc_Wait("40 s"); // 测试步骤 Step Wait 40 s
  g_HIL_Bus_Swc_Check("I_LDCU_BodySysSt3::I_LDCU_AutoPowerOffFuncSt 2"); // 预期结果 Step Check I_LDCU_BodySysSt3::I_LDCU_AutoPowerOffFuncSt 2//Ten min Count Down Started(T2计时)
  g_HIL_Bus_Swc_Check("I_LDCU_BodySysSt1::I_LDCU_PowerMode 1"); // 预期结果 Step Check I_LDCU_BodySysSt1::I_LDCU_PowerMode 1//Local ON
  g_HIL_Gen_Swc_Wait("29 s"); // 测试步骤 Step Wait 29 s
  g_HIL_Bus_Swc_Check("I_LDCU_BodySysSt3::I_LDCU_AutoPowerOffFuncSt 3"); // 预期结果 Step Check I_LDCU_BodySysSt3::I_LDCU_AutoPowerOffFuncSt 3//Count Down Canceled（持续300ms）
  g_HIL_Bus_Swc_Check("I_LDCU_BodySysSt3::I_LDCU_AutoPowerOffFuncSt 0 1 s"); // 预期结果 Step Check I_LDCU_BodySysSt3::I_LDCU_AutoPowerOffFuncSt 0 1 s//inactive
  g_HIL_Bus_Swc_Check("I_LDCU_BodySysSt1::I_LDCU_PowerMode 0"); // 预期结果 Step Check I_LDCU_BodySysSt1::I_LDCU_PowerMode 0//OFF
  g_HIL_Bus_Swc_Set("I_CDCU_LDCU_Ctrl::I_CDCU_AutoPoweroffConfig 0"); // 测试步骤 Step Set I_CDCU_LDCU_Ctrl::I_CDCU_AutoPoweroffConfig 0
  g_HIL_Bus_Swc_Check("I_LDCU_BodySysSt3::I_LDCU_AutoPoweroffCfgSt 0"); // 预期结果 Step Check I_LDCU_BodySysSt3::I_LDCU_AutoPoweroffCfgSt 0//inactive
}

testcase SYS_LDCU_Powermode_0117()
{
  TestDescription("延时自动下电功能执行-2");
  g_HIL_XCP_Swc_Set_XCP("CalEn_Vcu_MO_Motor_laeuft 1"); // 测试步骤 Step Set_XCP CalEn_Vcu_MO_Motor_laeuft 1
  g_HIL_XCP_Swc_Set_XCP("CalVal_Vcu_MO_Motor_laeuft 0"); // 测试步骤 Step Set_XCP CalVal_Vcu_MO_Motor_laeuft 0
  g_HIL_Bus_Swc_Check("C_Motor_14::C_MO_Motor_laeuft 0"); // 预期结果 Step Check C_Motor_14::C_MO_Motor_laeuft 0//Motor_laeuft_nicht
  g_HIL_XCP_Swc_Set_XCP("CalC_tPwMdLocalAutoPwrOff1 40"); // 测试步骤 Step Set_XCP CalC_tPwMdLocalAutoPwrOff1 40
  g_HIL_XCP_Swc_Set_XCP("CalC_tPwMdLocalAutoPwrOff2 30"); // 测试步骤 Step Set_XCP CalC_tPwMdLocalAutoPwrOff2 30
  g_HIL_Clib_Swc_Clib_RemoteON(); // 测试步骤 Step Clib RemoteON
  g_HIL_Bus_Swc_Check("I_LDCU_BodySysSt1::I_LDCU_PowerMode 2"); // 预期结果 Step Check I_LDCU_BodySysSt1::I_LDCU_PowerMode 2 //RemoteOn
  g_HIL_Bus_Swc_Set("I_CDCU_LDCU_Ctrl::I_CDCU_AutoPoweroffConfig 0"); // 测试步骤 Step Set I_CDCU_LDCU_Ctrl::I_CDCU_AutoPoweroffConfig 0
  g_HIL_Gen_Swc_Wait("301 ms"); // 测试步骤 Step Wait 301 ms
  g_HIL_Bus_Swc_Set("I_CDCU_LDCU_Ctrl::I_CDCU_AutoPoweroffConfig 1"); // 测试步骤 Step Set I_CDCU_LDCU_Ctrl::I_CDCU_AutoPoweroffConfig 1//自动下电功能INACTIVE
  g_HIL_Gen_Swc_Wait("301 ms"); // 测试步骤 Step Wait 301 ms
  g_HIL_Bus_Swc_Check("I_LDCU_BodySysSt3::I_LDCU_AutoPoweroffCfgSt 0"); // 预期结果 Step Check I_LDCU_BodySysSt3::I_LDCU_AutoPoweroffCfgSt 0//inactive
  g_HIL_Bus_Swc_Set("C_CDCU_DiagnosticSt::C_CDCU_DiagnosticSt 0"); // 测试步骤 Step Set C_CDCU_DiagnosticSt::C_CDCU_DiagnosticSt 0
  g_HIL_Bus_Swc_Set("C_IPB_SpdInfoF::C_IPB_VehSpd 0"); // 测试步骤 Step Set C_IPB_SpdInfoF::C_IPB_VehSpd 0//车速小于3Km
  g_HIL_Bus_Swc_Set("C_IPB_SpdInfoF::C_IPB_VehSpdVD 1"); // 测试步骤 Step Set C_IPB_SpdInfoF::C_IPB_VehSpdVD 1//车速有效
  g_HIL_Clib_Swc_Clib_P(); // 测试步骤 Step Clib P
  g_HIL_Bus_Swc_Set("I_XPU_BodyCtrl::I_XPU_LDCU_CurMode 0"); // 测试步骤 Step Set I_XPU_BodyCtrl::I_XPU_LDCU_CurMode 0// 智能驾驶模式Invalid
  g_HIL_Bus_Swc_Set("I_CDCU_LDCU_BodyCtrl::I_CDCU_AutoPowerOffDisableReq 0"); // 测试步骤 Step Set I_CDCU_LDCU_BodyCtrl::I_CDCU_AutoPowerOffDisableReq 0//No Command
  g_HIL_Bus_Swc_Set("I_CDCU_LDCU_Ctrl::I_CDCU_AutoPoweroffConfig 0"); // 测试步骤 Step Set I_CDCU_LDCU_Ctrl::I_CDCU_AutoPoweroffConfig 0
  g_HIL_Gen_Swc_Wait("301 ms"); // 测试步骤 Step Wait 301 ms
  g_HIL_Bus_Swc_Set("I_CDCU_LDCU_Ctrl::I_CDCU_AutoPoweroffConfig 2"); // 测试步骤 Step Set I_CDCU_LDCU_Ctrl::I_CDCU_AutoPoweroffConfig 2//自动下电功能ACTIVE
  g_HIL_Bus_Swc_Check("I_LDCU_BodySysSt3::I_LDCU_AutoPoweroffCfgSt 1"); // 预期结果 Step Check I_LDCU_BodySysSt3::I_LDCU_AutoPoweroffCfgSt 1//active
  g_HIL_Bus_Swc_Check("I_LDCU_BodySysSt3::I_LDCU_AutoPowerOffFuncSt 1"); // 预期结果 Step Check I_LDCU_BodySysSt3::I_LDCU_AutoPowerOffFuncSt 1//30min Count Down Started(T1计时）
  g_HIL_Gen_Swc_Wait("40 s"); // 测试步骤 Step Wait 40 s
  g_HIL_Bus_Swc_Check("I_LDCU_BodySysSt3::I_LDCU_AutoPowerOffFuncSt 2"); // 预期结果 Step Check I_LDCU_BodySysSt3::I_LDCU_AutoPowerOffFuncSt 2//Ten min Count Down Started(T2计时)
  g_HIL_Bus_Swc_Check("I_LDCU_BodySysSt1::I_LDCU_PowerMode 1"); // 预期结果 Step Check I_LDCU_BodySysSt1::I_LDCU_PowerMode 1//Local ON
  g_HIL_Gen_Swc_Wait("29 s"); // 测试步骤 Step Wait 29 s
  g_HIL_Bus_Swc_Check("I_LDCU_BodySysSt3::I_LDCU_AutoPowerOffFuncSt 3"); // 预期结果 Step Check I_LDCU_BodySysSt3::I_LDCU_AutoPowerOffFuncSt 3//Count Down Canceled（持续300ms）
  g_HIL_Bus_Swc_Check("I_LDCU_BodySysSt3::I_LDCU_AutoPowerOffFuncSt 0 1 s"); // 预期结果 Step Check I_LDCU_BodySysSt3::I_LDCU_AutoPowerOffFuncSt 0 1 s//inactive
  g_HIL_Bus_Swc_Check("I_LDCU_BodySysSt1::I_LDCU_PowerMode 0"); // 预期结果 Step Check I_LDCU_BodySysSt1::I_LDCU_PowerMode 0//OFF
  g_HIL_Bus_Swc_Set("I_CDCU_LDCU_Ctrl::I_CDCU_AutoPoweroffConfig 0"); // 测试步骤 Step Set I_CDCU_LDCU_Ctrl::I_CDCU_AutoPoweroffConfig 0
  g_HIL_Bus_Swc_Check("I_LDCU_BodySysSt3::I_LDCU_AutoPoweroffCfgSt 0"); // 预期结果 Step Check I_LDCU_BodySysSt3::I_LDCU_AutoPoweroffCfgSt 0//inactive
}

testcase SYS_LDCU_Powermode_0118()
{
  TestDescription("延时自动下电功能执行-3");
  g_HIL_XCP_Swc_Set_XCP("CalEn_Vcu_MO_Motor_laeuft 1"); // 测试步骤 Step Set_XCP CalEn_Vcu_MO_Motor_laeuft 1
  g_HIL_XCP_Swc_Set_XCP("CalVal_Vcu_MO_Motor_laeuft 0"); // 测试步骤 Step Set_XCP CalVal_Vcu_MO_Motor_laeuft 0
  g_HIL_Bus_Swc_Check("C_Motor_14::C_MO_Motor_laeuft 0"); // 预期结果 Step Check C_Motor_14::C_MO_Motor_laeuft 0//Motor_laeuft_nicht
  g_HIL_XCP_Swc_Set_XCP("CalC_tPwMdLocalAutoPwrOff1 40"); // 测试步骤 Step Set_XCP CalC_tPwMdLocalAutoPwrOff1 40
  g_HIL_XCP_Swc_Set_XCP("CalC_tPwMdLocalAutoPwrOff2 30"); // 测试步骤 Step Set_XCP CalC_tPwMdLocalAutoPwrOff2 30
  g_HIL_Clib_Swc_Clib_Convenience(); // 测试步骤 Step Clib Convenience
  g_HIL_Bus_Swc_Check("I_LDCU_BodySysSt1::I_LDCU_PowerMode 3"); // 预期结果 Step Check I_LDCU_BodySysSt1::I_LDCU_PowerMode 3 //Convenience
  g_HIL_Bus_Swc_Set("I_CDCU_LDCU_Ctrl::I_CDCU_AutoPoweroffConfig 0"); // 测试步骤 Step Set I_CDCU_LDCU_Ctrl::I_CDCU_AutoPoweroffConfig 0
  g_HIL_Gen_Swc_Wait("301 ms"); // 测试步骤 Step Wait 301 ms
  g_HIL_Bus_Swc_Set("I_CDCU_LDCU_Ctrl::I_CDCU_AutoPoweroffConfig 1"); // 测试步骤 Step Set I_CDCU_LDCU_Ctrl::I_CDCU_AutoPoweroffConfig 1//自动下电功能INACTIVE
  g_HIL_Gen_Swc_Wait("301 ms"); // 测试步骤 Step Wait 301 ms
  g_HIL_Bus_Swc_Check("I_LDCU_BodySysSt3::I_LDCU_AutoPoweroffCfgSt 0"); // 预期结果 Step Check I_LDCU_BodySysSt3::I_LDCU_AutoPoweroffCfgSt 0//inactive
  g_HIL_Bus_Swc_Set("C_CDCU_DiagnosticSt::C_CDCU_DiagnosticSt 0"); // 测试步骤 Step Set C_CDCU_DiagnosticSt::C_CDCU_DiagnosticSt 0
  g_HIL_Bus_Swc_Set("C_IPB_SpdInfoF::C_IPB_VehSpd 0"); // 测试步骤 Step Set C_IPB_SpdInfoF::C_IPB_VehSpd 0//车速小于3Km
  g_HIL_Bus_Swc_Set("C_IPB_SpdInfoF::C_IPB_VehSpdVD 1"); // 测试步骤 Step Set C_IPB_SpdInfoF::C_IPB_VehSpdVD 1//车速有效
  g_HIL_Clib_Swc_Clib_P(); // 测试步骤 Step Clib P
  g_HIL_Bus_Swc_Set("I_XPU_BodyCtrl::I_XPU_LDCU_CurMode 0"); // 测试步骤 Step Set I_XPU_BodyCtrl::I_XPU_LDCU_CurMode 0// 智能驾驶模式Invalid
  g_HIL_Bus_Swc_Set("I_CDCU_LDCU_BodyCtrl::I_CDCU_AutoPowerOffDisableReq 0"); // 测试步骤 Step Set I_CDCU_LDCU_BodyCtrl::I_CDCU_AutoPowerOffDisableReq 0//No Command
  g_HIL_Bus_Swc_Set("I_CDCU_LDCU_Ctrl::I_CDCU_AutoPoweroffConfig 0"); // 测试步骤 Step Set I_CDCU_LDCU_Ctrl::I_CDCU_AutoPoweroffConfig 0
  g_HIL_Gen_Swc_Wait("301 ms"); // 测试步骤 Step Wait 301 ms
  g_HIL_Bus_Swc_Set("I_CDCU_LDCU_Ctrl::I_CDCU_AutoPoweroffConfig 2"); // 测试步骤 Step Set I_CDCU_LDCU_Ctrl::I_CDCU_AutoPoweroffConfig 2//自动下电功能ACTIVE
  g_HIL_Bus_Swc_Check("I_LDCU_BodySysSt3::I_LDCU_AutoPoweroffCfgSt 1"); // 预期结果 Step Check I_LDCU_BodySysSt3::I_LDCU_AutoPoweroffCfgSt 1//active
  g_HIL_Bus_Swc_Check("I_LDCU_BodySysSt3::I_LDCU_AutoPowerOffFuncSt 1"); // 预期结果 Step Check I_LDCU_BodySysSt3::I_LDCU_AutoPowerOffFuncSt 1//30min Count Down Started(T1计时）
  g_HIL_Gen_Swc_Wait("40 s"); // 测试步骤 Step Wait 40 s
  g_HIL_Bus_Swc_Check("I_LDCU_BodySysSt3::I_LDCU_AutoPowerOffFuncSt 2"); // 预期结果 Step Check I_LDCU_BodySysSt3::I_LDCU_AutoPowerOffFuncSt 2//Ten min Count Down Started(T2计时)
  g_HIL_Bus_Swc_Check("I_LDCU_BodySysSt1::I_LDCU_PowerMode 1"); // 预期结果 Step Check I_LDCU_BodySysSt1::I_LDCU_PowerMode 1//Local ON
  g_HIL_Gen_Swc_Wait("29 s"); // 测试步骤 Step Wait 29 s
  g_HIL_Bus_Swc_Check("I_LDCU_BodySysSt3::I_LDCU_AutoPowerOffFuncSt 3"); // 预期结果 Step Check I_LDCU_BodySysSt3::I_LDCU_AutoPowerOffFuncSt 3//Count Down Canceled（持续300ms）
  g_HIL_Bus_Swc_Check("I_LDCU_BodySysSt3::I_LDCU_AutoPowerOffFuncSt 0 1 s"); // 预期结果 Step Check I_LDCU_BodySysSt3::I_LDCU_AutoPowerOffFuncSt 0 1 s//inactive
  g_HIL_Bus_Swc_Check("I_LDCU_BodySysSt1::I_LDCU_PowerMode 0"); // 预期结果 Step Check I_LDCU_BodySysSt1::I_LDCU_PowerMode 0//OFF
  g_HIL_Bus_Swc_Set("I_CDCU_LDCU_Ctrl::I_CDCU_AutoPoweroffConfig 0"); // 测试步骤 Step Set I_CDCU_LDCU_Ctrl::I_CDCU_AutoPoweroffConfig 0
  g_HIL_Bus_Swc_Check("I_LDCU_BodySysSt3::I_LDCU_AutoPoweroffCfgSt 0"); // 预期结果 Step Check I_LDCU_BodySysSt3::I_LDCU_AutoPoweroffCfgSt 0//inactive
}

testcase SYS_LDCU_Powermode_0119()
{
  TestDescription("实体开关仲裁-1");
  g_HIL_UDS_Swc_Set_UDS("SA_L1"); // 测试步骤 Step Set_UDS SA_L1
  g_HIL_Gen_Swc_Wait("151 ms"); // 测试步骤 Step Wait 151 ms
  g_HIL_UDS_Swc_Set_UDS("2E 31 11 02 00"); // 测试步骤 Step Set_UDS 2E 31 11 02 00//Dbldigital
  g_HIL_UDS_Swc_Check_UDS("6E 31 11"); // 预期结果 Step Check_UDS 6E 31 11//Dbldigital
  g_HIL_Bus_Swc_Set("VTS::VT2848_4_Ch27::DigitalOutput 0"); // 测试步骤 Step Set J_DI_SSBPin4SW_LS NotPressed
  g_HIL_Bus_Swc_Set("VTS::VT2848_4_Ch32::DigitalOutput 0"); // 测试步骤 Step Set J_DI_SSBPin6SW_LS NotPressed
  g_HIL_Bus_Swc_Check("I_LDCU_BodySysSt2::I_LDCU_ZATButtonSwSt 0 1 s"); // 预期结果 Step Check I_LDCU_BodySysSt2::I_LDCU_ZATButtonSwSt 0 1 s//notpressed
  g_HIL_Gen_Swc_Wait("301 ms"); // 测试步骤 Step Wait 301 ms
  g_HIL_Bus_Swc_Set("VTS::VT2848_4_Ch27::DigitalOutput 1"); // 测试步骤 Step Set J_DI_SSBPin4SW_LS Pressed
  g_HIL_Bus_Swc_Set("VTS::VT2848_4_Ch32::DigitalOutput 1"); // 测试步骤 Step Set J_DI_SSBPin6SW_LS Pressed
  g_HIL_Bus_Swc_Check("I_LDCU_BodySysSt2::I_LDCU_ZATButtonSwSt 1 1 s"); // 预期结果 Step Check I_LDCU_BodySysSt2::I_LDCU_ZATButtonSwSt 1 1 s//pressed
  g_HIL_Gen_Swc_Wait("301 ms"); // 测试步骤 Step Wait 301 ms//开关1，2按下
  g_HIL_Bus_Swc_Set("VTS::VT2848_4_Ch27::DigitalOutput 0"); // 测试步骤 Step Set J_DI_SSBPin4SW_LS NotPressed
  g_HIL_Bus_Swc_Set("VTS::VT2848_4_Ch32::DigitalOutput 0"); // 测试步骤 Step Set J_DI_SSBPin6SW_LS NotPressed
  g_HIL_Bus_Swc_Check("I_LDCU_BodySysSt2::I_LDCU_ZATButtonSwSt 0 1 s"); // 预期结果 Step Check I_LDCU_BodySysSt2::I_LDCU_ZATButtonSwSt 0 1 s//notpressed
}

testcase SYS_LDCU_Powermode_0120()
{
  TestDescription("实体开关仲裁-2");
  g_HIL_UDS_Swc_Set_UDS("SA_L1"); // 测试步骤 Step Set_UDS SA_L1
  g_HIL_Gen_Swc_Wait("151 ms"); // 测试步骤 Step Wait 151 ms
  g_HIL_UDS_Swc_Set_UDS("2E 31 11 02 00"); // 测试步骤 Step Set_UDS 2E 31 11 02 00//Dbldigital
  g_HIL_UDS_Swc_Check_UDS("6E 31 11"); // 预期结果 Step Check_UDS 6E 31 11//Dbldigital
  g_HIL_Bus_Swc_Set("VTS::VT2848_4_Ch27::DigitalOutput 0"); // 测试步骤 Step Set J_DI_SSBPin4SW_LS NotPressed
  g_HIL_Bus_Swc_Set("VTS::VT2848_4_Ch32::DigitalOutput 0"); // 测试步骤 Step Set J_DI_SSBPin6SW_LS NotPressed
  g_HIL_Bus_Swc_Check("I_LDCU_BodySysSt2::I_LDCU_ZATButtonSwSt 0 1 s"); // 预期结果 Step Check I_LDCU_BodySysSt2::I_LDCU_ZATButtonSwSt 0 1 s//notpressed
  g_HIL_Gen_Swc_Wait("301 ms"); // 测试步骤 Step Wait 301 ms
  g_HIL_Bus_Swc_Set("VTS::VT2848_4_Ch27::DigitalOutput 1"); // 测试步骤 Step Set J_DI_SSBPin4SW_LS Pressed
  g_HIL_Bus_Swc_Set("VTS::VT2848_4_Ch32::DigitalOutput 0"); // 测试步骤 Step Set J_DI_SSBPin6SW_LS NotPressed
  g_HIL_Bus_Swc_Check("I_LDCU_BodySysSt2::I_LDCU_ZATButtonSwSt 0 1 s"); // 预期结果 Step Check I_LDCU_BodySysSt2::I_LDCU_ZATButtonSwSt 0 1 s//notpressed
  g_HIL_Gen_Swc_Wait("301 ms"); // 测试步骤 Step Wait 301 ms//开关1按下，2释放
  g_HIL_Bus_Swc_Set("VTS::VT2848_4_Ch27::DigitalOutput 0"); // 测试步骤 Step Set J_DI_SSBPin4SW_LS NotPressed
  g_HIL_Bus_Swc_Set("VTS::VT2848_4_Ch32::DigitalOutput 0"); // 测试步骤 Step Set J_DI_SSBPin6SW_LS NotPressed
  g_HIL_Bus_Swc_Check("I_LDCU_BodySysSt2::I_LDCU_ZATButtonSwSt 0 1 s"); // 预期结果 Step Check I_LDCU_BodySysSt2::I_LDCU_ZATButtonSwSt 0 1 s//notpressed
}

testcase SYS_LDCU_Powermode_0121()
{
  TestDescription("实体开关仲裁-3");
  g_HIL_UDS_Swc_Set_UDS("SA_L1"); // 测试步骤 Step Set_UDS SA_L1
  g_HIL_Gen_Swc_Wait("151 ms"); // 测试步骤 Step Wait 151 ms
  g_HIL_UDS_Swc_Set_UDS("2E 31 11 02 00"); // 测试步骤 Step Set_UDS 2E 31 11 02 00//Dbldigital
  g_HIL_UDS_Swc_Check_UDS("6E 31 11"); // 预期结果 Step Check_UDS 6E 31 11//Dbldigital
  g_HIL_Bus_Swc_Set("VTS::VT2848_4_Ch27::DigitalOutput 0"); // 测试步骤 Step Set J_DI_SSBPin4SW_LS NotPressed
  g_HIL_Bus_Swc_Set("VTS::VT2848_4_Ch32::DigitalOutput 0"); // 测试步骤 Step Set J_DI_SSBPin6SW_LS NotPressed
  g_HIL_Bus_Swc_Check("I_LDCU_BodySysSt2::I_LDCU_ZATButtonSwSt 0 1 s"); // 预期结果 Step Check I_LDCU_BodySysSt2::I_LDCU_ZATButtonSwSt 0 1 s//notpressed
  g_HIL_Gen_Swc_Wait("301 ms"); // 测试步骤 Step Wait 301 ms
  g_HIL_Bus_Swc_Set("VTS::VT2848_4_Ch32::DigitalOutput 1"); // 测试步骤 Step Set J_DI_SSBPin6SW_LS Pressed
  g_HIL_Gen_Swc_Wait("61 s"); // 测试步骤 Step Wait 61 s//开关1按下，2粘滞
  g_HIL_Bus_Swc_Set("VTS::VT2848_4_Ch27::DigitalOutput 1"); // 测试步骤 Step Set J_DI_SSBPin4SW_LS Pressed
  g_HIL_Bus_Swc_Check("I_LDCU_BodySysSt2::I_LDCU_ZATButtonSwSt 1 1 s"); // 预期结果 Step Check I_LDCU_BodySysSt2::I_LDCU_ZATButtonSwSt 1 1 s//pressed
  g_HIL_Bus_Swc_Set("VTS::VT2848_4_Ch27::DigitalOutput 0"); // 测试步骤 Step Set J_DI_SSBPin4SW_LS NotPressed
  g_HIL_Bus_Swc_Set("VTS::VT2848_4_Ch32::DigitalOutput 0"); // 测试步骤 Step Set J_DI_SSBPin6SW_LS NotPressed
  g_HIL_Bus_Swc_Check("I_LDCU_BodySysSt2::I_LDCU_ZATButtonSwSt 0 1 s"); // 预期结果 Step Check I_LDCU_BodySysSt2::I_LDCU_ZATButtonSwSt 0 1 s//notpressed
}

testcase SYS_LDCU_Powermode_0122()
{
  TestDescription("实体开关仲裁-4");
  g_HIL_UDS_Swc_Set_UDS("SA_L1"); // 测试步骤 Step Set_UDS SA_L1
  g_HIL_Gen_Swc_Wait("151 ms"); // 测试步骤 Step Wait 151 ms
  g_HIL_UDS_Swc_Set_UDS("2E 31 11 02 00"); // 测试步骤 Step Set_UDS 2E 31 11 02 00//Dbldigital
  g_HIL_UDS_Swc_Check_UDS("6E 31 11"); // 预期结果 Step Check_UDS 6E 31 11//Dbldigital
  g_HIL_Bus_Swc_Set("VTS::VT2848_4_Ch27::DigitalOutput 0"); // 测试步骤 Step Set J_DI_SSBPin4SW_LS NotPressed
  g_HIL_Bus_Swc_Set("VTS::VT2848_4_Ch32::DigitalOutput 0"); // 测试步骤 Step Set J_DI_SSBPin6SW_LS NotPressed
  g_HIL_Bus_Swc_Check("I_LDCU_BodySysSt2::I_LDCU_ZATButtonSwSt 0 1 s"); // 预期结果 Step Check I_LDCU_BodySysSt2::I_LDCU_ZATButtonSwSt 0 1 s//notpressed
  g_HIL_Gen_Swc_Wait("301 ms"); // 测试步骤 Step Wait 301 ms
  g_HIL_Bus_Swc_Set("VTS::VT2848_4_Ch27::DigitalOutput 0"); // 测试步骤 Step Set J_DI_SSBPin4SW_LS NotPressed
  g_HIL_Bus_Swc_Set("VTS::VT2848_4_Ch32::DigitalOutput 1"); // 测试步骤 Step Set J_DI_SSBPin6SW_LS Pressed
  g_HIL_Bus_Swc_Check("I_LDCU_BodySysSt2::I_LDCU_ZATButtonSwSt 0 1 s"); // 预期结果 Step Check I_LDCU_BodySysSt2::I_LDCU_ZATButtonSwSt 0 1 s//pressed
  g_HIL_Gen_Swc_Wait("301 ms"); // 测试步骤 Step Wait 301 ms//开关1释放，2按下
  g_HIL_Bus_Swc_Set("VTS::VT2848_4_Ch27::DigitalOutput 0"); // 测试步骤 Step Set J_DI_SSBPin4SW_LS NotPressed
  g_HIL_Bus_Swc_Set("VTS::VT2848_4_Ch32::DigitalOutput 0"); // 测试步骤 Step Set J_DI_SSBPin6SW_LS NotPressed
  g_HIL_Bus_Swc_Check("I_LDCU_BodySysSt2::I_LDCU_ZATButtonSwSt 0 1 s"); // 预期结果 Step Check I_LDCU_BodySysSt2::I_LDCU_ZATButtonSwSt 0 1 s//notpressed
}

testcase SYS_LDCU_Powermode_0123()
{
  TestDescription("实体开关仲裁-5");
  g_HIL_UDS_Swc_Set_UDS("SA_L1"); // 测试步骤 Step Set_UDS SA_L1
  g_HIL_Gen_Swc_Wait("151 ms"); // 测试步骤 Step Wait 151 ms
  g_HIL_UDS_Swc_Set_UDS("2E 31 11 02 00"); // 测试步骤 Step Set_UDS 2E 31 11 02 00//Dbldigital
  g_HIL_UDS_Swc_Check_UDS("6E 31 11"); // 预期结果 Step Check_UDS 6E 31 11//Dbldigital
  g_HIL_Bus_Swc_Set("VTS::VT2848_4_Ch27::DigitalOutput 0"); // 测试步骤 Step Set J_DI_SSBPin4SW_LS NotPressed
  g_HIL_Bus_Swc_Set("VTS::VT2848_4_Ch32::DigitalOutput 0"); // 测试步骤 Step Set J_DI_SSBPin6SW_LS NotPressed
  g_HIL_Bus_Swc_Check("I_LDCU_BodySysSt2::I_LDCU_ZATButtonSwSt 0 1 s"); // 预期结果 Step Check I_LDCU_BodySysSt2::I_LDCU_ZATButtonSwSt 0 1 s//notpressed
  g_HIL_Gen_Swc_Wait("301 ms"); // 测试步骤 Step Wait 301 ms
  g_HIL_Bus_Swc_Set("VTS::VT2848_4_Ch27::DigitalOutput 0"); // 测试步骤 Step Set J_DI_SSBPin4SW_LS NotPressed
  g_HIL_Bus_Swc_Set("VTS::VT2848_4_Ch32::DigitalOutput 0"); // 测试步骤 Step Set J_DI_SSBPin6SW_LS NotPressed
  g_HIL_Bus_Swc_Check("I_LDCU_BodySysSt2::I_LDCU_ZATButtonSwSt 0 1 s"); // 预期结果 Step Check I_LDCU_BodySysSt2::I_LDCU_ZATButtonSwSt 0 1 s//notpressed
  g_HIL_Gen_Swc_Wait("301 ms"); // 测试步骤 Step Wait 301 ms//开关1，2释放
  g_HIL_Bus_Swc_Set("VTS::VT2848_4_Ch27::DigitalOutput 0"); // 测试步骤 Step Set J_DI_SSBPin4SW_LS NotPressed
  g_HIL_Bus_Swc_Set("VTS::VT2848_4_Ch32::DigitalOutput 0"); // 测试步骤 Step Set J_DI_SSBPin6SW_LS NotPressed
  g_HIL_Bus_Swc_Check("I_LDCU_BodySysSt2::I_LDCU_ZATButtonSwSt 0 1 s"); // 预期结果 Step Check I_LDCU_BodySysSt2::I_LDCU_ZATButtonSwSt 0 1 s//notpressed
}

testcase SYS_LDCU_Powermode_0124()
{
  TestDescription("实体开关仲裁-6");
  g_HIL_UDS_Swc_Set_UDS("SA_L1"); // 测试步骤 Step Set_UDS SA_L1
  g_HIL_Gen_Swc_Wait("151 ms"); // 测试步骤 Step Wait 151 ms
  g_HIL_UDS_Swc_Set_UDS("2E 31 11 02 00"); // 测试步骤 Step Set_UDS 2E 31 11 02 00//Dbldigital
  g_HIL_UDS_Swc_Check_UDS("6E 31 11"); // 预期结果 Step Check_UDS 6E 31 11//Dbldigital
  g_HIL_Bus_Swc_Set("VTS::VT2848_4_Ch27::DigitalOutput 0"); // 测试步骤 Step Set J_DI_SSBPin4SW_LS NotPressed
  g_HIL_Bus_Swc_Set("VTS::VT2848_4_Ch32::DigitalOutput 0"); // 测试步骤 Step Set J_DI_SSBPin6SW_LS NotPressed
  g_HIL_Bus_Swc_Check("I_LDCU_BodySysSt2::I_LDCU_ZATButtonSwSt 0 1 s"); // 预期结果 Step Check I_LDCU_BodySysSt2::I_LDCU_ZATButtonSwSt 0 1 s//notpressed
  g_HIL_Gen_Swc_Wait("301 ms"); // 测试步骤 Step Wait 301 ms
  g_HIL_Bus_Swc_Set("VTS::VT2848_4_Ch32::DigitalOutput 1"); // 测试步骤 Step Set J_DI_SSBPin6SW_LS Pressed
  g_HIL_Gen_Swc_Wait("61 s"); // 测试步骤 Step Wait 61 s//开关1释放，2粘滞
  g_HIL_Bus_Swc_Set("VTS::VT2848_4_Ch27::DigitalOutput 0"); // 测试步骤 Step Set J_DI_SSBPin4SW_LS NotPressed
  g_HIL_Bus_Swc_Check("I_LDCU_BodySysSt2::I_LDCU_ZATButtonSwSt 0 1 s"); // 预期结果 Step Check I_LDCU_BodySysSt2::I_LDCU_ZATButtonSwSt 0 1 s//pressed
  g_HIL_Bus_Swc_Set("VTS::VT2848_4_Ch27::DigitalOutput 0"); // 测试步骤 Step Set J_DI_SSBPin4SW_LS NotPressed
  g_HIL_Bus_Swc_Set("VTS::VT2848_4_Ch32::DigitalOutput 0"); // 测试步骤 Step Set J_DI_SSBPin6SW_LS NotPressed
  g_HIL_Bus_Swc_Check("I_LDCU_BodySysSt2::I_LDCU_ZATButtonSwSt 0 1 s"); // 预期结果 Step Check I_LDCU_BodySysSt2::I_LDCU_ZATButtonSwSt 0 1 s//notpressed
}

testcase SYS_LDCU_Powermode_0125()
{
  TestDescription("实体开关仲裁-7");
  g_HIL_UDS_Swc_Set_UDS("SA_L1"); // 测试步骤 Step Set_UDS SA_L1
  g_HIL_Gen_Swc_Wait("151 ms"); // 测试步骤 Step Wait 151 ms
  g_HIL_UDS_Swc_Set_UDS("2E 31 11 02 00"); // 测试步骤 Step Set_UDS 2E 31 11 02 00//Dbldigital
  g_HIL_UDS_Swc_Check_UDS("6E 31 11"); // 预期结果 Step Check_UDS 6E 31 11//Dbldigital
  g_HIL_Bus_Swc_Set("VTS::VT2848_4_Ch27::DigitalOutput 0"); // 测试步骤 Step Set J_DI_SSBPin4SW_LS NotPressed
  g_HIL_Bus_Swc_Set("VTS::VT2848_4_Ch32::DigitalOutput 0"); // 测试步骤 Step Set J_DI_SSBPin6SW_LS NotPressed
  g_HIL_Bus_Swc_Check("I_LDCU_BodySysSt2::I_LDCU_ZATButtonSwSt 0 1 s"); // 预期结果 Step Check I_LDCU_BodySysSt2::I_LDCU_ZATButtonSwSt 0 1 s//notpressed
  g_HIL_Gen_Swc_Wait("301 ms"); // 测试步骤 Step Wait 301 ms
  g_HIL_Bus_Swc_Set("VTS::VT2848_4_Ch27::DigitalOutput 1"); // 测试步骤 Step Set J_DI_SSBPin4SW_LS Pressed
  g_HIL_Gen_Swc_Wait("61 s"); // 测试步骤 Step Wait 61 s//开关1粘滞，2按下
  g_HIL_Bus_Swc_Set("VTS::VT2848_4_Ch32::DigitalOutput 1"); // 测试步骤 Step Set J_DI_SSBPin6SW_LS Pressed
  g_HIL_Bus_Swc_Check("I_LDCU_BodySysSt2::I_LDCU_ZATButtonSwSt 1 1 s"); // 预期结果 Step Check I_LDCU_BodySysSt2::I_LDCU_ZATButtonSwSt 1 1 s//pressed
  g_HIL_Bus_Swc_Set("VTS::VT2848_4_Ch27::DigitalOutput 0"); // 测试步骤 Step Set J_DI_SSBPin4SW_LS NotPressed
  g_HIL_Bus_Swc_Set("VTS::VT2848_4_Ch32::DigitalOutput 0"); // 测试步骤 Step Set J_DI_SSBPin6SW_LS NotPressed
  g_HIL_Bus_Swc_Check("I_LDCU_BodySysSt2::I_LDCU_ZATButtonSwSt 0 1 s"); // 预期结果 Step Check I_LDCU_BodySysSt2::I_LDCU_ZATButtonSwSt 0 1 s//notpressed
}

testcase SYS_LDCU_Powermode_0126()
{
  TestDescription("实体开关仲裁-8");
  g_HIL_UDS_Swc_Set_UDS("SA_L1"); // 测试步骤 Step Set_UDS SA_L1
  g_HIL_Gen_Swc_Wait("151 ms"); // 测试步骤 Step Wait 151 ms
  g_HIL_UDS_Swc_Set_UDS("2E 31 11 02 00"); // 测试步骤 Step Set_UDS 2E 31 11 02 00//Dbldigital
  g_HIL_UDS_Swc_Check_UDS("6E 31 11"); // 预期结果 Step Check_UDS 6E 31 11//Dbldigital
  g_HIL_Bus_Swc_Set("VTS::VT2848_4_Ch27::DigitalOutput 0"); // 测试步骤 Step Set J_DI_SSBPin4SW_LS NotPressed
  g_HIL_Bus_Swc_Set("VTS::VT2848_4_Ch32::DigitalOutput 0"); // 测试步骤 Step Set J_DI_SSBPin6SW_LS NotPressed
  g_HIL_Bus_Swc_Check("I_LDCU_BodySysSt2::I_LDCU_ZATButtonSwSt 0 1 s"); // 预期结果 Step Check I_LDCU_BodySysSt2::I_LDCU_ZATButtonSwSt 0 1 s//notpressed
  g_HIL_Gen_Swc_Wait("301 ms"); // 测试步骤 Step Wait 301 ms
  g_HIL_Bus_Swc_Set("VTS::VT2848_4_Ch27::DigitalOutput 1"); // 测试步骤 Step Set J_DI_SSBPin4SW_LS Pressed
  g_HIL_Gen_Swc_Wait("61 s"); // 测试步骤 Step Wait 61 s//开关1粘滞，2释放
  g_HIL_Bus_Swc_Set("VTS::VT2848_4_Ch32::DigitalOutput 0"); // 测试步骤 Step Set J_DI_SSBPin6SW_LS NotPressed
  g_HIL_Bus_Swc_Check("I_LDCU_BodySysSt2::I_LDCU_ZATButtonSwSt 0 1 s"); // 预期结果 Step Check I_LDCU_BodySysSt2::I_LDCU_ZATButtonSwSt 0 1 s//notpressed
  g_HIL_Bus_Swc_Set("VTS::VT2848_4_Ch27::DigitalOutput 0"); // 测试步骤 Step Set J_DI_SSBPin4SW_LS NotPressed
  g_HIL_Bus_Swc_Set("VTS::VT2848_4_Ch32::DigitalOutput 0"); // 测试步骤 Step Set J_DI_SSBPin6SW_LS NotPressed
  g_HIL_Bus_Swc_Check("I_LDCU_BodySysSt2::I_LDCU_ZATButtonSwSt 0 1 s"); // 预期结果 Step Check I_LDCU_BodySysSt2::I_LDCU_ZATButtonSwSt 0 1 s//notpressed
}

testcase SYS_LDCU_Powermode_0127()
{
  TestDescription("实体开关仲裁-9");
  g_HIL_UDS_Swc_Set_UDS("SA_L1"); // 测试步骤 Step Set_UDS SA_L1
  g_HIL_Gen_Swc_Wait("151 ms"); // 测试步骤 Step Wait 151 ms
  g_HIL_UDS_Swc_Set_UDS("2E 31 11 02 00"); // 测试步骤 Step Set_UDS 2E 31 11 02 00//Dbldigital
  g_HIL_UDS_Swc_Check_UDS("6E 31 11"); // 预期结果 Step Check_UDS 6E 31 11//Dbldigital
  g_HIL_Bus_Swc_Set("VTS::VT2848_4_Ch27::DigitalOutput 0"); // 测试步骤 Step Set J_DI_SSBPin4SW_LS NotPressed
  g_HIL_Bus_Swc_Set("VTS::VT2848_4_Ch32::DigitalOutput 0"); // 测试步骤 Step Set J_DI_SSBPin6SW_LS NotPressed
  g_HIL_Bus_Swc_Check("I_LDCU_BodySysSt2::I_LDCU_ZATButtonSwSt 0 1 s"); // 预期结果 Step Check I_LDCU_BodySysSt2::I_LDCU_ZATButtonSwSt 0 1 s//notpressed
  g_HIL_Gen_Swc_Wait("301 ms"); // 测试步骤 Step Wait 301 ms
  g_HIL_Bus_Swc_Set("VTS::VT2848_4_Ch27::DigitalOutput 1"); // 测试步骤 Step Set J_DI_SSBPin4SW_LS Pressed
  g_HIL_Bus_Swc_Set("VTS::VT2848_4_Ch32::DigitalOutput 1"); // 测试步骤 Step Set J_DI_SSBPin6SW_LS Pressed
  g_HIL_Gen_Swc_Wait("61 s"); // 测试步骤 Step Wait 61 s//开关1，2粘滞
  g_HIL_Bus_Swc_Check("I_LDCU_BodySysSt2::I_LDCU_ZATButtonSwSt 2 1 s"); // 预期结果 Step Check I_LDCU_BodySysSt2::I_LDCU_ZATButtonSwSt 2 1 s//Incalid
  g_HIL_Bus_Swc_Set("VTS::VT2848_4_Ch27::DigitalOutput 0"); // 测试步骤 Step Set J_DI_SSBPin4SW_LS NotPressed
  g_HIL_Bus_Swc_Set("VTS::VT2848_4_Ch32::DigitalOutput 0"); // 测试步骤 Step Set J_DI_SSBPin6SW_LS NotPressed
  g_HIL_Bus_Swc_Check("I_LDCU_BodySysSt2::I_LDCU_ZATButtonSwSt 0 1 s"); // 预期结果 Step Check I_LDCU_BodySysSt2::I_LDCU_ZATButtonSwSt 0 1 s//notpressed
}

testcase SYS_LDCU_Powermode_0128()
{
  TestDescription("静/动态强制下电-无二次确认-1");
  g_HIL_UDS_Swc_Set_UDS("SA_L1"); // 测试步骤 Step Set_UDS SA_L1
  g_HIL_Gen_Swc_Wait("151 ms"); // 测试步骤 Step Wait 151 ms
  g_HIL_UDS_Swc_Set_UDS("2E 31 11 02 01"); // 测试步骤 Step Set_UDS 2E 31 11 02 01//No 2nd Confirm
  g_HIL_UDS_Swc_Check_UDS("6E 31 11"); // 预期结果 Step Check_UDS 6E 31 11//Dbldigital
  g_HIL_Clib_Swc_Clib_BrkLocalON(); // 测试步骤 Step Clib BrkLocalON
  g_HIL_Bus_Swc_Check("I_LDCU_BodySysSt1::I_LDCU_PowerMode 1"); // 预期结果 Step Check I_LDCU_BodySysSt1::I_LDCU_PowerMode 1 //Local_ON
  g_HIL_Bus_Swc_Set("C_IPB_SpdInfoF::C_IPB_VehSpd 0"); // 测试步骤 Step Set C_IPB_SpdInfoF::C_IPB_VehSpd 0//车速小于3Km
  g_HIL_Bus_Swc_Set("C_IPB_SpdInfoF::C_IPB_VehSpdVD 1"); // 测试步骤 Step Set C_IPB_SpdInfoF::C_IPB_VehSpdVD 1//车速有效
  g_HIL_Bus_Swc_Set("VTS::VT2848_4_Ch27::DigitalOutput 0"); // 测试步骤 Step Set J_DI_SSBPin4SW_LS NotPressed
  g_HIL_Bus_Swc_Set("VTS::VT2848_4_Ch32::DigitalOutput 0"); // 测试步骤 Step Set J_DI_SSBPin6SW_LS NotPressed
  g_HIL_Bus_Swc_Check("I_LDCU_BodySysSt2::I_LDCU_ZATButtonSwSt 0 1 s"); // 预期结果 Step Check I_LDCU_BodySysSt2::I_LDCU_ZATButtonSwSt 0 1 s//notpressed
  g_HIL_Bus_Swc_Set("VTS::VT2848_4_Ch27::DigitalOutput 1"); // 测试步骤 Step Set J_DI_SSBPin4SW_LS Pressed
  g_HIL_Bus_Swc_Set("VTS::VT2848_4_Ch32::DigitalOutput 1"); // 测试步骤 Step Set J_DI_SSBPin6SW_LS Pressed
  g_HIL_Bus_Swc_Check("I_LDCU_BodySysSt2::I_LDCU_ZATButtonSwSt 1 1 s"); // 预期结果 Step Check I_LDCU_BodySysSt2::I_LDCU_ZATButtonSwSt 1 1 s//pressed
  g_HIL_Bus_Swc_Set("VTS::VT2848_4_Ch27::DigitalOutput 0"); // 测试步骤 Step Set J_DI_SSBPin4SW_LS NotPressed
  g_HIL_Bus_Swc_Set("VTS::VT2848_4_Ch32::DigitalOutput 0"); // 测试步骤 Step Set J_DI_SSBPin6SW_LS NotPressed
  g_HIL_Bus_Swc_Check("I_LDCU_BodySysSt2::I_LDCU_ZATButtonSwSt 0 1 s"); // 预期结果 Step Check I_LDCU_BodySysSt2::I_LDCU_ZATButtonSwSt 0 1 s//notpressed
  g_HIL_Bus_Swc_Set("VTS::VT2848_4_Ch27::DigitalOutput 1"); // 测试步骤 Step Set J_DI_SSBPin4SW_LS Pressed
  g_HIL_Bus_Swc_Set("VTS::VT2848_4_Ch32::DigitalOutput 1"); // 测试步骤 Step Set J_DI_SSBPin6SW_LS Pressed
  g_HIL_Bus_Swc_Check("I_LDCU_BodySysSt2::I_LDCU_ZATButtonSwSt 1 1 s"); // 预期结果 Step Check I_LDCU_BodySysSt2::I_LDCU_ZATButtonSwSt 1 1 s//pressed
  g_HIL_Bus_Swc_Set("VTS::VT2848_4_Ch27::DigitalOutput 0"); // 测试步骤 Step Set J_DI_SSBPin4SW_LS NotPressed
  g_HIL_Bus_Swc_Set("VTS::VT2848_4_Ch32::DigitalOutput 0"); // 测试步骤 Step Set J_DI_SSBPin6SW_LS NotPressed
  g_HIL_Bus_Swc_Check("I_LDCU_BodySysSt2::I_LDCU_ZATButtonSwSt 0 1 s"); // 预期结果 Step Check I_LDCU_BodySysSt2::I_LDCU_ZATButtonSwSt 0 1 s//notpressed
  g_HIL_Bus_Swc_Set("VTS::VT2848_4_Ch27::DigitalOutput 1"); // 测试步骤 Step Set J_DI_SSBPin4SW_LS Pressed
  g_HIL_Bus_Swc_Set("VTS::VT2848_4_Ch32::DigitalOutput 1"); // 测试步骤 Step Set J_DI_SSBPin6SW_LS Pressed
  g_HIL_Bus_Swc_Check("I_LDCU_BodySysSt2::I_LDCU_ZATButtonSwSt 1 1 s"); // 预期结果 Step Check I_LDCU_BodySysSt2::I_LDCU_ZATButtonSwSt 1 1 s//pressed
  g_HIL_Bus_Swc_Check("I_LDCU_BodySysSt2::I_LDCU_PowerOFFSource 2 1 s"); // 预期结果 Step Check I_LDCU_BodySysSt2::I_LDCU_PowerOFFSource 2 1 s//强制下电
  g_HIL_Bus_Swc_Check("I_LDCU_BodySysSt1::I_LDCU_PowerMode 0"); // 预期结果 Step Check I_LDCU_BodySysSt1::I_LDCU_PowerMode 0//OFF
  g_HIL_Bus_Swc_Check("VTS::VT2848_2_Ch26::CurBit 0"); // 预期结果 Step Check J_DO_HS_KL15_BackUp Inactive
  g_HIL_Bus_Swc_Set("VTS::VT2848_4_Ch27::DigitalOutput 0"); // 测试步骤 Step Set J_DI_SSBPin4SW_LS NotPressed
  g_HIL_Bus_Swc_Set("VTS::VT2848_4_Ch32::DigitalOutput 0"); // 测试步骤 Step Set J_DI_SSBPin6SW_LS NotPressed
  g_HIL_Bus_Swc_Check("I_LDCU_BodySysSt2::I_LDCU_ZATButtonSwSt 0 1 s"); // 预期结果 Step Check I_LDCU_BodySysSt2::I_LDCU_ZATButtonSwSt 0 1 s//notpressed
}

testcase SYS_LDCU_Powermode_0129()
{
  TestDescription("静/动态强制下电-无二次确认-2");
  g_HIL_UDS_Swc_Set_UDS("SA_L1"); // 测试步骤 Step Set_UDS SA_L1
  g_HIL_Gen_Swc_Wait("151 ms"); // 测试步骤 Step Wait 151 ms
  g_HIL_UDS_Swc_Set_UDS("2E 31 11 02 01"); // 测试步骤 Step Set_UDS 2E 31 11 02 01//No 2nd Confirm
  g_HIL_UDS_Swc_Check_UDS("6E 31 11"); // 预期结果 Step Check_UDS 6E 31 11//Dbldigital
  g_HIL_Clib_Swc_Clib_BrkLocalON(); // 测试步骤 Step Clib BrkLocalON
  g_HIL_Bus_Swc_Check("I_LDCU_BodySysSt1::I_LDCU_PowerMode 1"); // 预期结果 Step Check I_LDCU_BodySysSt1::I_LDCU_PowerMode 1 //Local_ON
  g_HIL_Bus_Swc_Set("C_IPB_SpdInfoF::C_IPB_VehSpd 20"); // 测试步骤 Step Set C_IPB_SpdInfoF::C_IPB_VehSpd 20//
  g_HIL_Bus_Swc_Set("C_IPB_SpdInfoF::C_IPB_VehSpdVD 1"); // 测试步骤 Step Set C_IPB_SpdInfoF::C_IPB_VehSpdVD 1//车速有效
  g_HIL_Bus_Swc_Set("VTS::VT2848_4_Ch27::DigitalOutput 0"); // 测试步骤 Step Set J_DI_SSBPin4SW_LS NotPressed
  g_HIL_Bus_Swc_Set("VTS::VT2848_4_Ch32::DigitalOutput 0"); // 测试步骤 Step Set J_DI_SSBPin6SW_LS NotPressed
  g_HIL_Bus_Swc_Check("I_LDCU_BodySysSt2::I_LDCU_ZATButtonSwSt 0 1 s"); // 预期结果 Step Check I_LDCU_BodySysSt2::I_LDCU_ZATButtonSwSt 0 1 s//notpressed
  g_HIL_Bus_Swc_Set("VTS::VT2848_4_Ch27::DigitalOutput 1"); // 测试步骤 Step Set J_DI_SSBPin4SW_LS Pressed
  g_HIL_Bus_Swc_Set("VTS::VT2848_4_Ch32::DigitalOutput 1"); // 测试步骤 Step Set J_DI_SSBPin6SW_LS Pressed
  g_HIL_Bus_Swc_Check("I_LDCU_BodySysSt2::I_LDCU_ZATButtonSwSt 1 1 s"); // 预期结果 Step Check I_LDCU_BodySysSt2::I_LDCU_ZATButtonSwSt 1 1 s//pressed
  g_HIL_Gen_Swc_Wait("4 s"); // 测试步骤 Step Wait 4 s
  g_HIL_Bus_Swc_Check("I_LDCU_BodySysSt2::I_LDCU_PowerOFFSource 2 2 s"); // 预期结果 Step Check I_LDCU_BodySysSt2::I_LDCU_PowerOFFSource 2 2 s//强制下电
  g_HIL_Bus_Swc_Check("I_LDCU_BodySysSt1::I_LDCU_PowerMode 0"); // 预期结果 Step Check I_LDCU_BodySysSt1::I_LDCU_PowerMode 0//OFF
  g_HIL_Bus_Swc_Check("VTS::VT2848_2_Ch26::CurBit 0"); // 预期结果 Step Check J_DO_HS_KL15_BackUp Inactive
  g_HIL_Bus_Swc_Set("VTS::VT2848_4_Ch27::DigitalOutput 0"); // 测试步骤 Step Set J_DI_SSBPin4SW_LS NotPressed
  g_HIL_Bus_Swc_Set("VTS::VT2848_4_Ch32::DigitalOutput 0"); // 测试步骤 Step Set J_DI_SSBPin6SW_LS NotPressed
  g_HIL_Bus_Swc_Check("I_LDCU_BodySysSt2::I_LDCU_ZATButtonSwSt 0 1 s"); // 预期结果 Step Check I_LDCU_BodySysSt2::I_LDCU_ZATButtonSwSt 0 1 s//notpressed
  g_HIL_Bus_Swc_Set("C_IPB_SpdInfoF::C_IPB_VehSpd 0"); // 测试步骤 Step Set C_IPB_SpdInfoF::C_IPB_VehSpd 0//车速小于3Km
}

testcase SYS_LDCU_Powermode_0130()
{
  TestDescription("静/动态强制下电-无二次确认-3");
  g_HIL_UDS_Swc_Set_UDS("SA_L1"); // 测试步骤 Step Set_UDS SA_L1
  g_HIL_Gen_Swc_Wait("151 ms"); // 测试步骤 Step Wait 151 ms
  g_HIL_UDS_Swc_Set_UDS("2E 31 11 02 01"); // 测试步骤 Step Set_UDS 2E 31 11 02 01//No 2nd Confirm
  g_HIL_UDS_Swc_Check_UDS("6E 31 11"); // 预期结果 Step Check_UDS 6E 31 11//Dbldigital
  g_HIL_Clib_Swc_Clib_RemoteON(); // 测试步骤 Step Clib RemoteON
  g_HIL_Bus_Swc_Check("I_LDCU_BodySysSt1::I_LDCU_PowerMode 2"); // 预期结果 Step Check I_LDCU_BodySysSt1::I_LDCU_PowerMode 2 //RemoteON
  g_HIL_Bus_Swc_Set("C_IPB_SpdInfoF::C_IPB_VehSpd 0"); // 测试步骤 Step Set C_IPB_SpdInfoF::C_IPB_VehSpd 0//车速小于3Km
  g_HIL_Bus_Swc_Set("C_IPB_SpdInfoF::C_IPB_VehSpdVD 1"); // 测试步骤 Step Set C_IPB_SpdInfoF::C_IPB_VehSpdVD 1//车速有效
  g_HIL_Bus_Swc_Set("VTS::VT2848_4_Ch27::DigitalOutput 0"); // 测试步骤 Step Set J_DI_SSBPin4SW_LS NotPressed
  g_HIL_Bus_Swc_Set("VTS::VT2848_4_Ch32::DigitalOutput 0"); // 测试步骤 Step Set J_DI_SSBPin6SW_LS NotPressed
  g_HIL_Bus_Swc_Check("I_LDCU_BodySysSt2::I_LDCU_ZATButtonSwSt 0 1 s"); // 预期结果 Step Check I_LDCU_BodySysSt2::I_LDCU_ZATButtonSwSt 0 1 s//notpressed
  g_HIL_Bus_Swc_Set("VTS::VT2848_4_Ch27::DigitalOutput 1"); // 测试步骤 Step Set J_DI_SSBPin4SW_LS Pressed
  g_HIL_Bus_Swc_Set("VTS::VT2848_4_Ch32::DigitalOutput 1"); // 测试步骤 Step Set J_DI_SSBPin6SW_LS Pressed
  g_HIL_Bus_Swc_Check("I_LDCU_BodySysSt2::I_LDCU_ZATButtonSwSt 1 1 s"); // 预期结果 Step Check I_LDCU_BodySysSt2::I_LDCU_ZATButtonSwSt 1 1 s//pressed
  g_HIL_Bus_Swc_Set("VTS::VT2848_4_Ch27::DigitalOutput 0"); // 测试步骤 Step Set J_DI_SSBPin4SW_LS NotPressed
  g_HIL_Bus_Swc_Set("VTS::VT2848_4_Ch32::DigitalOutput 0"); // 测试步骤 Step Set J_DI_SSBPin6SW_LS NotPressed
  g_HIL_Bus_Swc_Check("I_LDCU_BodySysSt2::I_LDCU_ZATButtonSwSt 0 1 s"); // 预期结果 Step Check I_LDCU_BodySysSt2::I_LDCU_ZATButtonSwSt 0 1 s//notpressed
  g_HIL_Bus_Swc_Set("VTS::VT2848_4_Ch27::DigitalOutput 1"); // 测试步骤 Step Set J_DI_SSBPin4SW_LS Pressed
  g_HIL_Bus_Swc_Set("VTS::VT2848_4_Ch32::DigitalOutput 1"); // 测试步骤 Step Set J_DI_SSBPin6SW_LS Pressed
  g_HIL_Bus_Swc_Check("I_LDCU_BodySysSt2::I_LDCU_ZATButtonSwSt 1 1 s"); // 预期结果 Step Check I_LDCU_BodySysSt2::I_LDCU_ZATButtonSwSt 1 1 s//pressed
  g_HIL_Bus_Swc_Set("VTS::VT2848_4_Ch27::DigitalOutput 0"); // 测试步骤 Step Set J_DI_SSBPin4SW_LS NotPressed
  g_HIL_Bus_Swc_Set("VTS::VT2848_4_Ch32::DigitalOutput 0"); // 测试步骤 Step Set J_DI_SSBPin6SW_LS NotPressed
  g_HIL_Bus_Swc_Check("I_LDCU_BodySysSt2::I_LDCU_ZATButtonSwSt 0 1 s"); // 预期结果 Step Check I_LDCU_BodySysSt2::I_LDCU_ZATButtonSwSt 0 1 s//notpressed
  g_HIL_Bus_Swc_Set("VTS::VT2848_4_Ch27::DigitalOutput 1"); // 测试步骤 Step Set J_DI_SSBPin4SW_LS Pressed
  g_HIL_Bus_Swc_Set("VTS::VT2848_4_Ch32::DigitalOutput 1"); // 测试步骤 Step Set J_DI_SSBPin6SW_LS Pressed
  g_HIL_Bus_Swc_Check("I_LDCU_BodySysSt2::I_LDCU_ZATButtonSwSt 1 1 s"); // 预期结果 Step Check I_LDCU_BodySysSt2::I_LDCU_ZATButtonSwSt 1 1 s//pressed
  g_HIL_Bus_Swc_Check("I_LDCU_BodySysSt2::I_LDCU_PowerOFFSource 2 1 s"); // 预期结果 Step Check I_LDCU_BodySysSt2::I_LDCU_PowerOFFSource 2 1 s//强制下电
  g_HIL_Bus_Swc_Check("I_LDCU_BodySysSt1::I_LDCU_PowerMode 0"); // 预期结果 Step Check I_LDCU_BodySysSt1::I_LDCU_PowerMode 0//OFF
  g_HIL_Bus_Swc_Check("VTS::VT2848_2_Ch26::CurBit 0"); // 预期结果 Step Check J_DO_HS_KL15_BackUp Inactive
  g_HIL_Bus_Swc_Set("VTS::VT2848_4_Ch27::DigitalOutput 0"); // 测试步骤 Step Set J_DI_SSBPin4SW_LS NotPressed
  g_HIL_Bus_Swc_Set("VTS::VT2848_4_Ch32::DigitalOutput 0"); // 测试步骤 Step Set J_DI_SSBPin6SW_LS NotPressed
  g_HIL_Bus_Swc_Check("I_LDCU_BodySysSt2::I_LDCU_ZATButtonSwSt 0 1 s"); // 预期结果 Step Check I_LDCU_BodySysSt2::I_LDCU_ZATButtonSwSt 0 1 s//notpressed
}

testcase SYS_LDCU_Powermode_0131()
{
  TestDescription("静/动态强制下电-无二次确认-4");
  g_HIL_UDS_Swc_Set_UDS("SA_L1"); // 测试步骤 Step Set_UDS SA_L1
  g_HIL_Gen_Swc_Wait("151 ms"); // 测试步骤 Step Wait 151 ms
  g_HIL_UDS_Swc_Set_UDS("2E 31 11 02 01"); // 测试步骤 Step Set_UDS 2E 31 11 02 01//No 2nd Confirm
  g_HIL_UDS_Swc_Check_UDS("6E 31 11"); // 预期结果 Step Check_UDS 6E 31 11//Dbldigital
  g_HIL_Clib_Swc_Clib_RemoteON(); // 测试步骤 Step Clib RemoteON
  g_HIL_Bus_Swc_Check("I_LDCU_BodySysSt1::I_LDCU_PowerMode 2"); // 预期结果 Step Check I_LDCU_BodySysSt1::I_LDCU_PowerMode 2 //RemoteON
  g_HIL_Bus_Swc_Set("C_IPB_SpdInfoF::C_IPB_VehSpd 20"); // 测试步骤 Step Set C_IPB_SpdInfoF::C_IPB_VehSpd 20//
  g_HIL_Bus_Swc_Set("C_IPB_SpdInfoF::C_IPB_VehSpdVD 1"); // 测试步骤 Step Set C_IPB_SpdInfoF::C_IPB_VehSpdVD 1//车速有效
  g_HIL_Bus_Swc_Set("VTS::VT2848_4_Ch27::DigitalOutput 0"); // 测试步骤 Step Set J_DI_SSBPin4SW_LS NotPressed
  g_HIL_Bus_Swc_Set("VTS::VT2848_4_Ch32::DigitalOutput 0"); // 测试步骤 Step Set J_DI_SSBPin6SW_LS NotPressed
  g_HIL_Bus_Swc_Check("I_LDCU_BodySysSt2::I_LDCU_ZATButtonSwSt 0 1 s"); // 预期结果 Step Check I_LDCU_BodySysSt2::I_LDCU_ZATButtonSwSt 0 1 s//notpressed
  g_HIL_Bus_Swc_Set("VTS::VT2848_4_Ch27::DigitalOutput 1"); // 测试步骤 Step Set J_DI_SSBPin4SW_LS Pressed
  g_HIL_Bus_Swc_Set("VTS::VT2848_4_Ch32::DigitalOutput 1"); // 测试步骤 Step Set J_DI_SSBPin6SW_LS Pressed
  g_HIL_Bus_Swc_Check("I_LDCU_BodySysSt2::I_LDCU_ZATButtonSwSt 1 1 s"); // 预期结果 Step Check I_LDCU_BodySysSt2::I_LDCU_ZATButtonSwSt 1 1 s//pressed
  g_HIL_Gen_Swc_Wait("4 s"); // 测试步骤 Step Wait 4 s
  g_HIL_Bus_Swc_Check("I_LDCU_BodySysSt2::I_LDCU_PowerOFFSource 2 2 s"); // 预期结果 Step Check I_LDCU_BodySysSt2::I_LDCU_PowerOFFSource 2 2 s//强制下电
  g_HIL_Bus_Swc_Check("I_LDCU_BodySysSt1::I_LDCU_PowerMode 0"); // 预期结果 Step Check I_LDCU_BodySysSt1::I_LDCU_PowerMode 0//OFF
  g_HIL_Bus_Swc_Check("VTS::VT2848_2_Ch26::CurBit 0"); // 预期结果 Step Check J_DO_HS_KL15_BackUp Inactive
  g_HIL_Bus_Swc_Set("VTS::VT2848_4_Ch27::DigitalOutput 0"); // 测试步骤 Step Set J_DI_SSBPin4SW_LS NotPressed
  g_HIL_Bus_Swc_Set("VTS::VT2848_4_Ch32::DigitalOutput 0"); // 测试步骤 Step Set J_DI_SSBPin6SW_LS NotPressed
  g_HIL_Bus_Swc_Check("I_LDCU_BodySysSt2::I_LDCU_ZATButtonSwSt 0 1 s"); // 预期结果 Step Check I_LDCU_BodySysSt2::I_LDCU_ZATButtonSwSt 0 1 s//notpressed
  g_HIL_Bus_Swc_Set("C_IPB_SpdInfoF::C_IPB_VehSpd 0"); // 测试步骤 Step Set C_IPB_SpdInfoF::C_IPB_VehSpd 0//车速小于3Km
}

testcase SYS_LDCU_Powermode_0132()
{
  TestDescription("静态强制下电-二次确认-1");
  g_HIL_UDS_Swc_Set_UDS("SA_L1"); // 测试步骤 Step Set_UDS SA_L1
  g_HIL_Gen_Swc_Wait("151 ms"); // 测试步骤 Step Wait 151 ms
  g_HIL_UDS_Swc_Set_UDS("2E 31 11 02 00"); // 测试步骤 Step Set_UDS 2E 31 11 02 00//Need 2nd Confirm
  g_HIL_UDS_Swc_Check_UDS("6E 31 11"); // 预期结果 Step Check_UDS 6E 31 11//Dbldigital
  g_HIL_Clib_Swc_Clib_BrkLocalON(); // 测试步骤 Step Clib BrkLocalON
  g_HIL_Bus_Swc_Check("I_LDCU_BodySysSt1::I_LDCU_PowerMode 1"); // 预期结果 Step Check I_LDCU_BodySysSt1::I_LDCU_PowerMode 1 //Local_ON
  g_HIL_Bus_Swc_Set("C_IPB_SpdInfoF::C_IPB_VehSpd 0"); // 测试步骤 Step Set C_IPB_SpdInfoF::C_IPB_VehSpd 0//车速小于3Km
  g_HIL_Bus_Swc_Set("C_IPB_SpdInfoF::C_IPB_VehSpdVD 1"); // 测试步骤 Step Set C_IPB_SpdInfoF::C_IPB_VehSpdVD 1//车速有效
  g_HIL_Bus_Swc_Set("VTS::VT2848_4_Ch27::DigitalOutput 0"); // 测试步骤 Step Set J_DI_SSBPin4SW_LS NotPressed
  g_HIL_Bus_Swc_Set("VTS::VT2848_4_Ch32::DigitalOutput 0"); // 测试步骤 Step Set J_DI_SSBPin6SW_LS NotPressed
  g_HIL_Bus_Swc_Check("I_LDCU_BodySysSt2::I_LDCU_ZATButtonSwSt 0 1 s"); // 预期结果 Step Check I_LDCU_BodySysSt2::I_LDCU_ZATButtonSwSt 0 1 s//notpressed
  g_HIL_Bus_Swc_Set("VTS::VT2848_4_Ch27::DigitalOutput 1"); // 测试步骤 Step Set J_DI_SSBPin4SW_LS Pressed
  g_HIL_Bus_Swc_Set("VTS::VT2848_4_Ch32::DigitalOutput 1"); // 测试步骤 Step Set J_DI_SSBPin6SW_LS Pressed
  g_HIL_Bus_Swc_Check("I_LDCU_BodySysSt2::I_LDCU_ZATButtonSwSt 1 1 s"); // 预期结果 Step Check I_LDCU_BodySysSt2::I_LDCU_ZATButtonSwSt 1 1 s//pressed
  g_HIL_Bus_Swc_Set("VTS::VT2848_4_Ch27::DigitalOutput 0"); // 测试步骤 Step Set J_DI_SSBPin4SW_LS NotPressed
  g_HIL_Bus_Swc_Set("VTS::VT2848_4_Ch32::DigitalOutput 0"); // 测试步骤 Step Set J_DI_SSBPin6SW_LS NotPressed
  g_HIL_Bus_Swc_Check("I_LDCU_BodySysSt2::I_LDCU_ZATButtonSwSt 0 1 s"); // 预期结果 Step Check I_LDCU_BodySysSt2::I_LDCU_ZATButtonSwSt 0 1 s//notpressed
  g_HIL_Bus_Swc_Set("VTS::VT2848_4_Ch27::DigitalOutput 1"); // 测试步骤 Step Set J_DI_SSBPin4SW_LS Pressed
  g_HIL_Bus_Swc_Set("VTS::VT2848_4_Ch32::DigitalOutput 1"); // 测试步骤 Step Set J_DI_SSBPin6SW_LS Pressed
  g_HIL_Bus_Swc_Check("I_LDCU_BodySysSt2::I_LDCU_ZATButtonSwSt 1 1 s"); // 预期结果 Step Check I_LDCU_BodySysSt2::I_LDCU_ZATButtonSwSt 1 1 s//pressed
  g_HIL_Bus_Swc_Set("VTS::VT2848_4_Ch27::DigitalOutput 0"); // 测试步骤 Step Set J_DI_SSBPin4SW_LS NotPressed
  g_HIL_Bus_Swc_Check("I_LDCU_BodySysSt1::I_LDCU_PowerMode 1"); // 预期结果 Step Check I_LDCU_BodySysSt1::I_LDCU_PowerMode 1 //Local_ON
  g_HIL_Bus_Swc_Set("VTS::VT2848_4_Ch32::DigitalOutput 0"); // 测试步骤 Step Set J_DI_SSBPin6SW_LS NotPressed
  g_HIL_Bus_Swc_Check("I_LDCU_BodySysSt2::I_LDCU_ZATButtonSwSt 0 1 s"); // 预期结果 Step Check I_LDCU_BodySysSt2::I_LDCU_ZATButtonSwSt 0 1 s//notpressed
  g_HIL_Bus_Swc_Set("VTS::VT2848_4_Ch27::DigitalOutput 1"); // 测试步骤 Step Set J_DI_SSBPin4SW_LS Pressed
  g_HIL_Bus_Swc_Set("VTS::VT2848_4_Ch32::DigitalOutput 1"); // 测试步骤 Step Set J_DI_SSBPin6SW_LS Pressed
  g_HIL_Bus_Swc_Check("I_LDCU_BodySysSt2::I_LDCU_ZATButtonSwSt 1 1 s"); // 预期结果 Step Check I_LDCU_BodySysSt2::I_LDCU_ZATButtonSwSt 1 1 s//pressed
  g_HIL_Bus_Swc_Check("I_LDCU_BodySysSt2::I_LDCU_PowerOFFSource 2 1 s"); // 预期结果 Step Check I_LDCU_BodySysSt2::I_LDCU_PowerOFFSource 2 1 s//强制下电
  g_HIL_Bus_Swc_Check("I_LDCU_BodySysSt1::I_LDCU_PowerMode 0"); // 预期结果 Step Check I_LDCU_BodySysSt1::I_LDCU_PowerMode 0//OFF
  g_HIL_Bus_Swc_Check("VTS::VT2848_2_Ch26::CurBit 0"); // 预期结果 Step Check J_DO_HS_KL15_BackUp Inactive
  g_HIL_Bus_Swc_Set("VTS::VT2848_4_Ch27::DigitalOutput 0"); // 测试步骤 Step Set J_DI_SSBPin4SW_LS NotPressed
  g_HIL_Bus_Swc_Set("VTS::VT2848_4_Ch32::DigitalOutput 0"); // 测试步骤 Step Set J_DI_SSBPin6SW_LS NotPressed
  g_HIL_Bus_Swc_Check("I_LDCU_BodySysSt2::I_LDCU_ZATButtonSwSt 0 1 s"); // 预期结果 Step Check I_LDCU_BodySysSt2::I_LDCU_ZATButtonSwSt 0 1 s//notpressed
}

testcase SYS_LDCU_Powermode_0133()
{
  TestDescription("静态强制下电-二次确认-2");
  g_HIL_UDS_Swc_Set_UDS("SA_L1"); // 测试步骤 Step Set_UDS SA_L1
  g_HIL_Gen_Swc_Wait("151 ms"); // 测试步骤 Step Wait 151 ms
  g_HIL_UDS_Swc_Set_UDS("2E 31 11 02 00"); // 测试步骤 Step Set_UDS 2E 31 11 02 00//Need 2nd Confirm
  g_HIL_UDS_Swc_Check_UDS("6E 31 11"); // 预期结果 Step Check_UDS 6E 31 11//Dbldigital
  g_HIL_Clib_Swc_Clib_BrkLocalON(); // 测试步骤 Step Clib BrkLocalON
  g_HIL_Bus_Swc_Check("I_LDCU_BodySysSt1::I_LDCU_PowerMode 1"); // 预期结果 Step Check I_LDCU_BodySysSt1::I_LDCU_PowerMode 1 //Local_ON
  g_HIL_Bus_Swc_Set("C_IPB_SpdInfoF::C_IPB_VehSpd 20"); // 测试步骤 Step Set C_IPB_SpdInfoF::C_IPB_VehSpd 20//
  g_HIL_Bus_Swc_Set("C_IPB_SpdInfoF::C_IPB_VehSpdVD 1"); // 测试步骤 Step Set C_IPB_SpdInfoF::C_IPB_VehSpdVD 1//车速有效
  g_HIL_Bus_Swc_Set("VTS::VT2848_4_Ch27::DigitalOutput 0"); // 测试步骤 Step Set J_DI_SSBPin4SW_LS NotPressed
  g_HIL_Bus_Swc_Set("VTS::VT2848_4_Ch32::DigitalOutput 0"); // 测试步骤 Step Set J_DI_SSBPin6SW_LS NotPressed
  g_HIL_Bus_Swc_Check("I_LDCU_BodySysSt2::I_LDCU_ZATButtonSwSt 0 1 s"); // 预期结果 Step Check I_LDCU_BodySysSt2::I_LDCU_ZATButtonSwSt 0 1 s//notpressed
  g_HIL_Bus_Swc_Set("VTS::VT2848_4_Ch27::DigitalOutput 1"); // 测试步骤 Step Set J_DI_SSBPin4SW_LS Pressed
  g_HIL_Bus_Swc_Set("VTS::VT2848_4_Ch32::DigitalOutput 1"); // 测试步骤 Step Set J_DI_SSBPin6SW_LS Pressed
  g_HIL_Bus_Swc_Check("I_LDCU_BodySysSt2::I_LDCU_ZATButtonSwSt 1 1 s"); // 预期结果 Step Check I_LDCU_BodySysSt2::I_LDCU_ZATButtonSwSt 1 1 s//pressed
  g_HIL_Bus_Swc_Check("I_LDCU_BodySysSt1::I_LDCU_PowerMode 1"); // 预期结果 Step Check I_LDCU_BodySysSt1::I_LDCU_PowerMode 1 //Local_ON
  g_HIL_Gen_Swc_Wait("4 s"); // 测试步骤 Step Wait 4 s
  g_HIL_Bus_Swc_Check("I_LDCU_BodySysSt2::I_LDCU_PowerOFFSource 2 2 s"); // 预期结果 Step Check I_LDCU_BodySysSt2::I_LDCU_PowerOFFSource 2 2 s//强制下电
  g_HIL_Bus_Swc_Check("I_LDCU_BodySysSt1::I_LDCU_PowerMode 0"); // 预期结果 Step Check I_LDCU_BodySysSt1::I_LDCU_PowerMode 0//OFF
  g_HIL_Bus_Swc_Check("VTS::VT2848_2_Ch26::CurBit 0"); // 预期结果 Step Check J_DO_HS_KL15_BackUp Inactive
  g_HIL_Bus_Swc_Set("VTS::VT2848_4_Ch27::DigitalOutput 0"); // 测试步骤 Step Set J_DI_SSBPin4SW_LS NotPressed
  g_HIL_Bus_Swc_Set("VTS::VT2848_4_Ch32::DigitalOutput 0"); // 测试步骤 Step Set J_DI_SSBPin6SW_LS NotPressed
  g_HIL_Bus_Swc_Check("I_LDCU_BodySysSt2::I_LDCU_ZATButtonSwSt 0 1 s"); // 预期结果 Step Check I_LDCU_BodySysSt2::I_LDCU_ZATButtonSwSt 0 1 s//notpressed
  g_HIL_Bus_Swc_Set("C_IPB_SpdInfoF::C_IPB_VehSpd 0"); // 测试步骤 Step Set C_IPB_SpdInfoF::C_IPB_VehSpd 0//车速小于3Km
}

testcase SYS_LDCU_Powermode_0134()
{
  TestDescription("静态强制下电-二次确认-3");
  g_HIL_UDS_Swc_Set_UDS("SA_L1"); // 测试步骤 Step Set_UDS SA_L1
  g_HIL_Gen_Swc_Wait("151 ms"); // 测试步骤 Step Wait 151 ms
  g_HIL_UDS_Swc_Set_UDS("2E 31 11 02 00"); // 测试步骤 Step Set_UDS 2E 31 11 02 00//Need 2nd Confirm
  g_HIL_UDS_Swc_Check_UDS("6E 31 11"); // 预期结果 Step Check_UDS 6E 31 11//Dbldigital
  g_HIL_Clib_Swc_Clib_RemoteON(); // 测试步骤 Step Clib RemoteON
  g_HIL_Bus_Swc_Check("I_LDCU_BodySysSt1::I_LDCU_PowerMode 2"); // 预期结果 Step Check I_LDCU_BodySysSt1::I_LDCU_PowerMode 2 //RemoteON
  g_HIL_Bus_Swc_Set("C_IPB_SpdInfoF::C_IPB_VehSpd 0"); // 测试步骤 Step Set C_IPB_SpdInfoF::C_IPB_VehSpd 0//车速小于3Km
  g_HIL_Bus_Swc_Set("C_IPB_SpdInfoF::C_IPB_VehSpdVD 1"); // 测试步骤 Step Set C_IPB_SpdInfoF::C_IPB_VehSpdVD 1//车速有效
  g_HIL_Bus_Swc_Set("VTS::VT2848_4_Ch27::DigitalOutput 0"); // 测试步骤 Step Set J_DI_SSBPin4SW_LS NotPressed
  g_HIL_Bus_Swc_Set("VTS::VT2848_4_Ch32::DigitalOutput 0"); // 测试步骤 Step Set J_DI_SSBPin6SW_LS NotPressed
  g_HIL_Bus_Swc_Check("I_LDCU_BodySysSt2::I_LDCU_ZATButtonSwSt 0 1 s"); // 预期结果 Step Check I_LDCU_BodySysSt2::I_LDCU_ZATButtonSwSt 0 1 s//notpressed
  g_HIL_Bus_Swc_Set("VTS::VT2848_4_Ch27::DigitalOutput 1"); // 测试步骤 Step Set J_DI_SSBPin4SW_LS Pressed
  g_HIL_Bus_Swc_Set("VTS::VT2848_4_Ch32::DigitalOutput 1"); // 测试步骤 Step Set J_DI_SSBPin6SW_LS Pressed
  g_HIL_Bus_Swc_Check("I_LDCU_BodySysSt2::I_LDCU_ZATButtonSwSt 1 1 s"); // 预期结果 Step Check I_LDCU_BodySysSt2::I_LDCU_ZATButtonSwSt 1 1 s//pressed
  g_HIL_Bus_Swc_Set("VTS::VT2848_4_Ch27::DigitalOutput 0"); // 测试步骤 Step Set J_DI_SSBPin4SW_LS NotPressed
  g_HIL_Bus_Swc_Set("VTS::VT2848_4_Ch32::DigitalOutput 0"); // 测试步骤 Step Set J_DI_SSBPin6SW_LS NotPressed
  g_HIL_Bus_Swc_Check("I_LDCU_BodySysSt2::I_LDCU_ZATButtonSwSt 0 1 s"); // 预期结果 Step Check I_LDCU_BodySysSt2::I_LDCU_ZATButtonSwSt 0 1 s//notpressed
  g_HIL_Bus_Swc_Set("VTS::VT2848_4_Ch27::DigitalOutput 1"); // 测试步骤 Step Set J_DI_SSBPin4SW_LS Pressed
  g_HIL_Bus_Swc_Set("VTS::VT2848_4_Ch32::DigitalOutput 1"); // 测试步骤 Step Set J_DI_SSBPin6SW_LS Pressed
  g_HIL_Bus_Swc_Check("I_LDCU_BodySysSt2::I_LDCU_ZATButtonSwSt 1 1 s"); // 预期结果 Step Check I_LDCU_BodySysSt2::I_LDCU_ZATButtonSwSt 1 1 s//pressed
  g_HIL_Bus_Swc_Set("VTS::VT2848_4_Ch27::DigitalOutput 0"); // 测试步骤 Step Set J_DI_SSBPin4SW_LS NotPressed
  g_HIL_Bus_Swc_Check("I_LDCU_BodySysSt1::I_LDCU_PowerMode 2"); // 预期结果 Step Check I_LDCU_BodySysSt1::I_LDCU_PowerMode 2 //RemoteON
  g_HIL_Bus_Swc_Set("VTS::VT2848_4_Ch32::DigitalOutput 0"); // 测试步骤 Step Set J_DI_SSBPin6SW_LS NotPressed
  g_HIL_Bus_Swc_Check("I_LDCU_BodySysSt2::I_LDCU_ZATButtonSwSt 0 1 s"); // 预期结果 Step Check I_LDCU_BodySysSt2::I_LDCU_ZATButtonSwSt 0 1 s//notpressed
  g_HIL_Bus_Swc_Set("VTS::VT2848_4_Ch27::DigitalOutput 1"); // 测试步骤 Step Set J_DI_SSBPin4SW_LS Pressed
  g_HIL_Bus_Swc_Set("VTS::VT2848_4_Ch32::DigitalOutput 1"); // 测试步骤 Step Set J_DI_SSBPin6SW_LS Pressed
  g_HIL_Bus_Swc_Check("I_LDCU_BodySysSt2::I_LDCU_ZATButtonSwSt 1 1 s"); // 预期结果 Step Check I_LDCU_BodySysSt2::I_LDCU_ZATButtonSwSt 1 1 s//pressed
  g_HIL_Bus_Swc_Check("I_LDCU_BodySysSt2::I_LDCU_PowerOFFSource 2 1 s"); // 预期结果 Step Check I_LDCU_BodySysSt2::I_LDCU_PowerOFFSource 2 1 s//强制下电
  g_HIL_Bus_Swc_Check("I_LDCU_BodySysSt1::I_LDCU_PowerMode 0"); // 预期结果 Step Check I_LDCU_BodySysSt1::I_LDCU_PowerMode 0//OFF
  g_HIL_Bus_Swc_Check("VTS::VT2848_2_Ch26::CurBit 0"); // 预期结果 Step Check J_DO_HS_KL15_BackUp Inactive
  g_HIL_Bus_Swc_Set("VTS::VT2848_4_Ch27::DigitalOutput 0"); // 测试步骤 Step Set J_DI_SSBPin4SW_LS NotPressed
  g_HIL_Bus_Swc_Set("VTS::VT2848_4_Ch32::DigitalOutput 0"); // 测试步骤 Step Set J_DI_SSBPin6SW_LS NotPressed
  g_HIL_Bus_Swc_Check("I_LDCU_BodySysSt2::I_LDCU_ZATButtonSwSt 0 1 s"); // 预期结果 Step Check I_LDCU_BodySysSt2::I_LDCU_ZATButtonSwSt 0 1 s//notpressed
}

testcase SYS_LDCU_Powermode_0135()
{
  TestDescription("静态强制下电-二次确认-4");
  g_HIL_UDS_Swc_Set_UDS("SA_L1"); // 测试步骤 Step Set_UDS SA_L1
  g_HIL_Gen_Swc_Wait("151 ms"); // 测试步骤 Step Wait 151 ms
  g_HIL_UDS_Swc_Set_UDS("2E 31 11 02 00"); // 测试步骤 Step Set_UDS 2E 31 11 02 00//Need 2nd Confirm
  g_HIL_UDS_Swc_Check_UDS("6E 31 11"); // 预期结果 Step Check_UDS 6E 31 11//Dbldigital
  g_HIL_Clib_Swc_Clib_RemoteON(); // 测试步骤 Step Clib RemoteON
  g_HIL_Bus_Swc_Check("I_LDCU_BodySysSt1::I_LDCU_PowerMode 2"); // 预期结果 Step Check I_LDCU_BodySysSt1::I_LDCU_PowerMode 2 //RemoteON
  g_HIL_Bus_Swc_Set("C_IPB_SpdInfoF::C_IPB_VehSpd 20"); // 测试步骤 Step Set C_IPB_SpdInfoF::C_IPB_VehSpd 20//
  g_HIL_Bus_Swc_Set("C_IPB_SpdInfoF::C_IPB_VehSpdVD 1"); // 测试步骤 Step Set C_IPB_SpdInfoF::C_IPB_VehSpdVD 1//车速有效
  g_HIL_Bus_Swc_Set("VTS::VT2848_4_Ch27::DigitalOutput 0"); // 测试步骤 Step Set J_DI_SSBPin4SW_LS NotPressed
  g_HIL_Bus_Swc_Set("VTS::VT2848_4_Ch32::DigitalOutput 0"); // 测试步骤 Step Set J_DI_SSBPin6SW_LS NotPressed
  g_HIL_Bus_Swc_Check("I_LDCU_BodySysSt2::I_LDCU_ZATButtonSwSt 0 1 s"); // 预期结果 Step Check I_LDCU_BodySysSt2::I_LDCU_ZATButtonSwSt 0 1 s//notpressed
  g_HIL_Bus_Swc_Set("VTS::VT2848_4_Ch27::DigitalOutput 1"); // 测试步骤 Step Set J_DI_SSBPin4SW_LS Pressed
  g_HIL_Bus_Swc_Set("VTS::VT2848_4_Ch32::DigitalOutput 1"); // 测试步骤 Step Set J_DI_SSBPin6SW_LS Pressed
  g_HIL_Bus_Swc_Check("I_LDCU_BodySysSt2::I_LDCU_ZATButtonSwSt 1 1 s"); // 预期结果 Step Check I_LDCU_BodySysSt2::I_LDCU_ZATButtonSwSt 1 1 s//pressed
  g_HIL_Bus_Swc_Check("I_LDCU_BodySysSt1::I_LDCU_PowerMode 2"); // 预期结果 Step Check I_LDCU_BodySysSt1::I_LDCU_PowerMode 2 //RemoteON
  g_HIL_Gen_Swc_Wait("4 s"); // 测试步骤 Step Wait 4 s
  g_HIL_Bus_Swc_Check("I_LDCU_BodySysSt2::I_LDCU_PowerOFFSource 2 2 s"); // 预期结果 Step Check I_LDCU_BodySysSt2::I_LDCU_PowerOFFSource 2 2 s//强制下电
  g_HIL_Bus_Swc_Check("I_LDCU_BodySysSt1::I_LDCU_PowerMode 0"); // 预期结果 Step Check I_LDCU_BodySysSt1::I_LDCU_PowerMode 0//OFF
  g_HIL_Bus_Swc_Check("VTS::VT2848_2_Ch26::CurBit 0"); // 预期结果 Step Check J_DO_HS_KL15_BackUp Inactive
  g_HIL_Bus_Swc_Set("VTS::VT2848_4_Ch27::DigitalOutput 0"); // 测试步骤 Step Set J_DI_SSBPin4SW_LS NotPressed
  g_HIL_Bus_Swc_Set("VTS::VT2848_4_Ch32::DigitalOutput 0"); // 测试步骤 Step Set J_DI_SSBPin6SW_LS NotPressed
  g_HIL_Bus_Swc_Check("I_LDCU_BodySysSt2::I_LDCU_ZATButtonSwSt 0 1 s"); // 预期结果 Step Check I_LDCU_BodySysSt2::I_LDCU_ZATButtonSwSt 0 1 s//notpressed
  g_HIL_Bus_Swc_Set("C_IPB_SpdInfoF::C_IPB_VehSpd 0"); // 测试步骤 Step Set C_IPB_SpdInfoF::C_IPB_VehSpd 0//车速小于3Km
}

testcase SYS_LDCU_Powermode_0136()
{
  TestDescription("动态强制下电-二次确认-1");
  g_HIL_UDS_Swc_Set_UDS("SA_L1"); // 测试步骤 Step Set_UDS SA_L1
  g_HIL_Gen_Swc_Wait("151 ms"); // 测试步骤 Step Wait 151 ms
  g_HIL_UDS_Swc_Set_UDS("2E 31 11 02 00"); // 测试步骤 Step Set_UDS 2E 31 11 02 00//Need 2nd Confirm
  g_HIL_UDS_Swc_Check_UDS("6E 31 11"); // 预期结果 Step Check_UDS 6E 31 11//Dbldigital
  g_HIL_XCP_Swc_Set_XCP("CalC_tPwMdEmrgPwrOffSwLongPrsdCmd 2000"); // 测试步骤 Step Set_XCP CalC_tPwMdEmrgPwrOffSwLongPrsdCmd 2000
  g_HIL_XCP_Swc_Set_XCP("CalC_tPwMdEmrgPwrOff2ndCnfrmTmrWnd 2000"); // 测试步骤 Step Set_XCP CalC_tPwMdEmrgPwrOff2ndCnfrmTmrWnd 2000
  g_HIL_Bus_Swc_Check("I_LDCU_BodySysSt1::I_LDCU_PowerMode 1"); // 预期结果 Step Check I_LDCU_BodySysSt1::I_LDCU_PowerMode 1//Local on
  g_HIL_Clib_Swc_Clib_BrkLocalON(); // 测试步骤 Step Clib BrkLocalON
  g_HIL_Bus_Swc_Set("C_IPB_SpdInfoF::C_IPB_VehSpd 4"); // 测试步骤 Step Set C_IPB_SpdInfoF::C_IPB_VehSpd 4//车速小于3Km
  g_HIL_Bus_Swc_Set("C_IPB_SpdInfoF::C_IPB_VehSpdVD 1"); // 测试步骤 Step Set C_IPB_SpdInfoF::C_IPB_VehSpdVD 1//车速有效
  g_HIL_Bus_Swc_Check("I_LDCU_BodySysSt1::I_LDCU_CDCU_2ndOFFReq 0"); // 预期结果 Step Check I_LDCU_BodySysSt1::I_LDCU_CDCU_2ndOFFReq 0//No command
  g_HIL_Bus_Swc_Set("I_CDCU_InvolvingSafety_Ctrl::I_CDCU_LDCU_2ndOffResult 0"); // 测试步骤 Step Set I_CDCU_InvolvingSafety_Ctrl::I_CDCU_LDCU_2ndOffResult 0
  g_HIL_Bus_Swc_Set("VTS::VT2848_4_Ch24::DigitalOutput 0"); // 测试步骤 Step Set J_DI_EmergencyPowerOffSw1_LS NotPressed
  g_HIL_Bus_Swc_Set("VTS::VT2516_2_Ch12::DigitalOutput 0"); // 测试步骤 Step Set J_DI_EmergencyPowerOffSw2_LS NotPressed
  g_HIL_Bus_Swc_Set("VTS::VT2848_4_Ch24::DigitalOutput 1"); // 测试步骤 Step Set J_DI_EmergencyPowerOffSw1_LS Pressed
  g_HIL_Bus_Swc_Set("VTS::VT2516_2_Ch12::DigitalOutput 1"); // 测试步骤 Step Set J_DI_EmergencyPowerOffSw2_LS Pressed
  g_HIL_Bus_Swc_Check("I_LDCU_BodySysSt1::I_LDCU_CDCU_2ndOFFReq 1 1 s"); // 预期结果 Step Check I_LDCU_BodySysSt1::I_LDCU_CDCU_2ndOFFReq 1 1 s//发送请求
  g_HIL_Gen_Swc_Wait("2 s"); // 测试步骤 Step Wait 2 s
  g_HIL_Bus_Swc_Set("VTS::VT2848_4_Ch24::DigitalOutput 0"); // 测试步骤 Step Set J_DI_EmergencyPowerOffSw1_LS NotPressed
  g_HIL_Bus_Swc_Set("VTS::VT2516_2_Ch12::DigitalOutput 0"); // 测试步骤 Step Set J_DI_EmergencyPowerOffSw2_LS NotPressed
  g_HIL_Gen_Swc_Wait("1.5 s"); // 测试步骤 Step Wait 1.5 s//延时
  g_HIL_Bus_Swc_Check("I_LDCU_BodySysSt2::I_LDCU_PowerOFFSource 2 1 s"); // 预期结果 Step Check I_LDCU_BodySysSt2::I_LDCU_PowerOFFSource 2 1 s//强制下电
  g_HIL_Bus_Swc_Set("I_CDCU_InvolvingSafety_Ctrl::I_CDCU_LDCU_2ndOffResult 1"); // 测试步骤 Step Set I_CDCU_InvolvingSafety_Ctrl::I_CDCU_LDCU_2ndOffResult 1//二次确认下电
  g_HIL_Bus_Swc_Check("I_LDCU_BodySysSt1::I_LDCU_PowerMode 0"); // 预期结果 Step Check I_LDCU_BodySysSt1::I_LDCU_PowerMode 0//OFF
  g_HIL_Gen_Swc_Wait("301 ms"); // 测试步骤 Step Wait 301 ms
  g_HIL_Bus_Swc_Check("VTS::VT2848_2_Ch26::CurBit 0"); // 预期结果 Step Check J_DO_HS_KL15_BackUp Inactive
  g_HIL_Bus_Swc_Set("I_CDCU_InvolvingSafety_Ctrl::I_CDCU_LDCU_2ndOffResult 0"); // 测试步骤 Step Set I_CDCU_InvolvingSafety_Ctrl::I_CDCU_LDCU_2ndOffResult 0
}

testcase SYS_LDCU_Powermode_0137()
{
  TestDescription("动态强制下电-二次确认-2");
  g_HIL_UDS_Swc_Set_UDS("SA_L1"); // 测试步骤 Step Set_UDS SA_L1
  g_HIL_Gen_Swc_Wait("151 ms"); // 测试步骤 Step Wait 151 ms
  g_HIL_UDS_Swc_Set_UDS("2E 31 11 02 00"); // 测试步骤 Step Set_UDS 2E 31 11 02 00//Need 2nd Confirm
  g_HIL_UDS_Swc_Check_UDS("6E 31 11"); // 预期结果 Step Check_UDS 6E 31 11//Dbldigital
  g_HIL_XCP_Swc_Set_XCP("CalC_tPwMdEmrgPwrOffSwLongPrsdCmd 2000"); // 测试步骤 Step Set_XCP CalC_tPwMdEmrgPwrOffSwLongPrsdCmd 2000
  g_HIL_XCP_Swc_Set_XCP("CalC_tPwMdEmrgPwrOff2ndCnfrmTmrWnd 2000"); // 测试步骤 Step Set_XCP CalC_tPwMdEmrgPwrOff2ndCnfrmTmrWnd 2000
  g_HIL_Bus_Swc_Check("I_LDCU_BodySysSt1::I_LDCU_CDCU_2ndOFFReq 0"); // 预期结果 Step Check I_LDCU_BodySysSt1::I_LDCU_CDCU_2ndOFFReq 0//No command
  g_HIL_Clib_Swc_Clib_BrkLocalON(); // 测试步骤 Step Clib BrkLocalON
  g_HIL_Bus_Swc_Check("I_LDCU_BodySysSt1::I_LDCU_PowerMode 1"); // 预期结果 Step Check I_LDCU_BodySysSt1::I_LDCU_PowerMode 1//Local on
  g_HIL_Bus_Swc_Set("C_IPB_SpdInfoF::C_IPB_VehSpd 4"); // 测试步骤 Step Set C_IPB_SpdInfoF::C_IPB_VehSpd 4//车速小于3Km
  g_HIL_Bus_Swc_Set("C_IPB_SpdInfoF::C_IPB_VehSpdVD 1"); // 测试步骤 Step Set C_IPB_SpdInfoF::C_IPB_VehSpdVD 1//车速有效
  g_HIL_Bus_Swc_Set("I_CDCU_InvolvingSafety_Ctrl::I_CDCU_LDCU_2ndOffResult 0"); // 测试步骤 Step Set I_CDCU_InvolvingSafety_Ctrl::I_CDCU_LDCU_2ndOffResult 0
  g_HIL_Bus_Swc_Set("VTS::VT2848_4_Ch24::DigitalOutput 0"); // 测试步骤 Step Set J_DI_EmergencyPowerOffSw1_LS NotPressed
  g_HIL_Bus_Swc_Set("VTS::VT2516_2_Ch12::DigitalOutput 0"); // 测试步骤 Step Set J_DI_EmergencyPowerOffSw2_LS NotPressed
  g_HIL_Bus_Swc_Set("VTS::VT2848_4_Ch24::DigitalOutput 1"); // 测试步骤 Step Set J_DI_EmergencyPowerOffSw1_LS Pressed
  g_HIL_Bus_Swc_Set("VTS::VT2516_2_Ch12::DigitalOutput 1"); // 测试步骤 Step Set J_DI_EmergencyPowerOffSw2_LS Pressed
  g_HIL_Gen_Swc_Wait("2 s"); // 测试步骤 Step Wait 2 s
  g_HIL_Bus_Swc_Check("I_LDCU_BodySysSt1::I_LDCU_CDCU_2ndOFFReq 1 1 s"); // 预期结果 Step Check I_LDCU_BodySysSt1::I_LDCU_CDCU_2ndOFFReq 1 1 s//发送请求
  g_HIL_Bus_Swc_Set("I_CDCU_InvolvingSafety_Ctrl::I_CDCU_LDCU_2ndOffResult 2"); // 测试步骤 Step Set I_CDCU_InvolvingSafety_Ctrl::I_CDCU_LDCU_2ndOffResult 2//取消二次确认下电
  g_HIL_Bus_Swc_Check("I_LDCU_BodySysSt1::I_LDCU_CDCU_2ndOFFReq 0 1 s"); // 预期结果 Step Check I_LDCU_BodySysSt1::I_LDCU_CDCU_2ndOFFReq 0 1 s//No command
  g_HIL_Bus_Swc_Set("VTS::VT2848_4_Ch24::DigitalOutput 0"); // 测试步骤 Step Set J_DI_EmergencyPowerOffSw1_LS NotPressed
  g_HIL_Bus_Swc_Check("I_LDCU_BodySysSt1::I_LDCU_PowerMode 1"); // 预期结果 Step Check I_LDCU_BodySysSt1::I_LDCU_PowerMode 1//Local on
  g_HIL_Bus_Swc_Set("VTS::VT2516_2_Ch12::DigitalOutput 0"); // 测试步骤 Step Set J_DI_EmergencyPowerOffSw2_LS NotPressed
  g_HIL_Bus_Swc_Set("I_CDCU_InvolvingSafety_Ctrl::I_CDCU_LDCU_2ndOffResult 0"); // 测试步骤 Step Set I_CDCU_InvolvingSafety_Ctrl::I_CDCU_LDCU_2ndOffResult 0
}

testcase SYS_LDCU_Powermode_0138()
{
  TestDescription("动态强制下电-二次确认-3");
  g_HIL_UDS_Swc_Set_UDS("SA_L1"); // 测试步骤 Step Set_UDS SA_L1
  g_HIL_Gen_Swc_Wait("151 ms"); // 测试步骤 Step Wait 151 ms
  g_HIL_UDS_Swc_Set_UDS("2E 31 11 02 00"); // 测试步骤 Step Set_UDS 2E 31 11 02 00//Need 2nd Confirm
  g_HIL_UDS_Swc_Check_UDS("6E 31 11"); // 预期结果 Step Check_UDS 6E 31 11//Dbldigital
  g_HIL_XCP_Swc_Set_XCP("CalC_tPwMdEmrgPwrOffSwLongPrsdCmd 2000"); // 测试步骤 Step Set_XCP CalC_tPwMdEmrgPwrOffSwLongPrsdCmd 2000
  g_HIL_XCP_Swc_Set_XCP("CalC_tPwMdEmrgPwrOff2ndCnfrmTmrWnd 2000"); // 测试步骤 Step Set_XCP CalC_tPwMdEmrgPwrOff2ndCnfrmTmrWnd 2000
  g_HIL_Bus_Swc_Check("I_LDCU_BodySysSt1::I_LDCU_CDCU_2ndOFFReq 0"); // 预期结果 Step Check I_LDCU_BodySysSt1::I_LDCU_CDCU_2ndOFFReq 0//No command
  g_HIL_Clib_Swc_Clib_BrkLocalON(); // 测试步骤 Step Clib BrkLocalON
  g_HIL_Bus_Swc_Check("I_LDCU_BodySysSt1::I_LDCU_PowerMode 1"); // 预期结果 Step Check I_LDCU_BodySysSt1::I_LDCU_PowerMode 1//Local on
  g_HIL_Bus_Swc_Set("C_IPB_SpdInfoF::C_IPB_VehSpd 4"); // 测试步骤 Step Set C_IPB_SpdInfoF::C_IPB_VehSpd 4//车速小于3Km
  g_HIL_Bus_Swc_Set("C_IPB_SpdInfoF::C_IPB_VehSpdVD 1"); // 测试步骤 Step Set C_IPB_SpdInfoF::C_IPB_VehSpdVD 1//车速有效
  g_HIL_Bus_Swc_Set("I_CDCU_InvolvingSafety_Ctrl::I_CDCU_LDCU_2ndOffResult 0"); // 测试步骤 Step Set I_CDCU_InvolvingSafety_Ctrl::I_CDCU_LDCU_2ndOffResult 0
  g_HIL_Bus_Swc_Set("VTS::VT2848_4_Ch24::DigitalOutput 0"); // 测试步骤 Step Set J_DI_EmergencyPowerOffSw1_LS NotPressed
  g_HIL_Bus_Swc_Set("VTS::VT2516_2_Ch12::DigitalOutput 0"); // 测试步骤 Step Set J_DI_EmergencyPowerOffSw2_LS NotPressed
  g_HIL_Bus_Swc_Set("VTS::VT2848_4_Ch24::DigitalOutput 1"); // 测试步骤 Step Set J_DI_EmergencyPowerOffSw1_LS Pressed
  g_HIL_Bus_Swc_Set("VTS::VT2516_2_Ch12::DigitalOutput 1"); // 测试步骤 Step Set J_DI_EmergencyPowerOffSw2_LS Pressed
  g_HIL_Gen_Swc_Wait("2 s"); // 测试步骤 Step Wait 2 s
  g_HIL_Bus_Swc_Check("I_LDCU_BodySysSt1::I_LDCU_CDCU_2ndOFFReq 1 1 s"); // 预期结果 Step Check I_LDCU_BodySysSt1::I_LDCU_CDCU_2ndOFFReq 1 1 s//发送请求
  g_HIL_Clib_Swc_Clib_OFF(); // 测试步骤 Step Clib OFF
  g_HIL_Bus_Swc_Check("I_LDCU_BodySysSt1::I_LDCU_CDCU_2ndOFFReq 0 1 s"); // 预期结果 Step Check I_LDCU_BodySysSt1::I_LDCU_CDCU_2ndOFFReq 0 1 s//No command
  g_HIL_Bus_Swc_Set("I_CDCU_InvolvingSafety_Ctrl::I_CDCU_LDCU_2ndOffResult 2"); // 测试步骤 Step Set I_CDCU_InvolvingSafety_Ctrl::I_CDCU_LDCU_2ndOffResult 2//取消二次确认下电
  g_HIL_Bus_Swc_Check("I_LDCU_BodySysSt1::I_LDCU_PowerMode 0"); // 预期结果 Step Check I_LDCU_BodySysSt1::I_LDCU_PowerMode 0//OFF
  g_HIL_Bus_Swc_Set("VTS::VT2848_4_Ch24::DigitalOutput 0"); // 测试步骤 Step Set J_DI_EmergencyPowerOffSw1_LS NotPressed
  g_HIL_Bus_Swc_Set("VTS::VT2516_2_Ch12::DigitalOutput 0"); // 测试步骤 Step Set J_DI_EmergencyPowerOffSw2_LS NotPressed
  g_HIL_Bus_Swc_Set("I_CDCU_InvolvingSafety_Ctrl::I_CDCU_LDCU_2ndOffResult 0"); // 测试步骤 Step Set I_CDCU_InvolvingSafety_Ctrl::I_CDCU_LDCU_2ndOffResult 0
}

testcase SYS_LDCU_Powermode_0208()
{
  TestDescription("动态强制下电-二次确认-4");
  g_HIL_UDS_Swc_Set_UDS("SA_L1"); // 测试步骤 Step Set_UDS SA_L1
  g_HIL_Gen_Swc_Wait("151 ms"); // 测试步骤 Step Wait 151 ms
  g_HIL_UDS_Swc_Set_UDS("2E 31 11 02 00"); // 测试步骤 Step Set_UDS 2E 31 11 02 00//Need 2nd Confirm
  g_HIL_UDS_Swc_Check_UDS("6E 31 11"); // 预期结果 Step Check_UDS 6E 31 11//Dbldigital
  g_HIL_XCP_Swc_Set_XCP("CalC_tPwMdEmrgPwrOffSwLongPrsdCmd 2000"); // 测试步骤 Step Set_XCP CalC_tPwMdEmrgPwrOffSwLongPrsdCmd 2000
  g_HIL_XCP_Swc_Set_XCP("CalC_tPwMdEmrgPwrOff2ndCnfrmTmrWnd 2000"); // 测试步骤 Step Set_XCP CalC_tPwMdEmrgPwrOff2ndCnfrmTmrWnd 2000
  g_HIL_Bus_Swc_Check("I_LDCU_BodySysSt1::I_LDCU_CDCU_2ndOFFReq 0"); // 预期结果 Step Check I_LDCU_BodySysSt1::I_LDCU_CDCU_2ndOFFReq 0//No command
  g_HIL_Clib_Swc_Clib_RemoteON(); // 测试步骤 Step Clib RemoteON
  g_HIL_Bus_Swc_Check("I_LDCU_BodySysSt1::I_LDCU_PowerMode 2"); // 预期结果 Step Check I_LDCU_BodySysSt1::I_LDCU_PowerMode 2//Remote ON
  g_HIL_Bus_Swc_Set("C_IPB_SpdInfoF::C_IPB_VehSpd 4"); // 测试步骤 Step Set C_IPB_SpdInfoF::C_IPB_VehSpd 4//车速小于3Km
  g_HIL_Bus_Swc_Set("C_IPB_SpdInfoF::C_IPB_VehSpdVD 1"); // 测试步骤 Step Set C_IPB_SpdInfoF::C_IPB_VehSpdVD 1//车速有效
  g_HIL_Bus_Swc_Set("I_CDCU_InvolvingSafety_Ctrl::I_CDCU_LDCU_2ndOffResult 0"); // 测试步骤 Step Set I_CDCU_InvolvingSafety_Ctrl::I_CDCU_LDCU_2ndOffResult 0
  g_HIL_Bus_Swc_Set("VTS::VT2848_4_Ch24::DigitalOutput 0"); // 测试步骤 Step Set J_DI_EmergencyPowerOffSw1_LS NotPressed
  g_HIL_Bus_Swc_Set("VTS::VT2516_2_Ch12::DigitalOutput 0"); // 测试步骤 Step Set J_DI_EmergencyPowerOffSw2_LS NotPressed
  g_HIL_Bus_Swc_Set("VTS::VT2848_4_Ch24::DigitalOutput 1"); // 测试步骤 Step Set J_DI_EmergencyPowerOffSw1_LS Pressed
  g_HIL_Bus_Swc_Set("VTS::VT2516_2_Ch12::DigitalOutput 1"); // 测试步骤 Step Set J_DI_EmergencyPowerOffSw2_LS Pressed
  g_HIL_Gen_Swc_Wait("2 s"); // 测试步骤 Step Wait 2 s
  g_HIL_Bus_Swc_Check("I_LDCU_BodySysSt1::I_LDCU_CDCU_2ndOFFReq 1 1 s"); // 预期结果 Step Check I_LDCU_BodySysSt1::I_LDCU_CDCU_2ndOFFReq 1 1 s//发送请求
  g_HIL_Bus_Swc_Set("VTS::VT2848_4_Ch24::DigitalOutput 0"); // 测试步骤 Step Set J_DI_EmergencyPowerOffSw1_LS NotPressed
  g_HIL_Bus_Swc_Set("VTS::VT2516_2_Ch12::DigitalOutput 0"); // 测试步骤 Step Set J_DI_EmergencyPowerOffSw2_LS NotPressed
  g_HIL_Gen_Swc_Wait("1.5 s"); // 测试步骤 Step Wait 1.5 s//延时
  g_HIL_Bus_Swc_Set("I_CDCU_InvolvingSafety_Ctrl::I_CDCU_LDCU_2ndOffResult 1"); // 测试步骤 Step Set I_CDCU_InvolvingSafety_Ctrl::I_CDCU_LDCU_2ndOffResult 1//二次确认下电
  g_HIL_Bus_Swc_Check("I_LDCU_BodySysSt2::I_LDCU_PowerOFFSource 2 1 s"); // 预期结果 Step Check I_LDCU_BodySysSt2::I_LDCU_PowerOFFSource 2 1 s//强制下电
  g_HIL_Gen_Swc_Wait("301 ms"); // 测试步骤 Step Wait 301 ms
  g_HIL_Bus_Swc_Check("I_LDCU_BodySysSt1::I_LDCU_PowerMode 0"); // 预期结果 Step Check I_LDCU_BodySysSt1::I_LDCU_PowerMode 0//OFF
  g_HIL_Bus_Swc_Set("I_CDCU_InvolvingSafety_Ctrl::I_CDCU_LDCU_2ndOffResult 0"); // 测试步骤 Step Set I_CDCU_InvolvingSafety_Ctrl::I_CDCU_LDCU_2ndOffResult 0
  g_HIL_Bus_Swc_Check("VTS::VT2848_2_Ch26::CurBit 0"); // 预期结果 Step Check J_DO_HS_KL15_BackUp Inactive
}

testcase SYS_LDCU_Powermode_0139()
{
  TestDescription("动态强制下电-二次确认-5");
  g_HIL_UDS_Swc_Set_UDS("SA_L1"); // 测试步骤 Step Set_UDS SA_L1
  g_HIL_Gen_Swc_Wait("151 ms"); // 测试步骤 Step Wait 151 ms
  g_HIL_UDS_Swc_Set_UDS("2E 31 11 02 00"); // 测试步骤 Step Set_UDS 2E 31 11 02 00//Need 2nd Confirm
  g_HIL_UDS_Swc_Check_UDS("6E 31 11"); // 预期结果 Step Check_UDS 6E 31 11//Dbldigital
  g_HIL_XCP_Swc_Set_XCP("CalC_tPwMdEmrgPwrOffSwLongPrsdCmd 2000"); // 测试步骤 Step Set_XCP CalC_tPwMdEmrgPwrOffSwLongPrsdCmd 2000
  g_HIL_XCP_Swc_Set_XCP("CalC_tPwMdEmrgPwrOff2ndCnfrmTmrWnd 2000"); // 测试步骤 Step Set_XCP CalC_tPwMdEmrgPwrOff2ndCnfrmTmrWnd 2000
  g_HIL_Bus_Swc_Check("I_LDCU_BodySysSt1::I_LDCU_CDCU_2ndOFFReq 0"); // 预期结果 Step Check I_LDCU_BodySysSt1::I_LDCU_CDCU_2ndOFFReq 0//No command
  g_HIL_Clib_Swc_Clib_RemoteON(); // 测试步骤 Step Clib RemoteON
  g_HIL_Bus_Swc_Check("I_LDCU_BodySysSt1::I_LDCU_PowerMode 2"); // 预期结果 Step Check I_LDCU_BodySysSt1::I_LDCU_PowerMode 2 //RemoteON
  g_HIL_Bus_Swc_Set("C_IPB_SpdInfoF::C_IPB_VehSpd 4"); // 测试步骤 Step Set C_IPB_SpdInfoF::C_IPB_VehSpd 4//车速小于3Km
  g_HIL_Bus_Swc_Set("C_IPB_SpdInfoF::C_IPB_VehSpdVD 1"); // 测试步骤 Step Set C_IPB_SpdInfoF::C_IPB_VehSpdVD 1//车速有效
  g_HIL_Bus_Swc_Set("I_CDCU_InvolvingSafety_Ctrl::I_CDCU_LDCU_2ndOffResult 0"); // 测试步骤 Step Set I_CDCU_InvolvingSafety_Ctrl::I_CDCU_LDCU_2ndOffResult 0
  g_HIL_Bus_Swc_Set("VTS::VT2848_4_Ch24::DigitalOutput 0"); // 测试步骤 Step Set J_DI_EmergencyPowerOffSw1_LS NotPressed
  g_HIL_Bus_Swc_Set("VTS::VT2516_2_Ch12::DigitalOutput 0"); // 测试步骤 Step Set J_DI_EmergencyPowerOffSw2_LS NotPressed
  g_HIL_Bus_Swc_Set("VTS::VT2848_4_Ch24::DigitalOutput 1"); // 测试步骤 Step Set J_DI_EmergencyPowerOffSw1_LS Pressed
  g_HIL_Bus_Swc_Set("VTS::VT2516_2_Ch12::DigitalOutput 1"); // 测试步骤 Step Set J_DI_EmergencyPowerOffSw2_LS Pressed
  g_HIL_Gen_Swc_Wait("2 s"); // 测试步骤 Step Wait 2 s
  g_HIL_Bus_Swc_Check("I_LDCU_BodySysSt1::I_LDCU_CDCU_2ndOFFReq 1 1 s"); // 预期结果 Step Check I_LDCU_BodySysSt1::I_LDCU_CDCU_2ndOFFReq 1 1 s//发送请求
  g_HIL_Bus_Swc_Set("I_CDCU_InvolvingSafety_Ctrl::I_CDCU_LDCU_2ndOffResult 2"); // 测试步骤 Step Set I_CDCU_InvolvingSafety_Ctrl::I_CDCU_LDCU_2ndOffResult 2//取消二次确认下电
  g_HIL_Bus_Swc_Check("I_LDCU_BodySysSt1::I_LDCU_CDCU_2ndOFFReq 0 1 s"); // 预期结果 Step Check I_LDCU_BodySysSt1::I_LDCU_CDCU_2ndOFFReq 0 1 s//No command
  g_HIL_Bus_Swc_Set("VTS::VT2848_4_Ch24::DigitalOutput 0"); // 测试步骤 Step Set J_DI_EmergencyPowerOffSw1_LS NotPressed
  g_HIL_Bus_Swc_Check("I_LDCU_BodySysSt1::I_LDCU_PowerMode 1"); // 预期结果 Step Check I_LDCU_BodySysSt1::I_LDCU_PowerMode 1//Local on
  g_HIL_Bus_Swc_Set("VTS::VT2516_2_Ch12::DigitalOutput 0"); // 测试步骤 Step Set J_DI_EmergencyPowerOffSw2_LS NotPressed
  g_HIL_Bus_Swc_Set("I_CDCU_InvolvingSafety_Ctrl::I_CDCU_LDCU_2ndOffResult 0"); // 测试步骤 Step Set I_CDCU_InvolvingSafety_Ctrl::I_CDCU_LDCU_2ndOffResult 0
}

testcase SYS_LDCU_Powermode_0140()
{
  TestDescription("动态强制下电-二次确认-6");
  g_HIL_UDS_Swc_Set_UDS("SA_L1"); // 测试步骤 Step Set_UDS SA_L1
  g_HIL_Gen_Swc_Wait("151 ms"); // 测试步骤 Step Wait 151 ms
  g_HIL_UDS_Swc_Set_UDS("2E 31 11 02 00"); // 测试步骤 Step Set_UDS 2E 31 11 02 00//Need 2nd Confirm
  g_HIL_UDS_Swc_Check_UDS("6E 31 11"); // 预期结果 Step Check_UDS 6E 31 11//Dbldigital
  g_HIL_XCP_Swc_Set_XCP("CalC_tPwMdEmrgPwrOffSwLongPrsdCmd 2000"); // 测试步骤 Step Set_XCP CalC_tPwMdEmrgPwrOffSwLongPrsdCmd 2000
  g_HIL_XCP_Swc_Set_XCP("CalC_tPwMdEmrgPwrOff2ndCnfrmTmrWnd 2000"); // 测试步骤 Step Set_XCP CalC_tPwMdEmrgPwrOff2ndCnfrmTmrWnd 2000
  g_HIL_Bus_Swc_Check("I_LDCU_BodySysSt1::I_LDCU_CDCU_2ndOFFReq 0"); // 预期结果 Step Check I_LDCU_BodySysSt1::I_LDCU_CDCU_2ndOFFReq 0//No command
  g_HIL_Clib_Swc_Clib_RemoteON(); // 测试步骤 Step Clib RemoteON
  g_HIL_Bus_Swc_Check("I_LDCU_BodySysSt1::I_LDCU_PowerMode 2"); // 预期结果 Step Check I_LDCU_BodySysSt1::I_LDCU_PowerMode 2 //RemoteON
  g_HIL_Bus_Swc_Set("C_IPB_SpdInfoF::C_IPB_VehSpd 4"); // 测试步骤 Step Set C_IPB_SpdInfoF::C_IPB_VehSpd 4//车速小于3Km
  g_HIL_Bus_Swc_Set("C_IPB_SpdInfoF::C_IPB_VehSpdVD 1"); // 测试步骤 Step Set C_IPB_SpdInfoF::C_IPB_VehSpdVD 1//车速有效
  g_HIL_Bus_Swc_Set("I_CDCU_InvolvingSafety_Ctrl::I_CDCU_LDCU_2ndOffResult 0"); // 测试步骤 Step Set I_CDCU_InvolvingSafety_Ctrl::I_CDCU_LDCU_2ndOffResult 0
  g_HIL_Bus_Swc_Set("VTS::VT2848_4_Ch24::DigitalOutput 0"); // 测试步骤 Step Set J_DI_EmergencyPowerOffSw1_LS NotPressed
  g_HIL_Bus_Swc_Set("VTS::VT2516_2_Ch12::DigitalOutput 0"); // 测试步骤 Step Set J_DI_EmergencyPowerOffSw2_LS NotPressed
  g_HIL_Bus_Swc_Set("VTS::VT2848_4_Ch24::DigitalOutput 1"); // 测试步骤 Step Set J_DI_EmergencyPowerOffSw1_LS Pressed
  g_HIL_Bus_Swc_Set("VTS::VT2516_2_Ch12::DigitalOutput 1"); // 测试步骤 Step Set J_DI_EmergencyPowerOffSw2_LS Pressed
  g_HIL_Gen_Swc_Wait("2 s"); // 测试步骤 Step Wait 2 s
  g_HIL_Bus_Swc_Check("I_LDCU_BodySysSt1::I_LDCU_CDCU_2ndOFFReq 1 1 s"); // 预期结果 Step Check I_LDCU_BodySysSt1::I_LDCU_CDCU_2ndOFFReq 1 1 s//发送请求
  g_HIL_Clib_Swc_Clib_OFF(); // 测试步骤 Step Clib OFF
  g_HIL_Bus_Swc_Check("I_LDCU_BodySysSt1::I_LDCU_CDCU_2ndOFFReq 0 1 s"); // 预期结果 Step Check I_LDCU_BodySysSt1::I_LDCU_CDCU_2ndOFFReq 0 1 s//No command
  g_HIL_Bus_Swc_Set("I_CDCU_InvolvingSafety_Ctrl::I_CDCU_LDCU_2ndOffResult 2"); // 测试步骤 Step Set I_CDCU_InvolvingSafety_Ctrl::I_CDCU_LDCU_2ndOffResult 2//取消二次确认下电
  g_HIL_Bus_Swc_Check("I_LDCU_BodySysSt1::I_LDCU_PowerMode 0"); // 预期结果 Step Check I_LDCU_BodySysSt1::I_LDCU_PowerMode 0//OFF
  g_HIL_Bus_Swc_Set("VTS::VT2848_4_Ch24::DigitalOutput 0"); // 测试步骤 Step Set J_DI_EmergencyPowerOffSw1_LS NotPressed
  g_HIL_Bus_Swc_Set("VTS::VT2516_2_Ch12::DigitalOutput 0"); // 测试步骤 Step Set J_DI_EmergencyPowerOffSw2_LS NotPressed
  g_HIL_Bus_Swc_Set("I_CDCU_InvolvingSafety_Ctrl::I_CDCU_LDCU_2ndOffResult 0"); // 测试步骤 Step Set I_CDCU_InvolvingSafety_Ctrl::I_CDCU_LDCU_2ndOffResult 0
}

testcase SYS_LDCU_Powermode_0141()
{
  TestDescription("运输模式下电-1");
  g_HIL_XCP_Swc_Set_XCP("CalEn_Vcu_MO_Motor_laeuft 1"); // 测试步骤 Step Set_XCP CalEn_Vcu_MO_Motor_laeuft 1
  g_HIL_XCP_Swc_Set_XCP("CalVal_Vcu_MO_Motor_laeuft 0"); // 测试步骤 Step Set_XCP CalVal_Vcu_MO_Motor_laeuft 0
  g_HIL_Bus_Swc_Check("C_Motor_14::C_MO_Motor_laeuft 0"); // 预期结果 Step Check C_Motor_14::C_MO_Motor_laeuft 0//Motor_laeuft_nicht
  g_HIL_XCP_Swc_Set_XCP("CalC_tPwMdLogisticAutoPwrOff 10"); // 测试步骤 Step Set_XCP CalC_tPwMdLogisticAutoPwrOff 10//
  g_HIL_Clib_Swc_Clib_P(); // 测试步骤 Step Clib P
  g_HIL_Bus_Swc_Set("VTS::VT2516_1_Ch4::DigitalOutput 1"); // 测试步骤 Step Set J_AI_DrvSeatSBRSt Unoccupied//主驾无人
  g_HIL_Bus_Swc_Set("I_CDCU_AssistSysSwSt::I_DrvSeatOccupancySt 0"); // 测试步骤 Step Set I_CDCU_AssistSysSwSt::I_DrvSeatOccupancySt 0//主驾不占位
  g_HIL_Bus_Swc_Set("I_XPU_BodyCtrl::I_XPU_LDCU_CurMode 0"); // 测试步骤 Step Set I_XPU_BodyCtrl::I_XPU_LDCU_CurMode 0// 智能驾驶模式Invalid
  g_HIL_UDS_Swc_Set_UDS("SA_L1"); // 测试步骤 Step Set_UDS SA_L1
  g_HIL_Gen_Swc_Wait("301 ms"); // 测试步骤 Step Wait 301 ms
  g_HIL_UDS_Swc_Set_UDS("2E 01 20 00 00 00 01 00 00 00 00"); // 测试步骤 Step Set_UDS 2E 01 20 00 00 00 01 00 00 00 00//运输模式打开
  g_HIL_Gen_Swc_Wait("301 ms"); // 测试步骤 Step Wait 301 ms
  g_HIL_Bus_Swc_Set("I_CDCU_AssistSysSwSt::I_DrvSeatBeltBuckleSt 0"); // 测试步骤 Step Set I_CDCU_AssistSysSwSt::I_DrvSeatBeltBuckleSt 0//Unbuckled
  g_HIL_Clib_Swc_Clib_LocalON(); // 测试步骤 Step Clib LocalON
  g_HIL_Bus_Swc_Check("I_LDCU_BodySysSt1::I_LDCU_PowerMode 1 1 s"); // 预期结果 Step Check I_LDCU_BodySysSt1::I_LDCU_PowerMode 1 1 s//Local on
  g_HIL_Gen_Swc_Wait("9 s"); // 测试步骤 Step Wait 9 s
  g_HIL_Bus_Swc_Check("I_LDCU_BodySysSt1::I_LDCU_PowerMode 1"); // 预期结果 Step Check I_LDCU_BodySysSt1::I_LDCU_PowerMode 1//Local on
  g_HIL_UDS_Swc_Set_UDS("SA_L1"); // 测试步骤 Step Set_UDS SA_L1
  g_HIL_Bus_Swc_Check("I_LDCU_BodySysSt1::I_LDCU_PowerMode 0 1 s"); // 预期结果 Step Check I_LDCU_BodySysSt1::I_LDCU_PowerMode 0 1 s//OFF
  g_HIL_Gen_Swc_Wait("301 ms"); // 测试步骤 Step Wait 301 ms
  g_HIL_Bus_Swc_Check("I_LDCU_BodySysSt2::I_LDCU_PowerOFFSource 5"); // 预期结果 Step Check I_LDCU_BodySysSt2::I_LDCU_PowerOFFSource 5//Auto Power Off
  g_HIL_UDS_Swc_Set_UDS("2E 01 20 00 00 00 00 00 00 00 00"); // 测试步骤 Step Set_UDS 2E 01 20 00 00 00 00 00 00 00 00//运输模式关闭
}

testcase SYS_LDCU_Powermode_0142()
{
  TestDescription("运输模式下电-2");
  g_HIL_XCP_Swc_Set_XCP("CalEn_Vcu_MO_Motor_laeuft 1"); // 测试步骤 Step Set_XCP CalEn_Vcu_MO_Motor_laeuft 1
  g_HIL_XCP_Swc_Set_XCP("CalVal_Vcu_MO_Motor_laeuft 0"); // 测试步骤 Step Set_XCP CalVal_Vcu_MO_Motor_laeuft 0
  g_HIL_Bus_Swc_Check("C_Motor_14::C_MO_Motor_laeuft 0"); // 预期结果 Step Check C_Motor_14::C_MO_Motor_laeuft 0//Motor_laeuft_nicht
  g_HIL_XCP_Swc_Set_XCP("CalC_tPwMdLogisticAutoPwrOff 10"); // 测试步骤 Step Set_XCP CalC_tPwMdLogisticAutoPwrOff 10
  g_HIL_Clib_Swc_Clib_P(); // 测试步骤 Step Clib P
  g_HIL_XCP_Swc_Set_XCP("TxBCM_bool_PGearVDOvridSwt_C 1"); // 测试步骤 Step Set_XCP TxBCM_bool_PGearVDOvridSwt_C 1
  g_HIL_XCP_Swc_Set_XCP("TxBCM_u8_PGearVDOvridVal_C 1"); // 测试步骤 Step Set_XCP TxBCM_u8_PGearVDOvridVal_C 1//PgearVD有效
  g_HIL_Bus_Swc_Set("VTS::VT2516_1_Ch4::DigitalOutput 1"); // 测试步骤 Step Set J_AI_DrvSeatSBRSt Unoccupied//主驾无人
  g_HIL_Bus_Swc_Set("I_XPU_BodyCtrl::I_XPU_LDCU_CurMode 0"); // 测试步骤 Step Set I_XPU_BodyCtrl::I_XPU_LDCU_CurMode 0// 智能驾驶模式Invalid
  g_HIL_UDS_Swc_Set_UDS("SA_L1"); // 测试步骤 Step Set_UDS SA_L1
  g_HIL_Gen_Swc_Wait("301 ms"); // 测试步骤 Step Wait 301 ms
  g_HIL_UDS_Swc_Set_UDS("2E 01 20 00 00 00 01 00 00 00 00"); // 测试步骤 Step Set_UDS 2E 01 20 00 00 00 01 00 00 00 00//运输模式打开
  g_HIL_Gen_Swc_Wait("301 ms"); // 测试步骤 Step Wait 301 ms
  g_HIL_Bus_Swc_Set("I_CDCU_AssistSysSwSt::I_DrvSeatBeltBuckleSt 0"); // 测试步骤 Step Set I_CDCU_AssistSysSwSt::I_DrvSeatBeltBuckleSt 0//Unbuckled
  g_HIL_Clib_Swc_Clib_LocalON(); // 测试步骤 Step Clib LocalON
  g_HIL_Gen_Swc_Wait("8 s"); // 测试步骤 Step Wait 8 s
  g_HIL_Bus_Swc_Check("I_LDCU_BodySysSt1::I_LDCU_PowerMode 1"); // 预期结果 Step Check I_LDCU_BodySysSt1::I_LDCU_PowerMode 1//Local on
  g_HIL_Bus_Swc_Set("VTS::VT2848_3_Ch34::DigitalOutput 1"); // 测试步骤 Step Set J_DI_FLDoorAjarSW_LS Open//左前门开
  g_HIL_Gen_Swc_Wait("301 ms"); // 测试步骤 Step Wait 301 ms
  g_HIL_Bus_Swc_Check("I_LDCU_BodySysSt1::I_LDCU_PowerMode 0 1 s"); // 预期结果 Step Check I_LDCU_BodySysSt1::I_LDCU_PowerMode 0 1 s//OFF
  g_HIL_Bus_Swc_Check("I_LDCU_BodySysSt2::I_LDCU_PowerOFFSource 7"); // 预期结果 Step Check I_LDCU_BodySysSt2::I_LDCU_PowerOFFSource 7//Door Open
  g_HIL_Bus_Swc_Set("VTS::VT2848_3_Ch34::DigitalOutput 0"); // 测试步骤 Step Set J_DI_FLDoorAjarSW_LS Close//左前门关
  g_HIL_UDS_Swc_Set_UDS("SA_L1"); // 测试步骤 Step Set_UDS SA_L1
  g_HIL_Gen_Swc_Wait("301 ms"); // 测试步骤 Step Wait 301 ms
  g_HIL_UDS_Swc_Set_UDS("2E 01 20 00 00 00 00 00 00 00 00"); // 测试步骤 Step Set_UDS 2E 01 20 00 00 00 00 00 00 00 00//运输模式关闭
}

testcase SYS_LDCU_Powermode_0143()
{
  TestDescription("运输模式下电-3");
  g_HIL_XCP_Swc_Set_XCP("CalEn_Vcu_MO_Motor_laeuft 1"); // 测试步骤 Step Set_XCP CalEn_Vcu_MO_Motor_laeuft 1
  g_HIL_XCP_Swc_Set_XCP("CalVal_Vcu_MO_Motor_laeuft 0"); // 测试步骤 Step Set_XCP CalVal_Vcu_MO_Motor_laeuft 0
  g_HIL_Bus_Swc_Check("C_Motor_14::C_MO_Motor_laeuft 0"); // 预期结果 Step Check C_Motor_14::C_MO_Motor_laeuft 0//Motor_laeuft_nicht
  g_HIL_XCP_Swc_Set_XCP("CalC_tPwMdLogisticAutoPwrOff 10"); // 测试步骤 Step Set_XCP CalC_tPwMdLogisticAutoPwrOff 10
  g_HIL_Clib_Swc_Clib_P(); // 测试步骤 Step Clib P
  g_HIL_Clib_Swc_Clib_NotReady(); // 测试步骤 Step Clib NotReady
  g_HIL_XCP_Swc_Set_XCP("TxBCM_bool_PGearVDOvridSwt_C 1"); // 测试步骤 Step Set_XCP TxBCM_bool_PGearVDOvridSwt_C 1
  g_HIL_XCP_Swc_Set_XCP("TxBCM_u8_PGearVDOvridVal_C 1"); // 测试步骤 Step Set_XCP TxBCM_u8_PGearVDOvridVal_C 1//PgearVD有效
  g_HIL_Bus_Swc_Set("VTS::VT2516_1_Ch4::DigitalOutput 1"); // 测试步骤 Step Set J_AI_DrvSeatSBRSt Unoccupied//主驾无人
  g_HIL_Bus_Swc_Set("I_XPU_BodyCtrl::I_XPU_LDCU_CurMode 0"); // 测试步骤 Step Set I_XPU_BodyCtrl::I_XPU_LDCU_CurMode 0// 智能驾驶模式Invalid
  g_HIL_UDS_Swc_Set_UDS("SA_L1"); // 测试步骤 Step Set_UDS SA_L1
  g_HIL_Gen_Swc_Wait("301 ms"); // 测试步骤 Step Wait 301 ms
  g_HIL_UDS_Swc_Set_UDS("2E 01 20 00 00 00 01 00 00 00 00"); // 测试步骤 Step Set_UDS 2E 01 20 00 00 00 01 00 00 00 00//运输模式打开
  g_HIL_Gen_Swc_Wait("301 ms"); // 测试步骤 Step Wait 301 ms
  g_HIL_Bus_Swc_Set("I_CDCU_AssistSysSwSt::I_DrvSeatBeltBuckleSt 0"); // 测试步骤 Step Set I_CDCU_AssistSysSwSt::I_DrvSeatBeltBuckleSt 0//Unbuckled
  g_HIL_Clib_Swc_Clib_LocalON(); // 测试步骤 Step Clib LocalON
  g_HIL_Bus_Swc_Check("I_LDCU_BodySysSt1::I_LDCU_PowerMode 1"); // 预期结果 Step Check I_LDCU_BodySysSt1::I_LDCU_PowerMode 1//Local on
  g_HIL_Gen_Swc_Wait("8 s"); // 测试步骤 Step Wait 8 s
  g_HIL_Bus_Swc_Set("VTS::VT2848_4_Ch31::DigitalOutput 1"); // 测试步骤 Step Set J_DI_RLDoorAjarSW_LS Open//左后门开
  g_HIL_Gen_Swc_Wait("301 ms"); // 测试步骤 Step Wait 301 ms
  g_HIL_Bus_Swc_Check("I_LDCU_BodySysSt1::I_LDCU_PowerMode 0 1 s"); // 预期结果 Step Check I_LDCU_BodySysSt1::I_LDCU_PowerMode 0 1 s//OFF
  g_HIL_Bus_Swc_Check("I_LDCU_BodySysSt2::I_LDCU_PowerOFFSource 7"); // 预期结果 Step Check I_LDCU_BodySysSt2::I_LDCU_PowerOFFSource 7//Door Open
  g_HIL_Bus_Swc_Set("VTS::VT2848_4_Ch31::DigitalOutput 0"); // 测试步骤 Step Set J_DI_RLDoorAjarSW_LS Close//左后门关
  g_HIL_UDS_Swc_Set_UDS("SA_L1"); // 测试步骤 Step Set_UDS SA_L1
  g_HIL_Gen_Swc_Wait("301 ms"); // 测试步骤 Step Wait 301 ms
  g_HIL_UDS_Swc_Set_UDS("2E 01 20 00 00 00 00 00 00 00 00"); // 测试步骤 Step Set_UDS 2E 01 20 00 00 00 00 00 00 00 00//运输模式关闭
}

testcase SYS_LDCU_Powermode_0144()
{
  TestDescription("运输模式下电-4");
  g_HIL_XCP_Swc_Set_XCP("CalEn_Vcu_MO_Motor_laeuft 1"); // 测试步骤 Step Set_XCP CalEn_Vcu_MO_Motor_laeuft 1
  g_HIL_XCP_Swc_Set_XCP("CalVal_Vcu_MO_Motor_laeuft 0"); // 测试步骤 Step Set_XCP CalVal_Vcu_MO_Motor_laeuft 0
  g_HIL_Bus_Swc_Check("C_Motor_14::C_MO_Motor_laeuft 0"); // 预期结果 Step Check C_Motor_14::C_MO_Motor_laeuft 0//Motor_laeuft_nicht
  g_HIL_XCP_Swc_Set_XCP("CalC_tPwMdLogisticAutoPwrOff 10"); // 测试步骤 Step Set_XCP CalC_tPwMdLogisticAutoPwrOff 10
  g_HIL_Clib_Swc_Clib_P(); // 测试步骤 Step Clib P
  g_HIL_XCP_Swc_Set_XCP("TxBCM_bool_PGearVDOvridSwt_C 1"); // 测试步骤 Step Set_XCP TxBCM_bool_PGearVDOvridSwt_C 1
  g_HIL_XCP_Swc_Set_XCP("TxBCM_u8_PGearVDOvridVal_C 1"); // 测试步骤 Step Set_XCP TxBCM_u8_PGearVDOvridVal_C 1//PgearVD有效
  g_HIL_Bus_Swc_Set("VTS::VT2516_1_Ch4::DigitalOutput 1"); // 测试步骤 Step Set J_AI_DrvSeatSBRSt Unoccupied//主驾无人
  g_HIL_Bus_Swc_Set("I_XPU_BodyCtrl::I_XPU_LDCU_CurMode 0"); // 测试步骤 Step Set I_XPU_BodyCtrl::I_XPU_LDCU_CurMode 0// 智能驾驶模式Invalid
  g_HIL_UDS_Swc_Set_UDS("SA_L1"); // 测试步骤 Step Set_UDS SA_L1
  g_HIL_Gen_Swc_Wait("301 ms"); // 测试步骤 Step Wait 301 ms
  g_HIL_UDS_Swc_Set_UDS("2E 01 20 00 00 00 01 00 00 00 00"); // 测试步骤 Step Set_UDS 2E 01 20 00 00 00 01 00 00 00 00//运输模式打开
  g_HIL_Gen_Swc_Wait("301 ms"); // 测试步骤 Step Wait 301 ms
  g_HIL_Bus_Swc_Set("I_CDCU_AssistSysSwSt::I_DrvSeatBeltBuckleSt 0"); // 测试步骤 Step Set I_CDCU_AssistSysSwSt::I_DrvSeatBeltBuckleSt 0//Unbuckled
  g_HIL_Clib_Swc_Clib_LocalON(); // 测试步骤 Step Clib LocalON
  g_HIL_Bus_Swc_Check("I_LDCU_BodySysSt1::I_LDCU_PowerMode 1"); // 预期结果 Step Check I_LDCU_BodySysSt1::I_LDCU_PowerMode 1//Local on
  g_HIL_Gen_Swc_Wait("8 s"); // 测试步骤 Step Wait 8 s
  g_HIL_Bus_Swc_Set("I_RDCU_BodySysSt1::I_RDCU_PsngrDoorAjarSt Open"); // 测试步骤 Step Set I_RDCU_BodySysSt1::I_RDCU_PsngrDoorAjarSt Open//右前门开
  g_HIL_Gen_Swc_Wait("301 ms"); // 测试步骤 Step Wait 301 ms
  g_HIL_Bus_Swc_Check("I_LDCU_BodySysSt1::I_LDCU_PowerMode 0 1 s"); // 预期结果 Step Check I_LDCU_BodySysSt1::I_LDCU_PowerMode 0 1 s//OFF
  g_HIL_Bus_Swc_Check("I_LDCU_BodySysSt2::I_LDCU_PowerOFFSource 7"); // 预期结果 Step Check I_LDCU_BodySysSt2::I_LDCU_PowerOFFSource 7//Door Open
  g_HIL_Bus_Swc_Set("I_RDCU_BodySysSt1::I_RDCU_PsngrDoorAjarSt Close"); // 测试步骤 Step Set I_RDCU_BodySysSt1::I_RDCU_PsngrDoorAjarSt  Close//右前门关
  g_HIL_UDS_Swc_Set_UDS("SA_L1"); // 测试步骤 Step Set_UDS SA_L1
  g_HIL_Gen_Swc_Wait("301 ms"); // 测试步骤 Step Wait 301 ms
  g_HIL_UDS_Swc_Set_UDS("2E 01 20 00 00 00 00 00 00 00 00"); // 测试步骤 Step Set_UDS 2E 01 20 00 00 00 00 00 00 00 00//运输模式关闭
}

testcase SYS_LDCU_Powermode_0145()
{
  TestDescription("运输模式下电-5");
  g_HIL_XCP_Swc_Set_XCP("CalEn_Vcu_MO_Motor_laeuft 1"); // 测试步骤 Step Set_XCP CalEn_Vcu_MO_Motor_laeuft 1
  g_HIL_XCP_Swc_Set_XCP("CalVal_Vcu_MO_Motor_laeuft 0"); // 测试步骤 Step Set_XCP CalVal_Vcu_MO_Motor_laeuft 0
  g_HIL_Bus_Swc_Check("C_Motor_14::C_MO_Motor_laeuft 0"); // 预期结果 Step Check C_Motor_14::C_MO_Motor_laeuft 0//Motor_laeuft_nicht
  g_HIL_XCP_Swc_Set_XCP("CalC_tPwMdLogisticAutoPwrOff 10"); // 测试步骤 Step Set_XCP CalC_tPwMdLogisticAutoPwrOff 10
  g_HIL_Clib_Swc_Clib_P(); // 测试步骤 Step Clib P
  g_HIL_XCP_Swc_Set_XCP("TxBCM_bool_PGearVDOvridSwt_C 1"); // 测试步骤 Step Set_XCP TxBCM_bool_PGearVDOvridSwt_C 1
  g_HIL_Bus_Swc_Set("VTS::VT2516_1_Ch4::DigitalOutput 1"); // 测试步骤 Step Set J_AI_DrvSeatSBRSt Unoccupied//主驾无人
  g_HIL_Bus_Swc_Set("I_XPU_BodyCtrl::I_XPU_LDCU_CurMode 0"); // 测试步骤 Step Set I_XPU_BodyCtrl::I_XPU_LDCU_CurMode 0// 智能驾驶模式Invalid
  g_HIL_UDS_Swc_Set_UDS("SA_L1"); // 测试步骤 Step Set_UDS SA_L1
  g_HIL_Gen_Swc_Wait("301 ms"); // 测试步骤 Step Wait 301 ms
  g_HIL_UDS_Swc_Set_UDS("2E 01 20 00 00 00 01 00 00 00 00"); // 测试步骤 Step Set_UDS 2E 01 20 00 00 00 01 00 00 00 00//运输模式打开
  g_HIL_Gen_Swc_Wait("301 ms"); // 测试步骤 Step Wait 301 ms
  g_HIL_Bus_Swc_Set("I_CDCU_AssistSysSwSt::I_DrvSeatBeltBuckleSt 0"); // 测试步骤 Step Set I_CDCU_AssistSysSwSt::I_DrvSeatBeltBuckleSt 0//Unbuckled
  g_HIL_Clib_Swc_Clib_LocalON(); // 测试步骤 Step Clib LocalON
  g_HIL_Bus_Swc_Check("I_LDCU_BodySysSt1::I_LDCU_PowerMode 1"); // 预期结果 Step Check I_LDCU_BodySysSt1::I_LDCU_PowerMode 1//Local on
  g_HIL_Gen_Swc_Wait("8 s"); // 测试步骤 Step Wait 8 s
  g_HIL_Bus_Swc_Set("I_RDCU_BodySysSt1::I_RDCU_RRDoorAjarSt Open"); // 测试步骤 Step Set I_RDCU_BodySysSt1::I_RDCU_RRDoorAjarSt Open//右后门开
  g_HIL_Gen_Swc_Wait("301 ms"); // 测试步骤 Step Wait 301 ms
  g_HIL_Bus_Swc_Check("I_LDCU_BodySysSt1::I_LDCU_PowerMode 0 1 s"); // 预期结果 Step Check I_LDCU_BodySysSt1::I_LDCU_PowerMode 0 1 s//OFF
  g_HIL_Bus_Swc_Check("I_LDCU_BodySysSt2::I_LDCU_PowerOFFSource 7"); // 预期结果 Step Check I_LDCU_BodySysSt2::I_LDCU_PowerOFFSource 7//Door Open
  g_HIL_Bus_Swc_Set("I_RDCU_BodySysSt1::I_RDCU_RRDoorAjarSt Close"); // 测试步骤 Step Set I_RDCU_BodySysSt1::I_RDCU_RRDoorAjarSt Close//右后门关
  g_HIL_UDS_Swc_Set_UDS("SA_L1"); // 测试步骤 Step Set_UDS SA_L1
  g_HIL_Gen_Swc_Wait("301 ms"); // 测试步骤 Step Wait 301 ms
  g_HIL_UDS_Swc_Set_UDS("2E 01 20 00 00 00 00 00 00 00 00"); // 测试步骤 Step Set_UDS 2E 01 20 00 00 00 00 00 00 00 00//运输模式关闭
}

testcase SYS_LDCU_Powermode_0146()
{
  TestDescription("运输模式下电-6");
  g_HIL_XCP_Swc_Set_XCP("CalEn_Vcu_MO_Motor_laeuft 1"); // 测试步骤 Step Set_XCP CalEn_Vcu_MO_Motor_laeuft 1
  g_HIL_XCP_Swc_Set_XCP("CalVal_Vcu_MO_Motor_laeuft 0"); // 测试步骤 Step Set_XCP CalVal_Vcu_MO_Motor_laeuft 0
  g_HIL_Bus_Swc_Check("C_Motor_14::C_MO_Motor_laeuft 0"); // 预期结果 Step Check C_Motor_14::C_MO_Motor_laeuft 0//Motor_laeuft_nicht
  g_HIL_XCP_Swc_Set_XCP("CalC_tPwMdLogisticAutoPwrOff 10"); // 测试步骤 Step Set_XCP CalC_tPwMdLogisticAutoPwrOff 10
  g_HIL_Clib_Swc_Clib_P(); // 测试步骤 Step Clib P
  g_HIL_XCP_Swc_Set_XCP("TxBCM_bool_PGearVDOvridSwt_C 1"); // 测试步骤 Step Set_XCP TxBCM_bool_PGearVDOvridSwt_C 1
  g_HIL_XCP_Swc_Set_XCP("TxBCM_u8_PGearVDOvridVal_C 1"); // 测试步骤 Step Set_XCP TxBCM_u8_PGearVDOvridVal_C 1//PgearVD有效
  g_HIL_Bus_Swc_Set("VTS::VT2516_1_Ch4::DigitalOutput 1"); // 测试步骤 Step Set J_AI_DrvSeatSBRSt Unoccupied//主驾无人
  g_HIL_Bus_Swc_Set("I_XPU_BodyCtrl::I_XPU_LDCU_CurMode 0"); // 测试步骤 Step Set I_XPU_BodyCtrl::I_XPU_LDCU_CurMode 0// 智能驾驶模式Invalid
  g_HIL_UDS_Swc_Set_UDS("SA_L1"); // 测试步骤 Step Set_UDS SA_L1
  g_HIL_Gen_Swc_Wait("301 ms"); // 测试步骤 Step Wait 301 ms
  g_HIL_UDS_Swc_Set_UDS("2E 01 20 00 00 00 01 00 00 00 00"); // 测试步骤 Step Set_UDS 2E 01 20 00 00 00 01 00 00 00 00//运输模式打开
  g_HIL_Gen_Swc_Wait("301 ms"); // 测试步骤 Step Wait 301 ms
  g_HIL_Bus_Swc_Set("I_CDCU_AssistSysSwSt::I_DrvSeatBeltBuckleSt 0"); // 测试步骤 Step Set I_CDCU_AssistSysSwSt::I_DrvSeatBeltBuckleSt 0//Unbuckled
  g_HIL_Clib_Swc_Clib_LocalON(); // 测试步骤 Step Clib LocalON
  g_HIL_Gen_Swc_Wait("8 s"); // 测试步骤 Step Wait 8 s
  g_HIL_Bus_Swc_Set("I_CDCU_AssistSysSwSt::I_DrvSeatOccupancySt 1"); // 测试步骤 Step Set I_CDCU_AssistSysSwSt::I_DrvSeatOccupancySt 1//主驾占位
  g_HIL_Bus_Swc_Check("I_LDCU_BodySysSt1::I_LDCU_PowerMode 1"); // 预期结果 Step Check I_LDCU_BodySysSt1::I_LDCU_PowerMode 1//Local on
  g_HIL_Gen_Swc_Wait("301 ms"); // 测试步骤 Step Wait 301 ms
  g_HIL_Bus_Swc_Set("I_CDCU_AssistSysSwSt::I_DrvSeatOccupancySt 0"); // 测试步骤 Step Set I_CDCU_AssistSysSwSt::I_DrvSeatOccupancySt 0//主驾不占位
  g_HIL_Gen_Swc_Wait("10 s"); // 测试步骤 Step Wait 10 s
  g_HIL_Bus_Swc_Check("I_LDCU_BodySysSt1::I_LDCU_PowerMode 1"); // 预期结果 Step Check I_LDCU_BodySysSt1::I_LDCU_PowerMode 1//Local on
  g_HIL_UDS_Swc_Set_UDS("SA_L1"); // 测试步骤 Step Set_UDS SA_L1
  g_HIL_Bus_Swc_Check("I_LDCU_BodySysSt1::I_LDCU_PowerMode 0 1 s"); // 预期结果 Step Check I_LDCU_BodySysSt1::I_LDCU_PowerMode 0 1 s//OFF
  g_HIL_Gen_Swc_Wait("301 ms"); // 测试步骤 Step Wait 301 ms
  g_HIL_Bus_Swc_Check("I_LDCU_BodySysSt2::I_LDCU_PowerOFFSource 5"); // 预期结果 Step Check I_LDCU_BodySysSt2::I_LDCU_PowerOFFSource 5//Auto Power Off
  g_HIL_UDS_Swc_Set_UDS("2E 01 20 00 00 00 00 00 00 00 00"); // 测试步骤 Step Set_UDS 2E 01 20 00 00 00 00 00 00 00 00//运输模式关闭
}

testcase SYS_LDCU_Powermode_0147()
{
  TestDescription("运输模式下电-7");
  g_HIL_XCP_Swc_Set_XCP("CalEn_Vcu_MO_Motor_laeuft 1"); // 测试步骤 Step Set_XCP CalEn_Vcu_MO_Motor_laeuft 1
  g_HIL_XCP_Swc_Set_XCP("CalVal_Vcu_MO_Motor_laeuft 0"); // 测试步骤 Step Set_XCP CalVal_Vcu_MO_Motor_laeuft 0
  g_HIL_Bus_Swc_Check("C_Motor_14::C_MO_Motor_laeuft 0"); // 预期结果 Step Check C_Motor_14::C_MO_Motor_laeuft 0//Motor_laeuft_nicht
  g_HIL_XCP_Swc_Set_XCP("CalC_tPwMdLogisticAutoPwrOff 10"); // 测试步骤 Step Set_XCP CalC_tPwMdLogisticAutoPwrOff 10
  g_HIL_Clib_Swc_Clib_P(); // 测试步骤 Step Clib P
  g_HIL_XCP_Swc_Set_XCP("TxBCM_bool_PGearVDOvridSwt_C 1"); // 测试步骤 Step Set_XCP TxBCM_bool_PGearVDOvridSwt_C 1
  g_HIL_XCP_Swc_Set_XCP("TxBCM_u8_PGearVDOvridVal_C 1"); // 测试步骤 Step Set_XCP TxBCM_u8_PGearVDOvridVal_C 1//PgearVD有效
  g_HIL_Bus_Swc_Set("VTS::VT2516_1_Ch4::DigitalOutput 1"); // 测试步骤 Step Set J_AI_DrvSeatSBRSt Unoccupied//主驾无人
  g_HIL_Bus_Swc_Set("I_XPU_BodyCtrl::I_XPU_LDCU_CurMode 0"); // 测试步骤 Step Set I_XPU_BodyCtrl::I_XPU_LDCU_CurMode 0// 智能驾驶模式Invalid
  g_HIL_UDS_Swc_Set_UDS("SA_L1"); // 测试步骤 Step Set_UDS SA_L1
  g_HIL_Gen_Swc_Wait("301 ms"); // 测试步骤 Step Wait 301 ms
  g_HIL_UDS_Swc_Set_UDS("2E 01 20 00 00 00 01 00 00 00 00"); // 测试步骤 Step Set_UDS 2E 01 20 00 00 00 01 00 00 00 00//运输模式打开
  g_HIL_Gen_Swc_Wait("301 ms"); // 测试步骤 Step Wait 301 ms
  g_HIL_Bus_Swc_Set("I_CDCU_AssistSysSwSt::I_DrvSeatBeltBuckleSt 0"); // 测试步骤 Step Set I_CDCU_AssistSysSwSt::I_DrvSeatBeltBuckleSt 0//Unbuckled
  g_HIL_Clib_Swc_Clib_LocalON(); // 测试步骤 Step Clib LocalON
  g_HIL_Gen_Swc_Wait("8 s"); // 测试步骤 Step Wait 8 s
  g_HIL_Bus_Swc_Check("I_LDCU_BodySysSt1::I_LDCU_PowerMode 1"); // 预期结果 Step Check I_LDCU_BodySysSt1::I_LDCU_PowerMode 1//Local on
  g_HIL_Bus_Swc_Set("I_XPU_BodyCtrl::I_XPU_LDCU_CurMode 1"); // 测试步骤 Step Set I_XPU_BodyCtrl::I_XPU_LDCU_CurMode 1
  g_HIL_Gen_Swc_Wait("100 ms"); // 测试步骤 Step Wait 100 ms
  g_HIL_Bus_Swc_Check("I_LDCU_BodySysSt1::I_LDCU_PowerMode 1"); // 预期结果 Step Check I_LDCU_BodySysSt1::I_LDCU_PowerMode 1//Local on
  g_HIL_Bus_Swc_Set("I_XPU_BodyCtrl::I_XPU_LDCU_CurMode 0"); // 测试步骤 Step Set I_XPU_BodyCtrl::I_XPU_LDCU_CurMode 0
  g_HIL_Gen_Swc_Wait("10 s"); // 测试步骤 Step Wait 10 s
  g_HIL_Bus_Swc_Check("I_LDCU_BodySysSt1::I_LDCU_PowerMode 0 1 s"); // 预期结果 Step Check I_LDCU_BodySysSt1::I_LDCU_PowerMode 0 1 s//OFF
  g_HIL_UDS_Swc_Set_UDS("SA_L1"); // 测试步骤 Step Set_UDS SA_L1
  g_HIL_Bus_Swc_Check("I_LDCU_BodySysSt2::I_LDCU_PowerOFFSource 5"); // 预期结果 Step Check I_LDCU_BodySysSt2::I_LDCU_PowerOFFSource 5//Auto Power Off
  g_HIL_Gen_Swc_Wait("301 ms"); // 测试步骤 Step Wait 301 ms
  g_HIL_UDS_Swc_Set_UDS("2E 01 20 00 00 00 00 00 00 00 00"); // 测试步骤 Step Set_UDS 2E 01 20 00 00 00 00 00 00 00 00//运输模式关闭
}

testcase SYS_LDCU_Powermode_0148()
{
  TestDescription("运输模式下电-8");
  g_HIL_XCP_Swc_Set_XCP("CalEn_Vcu_MO_Motor_laeuft 1"); // 测试步骤 Step Set_XCP CalEn_Vcu_MO_Motor_laeuft 1
  g_HIL_XCP_Swc_Set_XCP("CalVal_Vcu_MO_Motor_laeuft 0"); // 测试步骤 Step Set_XCP CalVal_Vcu_MO_Motor_laeuft 0
  g_HIL_Bus_Swc_Check("C_Motor_14::C_MO_Motor_laeuft 0"); // 预期结果 Step Check C_Motor_14::C_MO_Motor_laeuft 0//Motor_laeuft_nicht
  g_HIL_XCP_Swc_Set_XCP("CalC_tPwMdLogisticAutoPwrOff 10"); // 测试步骤 Step Set_XCP CalC_tPwMdLogisticAutoPwrOff 10
  g_HIL_Clib_Swc_Clib_P(); // 测试步骤 Step Clib P
  g_HIL_XCP_Swc_Set_XCP("TxBCM_bool_PGearVDOvridSwt_C 1"); // 测试步骤 Step Set_XCP TxBCM_bool_PGearVDOvridSwt_C 1
  g_HIL_XCP_Swc_Set_XCP("TxBCM_u8_PGearVDOvridVal_C 1"); // 测试步骤 Step Set_XCP TxBCM_u8_PGearVDOvridVal_C 1//PgearVD有效
  g_HIL_Bus_Swc_Set("VTS::VT2516_1_Ch4::DigitalOutput 1"); // 测试步骤 Step Set J_AI_DrvSeatSBRSt Unoccupied//主驾无人
  g_HIL_Bus_Swc_Set("I_XPU_BodyCtrl::I_XPU_LDCU_CurMode 0"); // 测试步骤 Step Set I_XPU_BodyCtrl::I_XPU_LDCU_CurMode 0// 智能驾驶模式Invalid
  g_HIL_UDS_Swc_Set_UDS("SA_L1"); // 测试步骤 Step Set_UDS SA_L1
  g_HIL_Gen_Swc_Wait("301 ms"); // 测试步骤 Step Wait 301 ms
  g_HIL_UDS_Swc_Set_UDS("2E 01 20 00 00 00 01 00 00 00 00"); // 测试步骤 Step Set_UDS 2E 01 20 00 00 00 01 00 00 00 00//运输模式打开
  g_HIL_Gen_Swc_Wait("301 ms"); // 测试步骤 Step Wait 301 ms
  g_HIL_Bus_Swc_Set("I_CDCU_AssistSysSwSt::I_DrvSeatBeltBuckleSt 0"); // 测试步骤 Step Set I_CDCU_AssistSysSwSt::I_DrvSeatBeltBuckleSt 0//Unbuckled
  g_HIL_Clib_Swc_Clib_LocalON(); // 测试步骤 Step Clib LocalON
  g_HIL_Gen_Swc_Wait("8 s"); // 测试步骤 Step Wait 8 s
  g_HIL_Bus_Swc_Check("I_LDCU_BodySysSt1::I_LDCU_PowerMode 1"); // 预期结果 Step Check I_LDCU_BodySysSt1::I_LDCU_PowerMode 1//Local on
  g_HIL_Bus_Swc_Set("I_XPU_BodyCtrl::I_XPU_LDCU_CurMode 2"); // 测试步骤 Step Set I_XPU_BodyCtrl::I_XPU_LDCU_CurMode 2
  g_HIL_Gen_Swc_Wait("100 ms"); // 测试步骤 Step Wait 100 ms
  g_HIL_Bus_Swc_Check("I_LDCU_BodySysSt1::I_LDCU_PowerMode 1"); // 预期结果 Step Check I_LDCU_BodySysSt1::I_LDCU_PowerMode 1//Local on
  g_HIL_Bus_Swc_Set("I_XPU_BodyCtrl::I_XPU_LDCU_CurMode 0"); // 测试步骤 Step Set I_XPU_BodyCtrl::I_XPU_LDCU_CurMode 0
  g_HIL_Gen_Swc_Wait("10 s"); // 测试步骤 Step Wait 10 s
  g_HIL_Bus_Swc_Check("I_LDCU_BodySysSt1::I_LDCU_PowerMode 0 1 s"); // 预期结果 Step Check I_LDCU_BodySysSt1::I_LDCU_PowerMode 0 1 s//OFF
  g_HIL_UDS_Swc_Set_UDS("SA_L1"); // 测试步骤 Step Set_UDS SA_L1
  g_HIL_Bus_Swc_Check("I_LDCU_BodySysSt2::I_LDCU_PowerOFFSource 5"); // 预期结果 Step Check I_LDCU_BodySysSt2::I_LDCU_PowerOFFSource 5//Auto Power Off
  g_HIL_Gen_Swc_Wait("301 ms"); // 测试步骤 Step Wait 301 ms
  g_HIL_UDS_Swc_Set_UDS("2E 01 20 00 00 00 00 00 00 00 00"); // 测试步骤 Step Set_UDS 2E 01 20 00 00 00 00 00 00 00 00//运输模式关闭
}

testcase SYS_LDCU_Powermode_0149()
{
  TestDescription("运输模式下电-9");
  g_HIL_XCP_Swc_Set_XCP("CalEn_Vcu_MO_Motor_laeuft 1"); // 测试步骤 Step Set_XCP CalEn_Vcu_MO_Motor_laeuft 1
  g_HIL_XCP_Swc_Set_XCP("CalVal_Vcu_MO_Motor_laeuft 0"); // 测试步骤 Step Set_XCP CalVal_Vcu_MO_Motor_laeuft 0
  g_HIL_Bus_Swc_Check("C_Motor_14::C_MO_Motor_laeuft 0"); // 预期结果 Step Check C_Motor_14::C_MO_Motor_laeuft 0//Motor_laeuft_nicht
  g_HIL_XCP_Swc_Set_XCP("CalC_tPwMdLogisticAutoPwrOff 10"); // 测试步骤 Step Set_XCP CalC_tPwMdLogisticAutoPwrOff 10
  g_HIL_Clib_Swc_Clib_P(); // 测试步骤 Step Clib P
  g_HIL_XCP_Swc_Set_XCP("TxBCM_bool_PGearVDOvridSwt_C 1"); // 测试步骤 Step Set_XCP TxBCM_bool_PGearVDOvridSwt_C 1
  g_HIL_XCP_Swc_Set_XCP("TxBCM_u8_PGearVDOvridVal_C 1"); // 测试步骤 Step Set_XCP TxBCM_u8_PGearVDOvridVal_C 1//PgearVD有效
  g_HIL_Bus_Swc_Set("VTS::VT2516_1_Ch4::DigitalOutput 1"); // 测试步骤 Step Set J_AI_DrvSeatSBRSt Unoccupied//主驾无人
  g_HIL_Bus_Swc_Set("I_XPU_BodyCtrl::I_XPU_LDCU_CurMode 0"); // 测试步骤 Step Set I_XPU_BodyCtrl::I_XPU_LDCU_CurMode 0// 智能驾驶模式Invalid
  g_HIL_UDS_Swc_Set_UDS("SA_L1"); // 测试步骤 Step Set_UDS SA_L1
  g_HIL_Gen_Swc_Wait("301 ms"); // 测试步骤 Step Wait 301 ms
  g_HIL_UDS_Swc_Set_UDS("2E 01 20 00 00 00 01 00 00 00 00"); // 测试步骤 Step Set_UDS 2E 01 20 00 00 00 01 00 00 00 00//运输模式打开
  g_HIL_Gen_Swc_Wait("301 ms"); // 测试步骤 Step Wait 301 ms
  g_HIL_Bus_Swc_Set("I_CDCU_AssistSysSwSt::I_DrvSeatBeltBuckleSt 0"); // 测试步骤 Step Set I_CDCU_AssistSysSwSt::I_DrvSeatBeltBuckleSt 0//Unbuckled
  g_HIL_Clib_Swc_Clib_LocalON(); // 测试步骤 Step Clib LocalON
  g_HIL_Gen_Swc_Wait("5 s"); // 测试步骤 Step Wait 5 s
  g_HIL_Bus_Swc_Check("I_LDCU_BodySysSt1::I_LDCU_PowerMode 1"); // 预期结果 Step Check I_LDCU_BodySysSt1::I_LDCU_PowerMode 1//Local on
  g_HIL_Clib_Swc_Clib_N(); // 测试步骤 Step Clib N
  g_HIL_Gen_Swc_Wait("301 ms"); // 测试步骤 Step Wait 301 ms
  g_HIL_Bus_Swc_Check("I_LDCU_BodySysSt1::I_LDCU_PowerMode 1"); // 预期结果 Step Check I_LDCU_BodySysSt1::I_LDCU_PowerMode 1//Local on
  g_HIL_Clib_Swc_Clib_P(); // 测试步骤 Step Clib P
  g_HIL_Gen_Swc_Wait("10 s"); // 测试步骤 Step Wait 10 s
  g_HIL_Bus_Swc_Check("I_LDCU_BodySysSt1::I_LDCU_PowerMode 0 1 s"); // 预期结果 Step Check I_LDCU_BodySysSt1::I_LDCU_PowerMode 0 1 s//OFF
  g_HIL_UDS_Swc_Set_UDS("SA_L1"); // 测试步骤 Step Set_UDS SA_L1
  g_HIL_Bus_Swc_Check("I_LDCU_BodySysSt2::I_LDCU_PowerOFFSource 5"); // 预期结果 Step Check I_LDCU_BodySysSt2::I_LDCU_PowerOFFSource 5//Auto Power Off
  g_HIL_Gen_Swc_Wait("301 ms"); // 测试步骤 Step Wait 301 ms
  g_HIL_UDS_Swc_Set_UDS("2E 01 20 00 00 00 00 00 00 00 00"); // 测试步骤 Step Set_UDS 2E 01 20 00 00 00 00 00 00 00 00//运输模式关闭
}

testcase SYS_LDCU_Powermode_0150()
{
  TestDescription("运输模式下电-10");
  g_HIL_XCP_Swc_Set_XCP("CalEn_Vcu_MO_Motor_laeuft 1"); // 测试步骤 Step Set_XCP CalEn_Vcu_MO_Motor_laeuft 1
  g_HIL_XCP_Swc_Set_XCP("CalVal_Vcu_MO_Motor_laeuft 0"); // 测试步骤 Step Set_XCP CalVal_Vcu_MO_Motor_laeuft 0
  g_HIL_Bus_Swc_Check("C_Motor_14::C_MO_Motor_laeuft 0"); // 预期结果 Step Check C_Motor_14::C_MO_Motor_laeuft 0//Motor_laeuft_nicht
  g_HIL_XCP_Swc_Set_XCP("CalC_tPwMdLogisticAutoPwrOff 10"); // 测试步骤 Step Set_XCP CalC_tPwMdLogisticAutoPwrOff 10
  g_HIL_Clib_Swc_Clib_P(); // 测试步骤 Step Clib P
  g_HIL_XCP_Swc_Set_XCP("TxBCM_bool_PGearVDOvridSwt_C 1"); // 测试步骤 Step Set_XCP TxBCM_bool_PGearVDOvridSwt_C 1
  g_HIL_XCP_Swc_Set_XCP("TxBCM_u8_PGearVDOvridVal_C 1"); // 测试步骤 Step Set_XCP TxBCM_u8_PGearVDOvridVal_C 1//PgearVD有效
  g_HIL_Bus_Swc_Set("VTS::VT2516_1_Ch4::DigitalOutput 1"); // 测试步骤 Step Set J_AI_DrvSeatSBRSt Unoccupied//主驾无人
  g_HIL_Bus_Swc_Set("I_XPU_BodyCtrl::I_XPU_LDCU_CurMode 0"); // 测试步骤 Step Set I_XPU_BodyCtrl::I_XPU_LDCU_CurMode 0// 智能驾驶模式Invalid
  g_HIL_UDS_Swc_Set_UDS("SA_L1"); // 测试步骤 Step Set_UDS SA_L1
  g_HIL_Gen_Swc_Wait("301 ms"); // 测试步骤 Step Wait 301 ms
  g_HIL_UDS_Swc_Set_UDS("2E 01 20 00 00 00 01 00 00 00 00"); // 测试步骤 Step Set_UDS 2E 01 20 00 00 00 01 00 00 00 00//运输模式打开
  g_HIL_Gen_Swc_Wait("301 ms"); // 测试步骤 Step Wait 301 ms
  g_HIL_Bus_Swc_Set("I_CDCU_AssistSysSwSt::I_DrvSeatBeltBuckleSt 0"); // 测试步骤 Step Set I_CDCU_AssistSysSwSt::I_DrvSeatBeltBuckleSt 0//Unbuckled
  g_HIL_Clib_Swc_Clib_LocalON(); // 测试步骤 Step Clib LocalON
  g_HIL_Gen_Swc_Wait("5 s"); // 测试步骤 Step Wait 5 s
  g_HIL_Bus_Swc_Check("I_LDCU_BodySysSt1::I_LDCU_PowerMode 1"); // 预期结果 Step Check I_LDCU_BodySysSt1::I_LDCU_PowerMode 1//Local on
  g_HIL_Clib_Swc_Clib_R(); // 测试步骤 Step Clib R
  g_HIL_Gen_Swc_Wait("301 ms"); // 测试步骤 Step Wait 301 ms
  g_HIL_Bus_Swc_Check("I_LDCU_BodySysSt1::I_LDCU_PowerMode 1"); // 预期结果 Step Check I_LDCU_BodySysSt1::I_LDCU_PowerMode 1//Local on
  g_HIL_Clib_Swc_Clib_P(); // 测试步骤 Step Clib P
  g_HIL_Gen_Swc_Wait("10 s"); // 测试步骤 Step Wait 10 s
  g_HIL_Bus_Swc_Check("I_LDCU_BodySysSt1::I_LDCU_PowerMode 0 1 s"); // 预期结果 Step Check I_LDCU_BodySysSt1::I_LDCU_PowerMode 0 1 s//OFF
  g_HIL_UDS_Swc_Set_UDS("SA_L1"); // 测试步骤 Step Set_UDS SA_L1
  g_HIL_Bus_Swc_Check("I_LDCU_BodySysSt2::I_LDCU_PowerOFFSource 5"); // 预期结果 Step Check I_LDCU_BodySysSt2::I_LDCU_PowerOFFSource 5//Auto Power Off
  g_HIL_Gen_Swc_Wait("301 ms"); // 测试步骤 Step Wait 301 ms
  g_HIL_UDS_Swc_Set_UDS("2E 01 20 00 00 00 00 00 00 00 00"); // 测试步骤 Step Set_UDS 2E 01 20 00 00 00 00 00 00 00 00//运输模式关闭
}

testcase SYS_LDCU_Powermode_0151()
{
  TestDescription("运输模式下电-11");
  g_HIL_XCP_Swc_Set_XCP("CalEn_Vcu_MO_Motor_laeuft 1"); // 测试步骤 Step Set_XCP CalEn_Vcu_MO_Motor_laeuft 1
  g_HIL_XCP_Swc_Set_XCP("CalVal_Vcu_MO_Motor_laeuft 0"); // 测试步骤 Step Set_XCP CalVal_Vcu_MO_Motor_laeuft 0
  g_HIL_Bus_Swc_Check("C_Motor_14::C_MO_Motor_laeuft 0"); // 预期结果 Step Check C_Motor_14::C_MO_Motor_laeuft 0//Motor_laeuft_nicht
  g_HIL_XCP_Swc_Set_XCP("CalC_tPwMdLogisticAutoPwrOff 10"); // 测试步骤 Step Set_XCP CalC_tPwMdLogisticAutoPwrOff 10
  g_HIL_Clib_Swc_Clib_P(); // 测试步骤 Step Clib P
  g_HIL_XCP_Swc_Set_XCP("TxBCM_bool_PGearVDOvridSwt_C 1"); // 测试步骤 Step Set_XCP TxBCM_bool_PGearVDOvridSwt_C 1
  g_HIL_XCP_Swc_Set_XCP("TxBCM_u8_PGearVDOvridVal_C 1"); // 测试步骤 Step Set_XCP TxBCM_u8_PGearVDOvridVal_C 1//PgearVD有效
  g_HIL_Bus_Swc_Set("VTS::VT2516_1_Ch4::DigitalOutput 1"); // 测试步骤 Step Set J_AI_DrvSeatSBRSt Unoccupied//主驾无人
  g_HIL_Bus_Swc_Set("I_XPU_BodyCtrl::I_XPU_LDCU_CurMode 0"); // 测试步骤 Step Set I_XPU_BodyCtrl::I_XPU_LDCU_CurMode 0// 智能驾驶模式Invalid
  g_HIL_UDS_Swc_Set_UDS("SA_L1"); // 测试步骤 Step Set_UDS SA_L1
  g_HIL_Gen_Swc_Wait("301 ms"); // 测试步骤 Step Wait 301 ms
  g_HIL_UDS_Swc_Set_UDS("2E 01 20 00 00 00 01 00 00 00 00"); // 测试步骤 Step Set_UDS 2E 01 20 00 00 00 01 00 00 00 00//运输模式打开
  g_HIL_Gen_Swc_Wait("301 ms"); // 测试步骤 Step Wait 301 ms
  g_HIL_Bus_Swc_Set("I_CDCU_AssistSysSwSt::I_DrvSeatBeltBuckleSt 0"); // 测试步骤 Step Set I_CDCU_AssistSysSwSt::I_DrvSeatBeltBuckleSt 0//Unbuckled
  g_HIL_Clib_Swc_Clib_LocalON(); // 测试步骤 Step Clib LocalON
  g_HIL_Gen_Swc_Wait("5 s"); // 测试步骤 Step Wait 5 s
  g_HIL_Bus_Swc_Check("I_LDCU_BodySysSt1::I_LDCU_PowerMode 1"); // 预期结果 Step Check I_LDCU_BodySysSt1::I_LDCU_PowerMode 1//Local on
  g_HIL_Clib_Swc_Clib_D(); // 测试步骤 Step Clib D
  g_HIL_Gen_Swc_Wait("301 ms"); // 测试步骤 Step Wait 301 ms
  g_HIL_Bus_Swc_Check("I_LDCU_BodySysSt1::I_LDCU_PowerMode 1"); // 预期结果 Step Check I_LDCU_BodySysSt1::I_LDCU_PowerMode 1//Local on
  g_HIL_Clib_Swc_Clib_P(); // 测试步骤 Step Clib P
  g_HIL_Gen_Swc_Wait("10 s"); // 测试步骤 Step Wait 10 s
  g_HIL_Bus_Swc_Check("I_LDCU_BodySysSt1::I_LDCU_PowerMode 0 1 s"); // 预期结果 Step Check I_LDCU_BodySysSt1::I_LDCU_PowerMode 0 1 s//OFF
  g_HIL_UDS_Swc_Set_UDS("SA_L1"); // 测试步骤 Step Set_UDS SA_L1
  g_HIL_Bus_Swc_Check("I_LDCU_BodySysSt2::I_LDCU_PowerOFFSource 5"); // 预期结果 Step Check I_LDCU_BodySysSt2::I_LDCU_PowerOFFSource 5//Auto Power Off
  g_HIL_Gen_Swc_Wait("301 ms"); // 测试步骤 Step Wait 301 ms
  g_HIL_UDS_Swc_Set_UDS("2E 01 20 00 00 00 00 00 00 00 00"); // 测试步骤 Step Set_UDS 2E 01 20 00 00 00 00 00 00 00 00//运输模式关闭
}

testcase SYS_LDCU_Powermode_0152()
{
  TestDescription("运输模式下电-12");
  g_HIL_XCP_Swc_Set_XCP("CalEn_Vcu_MO_Motor_laeuft 1"); // 测试步骤 Step Set_XCP CalEn_Vcu_MO_Motor_laeuft 1
  g_HIL_XCP_Swc_Set_XCP("CalVal_Vcu_MO_Motor_laeuft 0"); // 测试步骤 Step Set_XCP CalVal_Vcu_MO_Motor_laeuft 0
  g_HIL_Bus_Swc_Check("C_Motor_14::C_MO_Motor_laeuft 0"); // 预期结果 Step Check C_Motor_14::C_MO_Motor_laeuft 0//Motor_laeuft_nicht
  g_HIL_XCP_Swc_Set_XCP("CalC_tPwMdLogisticAutoPwrOff 10"); // 测试步骤 Step Set_XCP CalC_tPwMdLogisticAutoPwrOff 10
  g_HIL_Clib_Swc_Clib_P(); // 测试步骤 Step Clib P
  g_HIL_XCP_Swc_Set_XCP("TxBCM_bool_PGearVDOvridSwt_C 1"); // 测试步骤 Step Set_XCP TxBCM_bool_PGearVDOvridSwt_C 1
  g_HIL_XCP_Swc_Set_XCP("TxBCM_u8_PGearVDOvridVal_C 1"); // 测试步骤 Step Set_XCP TxBCM_u8_PGearVDOvridVal_C 1//PgearVD有效
  g_HIL_Bus_Swc_Set("VTS::VT2516_1_Ch4::DigitalOutput 1"); // 测试步骤 Step Set J_AI_DrvSeatSBRSt Unoccupied//主驾无人
  g_HIL_Bus_Swc_Set("I_XPU_BodyCtrl::I_XPU_LDCU_CurMode 0"); // 测试步骤 Step Set I_XPU_BodyCtrl::I_XPU_LDCU_CurMode 0// 智能驾驶模式Invalid
  g_HIL_UDS_Swc_Set_UDS("SA_L1"); // 测试步骤 Step Set_UDS SA_L1
  g_HIL_Gen_Swc_Wait("301 ms"); // 测试步骤 Step Wait 301 ms
  g_HIL_UDS_Swc_Set_UDS("2E 01 20 00 00 00 01 00 00 00 00"); // 测试步骤 Step Set_UDS 2E 01 20 00 00 00 01 00 00 00 00//运输模式打开
  g_HIL_Gen_Swc_Wait("301 ms"); // 测试步骤 Step Wait 301 ms
  g_HIL_Bus_Swc_Set("I_CDCU_AssistSysSwSt::I_DrvSeatBeltBuckleSt 0"); // 测试步骤 Step Set I_CDCU_AssistSysSwSt::I_DrvSeatBeltBuckleSt 0//Unbuckled
  g_HIL_Clib_Swc_Clib_LocalON(); // 测试步骤 Step Clib LocalON
  g_HIL_Gen_Swc_Wait("8 s"); // 测试步骤 Step Wait 8 s
  g_HIL_Bus_Swc_Check("I_LDCU_BodySysSt1::I_LDCU_PowerMode 1"); // 预期结果 Step Check I_LDCU_BodySysSt1::I_LDCU_PowerMode 1//Local on
  g_HIL_Bus_Swc_Set("C_SRS_SysSt::C_SRS_DrvSeatBeltBuckleSt 0"); // 测试步骤 Step Set C_SRS_SysSt::C_SRS_DrvSeatBeltBuckleSt 0
  g_HIL_Gen_Swc_Wait("301 ms"); // 测试步骤 Step Wait 301 ms
  g_HIL_Bus_Swc_Check("I_LDCU_BodySysSt1::I_LDCU_PowerMode 1"); // 预期结果 Step Check I_LDCU_BodySysSt1::I_LDCU_PowerMode 1//Local on
  g_HIL_Bus_Swc_Set("C_SRS_SysSt::C_SRS_DrvSeatBeltBuckleSt 1"); // 测试步骤 Step Set C_SRS_SysSt::C_SRS_DrvSeatBeltBuckleSt 1
  g_HIL_Gen_Swc_Wait("10 s"); // 测试步骤 Step Wait 10 s
  g_HIL_Bus_Swc_Check("I_LDCU_BodySysSt1::I_LDCU_PowerMode 0 1 s"); // 预期结果 Step Check I_LDCU_BodySysSt1::I_LDCU_PowerMode 0 1 s//OFF
  g_HIL_UDS_Swc_Set_UDS("SA_L1"); // 测试步骤 Step Set_UDS SA_L1
  g_HIL_Bus_Swc_Check("I_LDCU_BodySysSt2::I_LDCU_PowerOFFSource 5"); // 预期结果 Step Check I_LDCU_BodySysSt2::I_LDCU_PowerOFFSource 5//Auto Power Off
  g_HIL_Gen_Swc_Wait("301 ms"); // 测试步骤 Step Wait 301 ms
  g_HIL_UDS_Swc_Set_UDS("2E 01 20 00 00 00 00 00 00 00 00"); // 测试步骤 Step Set_UDS 2E 01 20 00 00 00 00 00 00 00 00//运输模式关闭
}

testcase SYS_LDCU_Powermode_0153()
{
  TestDescription("运输模式下电-13");
  g_HIL_XCP_Swc_Set_XCP("CalEn_Vcu_MO_Motor_laeuft 1"); // 测试步骤 Step Set_XCP CalEn_Vcu_MO_Motor_laeuft 1
  g_HIL_XCP_Swc_Set_XCP("CalVal_Vcu_MO_Motor_laeuft 0"); // 测试步骤 Step Set_XCP CalVal_Vcu_MO_Motor_laeuft 0
  g_HIL_Bus_Swc_Check("C_Motor_14::C_MO_Motor_laeuft 0"); // 预期结果 Step Check C_Motor_14::C_MO_Motor_laeuft 0//Motor_laeuft_nicht
  g_HIL_XCP_Swc_Set_XCP("CalC_tPwMdLogisticAutoPwrOff 10"); // 测试步骤 Step Set_XCP CalC_tPwMdLogisticAutoPwrOff 10
  g_HIL_Clib_Swc_Clib_P(); // 测试步骤 Step Clib P
  g_HIL_XCP_Swc_Set_XCP("TxBCM_bool_PGearVDOvridSwt_C 1"); // 测试步骤 Step Set_XCP TxBCM_bool_PGearVDOvridSwt_C 1
  g_HIL_XCP_Swc_Set_XCP("TxBCM_u8_PGearVDOvridVal_C 1"); // 测试步骤 Step Set_XCP TxBCM_u8_PGearVDOvridVal_C 1//PgearVD有效
  g_HIL_Bus_Swc_Set("VTS::VT2516_1_Ch4::DigitalOutput 1"); // 测试步骤 Step Set J_AI_DrvSeatSBRSt Unoccupied//主驾无人
  g_HIL_Bus_Swc_Set("I_XPU_BodyCtrl::I_XPU_LDCU_CurMode 0"); // 测试步骤 Step Set I_XPU_BodyCtrl::I_XPU_LDCU_CurMode 0// 智能驾驶模式Invalid
  g_HIL_UDS_Swc_Set_UDS("SA_L1"); // 测试步骤 Step Set_UDS SA_L1
  g_HIL_Gen_Swc_Wait("301 ms"); // 测试步骤 Step Wait 301 ms
  g_HIL_UDS_Swc_Set_UDS("2E 01 20 00 00 00 01 00 00 00 00"); // 测试步骤 Step Set_UDS 2E 01 20 00 00 00 01 00 00 00 00//运输模式打开
  g_HIL_Gen_Swc_Wait("301 ms"); // 测试步骤 Step Wait 301 ms
  g_HIL_Bus_Swc_Set("I_CDCU_AssistSysSwSt::I_DrvSeatBeltBuckleSt 0"); // 测试步骤 Step Set I_CDCU_AssistSysSwSt::I_DrvSeatBeltBuckleSt 0//Unbuckled
  g_HIL_Clib_Swc_Clib_LocalON(); // 测试步骤 Step Clib LocalON
  g_HIL_Gen_Swc_Wait("8 s"); // 测试步骤 Step Wait 8 s
  g_HIL_Bus_Swc_Check("I_LDCU_BodySysSt1::I_LDCU_PowerMode 1"); // 预期结果 Step Check I_LDCU_BodySysSt1::I_LDCU_PowerMode 1//Local on
  g_HIL_UDS_Swc_Set_UDS("SA_L1"); // 测试步骤 Step Set_UDS SA_L1
  g_HIL_UDS_Swc_Set_UDS("2E 01 20 00 00 00 00 00 00 00 00"); // 测试步骤 Step Set_UDS 2E 01 20 00 00 00 00 00 00 00 00//运输模式关闭
  g_HIL_Gen_Swc_Wait("301 ms"); // 测试步骤 Step Wait 301 ms
  g_HIL_Bus_Swc_Check("I_LDCU_BodySysSt1::I_LDCU_PowerMode 1"); // 预期结果 Step Check I_LDCU_BodySysSt1::I_LDCU_PowerMode 1//Local on
  g_HIL_UDS_Swc_Set_UDS("SA_L1"); // 测试步骤 Step Set_UDS SA_L1
  g_HIL_UDS_Swc_Set_UDS("2E 01 20 00 00 00 01 00 00 00 00"); // 测试步骤 Step Set_UDS 2E 01 20 00 00 00 01 00 00 00 00//运输模式打开
  g_HIL_Gen_Swc_Wait("10 s"); // 测试步骤 Step Wait 10 s
  g_HIL_Bus_Swc_Check("I_LDCU_BodySysSt1::I_LDCU_PowerMode 0 1 s"); // 预期结果 Step Check I_LDCU_BodySysSt1::I_LDCU_PowerMode 0 1 s//OFF
  g_HIL_UDS_Swc_Set_UDS("SA_L1"); // 测试步骤 Step Set_UDS SA_L1
  g_HIL_Bus_Swc_Check("I_LDCU_BodySysSt2::I_LDCU_PowerOFFSource 5"); // 预期结果 Step Check I_LDCU_BodySysSt2::I_LDCU_PowerOFFSource 5//Auto Power Off
  g_HIL_Gen_Swc_Wait("301 ms"); // 测试步骤 Step Wait 301 ms
  g_HIL_UDS_Swc_Set_UDS("2E 01 20 00 00 00 00 00 00 00 00"); // 测试步骤 Step Set_UDS 2E 01 20 00 00 00 00 00 00 00 00//运输模式关闭
}

testcase SYS_LDCU_Powermode_0154()
{
  TestDescription("运输模式下电-14");
  g_HIL_XCP_Swc_Set_XCP("CalEn_Vcu_MO_Motor_laeuft 1"); // 测试步骤 Step Set_XCP CalEn_Vcu_MO_Motor_laeuft 1
  g_HIL_XCP_Swc_Set_XCP("CalVal_Vcu_MO_Motor_laeuft 0"); // 测试步骤 Step Set_XCP CalVal_Vcu_MO_Motor_laeuft 0
  g_HIL_Bus_Swc_Check("C_Motor_14::C_MO_Motor_laeuft 0"); // 预期结果 Step Check C_Motor_14::C_MO_Motor_laeuft 0//Motor_laeuft_nicht
  g_HIL_XCP_Swc_Set_XCP("CalC_tPwMdLogisticAutoPwrOff 10"); // 测试步骤 Step Set_XCP CalC_tPwMdLogisticAutoPwrOff 10
  g_HIL_Clib_Swc_Clib_P(); // 测试步骤 Step Clib P
  g_HIL_XCP_Swc_Set_XCP("TxBCM_bool_PGearVDOvridSwt_C 1"); // 测试步骤 Step Set_XCP TxBCM_bool_PGearVDOvridSwt_C 1
  g_HIL_XCP_Swc_Set_XCP("TxBCM_u8_PGearVDOvridVal_C 1"); // 测试步骤 Step Set_XCP TxBCM_u8_PGearVDOvridVal_C 1//PgearVD有效
  g_HIL_Bus_Swc_Set("VTS::VT2516_1_Ch4::DigitalOutput 1"); // 测试步骤 Step Set J_AI_DrvSeatSBRSt Unoccupied//主驾无人
  g_HIL_Bus_Swc_Set("I_XPU_BodyCtrl::I_XPU_LDCU_CurMode 0"); // 测试步骤 Step Set I_XPU_BodyCtrl::I_XPU_LDCU_CurMode 0// 智能驾驶模式Invalid
  g_HIL_UDS_Swc_Set_UDS("SA_L1"); // 测试步骤 Step Set_UDS SA_L1
  g_HIL_Gen_Swc_Wait("301 ms"); // 测试步骤 Step Wait 301 ms
  g_HIL_UDS_Swc_Set_UDS("2E 01 20 00 00 00 01 00 00 00 00"); // 测试步骤 Step Set_UDS 2E 01 20 00 00 00 01 00 00 00 00//运输模式打开
  g_HIL_Gen_Swc_Wait("301 ms"); // 测试步骤 Step Wait 301 ms
  g_HIL_Bus_Swc_Set("I_CDCU_AssistSysSwSt::I_DrvSeatBeltBuckleSt 0"); // 测试步骤 Step Set I_CDCU_AssistSysSwSt::I_DrvSeatBeltBuckleSt 0//Unbuckled
  g_HIL_Clib_Swc_Clib_LocalON(); // 测试步骤 Step Clib LocalON
  g_HIL_Gen_Swc_Wait("8 s"); // 测试步骤 Step Wait 8 s
  g_HIL_Bus_Swc_Check("I_LDCU_BodySysSt1::I_LDCU_PowerMode 1"); // 预期结果 Step Check I_LDCU_BodySysSt1::I_LDCU_PowerMode 1//Local on
  g_HIL_Clib_Swc_Clib_OFF(); // 测试步骤 Step Clib OFF
  g_HIL_Gen_Swc_Wait("301 ms"); // 测试步骤 Step Wait 301 ms
  g_HIL_Clib_Swc_Clib_LocalON(); // 测试步骤 Step Clib LocalON
  g_HIL_Bus_Swc_Check("I_LDCU_BodySysSt1::I_LDCU_PowerMode 1"); // 预期结果 Step Check I_LDCU_BodySysSt1::I_LDCU_PowerMode 1//Local on
  g_HIL_Gen_Swc_Wait("10 s"); // 测试步骤 Step Wait 10 s
  g_HIL_Bus_Swc_Check("I_LDCU_BodySysSt1::I_LDCU_PowerMode 0 1 s"); // 预期结果 Step Check I_LDCU_BodySysSt1::I_LDCU_PowerMode 0 1 s//OFF
  g_HIL_UDS_Swc_Set_UDS("SA_L1"); // 测试步骤 Step Set_UDS SA_L1
  g_HIL_Bus_Swc_Check("I_LDCU_BodySysSt2::I_LDCU_PowerOFFSource 5"); // 预期结果 Step Check I_LDCU_BodySysSt2::I_LDCU_PowerOFFSource 5//Auto Power Off
  g_HIL_Gen_Swc_Wait("301 ms"); // 测试步骤 Step Wait 301 ms
  g_HIL_UDS_Swc_Set_UDS("2E 01 20 00 00 00 00 00 00 00 00"); // 测试步骤 Step Set_UDS 2E 01 20 00 00 00 00 00 00 00 00//运输模式关闭
}

testcase SYS_LDCU_Powermode_0209()
{
  TestDescription("运输模式下电-15");
  g_HIL_XCP_Swc_Set_XCP("CalEn_Vcu_MO_Motor_laeuft 1"); // 测试步骤 Step Set_XCP CalEn_Vcu_MO_Motor_laeuft 1
  g_HIL_XCP_Swc_Set_XCP("CalVal_Vcu_MO_Motor_laeuft 0"); // 测试步骤 Step Set_XCP CalVal_Vcu_MO_Motor_laeuft 0
  g_HIL_Bus_Swc_Check("C_Motor_14::C_MO_Motor_laeuft 0"); // 预期结果 Step Check C_Motor_14::C_MO_Motor_laeuft 0//Motor_laeuft_nicht
  g_HIL_XCP_Swc_Set_XCP("CalC_tPwMdLogisticAutoPwrOff 10"); // 测试步骤 Step Set_XCP CalC_tPwMdLogisticAutoPwrOff 10
  g_HIL_Clib_Swc_Clib_P(); // 测试步骤 Step Clib P
  g_HIL_XCP_Swc_Set_XCP("TxBCM_bool_PGearVDOvridSwt_C 1"); // 测试步骤 Step Set_XCP TxBCM_bool_PGearVDOvridSwt_C 1
  g_HIL_XCP_Swc_Set_XCP("TxBCM_u8_PGearVDOvridVal_C 1"); // 测试步骤 Step Set_XCP TxBCM_u8_PGearVDOvridVal_C 1//PgearVD有效
  g_HIL_Bus_Swc_Set("VTS::VT2516_1_Ch4::DigitalOutput 1"); // 测试步骤 Step Set J_AI_DrvSeatSBRSt Unoccupied//主驾无人
  g_HIL_Bus_Swc_Set("I_XPU_BodyCtrl::I_XPU_LDCU_CurMode 0"); // 测试步骤 Step Set I_XPU_BodyCtrl::I_XPU_LDCU_CurMode 0// 智能驾驶模式Invalid
  g_HIL_UDS_Swc_Set_UDS("SA_L1"); // 测试步骤 Step Set_UDS SA_L1
  g_HIL_Gen_Swc_Wait("301 ms"); // 测试步骤 Step Wait 301 ms
  g_HIL_UDS_Swc_Set_UDS("2E 01 20 00 00 00 01 00 00 00 00"); // 测试步骤 Step Set_UDS 2E 01 20 00 00 00 01 00 00 00 00//运输模式打开
  g_HIL_Gen_Swc_Wait("301 ms"); // 测试步骤 Step Wait 301 ms
  g_HIL_Bus_Swc_Set("I_CDCU_AssistSysSwSt::I_DrvSeatBeltBuckleSt 0"); // 测试步骤 Step Set I_CDCU_AssistSysSwSt::I_DrvSeatBeltBuckleSt 0//Unbuckled
  g_HIL_Clib_Swc_Clib_LocalON(); // 测试步骤 Step Clib LocalON
  g_HIL_Gen_Swc_Wait("8 s"); // 测试步骤 Step Wait 8 s
  g_HIL_Bus_Swc_Check("I_LDCU_BodySysSt1::I_LDCU_PowerMode 1"); // 预期结果 Step Check I_LDCU_BodySysSt1::I_LDCU_PowerMode 1//Local on
  g_HIL_Clib_Swc_Clib_OFF(); // 测试步骤 Step Clib OFF
  g_HIL_Gen_Swc_Wait("301 ms"); // 测试步骤 Step Wait 301 ms
  g_HIL_Clib_Swc_Clib_LocalON(); // 测试步骤 Step Clib LocalON
  g_HIL_Bus_Swc_Check("I_LDCU_BodySysSt1::I_LDCU_PowerMode 1"); // 预期结果 Step Check I_LDCU_BodySysSt1::I_LDCU_PowerMode 1//Local on
  g_HIL_Gen_Swc_Wait("10 s"); // 测试步骤 Step Wait 10 s
  g_HIL_Bus_Swc_Check("I_LDCU_BodySysSt1::I_LDCU_PowerMode 0 1 s"); // 预期结果 Step Check I_LDCU_BodySysSt1::I_LDCU_PowerMode 0 1 s//OFF
  g_HIL_UDS_Swc_Set_UDS("SA_L1"); // 测试步骤 Step Set_UDS SA_L1
  g_HIL_Bus_Swc_Check("I_LDCU_BodySysSt2::I_LDCU_PowerOFFSource 5"); // 预期结果 Step Check I_LDCU_BodySysSt2::I_LDCU_PowerOFFSource 5//Auto Power Off
  g_HIL_Gen_Swc_Wait("301 ms"); // 测试步骤 Step Wait 301 ms
  g_HIL_UDS_Swc_Set_UDS("2E 01 20 00 00 00 00 00 00 00 00"); // 测试步骤 Step Set_UDS 2E 01 20 00 00 00 00 00 00 00 00//运输模式关闭
}

testcase SYS_LDCU_Powermode_0155()
{
  TestDescription("运输模式下电-16");
  g_HIL_XCP_Swc_Set_XCP("CalEn_Vcu_MO_Motor_laeuft 1"); // 测试步骤 Step Set_XCP CalEn_Vcu_MO_Motor_laeuft 1
  g_HIL_XCP_Swc_Set_XCP("CalVal_Vcu_MO_Motor_laeuft 0"); // 测试步骤 Step Set_XCP CalVal_Vcu_MO_Motor_laeuft 0
  g_HIL_Bus_Swc_Check("C_Motor_14::C_MO_Motor_laeuft 0"); // 预期结果 Step Check C_Motor_14::C_MO_Motor_laeuft 0//Motor_laeuft_nicht
  g_HIL_XCP_Swc_Set_XCP("CalC_tPwMdLogisticAutoPwrOff 10"); // 测试步骤 Step Set_XCP CalC_tPwMdLogisticAutoPwrOff 10
  g_HIL_Clib_Swc_Clib_P(); // 测试步骤 Step Clib P
  g_HIL_XCP_Swc_Set_XCP("TxBCM_bool_PGearVDOvridSwt_C 1"); // 测试步骤 Step Set_XCP TxBCM_bool_PGearVDOvridSwt_C 1
  g_HIL_XCP_Swc_Set_XCP("TxBCM_u8_PGearVDOvridVal_C 1"); // 测试步骤 Step Set_XCP TxBCM_u8_PGearVDOvridVal_C 1//PgearVD有效
  g_HIL_Bus_Swc_Set("VTS::VT2516_1_Ch4::DigitalOutput 1"); // 测试步骤 Step Set J_AI_DrvSeatSBRSt Unoccupied//主驾无人
  g_HIL_Bus_Swc_Set("I_XPU_BodyCtrl::I_XPU_LDCU_CurMode 0"); // 测试步骤 Step Set I_XPU_BodyCtrl::I_XPU_LDCU_CurMode 0// 智能驾驶模式Invalid
  g_HIL_UDS_Swc_Set_UDS("SA_L1"); // 测试步骤 Step Set_UDS SA_L1
  g_HIL_Gen_Swc_Wait("301 ms"); // 测试步骤 Step Wait 301 ms
  g_HIL_UDS_Swc_Set_UDS("2E 01 20 00 00 00 01 00 00 00 00"); // 测试步骤 Step Set_UDS 2E 01 20 00 00 00 01 00 00 00 00//运输模式打开
  g_HIL_Gen_Swc_Wait("301 ms"); // 测试步骤 Step Wait 301 ms
  g_HIL_Bus_Swc_Set("I_CDCU_AssistSysSwSt::I_DrvSeatBeltBuckleSt 0"); // 测试步骤 Step Set I_CDCU_AssistSysSwSt::I_DrvSeatBeltBuckleSt 0//Unbuckled
  g_HIL_Clib_Swc_Clib_LocalON(); // 测试步骤 Step Clib LocalON
  g_HIL_Gen_Swc_Wait("8 s"); // 测试步骤 Step Wait 8 s
  g_HIL_Bus_Swc_Check("I_LDCU_BodySysSt1::I_LDCU_PowerMode 1"); // 预期结果 Step Check I_LDCU_BodySysSt1::I_LDCU_PowerMode 1//Local on
  g_HIL_XCP_Swc_Set_XCP("CalVal_Vcu_MO_Motor_laeuft 1"); // 测试步骤 Step Set_XCP CalVal_Vcu_MO_Motor_laeuft 1
  g_HIL_Gen_Swc_Wait("301 ms"); // 测试步骤 Step Wait 301 ms
  g_HIL_XCP_Swc_Set_XCP("CalVal_Vcu_MO_Motor_laeuft 0"); // 测试步骤 Step Set_XCP CalVal_Vcu_MO_Motor_laeuft 0//Motor_laeuft_nicht
  g_HIL_Bus_Swc_Check("I_LDCU_BodySysSt1::I_LDCU_PowerMode 1"); // 预期结果 Step Check I_LDCU_BodySysSt1::I_LDCU_PowerMode 1//Local on
  g_HIL_Gen_Swc_Wait("10 s"); // 测试步骤 Step Wait 10 s
  g_HIL_Bus_Swc_Check("I_LDCU_BodySysSt1::I_LDCU_PowerMode 0 1 s"); // 预期结果 Step Check I_LDCU_BodySysSt1::I_LDCU_PowerMode 0 1 s//OFF
  g_HIL_UDS_Swc_Set_UDS("SA_L1"); // 测试步骤 Step Set_UDS SA_L1
  g_HIL_Bus_Swc_Check("I_LDCU_BodySysSt2::I_LDCU_PowerOFFSource 5"); // 预期结果 Step Check I_LDCU_BodySysSt2::I_LDCU_PowerOFFSource 5//Auto Power Off
  g_HIL_Gen_Swc_Wait("301 ms"); // 测试步骤 Step Wait 301 ms
  g_HIL_UDS_Swc_Set_UDS("2E 01 20 00 00 00 00 00 00 00 00"); // 测试步骤 Step Set_UDS 2E 01 20 00 00 00 00 00 00 00 00//运输模式关闭
  g_HIL_XCP_Swc_Set_XCP("CalVal_Vcu_MO_Motor_laeuft 0"); // 测试步骤 Step Set_XCP CalVal_Vcu_MO_Motor_laeuft 0
}

testcase SYS_LDCU_Powermode_0156()
{
  TestDescription("车内有合法钥匙允许Ready使能");
  g_HIL_XCP_Swc_Set_XCP("CalEn_Vcu_MO_Motor_laeuft 1"); // 测试步骤 Step Set_XCP CalEn_Vcu_MO_Motor_laeuft 1
  g_HIL_XCP_Swc_Set_XCP("CalVal_Vcu_MO_Motor_laeuft 0"); // 测试步骤 Step Set_XCP CalVal_Vcu_MO_Motor_laeuft 0
  g_HIL_Bus_Swc_Check("C_Motor_14::C_MO_Motor_laeuft 0"); // 预期结果 Step Check C_Motor_14::C_MO_Motor_laeuft 0//Motor_laeuft_nicht
  g_HIL_Bus_Swc_Set("VTS::VT2848_4_Ch27::DigitalOutput 0"); // 测试步骤 Step Set J_DI_SSBPin4SW_LS NotPressed
  g_HIL_Bus_Swc_Set("VTS::VT2848_4_Ch32::DigitalOutput 0"); // 测试步骤 Step Set J_DI_SSBPin6SW_LS NotPressed
  g_HIL_Gen_Swc_Wait("301 ms"); // 测试步骤 Step Wait 301 ms
  g_HIL_Bus_Swc_Set("VTS::VT2848_4_Ch22::DigitalOutput 1"); // 测试步骤 Step Set J_DI_BrakeSw2_HS Pressed
  g_HIL_Bus_Swc_Set("VTS::VT2848_4_Ch17::DigitalOutput 1"); // 测试步骤 Step Set J_DI_BrakeSw1_HS Pressed
  g_HIL_Gen_Swc_Wait("450 ms"); // 测试步骤 Step Wait 450 ms
  g_HIL_Bus_Swc_Set("VTS::VT2848_4_Ch27::DigitalOutput 1"); // 测试步骤 Step Set J_DI_SSBPin4SW_LS Pressed
  g_HIL_Bus_Swc_Set("VTS::VT2848_4_Ch32::DigitalOutput 1"); // 测试步骤 Step Set J_DI_SSBPin6SW_LS Pressed
  g_HIL_Gen_Swc_Wait("301 ms"); // 测试步骤 Step Wait 301 ms
  g_HIL_XCP_Swc_Set_XCP("CalVal_KeyValidSt 1"); // 测试步骤 Step Set_XCP CalVal_KeyValidSt 1
  g_HIL_XCP_Swc_Set_XCP("CalEn_KeyValidSt 80"); // 测试步骤 Step Set_XCP CalEn_KeyValidSt 80
  g_HIL_Bus_Swc_Check("I_LDCU_Debug::I_KeyValidSt 1 1 s"); // 预期结果 Step Check I_LDCU_Debug::I_KeyValidSt 1 1 s//valid
  g_HIL_Bus_Swc_Check("I_LDCU_BodySysSt2::I_LDCU_ReadyEnable 1"); // 预期结果 Step Check I_LDCU_BodySysSt2::I_LDCU_ReadyEnable 1//Ready使能
  g_HIL_Bus_Swc_Set("VTS::VT2848_4_Ch27::DigitalOutput 0"); // 测试步骤 Step Set J_DI_SSBPin4SW_LS NotPressed
  g_HIL_Bus_Swc_Set("VTS::VT2848_4_Ch32::DigitalOutput 0"); // 测试步骤 Step Set J_DI_SSBPin6SW_LS NotPressed
  g_HIL_Bus_Swc_Set("VTS::VT2848_4_Ch17::DigitalOutput 0"); // 测试步骤 Step Set J_DI_BrakeSw1_HS NotPressed
  g_HIL_Bus_Swc_Set("VTS::VT2848_4_Ch22::DigitalOutput 0"); // 测试步骤 Step Set J_DI_BrakeSw2_HS NotPressed
}

testcase SYS_LDCU_Powermode_0157()
{
  TestDescription("发动机启动后将ReadyEnable使能接口置回默认值");
  g_HIL_XCP_Swc_Set_XCP("CalEn_Vcu_MO_Motor_laeuft 1"); // 测试步骤 Step Set_XCP CalEn_Vcu_MO_Motor_laeuft 1
  g_HIL_XCP_Swc_Set_XCP("CalVal_Vcu_MO_Motor_laeuft 0"); // 测试步骤 Step Set_XCP CalVal_Vcu_MO_Motor_laeuft 0
  g_HIL_Bus_Swc_Check("C_Motor_14::C_MO_Motor_laeuft 0"); // 预期结果 Step Check C_Motor_14::C_MO_Motor_laeuft 0//Motor_laeuft_nicht
  g_HIL_Bus_Swc_Set("VTS::VT2848_4_Ch27::DigitalOutput 0"); // 测试步骤 Step Set J_DI_SSBPin4SW_LS NotPressed
  g_HIL_Bus_Swc_Set("VTS::VT2848_4_Ch32::DigitalOutput 0"); // 测试步骤 Step Set J_DI_SSBPin6SW_LS NotPressed
  g_HIL_Gen_Swc_Wait("301 ms"); // 测试步骤 Step Wait 301 ms
  g_HIL_Bus_Swc_Set("VTS::VT2848_4_Ch22::DigitalOutput 1"); // 测试步骤 Step Set J_DI_BrakeSw2_HS Pressed
  g_HIL_Bus_Swc_Set("VTS::VT2848_4_Ch17::DigitalOutput 1"); // 测试步骤 Step Set J_DI_BrakeSw1_HS Pressed
  g_HIL_Gen_Swc_Wait("450 ms"); // 测试步骤 Step Wait 450 ms
  g_HIL_Bus_Swc_Set("VTS::VT2848_4_Ch27::DigitalOutput 1"); // 测试步骤 Step Set J_DI_SSBPin4SW_LS Pressed
  g_HIL_Bus_Swc_Set("VTS::VT2848_4_Ch32::DigitalOutput 1"); // 测试步骤 Step Set J_DI_SSBPin6SW_LS Pressed
  g_HIL_Gen_Swc_Wait("301 ms"); // 测试步骤 Step Wait 301 ms
  g_HIL_XCP_Swc_Set_XCP("CalVal_KeyValidSt 1"); // 测试步骤 Step Set_XCP CalVal_KeyValidSt 1
  g_HIL_XCP_Swc_Set_XCP("CalEn_KeyValidSt 80"); // 测试步骤 Step Set_XCP CalEn_KeyValidSt 80
  g_HIL_Bus_Swc_Check("I_LDCU_Debug::I_KeyValidSt 1 1 s"); // 预期结果 Step Check I_LDCU_Debug::I_KeyValidSt 1 1 s//valid
  g_HIL_XCP_Swc_Set_XCP("CalEn_Vcu_MO_Kl_50 1"); // 测试步骤 Step Set_XCP CalEn_Vcu_MO_Kl_50 1
  g_HIL_Bus_Swc_Check("I_LDCU_BodySysSt2::I_LDCU_ReadyEnable 1"); // 预期结果 Step Check I_LDCU_BodySysSt2::I_LDCU_ReadyEnable 1//Ready使能
  g_HIL_XCP_Swc_Set_XCP("CalVal_Vcu_MO_Kl_50 1"); // 测试步骤 Step Set_XCP CalVal_Vcu_MO_Kl_50 1
  g_HIL_Bus_Swc_Check("C_Motor_14::C_MO_Kl_50 1"); // 预期结果 Step Check C_Motor_14::C_MO_Kl_50 1//KL50_ein_Startausfuehrung_Fahrer
  g_HIL_XCP_Swc_Set_XCP("CalVal_Vcu_MO_Kl_50 0"); // 测试步骤 Step Set_XCP CalVal_Vcu_MO_Kl_50 0
  g_HIL_Bus_Swc_Check("C_Motor_14::C_MO_Kl_50 0"); // 预期结果 Step Check C_Motor_14::C_MO_Kl_50 0//aus
  g_HIL_Bus_Swc_Set("VTS::VT2848_4_Ch27::DigitalOutput 0"); // 测试步骤 Step Set J_DI_SSBPin4SW_LS NotPressed
  g_HIL_Bus_Swc_Check("I_LDCU_BodySysSt2::I_LDCU_ReadyEnable 0"); // 预期结果 Step Check I_LDCU_BodySysSt2::I_LDCU_ReadyEnable 0//Disable
  g_HIL_Bus_Swc_Set("VTS::VT2848_4_Ch32::DigitalOutput 0"); // 测试步骤 Step Set J_DI_SSBPin6SW_LS NotPressed
  g_HIL_Bus_Swc_Set("VTS::VT2848_4_Ch17::DigitalOutput 0"); // 测试步骤 Step Set J_DI_BrakeSw1_HS NotPressed
  g_HIL_Bus_Swc_Set("VTS::VT2848_4_Ch22::DigitalOutput 0"); // 测试步骤 Step Set J_DI_BrakeSw2_HS NotPressed
}

testcase SYS_LDCU_Powermode_0158()
{
  TestDescription("车辆进入Ready后，钥匙有效性变为无效导致退出Ready使能");
  g_HIL_XCP_Swc_Set_XCP("CalEn_Vcu_MO_Motor_laeuft 1"); // 测试步骤 Step Set_XCP CalEn_Vcu_MO_Motor_laeuft 1
  g_HIL_XCP_Swc_Set_XCP("CalVal_Vcu_MO_Motor_laeuft 0"); // 测试步骤 Step Set_XCP CalVal_Vcu_MO_Motor_laeuft 0
  g_HIL_Bus_Swc_Check("C_Motor_14::C_MO_Motor_laeuft 0"); // 预期结果 Step Check C_Motor_14::C_MO_Motor_laeuft 0//Motor_laeuft_nicht
  g_HIL_XCP_Swc_Set_XCP("CalEn_Vcu_MO_Kl_50 1"); // 测试步骤 Step Set_XCP CalEn_Vcu_MO_Kl_50 1
  g_HIL_XCP_Swc_Set_XCP("CalVal_Vcu_MO_Kl_50 0"); // 测试步骤 Step Set_XCP CalVal_Vcu_MO_Kl_50 0
  g_HIL_Bus_Swc_Check("C_Motor_14::C_MO_Kl_50 0"); // 预期结果 Step Check C_Motor_14::C_MO_Kl_50 0//aus
  g_HIL_Bus_Swc_Set("VTS::VT2848_4_Ch27::DigitalOutput 0"); // 测试步骤 Step Set J_DI_SSBPin4SW_LS NotPressed
  g_HIL_Bus_Swc_Set("VTS::VT2848_4_Ch32::DigitalOutput 0"); // 测试步骤 Step Set J_DI_SSBPin6SW_LS NotPressed
  g_HIL_Gen_Swc_Wait("301 ms"); // 测试步骤 Step Wait 301 ms
  g_HIL_Bus_Swc_Set("VTS::VT2848_4_Ch22::DigitalOutput 1"); // 测试步骤 Step Set J_DI_BrakeSw2_HS Pressed
  g_HIL_Bus_Swc_Set("VTS::VT2848_4_Ch17::DigitalOutput 1"); // 测试步骤 Step Set J_DI_BrakeSw1_HS Pressed
  g_HIL_Gen_Swc_Wait("450 ms"); // 测试步骤 Step Wait 450 ms
  g_HIL_Bus_Swc_Set("VTS::VT2848_4_Ch27::DigitalOutput 1"); // 测试步骤 Step Set J_DI_SSBPin4SW_LS Pressed
  g_HIL_Bus_Swc_Set("VTS::VT2848_4_Ch32::DigitalOutput 1"); // 测试步骤 Step Set J_DI_SSBPin6SW_LS Pressed
  g_HIL_Gen_Swc_Wait("301 ms"); // 测试步骤 Step Wait 301 ms
  g_HIL_XCP_Swc_Set_XCP("CalVal_KeyValidSt 1"); // 测试步骤 Step Set_XCP CalVal_KeyValidSt 1
  g_HIL_XCP_Swc_Set_XCP("CalEn_KeyValidSt 80"); // 测试步骤 Step Set_XCP CalEn_KeyValidSt 80
  g_HIL_Bus_Swc_Check("I_LDCU_Debug::I_KeyValidSt 1 1 s"); // 预期结果 Step Check I_LDCU_Debug::I_KeyValidSt 1 1 s//valid
  g_HIL_Bus_Swc_Check("I_LDCU_BodySysSt2::I_LDCU_ReadyEnable 1"); // 预期结果 Step Check I_LDCU_BodySysSt2::I_LDCU_ReadyEnable 1//Ready使能
  g_HIL_XCP_Swc_Set_XCP("CalVal_KeyValidSt 1"); // 测试步骤 Step Set_XCP CalVal_KeyValidSt 1
  g_HIL_XCP_Swc_Set_XCP("CalEn_KeyValidSt 0"); // 测试步骤 Step Set_XCP CalEn_KeyValidSt 0
  g_HIL_Bus_Swc_Check("I_LDCU_Debug::I_KeyValidSt 0 1 s"); // 预期结果 Step Check I_LDCU_Debug::I_KeyValidSt 0 1 s//Invalid
  g_HIL_Bus_Swc_Set("VTS::VT2848_4_Ch27::DigitalOutput 0"); // 测试步骤 Step Set J_DI_SSBPin4SW_LS NotPressed
  g_HIL_Bus_Swc_Check("I_LDCU_BodySysSt2::I_LDCU_ReadyEnable 0"); // 预期结果 Step Check I_LDCU_BodySysSt2::I_LDCU_ReadyEnable 0//Disable
  g_HIL_Bus_Swc_Set("VTS::VT2848_4_Ch32::DigitalOutput 0"); // 测试步骤 Step Set J_DI_SSBPin6SW_LS NotPressed
  g_HIL_Bus_Swc_Set("VTS::VT2848_4_Ch17::DigitalOutput 0"); // 测试步骤 Step Set J_DI_BrakeSw1_HS NotPressed
  g_HIL_Bus_Swc_Set("VTS::VT2848_4_Ch22::DigitalOutput 0"); // 测试步骤 Step Set J_DI_BrakeSw2_HS NotPressed
}

testcase SYS_LDCU_Powermode_0159()
{
  TestDescription("车辆进入Ready过程中，车辆PowerMode变化导致退出Ready使能-1");
  g_HIL_XCP_Swc_Set_XCP("CalEn_Vcu_MO_Motor_laeuft 1"); // 测试步骤 Step Set_XCP CalEn_Vcu_MO_Motor_laeuft 1
  g_HIL_XCP_Swc_Set_XCP("CalVal_Vcu_MO_Motor_laeuft 0"); // 测试步骤 Step Set_XCP CalVal_Vcu_MO_Motor_laeuft 0
  g_HIL_Bus_Swc_Check("C_Motor_14::C_MO_Motor_laeuft 0"); // 预期结果 Step Check C_Motor_14::C_MO_Motor_laeuft 0//Motor_laeuft_nicht
  g_HIL_XCP_Swc_Set_XCP("CalEn_Vcu_MO_Kl_50 1"); // 测试步骤 Step Set_XCP CalEn_Vcu_MO_Kl_50 1
  g_HIL_XCP_Swc_Set_XCP("CalVal_Vcu_MO_Kl_50 0"); // 测试步骤 Step Set_XCP CalVal_Vcu_MO_Kl_50 0
  g_HIL_Bus_Swc_Check("C_Motor_14::C_MO_Kl_50 0"); // 预期结果 Step Check C_Motor_14::C_MO_Kl_50 0//aus
  g_HIL_Bus_Swc_Set("VTS::VT2848_4_Ch27::DigitalOutput 0"); // 测试步骤 Step Set J_DI_SSBPin4SW_LS NotPressed
  g_HIL_Bus_Swc_Set("VTS::VT2848_4_Ch32::DigitalOutput 0"); // 测试步骤 Step Set J_DI_SSBPin6SW_LS NotPressed
  g_HIL_Gen_Swc_Wait("301 ms"); // 测试步骤 Step Wait 301 ms
  g_HIL_Bus_Swc_Set("VTS::VT2848_4_Ch22::DigitalOutput 1"); // 测试步骤 Step Set J_DI_BrakeSw2_HS Pressed
  g_HIL_Bus_Swc_Set("VTS::VT2848_4_Ch17::DigitalOutput 1"); // 测试步骤 Step Set J_DI_BrakeSw1_HS Pressed
  g_HIL_Gen_Swc_Wait("450 ms"); // 测试步骤 Step Wait 450 ms
  g_HIL_Bus_Swc_Set("VTS::VT2848_4_Ch27::DigitalOutput 1"); // 测试步骤 Step Set J_DI_SSBPin4SW_LS Pressed
  g_HIL_Bus_Swc_Set("VTS::VT2848_4_Ch32::DigitalOutput 1"); // 测试步骤 Step Set J_DI_SSBPin6SW_LS Pressed
  g_HIL_Gen_Swc_Wait("301 ms"); // 测试步骤 Step Wait 301 ms
  g_HIL_XCP_Swc_Set_XCP("CalVal_KeyValidSt 1"); // 测试步骤 Step Set_XCP CalVal_KeyValidSt 1
  g_HIL_XCP_Swc_Set_XCP("CalEn_KeyValidSt 80"); // 测试步骤 Step Set_XCP CalEn_KeyValidSt 80
  g_HIL_Bus_Swc_Check("I_LDCU_Debug::I_KeyValidSt 1 1 s"); // 预期结果 Step Check I_LDCU_Debug::I_KeyValidSt 1 1 s//valid
  g_HIL_Bus_Swc_Check("I_LDCU_BodySysSt2::I_LDCU_ReadyEnable 1"); // 预期结果 Step Check I_LDCU_BodySysSt2::I_LDCU_ReadyEnable 1//Ready使能
  g_HIL_Clib_Swc_Clib_Convenience(); // 测试步骤 Step Clib Convenience
  g_HIL_Bus_Swc_Check("I_LDCU_BodySysSt1::I_LDCU_PowerMode 3"); // 预期结果 Step Check I_LDCU_BodySysSt1::I_LDCU_PowerMode 3 //Convenience
  g_HIL_Bus_Swc_Set("VTS::VT2848_4_Ch27::DigitalOutput 0"); // 测试步骤 Step Set J_DI_SSBPin4SW_LS NotPressed
  g_HIL_Bus_Swc_Check("I_LDCU_BodySysSt2::I_LDCU_ReadyEnable 0"); // 预期结果 Step Check I_LDCU_BodySysSt2::I_LDCU_ReadyEnable 0//Disable
  g_HIL_Bus_Swc_Set("VTS::VT2848_4_Ch32::DigitalOutput 0"); // 测试步骤 Step Set J_DI_SSBPin6SW_LS NotPressed
  g_HIL_Bus_Swc_Set("VTS::VT2848_4_Ch17::DigitalOutput 0"); // 测试步骤 Step Set J_DI_BrakeSw1_HS NotPressed
  g_HIL_Bus_Swc_Set("VTS::VT2848_4_Ch22::DigitalOutput 0"); // 测试步骤 Step Set J_DI_BrakeSw2_HS NotPressed
}

testcase SYS_LDCU_Powermode_0160()
{
  TestDescription("车辆进入Ready过程中，车辆PowerMode变化导致退出Ready使能-2");
  g_HIL_XCP_Swc_Set_XCP("CalEn_Vcu_MO_Motor_laeuft 1"); // 测试步骤 Step Set_XCP CalEn_Vcu_MO_Motor_laeuft 1
  g_HIL_XCP_Swc_Set_XCP("CalVal_Vcu_MO_Motor_laeuft 0"); // 测试步骤 Step Set_XCP CalVal_Vcu_MO_Motor_laeuft 0
  g_HIL_Bus_Swc_Check("C_Motor_14::C_MO_Motor_laeuft 0"); // 预期结果 Step Check C_Motor_14::C_MO_Motor_laeuft 0//Motor_laeuft_nicht
  g_HIL_XCP_Swc_Set_XCP("CalEn_Vcu_MO_Kl_50 1"); // 测试步骤 Step Set_XCP CalEn_Vcu_MO_Kl_50 1
  g_HIL_XCP_Swc_Set_XCP("CalVal_Vcu_MO_Kl_50 0"); // 测试步骤 Step Set_XCP CalVal_Vcu_MO_Kl_50 0
  g_HIL_Bus_Swc_Check("C_Motor_14::C_MO_Kl_50 0"); // 预期结果 Step Check C_Motor_14::C_MO_Kl_50 0//aus
  g_HIL_Bus_Swc_Set("VTS::VT2848_4_Ch27::DigitalOutput 0"); // 测试步骤 Step Set J_DI_SSBPin4SW_LS NotPressed
  g_HIL_Bus_Swc_Set("VTS::VT2848_4_Ch32::DigitalOutput 0"); // 测试步骤 Step Set J_DI_SSBPin6SW_LS NotPressed
  g_HIL_Gen_Swc_Wait("301 ms"); // 测试步骤 Step Wait 301 ms
  g_HIL_Bus_Swc_Set("VTS::VT2848_4_Ch22::DigitalOutput 1"); // 测试步骤 Step Set J_DI_BrakeSw2_HS Pressed
  g_HIL_Bus_Swc_Set("VTS::VT2848_4_Ch17::DigitalOutput 1"); // 测试步骤 Step Set J_DI_BrakeSw1_HS Pressed
  g_HIL_Gen_Swc_Wait("450 ms"); // 测试步骤 Step Wait 450 ms
  g_HIL_Bus_Swc_Set("VTS::VT2848_4_Ch27::DigitalOutput 1"); // 测试步骤 Step Set J_DI_SSBPin4SW_LS Pressed
  g_HIL_Bus_Swc_Set("VTS::VT2848_4_Ch32::DigitalOutput 1"); // 测试步骤 Step Set J_DI_SSBPin6SW_LS Pressed
  g_HIL_Gen_Swc_Wait("301 ms"); // 测试步骤 Step Wait 301 ms
  g_HIL_XCP_Swc_Set_XCP("CalVal_KeyValidSt 1"); // 测试步骤 Step Set_XCP CalVal_KeyValidSt 1
  g_HIL_XCP_Swc_Set_XCP("CalEn_KeyValidSt 80"); // 测试步骤 Step Set_XCP CalEn_KeyValidSt 80
  g_HIL_Bus_Swc_Check("I_LDCU_Debug::I_KeyValidSt 1 1 s"); // 预期结果 Step Check I_LDCU_Debug::I_KeyValidSt 1 1 s//valid
  g_HIL_Bus_Swc_Check("I_LDCU_BodySysSt2::I_LDCU_ReadyEnable 1"); // 预期结果 Step Check I_LDCU_BodySysSt2::I_LDCU_ReadyEnable 1//Ready使能
  g_HIL_Clib_Swc_Clib_OFF(); // 测试步骤 Step Clib OFF
  g_HIL_Bus_Swc_Check("I_LDCU_BodySysSt1::I_LDCU_PowerMode 0"); // 预期结果 Step Check I_LDCU_BodySysSt1::I_LDCU_PowerMode 0 //OFF
  g_HIL_Bus_Swc_Set("VTS::VT2848_4_Ch27::DigitalOutput 0"); // 测试步骤 Step Set J_DI_SSBPin4SW_LS NotPressed
  g_HIL_Bus_Swc_Check("I_LDCU_BodySysSt2::I_LDCU_ReadyEnable 0"); // 预期结果 Step Check I_LDCU_BodySysSt2::I_LDCU_ReadyEnable 0//Disable
  g_HIL_Bus_Swc_Set("VTS::VT2848_4_Ch32::DigitalOutput 0"); // 测试步骤 Step Set J_DI_SSBPin6SW_LS NotPressed
  g_HIL_Bus_Swc_Set("VTS::VT2848_4_Ch17::DigitalOutput 0"); // 测试步骤 Step Set J_DI_BrakeSw1_HS NotPressed
  g_HIL_Bus_Swc_Set("VTS::VT2848_4_Ch22::DigitalOutput 0"); // 测试步骤 Step Set J_DI_BrakeSw2_HS NotPressed
}

testcase SYS_LDCU_Powermode_0161()
{
  TestDescription("车辆进入Ready过程中，车辆PowerMode变化导致退出Ready使能-3");
  g_HIL_XCP_Swc_Set_XCP("CalEn_Vcu_MO_Motor_laeuft 1"); // 测试步骤 Step Set_XCP CalEn_Vcu_MO_Motor_laeuft 1
  g_HIL_XCP_Swc_Set_XCP("CalVal_Vcu_MO_Motor_laeuft 0"); // 测试步骤 Step Set_XCP CalVal_Vcu_MO_Motor_laeuft 0
  g_HIL_Bus_Swc_Check("C_Motor_14::C_MO_Motor_laeuft 0"); // 预期结果 Step Check C_Motor_14::C_MO_Motor_laeuft 0//Motor_laeuft_nicht
  g_HIL_XCP_Swc_Set_XCP("CalEn_Vcu_MO_Kl_50 1"); // 测试步骤 Step Set_XCP CalEn_Vcu_MO_Kl_50 1
  g_HIL_XCP_Swc_Set_XCP("CalVal_Vcu_MO_Kl_50 0"); // 测试步骤 Step Set_XCP CalVal_Vcu_MO_Kl_50 0
  g_HIL_Bus_Swc_Check("C_Motor_14::C_MO_Kl_50 0"); // 预期结果 Step Check C_Motor_14::C_MO_Kl_50 0//aus
  g_HIL_Bus_Swc_Set("VTS::VT2848_4_Ch27::DigitalOutput 0"); // 测试步骤 Step Set J_DI_SSBPin4SW_LS NotPressed
  g_HIL_Bus_Swc_Set("VTS::VT2848_4_Ch32::DigitalOutput 0"); // 测试步骤 Step Set J_DI_SSBPin6SW_LS NotPressed
  g_HIL_Gen_Swc_Wait("301 ms"); // 测试步骤 Step Wait 301 ms
  g_HIL_Clib_Swc_Clib_LocalON(); // 测试步骤 Step Clib LocalON
  g_HIL_Bus_Swc_Check("I_LDCU_BodySysSt1::I_LDCU_PowerMode 1"); // 预期结果 Step Check I_LDCU_BodySysSt1::I_LDCU_PowerMode 1 //Local_ON
  g_HIL_Bus_Swc_Set("VTS::VT2848_4_Ch22::DigitalOutput 1"); // 测试步骤 Step Set J_DI_BrakeSw2_HS Pressed
  g_HIL_Bus_Swc_Set("VTS::VT2848_4_Ch17::DigitalOutput 1"); // 测试步骤 Step Set J_DI_BrakeSw1_HS Pressed
  g_HIL_Gen_Swc_Wait("450 ms"); // 测试步骤 Step Wait 450 ms
  g_HIL_Bus_Swc_Set("VTS::VT2848_4_Ch27::DigitalOutput 1"); // 测试步骤 Step Set J_DI_SSBPin4SW_LS Pressed
  g_HIL_Bus_Swc_Set("VTS::VT2848_4_Ch32::DigitalOutput 1"); // 测试步骤 Step Set J_DI_SSBPin6SW_LS Pressed
  g_HIL_Gen_Swc_Wait("301 ms"); // 测试步骤 Step Wait 301 ms
  g_HIL_XCP_Swc_Set_XCP("CalVal_KeyValidSt 1"); // 测试步骤 Step Set_XCP CalVal_KeyValidSt 1
  g_HIL_XCP_Swc_Set_XCP("CalEn_KeyValidSt 80"); // 测试步骤 Step Set_XCP CalEn_KeyValidSt 80
  g_HIL_Bus_Swc_Check("I_LDCU_Debug::I_KeyValidSt 1 1 s"); // 预期结果 Step Check I_LDCU_Debug::I_KeyValidSt 1 1 s//valid
  g_HIL_Bus_Swc_Check("I_LDCU_BodySysSt2::I_LDCU_ReadyEnable 1"); // 预期结果 Step Check I_LDCU_BodySysSt2::I_LDCU_ReadyEnable 1//Ready使能
  g_HIL_Clib_Swc_Clib_RemoteON(); // 测试步骤 Step Clib RemoteON
  g_HIL_Bus_Swc_Check("I_LDCU_BodySysSt1::I_LDCU_PowerMode 2"); // 预期结果 Step Check I_LDCU_BodySysSt1::I_LDCU_PowerMode 2 //RemoteON
  g_HIL_Bus_Swc_Set("VTS::VT2848_4_Ch27::DigitalOutput 0"); // 测试步骤 Step Set J_DI_SSBPin4SW_LS NotPressed
  g_HIL_Bus_Swc_Check("I_LDCU_BodySysSt2::I_LDCU_ReadyEnable 0"); // 预期结果 Step Check I_LDCU_BodySysSt2::I_LDCU_ReadyEnable 0//Disable
  g_HIL_Bus_Swc_Set("VTS::VT2848_4_Ch32::DigitalOutput 0"); // 测试步骤 Step Set J_DI_SSBPin6SW_LS NotPressed
  g_HIL_Bus_Swc_Set("VTS::VT2848_4_Ch17::DigitalOutput 0"); // 测试步骤 Step Set J_DI_BrakeSw1_HS NotPressed
  g_HIL_Bus_Swc_Set("VTS::VT2848_4_Ch22::DigitalOutput 0"); // 测试步骤 Step Set J_DI_BrakeSw2_HS NotPressed
}

testcase SYS_LDCU_Powermode_0162()
{
  TestDescription("解锁源状态（信号定义）");
  g_HIL_Clib_Swc_Clib_Sleep(); // 测试步骤 Step Clib Sleep
  g_HIL_Clib_Swc_Clib_WakeUp(); // 测试步骤 Step Clib WakeUp
  g_HIL_Gen_Swc_Wait("101 ms"); // 测试步骤 Step Wait 101 ms
  g_HIL_Bus_Swc_Check("I_LDCU_Debug::I_LastDoorUnlockSource 0"); // 预期结果 Step Check I_LDCU_Debug::I_LastDoorUnlockSource 0//key Unlock
}

testcase SYS_LDCU_Powermode_0163()
{
  TestDescription("解锁源状态（蓝牙/手机钥匙）");
  g_HIL_Bus_Swc_Set("I_TBOX_WinRemoteCtrl::I_TBOX_LDCU_DoorLockReq 0"); // 测试步骤 Step Set I_TBOX_WinRemoteCtrl::I_TBOX_LDCU_DoorLockReq 0//No operation
  g_HIL_Bus_Swc_Check("I_LDCU_Debug::I_LastDoorUnlockSource 0"); // 预期结果 Step Check I_LDCU_Debug::I_LastDoorUnlockSource 0//key unlock
  g_HIL_Gen_Swc_Wait("301 ms"); // 测试步骤 Step Wait 301 ms
  g_HIL_Bus_Swc_Set("I_TBOX_WinRemoteCtrl::I_TBOX_LDCU_DoorLockReq 2"); // 测试步骤 Step Set I_TBOX_WinRemoteCtrl::I_TBOX_LDCU_DoorLockReq 2//4G
  g_HIL_Gen_Swc_Wait("301 ms"); // 测试步骤 Step Wait 301 ms
  g_HIL_Bus_Swc_Check("I_LDCU_Debug::I_LastDoorUnlockSource 0"); // 预期结果 Step Check I_LDCU_Debug::I_LastDoorUnlockSource 0//key unlock
  g_HIL_Bus_Swc_Set("I_TBOX_WinRemoteCtrl::I_TBOX_LDCU_DoorLockReq 3"); // 测试步骤 Step Set I_TBOX_WinRemoteCtrl::I_TBOX_LDCU_DoorLockReq 3//BLE Door lock
  g_HIL_Gen_Swc_Wait("301 ms"); // 测试步骤 Step Wait 301 ms
  g_HIL_Bus_Swc_Set("I_TBOX_WinRemoteCtrl::I_TBOX_LDCU_DoorLockReq 4"); // 测试步骤 Step Set I_TBOX_WinRemoteCtrl::I_TBOX_LDCU_DoorLockReq 4//BLE unlock
  g_HIL_Gen_Swc_Wait("301 ms"); // 测试步骤 Step Wait 301 ms
  g_HIL_Bus_Swc_Check("I_LDCU_Debug::I_LastDoorUnlockSource 0"); // 预期结果 Step Check I_LDCU_Debug::I_LastDoorUnlockSource 0//key unlock
  g_HIL_Bus_Swc_Set("I_TBOX_WinRemoteCtrl::I_TBOX_LDCU_DoorLockReq 3"); // 测试步骤 Step Set I_TBOX_WinRemoteCtrl::I_TBOX_LDCU_DoorLockReq 3//BLE Door lock
  g_HIL_Gen_Swc_Wait("301 ms"); // 测试步骤 Step Wait 301 ms
  g_HIL_Bus_Swc_Set("I_TBOX_WinRemoteCtrl::I_TBOX_LDCU_DoorLockReq 6"); // 测试步骤 Step Set I_TBOX_WinRemoteCtrl::I_TBOX_LDCU_DoorLockReq 6//BLE polling unlock
  g_HIL_Gen_Swc_Wait("301 ms"); // 测试步骤 Step Wait 301 ms
  g_HIL_Bus_Swc_Check("I_LDCU_Debug::I_LastDoorUnlockSource 0"); // 预期结果 Step Check I_LDCU_Debug::I_LastDoorUnlockSource 0//key unlock
  g_HIL_Bus_Swc_Set("I_TBOX_WinRemoteCtrl::I_TBOX_LDCU_DoorLockReq 3"); // 测试步骤 Step Set I_TBOX_WinRemoteCtrl::I_TBOX_LDCU_DoorLockReq 3//BLE Door lock
  g_HIL_Gen_Swc_Wait("301 ms"); // 测试步骤 Step Wait 301 ms
  g_HIL_Bus_Swc_Set("I_TBOX_WinRemoteCtrl::I_TBOX_LDCU_DoorLockReq 0xD"); // 测试步骤 Step Set I_TBOX_WinRemoteCtrl::I_TBOX_LDCU_DoorLockReq 0xD//4G ready unlock
  g_HIL_Gen_Swc_Wait("301 ms"); // 测试步骤 Step Wait 301 ms
  g_HIL_Bus_Swc_Check("I_LDCU_Debug::I_LastDoorUnlockSource 0"); // 预期结果 Step Check I_LDCU_Debug::I_LastDoorUnlockSource 0//key Unlock
  g_HIL_Bus_Swc_Set("I_TBOX_WinRemoteCtrl::I_TBOX_LDCU_DoorLockReq 0"); // 测试步骤 Step Set I_TBOX_WinRemoteCtrl::I_TBOX_LDCU_DoorLockReq 0//No operation
}

testcase SYS_LDCU_Powermode_0164()
{
  TestDescription("解锁源状态（NFC钥匙）-1");
  g_HIL_Bus_Swc_Set("I_TBOX_WinRemoteCtrl::I_TBOX_LDCU_DoorLockReq 0xD"); // 测试步骤 Step Set I_TBOX_WinRemoteCtrl::I_TBOX_LDCU_DoorLockReq 0xD//4G ready unlock
  g_HIL_Gen_Swc_Wait("301 ms"); // 测试步骤 Step Wait 301 ms
  g_HIL_Bus_Swc_Check("I_LDCU_Debug::I_LastDoorUnlockSource 0"); // 预期结果 Step Check I_LDCU_Debug::I_LastDoorUnlockSource 0//key Unlock
  g_HIL_Bus_Swc_Set("BL_TBOX_DigitalKeyInfo::BL_OutsideNFCSt 0"); // 测试步骤 Step Set BL_TBOX_DigitalKeyInfo::BL_OutsideNFCSt 0
  g_HIL_Gen_Swc_Wait("301 ms"); // 测试步骤 Step Wait 301 ms
  g_HIL_Bus_Swc_Set("BL_TBOX_DigitalKeyInfo::BL_OutsideNFCSt 2"); // 测试步骤 Step Set BL_TBOX_DigitalKeyInfo::BL_OutsideNFCSt 2//valid
  g_HIL_Gen_Swc_Wait("301 ms"); // 测试步骤 Step Wait 301 ms
  g_HIL_Bus_Swc_Check("I_LDCU_Debug::I_LastDoorUnlockSource 1"); // 预期结果 Step Check I_LDCU_Debug::I_LastDoorUnlockSource 1//NFC unlock
  g_HIL_Bus_Swc_Set("BL_TBOX_DigitalKeyInfo::BL_OutsideNFCSt 0"); // 测试步骤 Step Set BL_TBOX_DigitalKeyInfo::BL_OutsideNFCSt 0
  g_HIL_Bus_Swc_Set("I_TBOX_WinRemoteCtrl::I_TBOX_LDCU_DoorLockReq 0"); // 测试步骤 Step Set I_TBOX_WinRemoteCtrl::I_TBOX_LDCU_DoorLockReq 0//No operation
}

testcase SYS_LDCU_Powermode_0165()
{
  TestDescription("解锁源状态（NFC钥匙）-2");
  g_HIL_Bus_Swc_Set("I_TBOX_WinRemoteCtrl::I_TBOX_LDCU_DoorLockReq 0xD"); // 测试步骤 Step Set I_TBOX_WinRemoteCtrl::I_TBOX_LDCU_DoorLockReq 0xD//4G ready unlock
  g_HIL_Gen_Swc_Wait("301 ms"); // 测试步骤 Step Wait 301 ms
  g_HIL_Bus_Swc_Check("I_LDCU_Debug::I_LastDoorUnlockSource 0"); // 预期结果 Step Check I_LDCU_Debug::I_LastDoorUnlockSource 0//key Unlock
  g_HIL_Bus_Swc_Set("BL_TBOX_DigitalKeyInfo::BL_IncarNFCSt 0"); // 测试步骤 Step Set BL_TBOX_DigitalKeyInfo::BL_IncarNFCSt 0
  g_HIL_Gen_Swc_Wait("301 ms"); // 测试步骤 Step Wait 301 ms
  g_HIL_Bus_Swc_Set("BL_TBOX_DigitalKeyInfo::BL_IncarNFCSt 2"); // 测试步骤 Step Set BL_TBOX_DigitalKeyInfo::BL_IncarNFCSt 2//valid
  g_HIL_Gen_Swc_Wait("301 ms"); // 测试步骤 Step Wait 301 ms
  g_HIL_Bus_Swc_Check("I_LDCU_Debug::I_LastDoorUnlockSource 1"); // 预期结果 Step Check I_LDCU_Debug::I_LastDoorUnlockSource 1//NFC unlock
  g_HIL_Bus_Swc_Set("BL_TBOX_DigitalKeyInfo::BL_IncarNFCSt 0"); // 测试步骤 Step Set BL_TBOX_DigitalKeyInfo::BL_IncarNFCSt 0
  g_HIL_Bus_Swc_Set("I_TBOX_WinRemoteCtrl::I_TBOX_LDCU_DoorLockReq 0"); // 测试步骤 Step Set I_TBOX_WinRemoteCtrl::I_TBOX_LDCU_DoorLockReq 0//No operation
}

testcase SYS_LDCU_Powermode_0166()
{
  TestDescription("蓝牙或手机解锁启动时车内无钥匙弹窗提示");
  g_HIL_Bus_Swc_Set("VTS::VT2848_4_Ch17::DigitalOutput 0"); // 测试步骤 Step Set J_DI_BrakeSw1_HS NotPressed
  g_HIL_Bus_Swc_Set("VTS::VT2848_4_Ch22::DigitalOutput 0"); // 测试步骤 Step Set J_DI_BrakeSw2_HS NotPressed
  g_HIL_Bus_Swc_Set("I_TBOX_WinRemoteCtrl::I_TBOX_LDCU_DoorLockReq 0xD"); // 测试步骤 Step Set I_TBOX_WinRemoteCtrl::I_TBOX_LDCU_DoorLockReq 0xD//4G ready unlock
  g_HIL_Gen_Swc_Wait("301 ms"); // 测试步骤 Step Wait 301 ms
  g_HIL_Bus_Swc_Check("I_LDCU_Debug::I_LastDoorUnlockSource 0"); // 预期结果 Step Check I_LDCU_Debug::I_LastDoorUnlockSource 0//key Unlock
  g_HIL_XCP_Swc_Set_XCP("CalEn_Vcu_MO_Motor_laeuft 1"); // 测试步骤 Step Set_XCP CalEn_Vcu_MO_Motor_laeuft 1
  g_HIL_XCP_Swc_Set_XCP("CalVal_Vcu_MO_Motor_laeuft 0"); // 测试步骤 Step Set_XCP CalVal_Vcu_MO_Motor_laeuft 0
  g_HIL_Bus_Swc_Check("C_Motor_14::C_MO_Motor_laeuft 0"); // 预期结果 Step Check C_Motor_14::C_MO_Motor_laeuft 0//Motor_laeuft_nicht
  g_HIL_Gen_Swc_Wait("301 ms"); // 测试步骤 Step Wait 301 ms
  g_HIL_Bus_Swc_Check("I_LDCU_BodySysSt2::I_LDCU_ReadyEnable 0"); // 预期结果 Step Check I_LDCU_BodySysSt2::I_LDCU_ReadyEnable 0//Disable
  g_HIL_Bus_Swc_Set("VTS::VT2848_4_Ch22::DigitalOutput 1"); // 测试步骤 Step Set J_DI_BrakeSw2_HS Pressed
  g_HIL_Bus_Swc_Check("C_LDCU_SysSt::C_LDCU_BrkPedalStVD 1"); // 预期结果 Step Check C_LDCU_SysSt::C_LDCU_BrkPedalStVD 1//valid
  g_HIL_Bus_Swc_Set("VTS::VT2848_4_Ch17::DigitalOutput 1"); // 测试步骤 Step Set J_DI_BrakeSw1_HS Pressed
  g_HIL_Bus_Swc_Check("C_LDCU_SysSt::C_LDCU_BrkPedalSt 1 1 s"); // 预期结果 Step Check C_LDCU_SysSt::C_LDCU_BrkPedalSt 1 1 s//Pressed
  g_HIL_Bus_Swc_Check("I_LDCU_State::I_KeySearchingSt 1"); // 预期结果 Step Check I_LDCU_State::I_KeySearchingSt 1//Initial Search
  g_HIL_Bus_Swc_Check("I_LDCU_State::I_KeySearchingSt 0 1 s"); // 预期结果 Step Check I_LDCU_State::I_KeySearchingSt 0 1 s//Not Searching
  g_HIL_Gen_Swc_Wait("100 ms"); // 测试步骤 Step Wait 100 ms
  g_HIL_Bus_Swc_Check("I_LDCU_BodySysSt2::I_LDCU_KeyInvalidAlertReq 2"); // 预期结果 Step Check I_LDCU_BodySysSt2::I_LDCU_KeyInvalidAlertReq 2//Key not found Alert3帧
  g_HIL_Gen_Swc_Wait("301 ms"); // 测试步骤 Step Wait 301 ms
  g_HIL_Bus_Swc_Check("I_LDCU_BodySysSt2::I_LDCU_KeyInvalidAlertReq 0 1 s"); // 预期结果 Step Check I_LDCU_BodySysSt2::I_LDCU_KeyInvalidAlertReq 0 1 s
  g_HIL_Bus_Swc_Set("I_TBOX_WinRemoteCtrl::I_TBOX_LDCU_DoorLockReq 0x0"); // 测试步骤 Step Set I_TBOX_WinRemoteCtrl::I_TBOX_LDCU_DoorLockReq 0x0
  g_HIL_Bus_Swc_Set("VTS::VT2848_4_Ch17::DigitalOutput 0"); // 测试步骤 Step Set J_DI_BrakeSw1_HS NotPressed
  g_HIL_Bus_Swc_Set("VTS::VT2848_4_Ch22::DigitalOutput 0"); // 测试步骤 Step Set J_DI_BrakeSw2_HS NotPressed
}

testcase SYS_LDCU_Powermode_0167()
{
  TestDescription("NFC钥匙解锁超时启动失败弹窗提示");
  g_HIL_Bus_Swc_Set("VTS::VT2848_4_Ch17::DigitalOutput 0"); // 测试步骤 Step Set J_DI_BrakeSw1_HS NotPressed
  g_HIL_Bus_Swc_Set("VTS::VT2848_4_Ch22::DigitalOutput 0"); // 测试步骤 Step Set J_DI_BrakeSw2_HS NotPressed
  g_HIL_Bus_Swc_Set("BL_TBOX_DigitalKeyInfo::BL_IncarNFCSt 1"); // 测试步骤 Step Set BL_TBOX_DigitalKeyInfo::BL_IncarNFCSt 1//Invalid
  g_HIL_Bus_Swc_Set("BL_TBOX_DigitalKeyInfo::BL_IncarNFCSt 2"); // 测试步骤 Step Set BL_TBOX_DigitalKeyInfo::BL_IncarNFCSt 2//valid
  g_HIL_Gen_Swc_Wait("301 ms"); // 测试步骤 Step Wait 301 ms
  g_HIL_Bus_Swc_Check("I_LDCU_Debug::I_LastDoorUnlockSource 1"); // 预期结果 Step Check I_LDCU_Debug::I_LastDoorUnlockSource 1//NFC unlock
  g_HIL_XCP_Swc_Set_XCP("CalEn_Vcu_MO_Motor_laeuft 1"); // 测试步骤 Step Set_XCP CalEn_Vcu_MO_Motor_laeuft 1
  g_HIL_XCP_Swc_Set_XCP("CalVal_Vcu_MO_Motor_laeuft 0"); // 测试步骤 Step Set_XCP CalVal_Vcu_MO_Motor_laeuft 0
  g_HIL_Bus_Swc_Check("C_Motor_14::C_MO_Motor_laeuft 0"); // 预期结果 Step Check C_Motor_14::C_MO_Motor_laeuft 0//Motor_laeuft_nicht
  g_HIL_Gen_Swc_Wait("301 ms"); // 测试步骤 Step Wait 301 ms
  g_HIL_Bus_Swc_Check("I_LDCU_BodySysSt2::I_LDCU_ReadyEnable 0"); // 预期结果 Step Check I_LDCU_BodySysSt2::I_LDCU_ReadyEnable 0//Disable
  g_HIL_Bus_Swc_Set("VTS::VT2848_4_Ch22::DigitalOutput 1"); // 测试步骤 Step Set J_DI_BrakeSw2_HS Pressed
  g_HIL_Bus_Swc_Check("C_LDCU_SysSt::C_LDCU_BrkPedalStVD 1"); // 预期结果 Step Check C_LDCU_SysSt::C_LDCU_BrkPedalStVD 1//valid
  g_HIL_Bus_Swc_Set("VTS::VT2848_4_Ch17::DigitalOutput 1"); // 测试步骤 Step Set J_DI_BrakeSw1_HS Pressed
  g_HIL_Bus_Swc_Check("C_LDCU_SysSt::C_LDCU_BrkPedalSt 1 1 s"); // 预期结果 Step Check C_LDCU_SysSt::C_LDCU_BrkPedalSt 1 1 s//Pressed
  g_HIL_Bus_Swc_Check("I_LDCU_State::I_KeySearchingSt 1"); // 预期结果 Step Check I_LDCU_State::I_KeySearchingSt 1//Initial Search
  g_HIL_Bus_Swc_Check("I_LDCU_State::I_KeySearchingSt 0 1 s"); // 预期结果 Step Check I_LDCU_State::I_KeySearchingSt 0 1 s//Not Searching
  g_HIL_Gen_Swc_Wait("100 ms"); // 测试步骤 Step Wait 100 ms
  g_HIL_Bus_Swc_Check("I_LDCU_BodySysSt2::I_LDCU_KeyInvalidAlertReq 5"); // 预期结果 Step Check I_LDCU_BodySysSt2::I_LDCU_KeyInvalidAlertReq 5//NFC not found Alert3帧
  g_HIL_Gen_Swc_Wait("301 ms"); // 测试步骤 Step Wait 301 ms
  g_HIL_Bus_Swc_Check("I_LDCU_BodySysSt2::I_LDCU_KeyInvalidAlertReq 0 1 s"); // 预期结果 Step Check I_LDCU_BodySysSt2::I_LDCU_KeyInvalidAlertReq 0 1 s
  g_HIL_Bus_Swc_Set("BL_TBOX_DigitalKeyInfo::BL_IncarNFCSt 0"); // 测试步骤 Step Set BL_TBOX_DigitalKeyInfo::BL_IncarNFCSt 0//Unknown
  g_HIL_Bus_Swc_Set("VTS::VT2848_4_Ch17::DigitalOutput 0"); // 测试步骤 Step Set J_DI_BrakeSw1_HS NotPressed
  g_HIL_Bus_Swc_Set("VTS::VT2848_4_Ch22::DigitalOutput 0"); // 测试步骤 Step Set J_DI_BrakeSw2_HS NotPressed
}

testcase SYS_LDCU_Powermode_0168()
{
  TestDescription("弹窗条件不满足时发出取消弹窗请求-1");
  g_HIL_XCP_Swc_Set_XCP("CalEn_Vcu_MO_Motor_laeuft 1"); // 测试步骤 Step Set_XCP CalEn_Vcu_MO_Motor_laeuft 1
  g_HIL_XCP_Swc_Set_XCP("CalVal_Vcu_MO_Motor_laeuft 0"); // 测试步骤 Step Set_XCP CalVal_Vcu_MO_Motor_laeuft 0
  g_HIL_Bus_Swc_Check("C_Motor_14::C_MO_Motor_laeuft 0"); // 预期结果 Step Check C_Motor_14::C_MO_Motor_laeuft 0//Motor_laeuft_nicht
  g_HIL_XCP_Swc_Set_XCP("CalEn_Vcu_MO_Kl_50 1"); // 测试步骤 Step Set_XCP CalEn_Vcu_MO_Kl_50 1
  g_HIL_XCP_Swc_Set_XCP("CalVal_Vcu_MO_Kl_50 0"); // 测试步骤 Step Set_XCP CalVal_Vcu_MO_Kl_50 0
  g_HIL_Bus_Swc_Check("C_Motor_14::C_MO_Kl_50 0"); // 预期结果 Step Check C_Motor_14::C_MO_Kl_50 0//aus
  g_HIL_Bus_Swc_Set("VTS::VT2848_4_Ch27::DigitalOutput 0"); // 测试步骤 Step Set J_DI_SSBPin4SW_LS NotPressed
  g_HIL_Bus_Swc_Set("VTS::VT2848_4_Ch32::DigitalOutput 0"); // 测试步骤 Step Set J_DI_SSBPin6SW_LS NotPressed
  g_HIL_Gen_Swc_Wait("301 ms"); // 测试步骤 Step Wait 301 ms
  g_HIL_Bus_Swc_Set("VTS::VT2848_4_Ch22::DigitalOutput 1"); // 测试步骤 Step Set J_DI_BrakeSw2_HS Pressed
  g_HIL_Bus_Swc_Set("VTS::VT2848_4_Ch17::DigitalOutput 1"); // 测试步骤 Step Set J_DI_BrakeSw1_HS Pressed
  g_HIL_Gen_Swc_Wait("450 ms"); // 测试步骤 Step Wait 450 ms
  g_HIL_Bus_Swc_Set("VTS::VT2848_4_Ch27::DigitalOutput 1"); // 测试步骤 Step Set J_DI_SSBPin4SW_LS Pressed
  g_HIL_Bus_Swc_Set("VTS::VT2848_4_Ch32::DigitalOutput 1"); // 测试步骤 Step Set J_DI_SSBPin6SW_LS Pressed
  g_HIL_Gen_Swc_Wait("301 ms"); // 测试步骤 Step Wait 301 ms
  g_HIL_XCP_Swc_Set_XCP("CalVal_KeyValidSt 1"); // 测试步骤 Step Set_XCP CalVal_KeyValidSt 1
  g_HIL_XCP_Swc_Set_XCP("CalEn_KeyValidSt 80"); // 测试步骤 Step Set_XCP CalEn_KeyValidSt 80
  g_HIL_Bus_Swc_Check("I_LDCU_Debug::I_KeyValidSt 1 1 s"); // 预期结果 Step Check I_LDCU_Debug::I_KeyValidSt 1 1 s//valid
  g_HIL_Bus_Swc_Check("I_LDCU_BodySysSt2::I_LDCU_ReadyEnable 1"); // 预期结果 Step Check I_LDCU_BodySysSt2::I_LDCU_ReadyEnable 1//Ready使能
  g_HIL_XCP_Swc_Set_XCP("CalVal_KeyValidSt 1"); // 测试步骤 Step Set_XCP CalVal_KeyValidSt 1
  g_HIL_XCP_Swc_Set_XCP("CalEn_KeyValidSt 0"); // 测试步骤 Step Set_XCP CalEn_KeyValidSt 0
  g_HIL_Bus_Swc_Check("I_LDCU_Debug::I_KeyValidSt 0 1 s"); // 预期结果 Step Check I_LDCU_Debug::I_KeyValidSt 0 1 s//Invalid
  g_HIL_Bus_Swc_Set("VTS::VT2848_4_Ch27::DigitalOutput 0"); // 测试步骤 Step Set J_DI_SSBPin4SW_LS NotPressed
  g_HIL_Bus_Swc_Check("I_LDCU_BodySysSt2::I_LDCU_ReadyEnable 0"); // 预期结果 Step Check I_LDCU_BodySysSt2::I_LDCU_ReadyEnable 0//Disable
  g_HIL_Bus_Swc_Set("VTS::VT2848_4_Ch32::DigitalOutput 0"); // 测试步骤 Step Set J_DI_SSBPin6SW_LS NotPressed
  g_HIL_Bus_Swc_Check("I_LDCU_BodySysSt2::I_LDCU_KeyInvalidAlertReq 3"); // 预期结果 Step Check I_LDCU_BodySysSt2::I_LDCU_KeyInvalidAlertReq 3//Cancel Alert3帧
  g_HIL_Bus_Swc_Set("VTS::VT2848_4_Ch17::DigitalOutput 0"); // 测试步骤 Step Set J_DI_BrakeSw1_HS NotPressed
  g_HIL_Bus_Swc_Check("I_LDCU_BodySysSt2::I_LDCU_KeyInvalidAlertReq 0 1 s"); // 预期结果 Step Check I_LDCU_BodySysSt2::I_LDCU_KeyInvalidAlertReq 0 1 s
  g_HIL_Bus_Swc_Set("VTS::VT2848_4_Ch22::DigitalOutput 0"); // 测试步骤 Step Set J_DI_BrakeSw2_HS NotPressed
}

testcase SYS_LDCU_Powermode_0169()
{
  TestDescription("弹窗条件不满足时发出取消弹窗请求-2");
  g_HIL_XCP_Swc_Set_XCP("CalEn_Vcu_MO_Motor_laeuft 1"); // 测试步骤 Step Set_XCP CalEn_Vcu_MO_Motor_laeuft 1
  g_HIL_XCP_Swc_Set_XCP("CalVal_Vcu_MO_Motor_laeuft 0"); // 测试步骤 Step Set_XCP CalVal_Vcu_MO_Motor_laeuft 0
  g_HIL_Bus_Swc_Check("C_Motor_14::C_MO_Motor_laeuft 0"); // 预期结果 Step Check C_Motor_14::C_MO_Motor_laeuft 0//Motor_laeuft_nicht
  g_HIL_Gen_Swc_Wait("450 ms"); // 测试步骤 Step Wait 450 ms
  g_HIL_XCP_Swc_Set_XCP("CalVal_Vcu_MO_Motor_laeuft 1"); // 测试步骤 Step Set_XCP CalVal_Vcu_MO_Motor_laeuft 1
  g_HIL_Gen_Swc_Wait("100 ms"); // 测试步骤 Step Wait 100 ms
  g_HIL_Bus_Swc_Check("I_LDCU_BodySysSt2::I_LDCU_KeyInvalidAlertReq 3"); // 预期结果 Step Check I_LDCU_BodySysSt2::I_LDCU_KeyInvalidAlertReq 3//Cancel Alert3帧
  g_HIL_Bus_Swc_Check("I_LDCU_BodySysSt2::I_LDCU_KeyInvalidAlertReq 0 1 s"); // 预期结果 Step Check I_LDCU_BodySysSt2::I_LDCU_KeyInvalidAlertReq 0 1 s
  g_HIL_XCP_Swc_Set_XCP("CalVal_Vcu_MO_Motor_laeuft 0"); // 测试步骤 Step Set_XCP CalVal_Vcu_MO_Motor_laeuft 0
}

testcase SYS_LDCU_Powermode_0170()
{
  TestDescription("钥匙无效性状态进入钥匙扫描状态-1");
  g_HIL_XCP_Swc_Set_XCP("CalEn_Vcu_MO_Motor_laeuft 1"); // 测试步骤 Step Set_XCP CalEn_Vcu_MO_Motor_laeuft 1
  g_HIL_XCP_Swc_Set_XCP("CalVal_Vcu_MO_Motor_laeuft 0"); // 测试步骤 Step Set_XCP CalVal_Vcu_MO_Motor_laeuft 0
  g_HIL_Bus_Swc_Check("C_Motor_14::C_MO_Motor_laeuft 0"); // 预期结果 Step Check C_Motor_14::C_MO_Motor_laeuft 0//Motor_laeuft_nicht
  g_HIL_Gen_Swc_Wait("100 ms"); // 测试步骤 Step Wait 100 ms
  g_HIL_Bus_Swc_Set("VTS::VT2848_4_Ch22::DigitalOutput 1"); // 测试步骤 Step Set J_DI_BrakeSw2_HS Pressed
  g_HIL_Bus_Swc_Check("C_LDCU_SysSt::C_LDCU_BrkPedalStVD 1"); // 预期结果 Step Check C_LDCU_SysSt::C_LDCU_BrkPedalStVD 1//valid
  g_HIL_Bus_Swc_Set("VTS::VT2848_4_Ch17::DigitalOutput 1"); // 测试步骤 Step Set J_DI_BrakeSw1_HS Pressed
  g_HIL_Bus_Swc_Check("C_LDCU_SysSt::C_LDCU_BrkPedalSt 1 1 s"); // 预期结果 Step Check C_LDCU_SysSt::C_LDCU_BrkPedalSt 1 1 s//Pressed
  g_HIL_Bus_Swc_Check("I_LDCU_State::I_KeySearchingSt 1 1 s"); // 预期结果 Step Check I_LDCU_State::I_KeySearchingSt 1 1 s//Initial Search
  g_HIL_Bus_Swc_Set("VTS::VT2848_4_Ch17::DigitalOutput 0"); // 测试步骤 Step Set J_DI_BrakeSw1_HS NotPressed
  g_HIL_Bus_Swc_Set("VTS::VT2848_4_Ch22::DigitalOutput 0"); // 测试步骤 Step Set J_DI_BrakeSw2_HS NotPressed
}

testcase SYS_LDCU_Powermode_0171()
{
  TestDescription("钥匙无效性状态进入钥匙扫描状态-2");
  g_HIL_XCP_Swc_Set_XCP("CalEn_Vcu_MO_Motor_laeuft 1"); // 测试步骤 Step Set_XCP CalEn_Vcu_MO_Motor_laeuft 1
  g_HIL_XCP_Swc_Set_XCP("CalVal_Vcu_MO_Motor_laeuft 0"); // 测试步骤 Step Set_XCP CalVal_Vcu_MO_Motor_laeuft 0
  g_HIL_Bus_Swc_Check("C_Motor_14::C_MO_Motor_laeuft 0"); // 预期结果 Step Check C_Motor_14::C_MO_Motor_laeuft 0//Motor_laeuft_nicht
  g_HIL_Bus_Swc_Set("C_Waehlhebel_04::C_WH_Fahrstufe 0"); // 测试步骤 Step Set C_Waehlhebel_04::C_WH_Fahrstufe 0//Init
  g_HIL_Bus_Swc_Check("I_LDCU_BodySysSt2::I_LDCU_ReadyEnable 0"); // 预期结果 Step Check I_LDCU_BodySysSt2::I_LDCU_ReadyEnable 0//Disable
  g_HIL_Bus_Swc_Set("VTS::VT2848_4_Ch17::DigitalOutput 0"); // 测试步骤 Step Set J_DI_BrakeSw1_HS NotPressed
  g_HIL_Bus_Swc_Set("VTS::VT2848_4_Ch22::DigitalOutput 0"); // 测试步骤 Step Set J_DI_BrakeSw2_HS NotPressed
  g_HIL_Gen_Swc_Wait("100 ms"); // 测试步骤 Step Wait 100 ms
  g_HIL_Bus_Swc_Set("VTS::VT2848_4_Ch22::DigitalOutput 1"); // 测试步骤 Step Set J_DI_BrakeSw2_HS Pressed
  g_HIL_Bus_Swc_Check("C_LDCU_SysSt::C_LDCU_BrkPedalStVD 1"); // 预期结果 Step Check C_LDCU_SysSt::C_LDCU_BrkPedalStVD 1//valid
  g_HIL_Bus_Swc_Set("VTS::VT2848_4_Ch17::DigitalOutput 1"); // 测试步骤 Step Set J_DI_BrakeSw1_HS Pressed
  g_HIL_Bus_Swc_Check("C_LDCU_SysSt::C_LDCU_BrkPedalSt 1 1 s"); // 预期结果 Step Check C_LDCU_SysSt::C_LDCU_BrkPedalSt 1 1 s//Pressed
  g_HIL_Bus_Swc_Set("C_Waehlhebel_04::C_WH_Fahrstufe 7"); // 测试步骤 Step Set C_Waehlhebel_04::C_WH_Fahrstufe 7//R
  g_HIL_Bus_Swc_Check("I_LDCU_State::I_KeySearchingSt 1 1 s"); // 预期结果 Step Check I_LDCU_State::I_KeySearchingSt 1 1 s//Initial Search
  g_HIL_Bus_Swc_Set("VTS::VT2848_4_Ch17::DigitalOutput 0"); // 测试步骤 Step Set J_DI_BrakeSw1_HS NotPressed
  g_HIL_Bus_Swc_Set("VTS::VT2848_4_Ch22::DigitalOutput 0"); // 测试步骤 Step Set J_DI_BrakeSw2_HS NotPressed
  g_HIL_Bus_Swc_Set("C_Waehlhebel_04::C_WH_Fahrstufe 0"); // 测试步骤 Step Set C_Waehlhebel_04::C_WH_Fahrstufe 0//Init
}

testcase SYS_LDCU_Powermode_0172()
{
  TestDescription("钥匙无效性状态进入钥匙扫描状态-3");
  g_HIL_XCP_Swc_Set_XCP("CalEn_Vcu_MO_Motor_laeuft 1"); // 测试步骤 Step Set_XCP CalEn_Vcu_MO_Motor_laeuft 1
  g_HIL_XCP_Swc_Set_XCP("CalVal_Vcu_MO_Motor_laeuft 0"); // 测试步骤 Step Set_XCP CalVal_Vcu_MO_Motor_laeuft 0
  g_HIL_Bus_Swc_Check("C_Motor_14::C_MO_Motor_laeuft 0"); // 预期结果 Step Check C_Motor_14::C_MO_Motor_laeuft 0//Motor_laeuft_nicht
  g_HIL_Bus_Swc_Set("C_Waehlhebel_04::C_WH_Fahrstufe 4"); // 测试步骤 Step Set C_Waehlhebel_04::C_WH_Fahrstufe 4//nicht_betaetigt
  g_HIL_Bus_Swc_Check("I_LDCU_BodySysSt2::I_LDCU_ReadyEnable 0"); // 预期结果 Step Check I_LDCU_BodySysSt2::I_LDCU_ReadyEnable 0//Disable
  g_HIL_Bus_Swc_Set("VTS::VT2848_4_Ch17::DigitalOutput 0"); // 测试步骤 Step Set J_DI_BrakeSw1_HS NotPressed
  g_HIL_Bus_Swc_Set("VTS::VT2848_4_Ch22::DigitalOutput 0"); // 测试步骤 Step Set J_DI_BrakeSw2_HS NotPressed
  g_HIL_Gen_Swc_Wait("100 ms"); // 测试步骤 Step Wait 100 ms
  g_HIL_Bus_Swc_Set("VTS::VT2848_4_Ch22::DigitalOutput 1"); // 测试步骤 Step Set J_DI_BrakeSw2_HS Pressed
  g_HIL_Bus_Swc_Check("C_LDCU_SysSt::C_LDCU_BrkPedalStVD 1"); // 预期结果 Step Check C_LDCU_SysSt::C_LDCU_BrkPedalStVD 1//valid
  g_HIL_Bus_Swc_Set("VTS::VT2848_4_Ch17::DigitalOutput 1"); // 测试步骤 Step Set J_DI_BrakeSw1_HS Pressed
  g_HIL_Bus_Swc_Check("C_LDCU_SysSt::C_LDCU_BrkPedalSt 1 1 s"); // 预期结果 Step Check C_LDCU_SysSt::C_LDCU_BrkPedalSt 1 1 s//Pressed
  g_HIL_Bus_Swc_Set("C_Waehlhebel_04::C_WH_Fahrstufe 7"); // 测试步骤 Step Set C_Waehlhebel_04::C_WH_Fahrstufe 7//R
  g_HIL_Bus_Swc_Check("I_LDCU_State::I_KeySearchingSt 1 1 s"); // 预期结果 Step Check I_LDCU_State::I_KeySearchingSt 1 1 s//Initial Search
  g_HIL_Bus_Swc_Set("VTS::VT2848_4_Ch17::DigitalOutput 0"); // 测试步骤 Step Set J_DI_BrakeSw1_HS NotPressed
  g_HIL_Bus_Swc_Set("VTS::VT2848_4_Ch22::DigitalOutput 0"); // 测试步骤 Step Set J_DI_BrakeSw2_HS NotPressed
  g_HIL_Bus_Swc_Set("C_Waehlhebel_04::C_WH_Fahrstufe 0"); // 测试步骤 Step Set C_Waehlhebel_04::C_WH_Fahrstufe 0//Init
}

testcase SYS_LDCU_Powermode_0173()
{
  TestDescription("钥匙无效性状态进入钥匙扫描状态-4");
  g_HIL_XCP_Swc_Set_XCP("CalEn_Vcu_MO_Motor_laeuft 1"); // 测试步骤 Step Set_XCP CalEn_Vcu_MO_Motor_laeuft 1
  g_HIL_XCP_Swc_Set_XCP("CalVal_Vcu_MO_Motor_laeuft 0"); // 测试步骤 Step Set_XCP CalVal_Vcu_MO_Motor_laeuft 0
  g_HIL_Bus_Swc_Check("C_Motor_14::C_MO_Motor_laeuft 0"); // 预期结果 Step Check C_Motor_14::C_MO_Motor_laeuft 0//Motor_laeuft_nicht
  g_HIL_Bus_Swc_Set("C_Waehlhebel_04::C_WH_Fahrstufe 5"); // 测试步骤 Step Set C_Waehlhebel_04::C_WH_Fahrstufe 5//D
  g_HIL_Bus_Swc_Check("I_LDCU_BodySysSt2::I_LDCU_ReadyEnable 0"); // 预期结果 Step Check I_LDCU_BodySysSt2::I_LDCU_ReadyEnable 0//Disable
  g_HIL_Bus_Swc_Set("VTS::VT2848_4_Ch17::DigitalOutput 0"); // 测试步骤 Step Set J_DI_BrakeSw1_HS NotPressed
  g_HIL_Bus_Swc_Set("VTS::VT2848_4_Ch22::DigitalOutput 0"); // 测试步骤 Step Set J_DI_BrakeSw2_HS NotPressed
  g_HIL_Gen_Swc_Wait("100 ms"); // 测试步骤 Step Wait 100 ms
  g_HIL_Bus_Swc_Set("VTS::VT2848_4_Ch22::DigitalOutput 1"); // 测试步骤 Step Set J_DI_BrakeSw2_HS Pressed
  g_HIL_Bus_Swc_Check("C_LDCU_SysSt::C_LDCU_BrkPedalStVD 1"); // 预期结果 Step Check C_LDCU_SysSt::C_LDCU_BrkPedalStVD 1//valid
  g_HIL_Bus_Swc_Set("VTS::VT2848_4_Ch17::DigitalOutput 1"); // 测试步骤 Step Set J_DI_BrakeSw1_HS Pressed
  g_HIL_Bus_Swc_Check("C_LDCU_SysSt::C_LDCU_BrkPedalSt 1 1 s"); // 预期结果 Step Check C_LDCU_SysSt::C_LDCU_BrkPedalSt 1 1 s//Pressed
  g_HIL_Bus_Swc_Set("C_Waehlhebel_04::C_WH_Fahrstufe 7"); // 测试步骤 Step Set C_Waehlhebel_04::C_WH_Fahrstufe 7//R
  g_HIL_Bus_Swc_Check("I_LDCU_State::I_KeySearchingSt 1 1 s"); // 预期结果 Step Check I_LDCU_State::I_KeySearchingSt 1 1 s//Initial Search
  g_HIL_Bus_Swc_Set("VTS::VT2848_4_Ch17::DigitalOutput 0"); // 测试步骤 Step Set J_DI_BrakeSw1_HS NotPressed
  g_HIL_Bus_Swc_Set("VTS::VT2848_4_Ch22::DigitalOutput 0"); // 测试步骤 Step Set J_DI_BrakeSw2_HS NotPressed
  g_HIL_Bus_Swc_Set("C_Waehlhebel_04::C_WH_Fahrstufe 0"); // 测试步骤 Step Set C_Waehlhebel_04::C_WH_Fahrstufe 0//Init
}

testcase SYS_LDCU_Powermode_0174()
{
  TestDescription("钥匙无效性状态进入钥匙扫描状态-5");
  g_HIL_XCP_Swc_Set_XCP("CalEn_Vcu_MO_Motor_laeuft 1"); // 测试步骤 Step Set_XCP CalEn_Vcu_MO_Motor_laeuft 1
  g_HIL_XCP_Swc_Set_XCP("CalVal_Vcu_MO_Motor_laeuft 0"); // 测试步骤 Step Set_XCP CalVal_Vcu_MO_Motor_laeuft 0
  g_HIL_Bus_Swc_Check("C_Motor_14::C_MO_Motor_laeuft 0"); // 预期结果 Step Check C_Motor_14::C_MO_Motor_laeuft 0//Motor_laeuft_nicht
  g_HIL_Bus_Swc_Set("C_Waehlhebel_04::C_WH_Fahrstufe 6"); // 测试步骤 Step Set C_Waehlhebel_04::C_WH_Fahrstufe 6//N
  g_HIL_Bus_Swc_Check("I_LDCU_BodySysSt2::I_LDCU_ReadyEnable 0"); // 预期结果 Step Check I_LDCU_BodySysSt2::I_LDCU_ReadyEnable 0//Disable
  g_HIL_Bus_Swc_Set("VTS::VT2848_4_Ch17::DigitalOutput 0"); // 测试步骤 Step Set J_DI_BrakeSw1_HS NotPressed
  g_HIL_Bus_Swc_Set("VTS::VT2848_4_Ch22::DigitalOutput 0"); // 测试步骤 Step Set J_DI_BrakeSw2_HS NotPressed
  g_HIL_Gen_Swc_Wait("100 ms"); // 测试步骤 Step Wait 100 ms
  g_HIL_Bus_Swc_Set("VTS::VT2848_4_Ch22::DigitalOutput 1"); // 测试步骤 Step Set J_DI_BrakeSw2_HS Pressed
  g_HIL_Bus_Swc_Check("C_LDCU_SysSt::C_LDCU_BrkPedalStVD 1"); // 预期结果 Step Check C_LDCU_SysSt::C_LDCU_BrkPedalStVD 1//valid
  g_HIL_Bus_Swc_Set("VTS::VT2848_4_Ch17::DigitalOutput 1"); // 测试步骤 Step Set J_DI_BrakeSw1_HS Pressed
  g_HIL_Bus_Swc_Check("C_LDCU_SysSt::C_LDCU_BrkPedalSt 1 1 s"); // 预期结果 Step Check C_LDCU_SysSt::C_LDCU_BrkPedalSt 1 1 s//Pressed
  g_HIL_Bus_Swc_Set("C_Waehlhebel_04::C_WH_Fahrstufe 7"); // 测试步骤 Step Set C_Waehlhebel_04::C_WH_Fahrstufe 7//R
  g_HIL_Bus_Swc_Check("I_LDCU_State::I_KeySearchingSt 1 1 s"); // 预期结果 Step Check I_LDCU_State::I_KeySearchingSt 1 1 s//Initial Search
  g_HIL_Bus_Swc_Set("VTS::VT2848_4_Ch17::DigitalOutput 0"); // 测试步骤 Step Set J_DI_BrakeSw1_HS NotPressed
  g_HIL_Bus_Swc_Set("VTS::VT2848_4_Ch22::DigitalOutput 0"); // 测试步骤 Step Set J_DI_BrakeSw2_HS NotPressed
  g_HIL_Bus_Swc_Set("C_Waehlhebel_04::C_WH_Fahrstufe 0"); // 测试步骤 Step Set C_Waehlhebel_04::C_WH_Fahrstufe 0//Init
}

testcase SYS_LDCU_Powermode_0175()
{
  TestDescription("钥匙无效性状态进入钥匙扫描状态-6");
  g_HIL_XCP_Swc_Set_XCP("CalEn_Vcu_MO_Motor_laeuft 1"); // 测试步骤 Step Set_XCP CalEn_Vcu_MO_Motor_laeuft 1
  g_HIL_XCP_Swc_Set_XCP("CalVal_Vcu_MO_Motor_laeuft 0"); // 测试步骤 Step Set_XCP CalVal_Vcu_MO_Motor_laeuft 0
  g_HIL_Bus_Swc_Check("C_Motor_14::C_MO_Motor_laeuft 0"); // 预期结果 Step Check C_Motor_14::C_MO_Motor_laeuft 0//Motor_laeuft_nicht
  g_HIL_Bus_Swc_Set("C_Waehlhebel_04::C_WH_Fahrstufe 8"); // 测试步骤 Step Set C_Waehlhebel_04::C_WH_Fahrstufe 8//P
  g_HIL_Bus_Swc_Check("I_LDCU_BodySysSt2::I_LDCU_ReadyEnable 0"); // 预期结果 Step Check I_LDCU_BodySysSt2::I_LDCU_ReadyEnable 0//Disable
  g_HIL_Bus_Swc_Set("VTS::VT2848_4_Ch17::DigitalOutput 0"); // 测试步骤 Step Set J_DI_BrakeSw1_HS NotPressed
  g_HIL_Bus_Swc_Set("VTS::VT2848_4_Ch22::DigitalOutput 0"); // 测试步骤 Step Set J_DI_BrakeSw2_HS NotPressed
  g_HIL_Gen_Swc_Wait("100 ms"); // 测试步骤 Step Wait 100 ms
  g_HIL_Bus_Swc_Set("VTS::VT2848_4_Ch22::DigitalOutput 1"); // 测试步骤 Step Set J_DI_BrakeSw2_HS Pressed
  g_HIL_Bus_Swc_Check("C_LDCU_SysSt::C_LDCU_BrkPedalStVD 1"); // 预期结果 Step Check C_LDCU_SysSt::C_LDCU_BrkPedalStVD 1//valid
  g_HIL_Bus_Swc_Set("VTS::VT2848_4_Ch17::DigitalOutput 1"); // 测试步骤 Step Set J_DI_BrakeSw1_HS Pressed
  g_HIL_Bus_Swc_Check("C_LDCU_SysSt::C_LDCU_BrkPedalSt 1 1 s"); // 预期结果 Step Check C_LDCU_SysSt::C_LDCU_BrkPedalSt 1 1 s//Pressed
  g_HIL_Bus_Swc_Set("C_Waehlhebel_04::C_WH_Fahrstufe 7"); // 测试步骤 Step Set C_Waehlhebel_04::C_WH_Fahrstufe 7//R
  g_HIL_Bus_Swc_Check("I_LDCU_State::I_KeySearchingSt 1 1 s"); // 预期结果 Step Check I_LDCU_State::I_KeySearchingSt 1 1 s//Initial Search
  g_HIL_Bus_Swc_Set("VTS::VT2848_4_Ch17::DigitalOutput 0"); // 测试步骤 Step Set J_DI_BrakeSw1_HS NotPressed
  g_HIL_Bus_Swc_Set("VTS::VT2848_4_Ch22::DigitalOutput 0"); // 测试步骤 Step Set J_DI_BrakeSw2_HS NotPressed
  g_HIL_Bus_Swc_Set("C_Waehlhebel_04::C_WH_Fahrstufe 0"); // 测试步骤 Step Set C_Waehlhebel_04::C_WH_Fahrstufe 0//Init
}

testcase SYS_LDCU_Powermode_0176()
{
  TestDescription("钥匙无效性状态进入钥匙扫描状态-6");
  g_HIL_XCP_Swc_Set_XCP("CalEn_Vcu_MO_Motor_laeuft 1"); // 测试步骤 Step Set_XCP CalEn_Vcu_MO_Motor_laeuft 1
  g_HIL_XCP_Swc_Set_XCP("CalVal_Vcu_MO_Motor_laeuft 0"); // 测试步骤 Step Set_XCP CalVal_Vcu_MO_Motor_laeuft 0
  g_HIL_Bus_Swc_Check("C_Motor_14::C_MO_Motor_laeuft 0"); // 预期结果 Step Check C_Motor_14::C_MO_Motor_laeuft 0//Motor_laeuft_nicht
  g_HIL_Bus_Swc_Set("C_Waehlhebel_04::C_WH_Fahrstufe 9"); // 测试步骤 Step Set C_Waehlhebel_04::C_WH_Fahrstufe 9//N_ohne_Spotausleuchtung
  g_HIL_Bus_Swc_Check("I_LDCU_BodySysSt2::I_LDCU_ReadyEnable 0"); // 预期结果 Step Check I_LDCU_BodySysSt2::I_LDCU_ReadyEnable 0//Disable
  g_HIL_Bus_Swc_Set("VTS::VT2848_4_Ch17::DigitalOutput 0"); // 测试步骤 Step Set J_DI_BrakeSw1_HS NotPressed
  g_HIL_Bus_Swc_Set("VTS::VT2848_4_Ch22::DigitalOutput 0"); // 测试步骤 Step Set J_DI_BrakeSw2_HS NotPressed
  g_HIL_Gen_Swc_Wait("100 ms"); // 测试步骤 Step Wait 100 ms
  g_HIL_Bus_Swc_Set("VTS::VT2848_4_Ch22::DigitalOutput 1"); // 测试步骤 Step Set J_DI_BrakeSw2_HS Pressed
  g_HIL_Bus_Swc_Check("C_LDCU_SysSt::C_LDCU_BrkPedalStVD 1"); // 预期结果 Step Check C_LDCU_SysSt::C_LDCU_BrkPedalStVD 1//valid
  g_HIL_Bus_Swc_Set("VTS::VT2848_4_Ch17::DigitalOutput 1"); // 测试步骤 Step Set J_DI_BrakeSw1_HS Pressed
  g_HIL_Bus_Swc_Check("C_LDCU_SysSt::C_LDCU_BrkPedalSt 1 1 s"); // 预期结果 Step Check C_LDCU_SysSt::C_LDCU_BrkPedalSt 1 1 s//Pressed
  g_HIL_Bus_Swc_Set("C_Waehlhebel_04::C_WH_Fahrstufe 7"); // 测试步骤 Step Set C_Waehlhebel_04::C_WH_Fahrstufe 7//R
  g_HIL_Bus_Swc_Check("I_LDCU_State::I_KeySearchingSt 1 1 s"); // 预期结果 Step Check I_LDCU_State::I_KeySearchingSt 1 1 s//Initial Search
  g_HIL_Bus_Swc_Set("VTS::VT2848_4_Ch17::DigitalOutput 0"); // 测试步骤 Step Set J_DI_BrakeSw1_HS NotPressed
  g_HIL_Bus_Swc_Set("VTS::VT2848_4_Ch22::DigitalOutput 0"); // 测试步骤 Step Set J_DI_BrakeSw2_HS NotPressed
  g_HIL_Bus_Swc_Set("C_Waehlhebel_04::C_WH_Fahrstufe 0"); // 测试步骤 Step Set C_Waehlhebel_04::C_WH_Fahrstufe 0//Init
}

testcase SYS_LDCU_Powermode_0177()
{
  TestDescription("钥匙无效性状态进入钥匙扫描状态-7");
  g_HIL_XCP_Swc_Set_XCP("CalEn_Vcu_MO_Motor_laeuft 1"); // 测试步骤 Step Set_XCP CalEn_Vcu_MO_Motor_laeuft 1
  g_HIL_XCP_Swc_Set_XCP("CalVal_Vcu_MO_Motor_laeuft 0"); // 测试步骤 Step Set_XCP CalVal_Vcu_MO_Motor_laeuft 0
  g_HIL_Bus_Swc_Check("C_Motor_14::C_MO_Motor_laeuft 0"); // 预期结果 Step Check C_Motor_14::C_MO_Motor_laeuft 0//Motor_laeuft_nicht
  g_HIL_Bus_Swc_Set("C_Waehlhebel_04::C_WH_Fahrstufe 0xA"); // 测试步骤 Step Set C_Waehlhebel_04::C_WH_Fahrstufe 0xA//Tipp_Plus
  g_HIL_Bus_Swc_Check("I_LDCU_BodySysSt2::I_LDCU_ReadyEnable 0"); // 预期结果 Step Check I_LDCU_BodySysSt2::I_LDCU_ReadyEnable 0//Disable
  g_HIL_Bus_Swc_Set("VTS::VT2848_4_Ch17::DigitalOutput 0"); // 测试步骤 Step Set J_DI_BrakeSw1_HS NotPressed
  g_HIL_Bus_Swc_Set("VTS::VT2848_4_Ch22::DigitalOutput 0"); // 测试步骤 Step Set J_DI_BrakeSw2_HS NotPressed
  g_HIL_Gen_Swc_Wait("100 ms"); // 测试步骤 Step Wait 100 ms
  g_HIL_Bus_Swc_Set("VTS::VT2848_4_Ch22::DigitalOutput 1"); // 测试步骤 Step Set J_DI_BrakeSw2_HS Pressed
  g_HIL_Bus_Swc_Check("C_LDCU_SysSt::C_LDCU_BrkPedalStVD 1"); // 预期结果 Step Check C_LDCU_SysSt::C_LDCU_BrkPedalStVD 1//valid
  g_HIL_Bus_Swc_Set("VTS::VT2848_4_Ch17::DigitalOutput 1"); // 测试步骤 Step Set J_DI_BrakeSw1_HS Pressed
  g_HIL_Bus_Swc_Check("C_LDCU_SysSt::C_LDCU_BrkPedalSt 1 1 s"); // 预期结果 Step Check C_LDCU_SysSt::C_LDCU_BrkPedalSt 1 1 s//Pressed
  g_HIL_Bus_Swc_Set("C_Waehlhebel_04::C_WH_Fahrstufe 7"); // 测试步骤 Step Set C_Waehlhebel_04::C_WH_Fahrstufe 7//R
  g_HIL_Bus_Swc_Check("I_LDCU_State::I_KeySearchingSt 1 1 s"); // 预期结果 Step Check I_LDCU_State::I_KeySearchingSt 1 1 s//Initial Search
  g_HIL_Bus_Swc_Set("VTS::VT2848_4_Ch17::DigitalOutput 0"); // 测试步骤 Step Set J_DI_BrakeSw1_HS NotPressed
  g_HIL_Bus_Swc_Set("VTS::VT2848_4_Ch22::DigitalOutput 0"); // 测试步骤 Step Set J_DI_BrakeSw2_HS NotPressed
  g_HIL_Bus_Swc_Set("C_Waehlhebel_04::C_WH_Fahrstufe 0"); // 测试步骤 Step Set C_Waehlhebel_04::C_WH_Fahrstufe 0//Init
}

testcase SYS_LDCU_Powermode_0178()
{
  TestDescription("钥匙无效性状态进入钥匙扫描状态-8");
  g_HIL_XCP_Swc_Set_XCP("CalEn_Vcu_MO_Motor_laeuft 1"); // 测试步骤 Step Set_XCP CalEn_Vcu_MO_Motor_laeuft 1
  g_HIL_XCP_Swc_Set_XCP("CalVal_Vcu_MO_Motor_laeuft 0"); // 测试步骤 Step Set_XCP CalVal_Vcu_MO_Motor_laeuft 0
  g_HIL_Bus_Swc_Check("C_Motor_14::C_MO_Motor_laeuft 0"); // 预期结果 Step Check C_Motor_14::C_MO_Motor_laeuft 0//Motor_laeuft_nicht
  g_HIL_Bus_Swc_Set("C_Waehlhebel_04::C_WH_Fahrstufe 0xB"); // 测试步骤 Step Set C_Waehlhebel_04::C_WH_Fahrstufe 0xB//Tipp_Minus
  g_HIL_Bus_Swc_Check("I_LDCU_BodySysSt2::I_LDCU_ReadyEnable 0"); // 预期结果 Step Check I_LDCU_BodySysSt2::I_LDCU_ReadyEnable 0//Disable
  g_HIL_Bus_Swc_Set("VTS::VT2848_4_Ch17::DigitalOutput 0"); // 测试步骤 Step Set J_DI_BrakeSw1_HS NotPressed
  g_HIL_Bus_Swc_Set("VTS::VT2848_4_Ch22::DigitalOutput 0"); // 测试步骤 Step Set J_DI_BrakeSw2_HS NotPressed
  g_HIL_Gen_Swc_Wait("100 ms"); // 测试步骤 Step Wait 100 ms
  g_HIL_Bus_Swc_Set("VTS::VT2848_4_Ch22::DigitalOutput 1"); // 测试步骤 Step Set J_DI_BrakeSw2_HS Pressed
  g_HIL_Bus_Swc_Check("C_LDCU_SysSt::C_LDCU_BrkPedalStVD 1"); // 预期结果 Step Check C_LDCU_SysSt::C_LDCU_BrkPedalStVD 1//valid
  g_HIL_Bus_Swc_Set("VTS::VT2848_4_Ch17::DigitalOutput 1"); // 测试步骤 Step Set J_DI_BrakeSw1_HS Pressed
  g_HIL_Bus_Swc_Check("C_LDCU_SysSt::C_LDCU_BrkPedalSt 1 1 s"); // 预期结果 Step Check C_LDCU_SysSt::C_LDCU_BrkPedalSt 1 1 s//Pressed
  g_HIL_Bus_Swc_Set("C_Waehlhebel_04::C_WH_Fahrstufe 7"); // 测试步骤 Step Set C_Waehlhebel_04::C_WH_Fahrstufe 7//R
  g_HIL_Bus_Swc_Check("I_LDCU_State::I_KeySearchingSt 1 1 s"); // 预期结果 Step Check I_LDCU_State::I_KeySearchingSt 1 1 s//Initial Search
  g_HIL_Bus_Swc_Set("VTS::VT2848_4_Ch17::DigitalOutput 0"); // 测试步骤 Step Set J_DI_BrakeSw1_HS NotPressed
  g_HIL_Bus_Swc_Set("VTS::VT2848_4_Ch22::DigitalOutput 0"); // 测试步骤 Step Set J_DI_BrakeSw2_HS NotPressed
  g_HIL_Bus_Swc_Set("C_Waehlhebel_04::C_WH_Fahrstufe 0"); // 测试步骤 Step Set C_Waehlhebel_04::C_WH_Fahrstufe 0//Init
}

testcase SYS_LDCU_Powermode_0179()
{
  TestDescription("钥匙无效性状态进入钥匙扫描状态-9");
  g_HIL_XCP_Swc_Set_XCP("CalEn_Vcu_MO_Motor_laeuft 1"); // 测试步骤 Step Set_XCP CalEn_Vcu_MO_Motor_laeuft 1
  g_HIL_XCP_Swc_Set_XCP("CalVal_Vcu_MO_Motor_laeuft 0"); // 测试步骤 Step Set_XCP CalVal_Vcu_MO_Motor_laeuft 0
  g_HIL_Bus_Swc_Check("C_Motor_14::C_MO_Motor_laeuft 0"); // 预期结果 Step Check C_Motor_14::C_MO_Motor_laeuft 0//Motor_laeuft_nicht
  g_HIL_Bus_Swc_Set("C_Waehlhebel_04::C_WH_Fahrstufe 0xC"); // 测试步骤 Step Set C_Waehlhebel_04::C_WH_Fahrstufe 0xC//S
  g_HIL_Bus_Swc_Check("I_LDCU_BodySysSt2::I_LDCU_ReadyEnable 0"); // 预期结果 Step Check I_LDCU_BodySysSt2::I_LDCU_ReadyEnable 0//Disable
  g_HIL_Bus_Swc_Set("VTS::VT2848_4_Ch17::DigitalOutput 0"); // 测试步骤 Step Set J_DI_BrakeSw1_HS NotPressed
  g_HIL_Bus_Swc_Set("VTS::VT2848_4_Ch22::DigitalOutput 0"); // 测试步骤 Step Set J_DI_BrakeSw2_HS NotPressed
  g_HIL_Gen_Swc_Wait("100 ms"); // 测试步骤 Step Wait 100 ms
  g_HIL_Bus_Swc_Set("VTS::VT2848_4_Ch22::DigitalOutput 1"); // 测试步骤 Step Set J_DI_BrakeSw2_HS Pressed
  g_HIL_Bus_Swc_Check("C_LDCU_SysSt::C_LDCU_BrkPedalStVD 1"); // 预期结果 Step Check C_LDCU_SysSt::C_LDCU_BrkPedalStVD 1//valid
  g_HIL_Bus_Swc_Set("VTS::VT2848_4_Ch17::DigitalOutput 1"); // 测试步骤 Step Set J_DI_BrakeSw1_HS Pressed
  g_HIL_Bus_Swc_Check("C_LDCU_SysSt::C_LDCU_BrkPedalSt 1 1 s"); // 预期结果 Step Check C_LDCU_SysSt::C_LDCU_BrkPedalSt 1 1 s//Pressed
  g_HIL_Bus_Swc_Set("C_Waehlhebel_04::C_WH_Fahrstufe 7"); // 测试步骤 Step Set C_Waehlhebel_04::C_WH_Fahrstufe 7//R
  g_HIL_Bus_Swc_Check("I_LDCU_State::I_KeySearchingSt 1 1 s"); // 预期结果 Step Check I_LDCU_State::I_KeySearchingSt 1 1 s//Initial Search
  g_HIL_Bus_Swc_Set("VTS::VT2848_4_Ch17::DigitalOutput 0"); // 测试步骤 Step Set J_DI_BrakeSw1_HS NotPressed
  g_HIL_Bus_Swc_Set("VTS::VT2848_4_Ch22::DigitalOutput 0"); // 测试步骤 Step Set J_DI_BrakeSw2_HS NotPressed
  g_HIL_Bus_Swc_Set("C_Waehlhebel_04::C_WH_Fahrstufe 0"); // 测试步骤 Step Set C_Waehlhebel_04::C_WH_Fahrstufe 0//Init
}

testcase SYS_LDCU_Powermode_0180()
{
  TestDescription("钥匙无效性状态进入钥匙扫描状态-10");
  g_HIL_XCP_Swc_Set_XCP("CalEn_Vcu_MO_Motor_laeuft 1"); // 测试步骤 Step Set_XCP CalEn_Vcu_MO_Motor_laeuft 1
  g_HIL_XCP_Swc_Set_XCP("CalVal_Vcu_MO_Motor_laeuft 0"); // 测试步骤 Step Set_XCP CalVal_Vcu_MO_Motor_laeuft 0
  g_HIL_Bus_Swc_Check("C_Motor_14::C_MO_Motor_laeuft 0"); // 预期结果 Step Check C_Motor_14::C_MO_Motor_laeuft 0//Motor_laeuft_nicht
  g_HIL_Bus_Swc_Set("C_Waehlhebel_04::C_WH_Fahrstufe 0xE"); // 测试步骤 Step Set C_Waehlhebel_04::C_WH_Fahrstufe 0xE//Tipp_Gasse
  g_HIL_Bus_Swc_Check("I_LDCU_BodySysSt2::I_LDCU_ReadyEnable 0"); // 预期结果 Step Check I_LDCU_BodySysSt2::I_LDCU_ReadyEnable 0//Disable
  g_HIL_Bus_Swc_Set("VTS::VT2848_4_Ch17::DigitalOutput 0"); // 测试步骤 Step Set J_DI_BrakeSw1_HS NotPressed
  g_HIL_Bus_Swc_Set("VTS::VT2848_4_Ch22::DigitalOutput 0"); // 测试步骤 Step Set J_DI_BrakeSw2_HS NotPressed
  g_HIL_Gen_Swc_Wait("100 ms"); // 测试步骤 Step Wait 100 ms
  g_HIL_Bus_Swc_Set("VTS::VT2848_4_Ch22::DigitalOutput 1"); // 测试步骤 Step Set J_DI_BrakeSw2_HS Pressed
  g_HIL_Bus_Swc_Check("C_LDCU_SysSt::C_LDCU_BrkPedalStVD 1"); // 预期结果 Step Check C_LDCU_SysSt::C_LDCU_BrkPedalStVD 1//valid
  g_HIL_Bus_Swc_Set("VTS::VT2848_4_Ch17::DigitalOutput 1"); // 测试步骤 Step Set J_DI_BrakeSw1_HS Pressed
  g_HIL_Bus_Swc_Check("C_LDCU_SysSt::C_LDCU_BrkPedalSt 1 1 s"); // 预期结果 Step Check C_LDCU_SysSt::C_LDCU_BrkPedalSt 1 1 s//Pressed
  g_HIL_Bus_Swc_Set("C_Waehlhebel_04::C_WH_Fahrstufe 7"); // 测试步骤 Step Set C_Waehlhebel_04::C_WH_Fahrstufe 7//R
  g_HIL_Bus_Swc_Check("I_LDCU_State::I_KeySearchingSt 1 1 s"); // 预期结果 Step Check I_LDCU_State::I_KeySearchingSt 1 1 s//Initial Search
  g_HIL_Bus_Swc_Set("VTS::VT2848_4_Ch17::DigitalOutput 0"); // 测试步骤 Step Set J_DI_BrakeSw1_HS NotPressed
  g_HIL_Bus_Swc_Set("VTS::VT2848_4_Ch22::DigitalOutput 0"); // 测试步骤 Step Set J_DI_BrakeSw2_HS NotPressed
  g_HIL_Bus_Swc_Set("C_Waehlhebel_04::C_WH_Fahrstufe 0"); // 测试步骤 Step Set C_Waehlhebel_04::C_WH_Fahrstufe 0//Init
}

testcase SYS_LDCU_Powermode_0181()
{
  TestDescription("钥匙无效性状态进入钥匙扫描状态-11");
  g_HIL_XCP_Swc_Set_XCP("CalEn_Vcu_MO_Motor_laeuft 1"); // 测试步骤 Step Set_XCP CalEn_Vcu_MO_Motor_laeuft 1
  g_HIL_XCP_Swc_Set_XCP("CalVal_Vcu_MO_Motor_laeuft 0"); // 测试步骤 Step Set_XCP CalVal_Vcu_MO_Motor_laeuft 0
  g_HIL_Bus_Swc_Check("C_Motor_14::C_MO_Motor_laeuft 0"); // 预期结果 Step Check C_Motor_14::C_MO_Motor_laeuft 0//Motor_laeuft_nicht
  g_HIL_Bus_Swc_Set("C_Waehlhebel_04::C_WH_Fahrstufe 0xF"); // 测试步骤 Step Set C_Waehlhebel_04::C_WH_Fahrstufe 0xF//Fehler
  g_HIL_Bus_Swc_Check("I_LDCU_BodySysSt2::I_LDCU_ReadyEnable 0"); // 预期结果 Step Check I_LDCU_BodySysSt2::I_LDCU_ReadyEnable 0//Disable
  g_HIL_Bus_Swc_Set("VTS::VT2848_4_Ch17::DigitalOutput 0"); // 测试步骤 Step Set J_DI_BrakeSw1_HS NotPressed
  g_HIL_Bus_Swc_Set("VTS::VT2848_4_Ch22::DigitalOutput 0"); // 测试步骤 Step Set J_DI_BrakeSw2_HS NotPressed
  g_HIL_Gen_Swc_Wait("100 ms"); // 测试步骤 Step Wait 100 ms
  g_HIL_Bus_Swc_Set("VTS::VT2848_4_Ch22::DigitalOutput 1"); // 测试步骤 Step Set J_DI_BrakeSw2_HS Pressed
  g_HIL_Bus_Swc_Check("C_LDCU_SysSt::C_LDCU_BrkPedalStVD 1"); // 预期结果 Step Check C_LDCU_SysSt::C_LDCU_BrkPedalStVD 1//valid
  g_HIL_Bus_Swc_Set("VTS::VT2848_4_Ch17::DigitalOutput 1"); // 测试步骤 Step Set J_DI_BrakeSw1_HS Pressed
  g_HIL_Bus_Swc_Check("C_LDCU_SysSt::C_LDCU_BrkPedalSt 1 1 s"); // 预期结果 Step Check C_LDCU_SysSt::C_LDCU_BrkPedalSt 1 1 s//Pressed
  g_HIL_Bus_Swc_Set("C_Waehlhebel_04::C_WH_Fahrstufe 7"); // 测试步骤 Step Set C_Waehlhebel_04::C_WH_Fahrstufe 7//R
  g_HIL_Bus_Swc_Check("I_LDCU_State::I_KeySearchingSt 1 1 s"); // 预期结果 Step Check I_LDCU_State::I_KeySearchingSt 1 1 s//Initial Search
  g_HIL_Bus_Swc_Set("VTS::VT2848_4_Ch17::DigitalOutput 0"); // 测试步骤 Step Set J_DI_BrakeSw1_HS NotPressed
  g_HIL_Bus_Swc_Set("VTS::VT2848_4_Ch22::DigitalOutput 0"); // 测试步骤 Step Set J_DI_BrakeSw2_HS NotPressed
  g_HIL_Bus_Swc_Set("C_Waehlhebel_04::C_WH_Fahrstufe 0"); // 测试步骤 Step Set C_Waehlhebel_04::C_WH_Fahrstufe 0//Init
}

testcase SYS_LDCU_Powermode_0182()
{
  TestDescription("钥匙无效性状态进入钥匙扫描状态-12");
  g_HIL_XCP_Swc_Set_XCP("CalEn_Vcu_MO_Motor_laeuft 1"); // 测试步骤 Step Set_XCP CalEn_Vcu_MO_Motor_laeuft 1
  g_HIL_XCP_Swc_Set_XCP("CalVal_Vcu_MO_Motor_laeuft 0"); // 测试步骤 Step Set_XCP CalVal_Vcu_MO_Motor_laeuft 0
  g_HIL_Bus_Swc_Check("C_Motor_14::C_MO_Motor_laeuft 0"); // 预期结果 Step Check C_Motor_14::C_MO_Motor_laeuft 0//Motor_laeuft_nicht
  g_HIL_Bus_Swc_Set("C_Waehlhebel_04::C_WH_Fahrstufe 0"); // 测试步骤 Step Set C_Waehlhebel_04::C_WH_Fahrstufe 0//Init
  g_HIL_Bus_Swc_Check("I_LDCU_BodySysSt2::I_LDCU_ReadyEnable 0"); // 预期结果 Step Check I_LDCU_BodySysSt2::I_LDCU_ReadyEnable 0//Disable
  g_HIL_Bus_Swc_Set("VTS::VT2848_4_Ch17::DigitalOutput 0"); // 测试步骤 Step Set J_DI_BrakeSw1_HS NotPressed
  g_HIL_Bus_Swc_Set("VTS::VT2848_4_Ch22::DigitalOutput 0"); // 测试步骤 Step Set J_DI_BrakeSw2_HS NotPressed
  g_HIL_Gen_Swc_Wait("100 ms"); // 测试步骤 Step Wait 100 ms
  g_HIL_Bus_Swc_Set("VTS::VT2848_4_Ch22::DigitalOutput 1"); // 测试步骤 Step Set J_DI_BrakeSw2_HS Pressed
  g_HIL_Bus_Swc_Check("C_LDCU_SysSt::C_LDCU_BrkPedalStVD 1"); // 预期结果 Step Check C_LDCU_SysSt::C_LDCU_BrkPedalStVD 1//valid
  g_HIL_Bus_Swc_Set("VTS::VT2848_4_Ch17::DigitalOutput 1"); // 测试步骤 Step Set J_DI_BrakeSw1_HS Pressed
  g_HIL_Bus_Swc_Check("C_LDCU_SysSt::C_LDCU_BrkPedalSt 1 1 s"); // 预期结果 Step Check C_LDCU_SysSt::C_LDCU_BrkPedalSt 1 1 s//Pressed
  g_HIL_Bus_Swc_Set("C_Waehlhebel_04::C_WH_Fahrstufe 5"); // 测试步骤 Step Set C_Waehlhebel_04::C_WH_Fahrstufe 5//D
  g_HIL_Bus_Swc_Check("I_LDCU_State::I_KeySearchingSt 1 1 s"); // 预期结果 Step Check I_LDCU_State::I_KeySearchingSt 1 1 s//Initial Search
  g_HIL_Bus_Swc_Set("VTS::VT2848_4_Ch17::DigitalOutput 0"); // 测试步骤 Step Set J_DI_BrakeSw1_HS NotPressed
  g_HIL_Bus_Swc_Set("VTS::VT2848_4_Ch22::DigitalOutput 0"); // 测试步骤 Step Set J_DI_BrakeSw2_HS NotPressed
  g_HIL_Bus_Swc_Set("C_Waehlhebel_04::C_WH_Fahrstufe 0"); // 测试步骤 Step Set C_Waehlhebel_04::C_WH_Fahrstufe 0//Init
}

testcase SYS_LDCU_Powermode_0183()
{
  TestDescription("钥匙无效性状态进入钥匙扫描状态-13");
  g_HIL_XCP_Swc_Set_XCP("CalEn_Vcu_MO_Motor_laeuft 1"); // 测试步骤 Step Set_XCP CalEn_Vcu_MO_Motor_laeuft 1
  g_HIL_XCP_Swc_Set_XCP("CalVal_Vcu_MO_Motor_laeuft 0"); // 测试步骤 Step Set_XCP CalVal_Vcu_MO_Motor_laeuft 0
  g_HIL_Bus_Swc_Check("C_Motor_14::C_MO_Motor_laeuft 0"); // 预期结果 Step Check C_Motor_14::C_MO_Motor_laeuft 0//Motor_laeuft_nicht
  g_HIL_Bus_Swc_Set("C_Waehlhebel_04::C_WH_Fahrstufe 4"); // 测试步骤 Step Set C_Waehlhebel_04::C_WH_Fahrstufe 4//nicht_betaetigt
  g_HIL_Bus_Swc_Check("I_LDCU_BodySysSt2::I_LDCU_ReadyEnable 0"); // 预期结果 Step Check I_LDCU_BodySysSt2::I_LDCU_ReadyEnable 0//Disable
  g_HIL_Bus_Swc_Set("VTS::VT2848_4_Ch17::DigitalOutput 0"); // 测试步骤 Step Set J_DI_BrakeSw1_HS NotPressed
  g_HIL_Bus_Swc_Set("VTS::VT2848_4_Ch22::DigitalOutput 0"); // 测试步骤 Step Set J_DI_BrakeSw2_HS NotPressed
  g_HIL_Gen_Swc_Wait("100 ms"); // 测试步骤 Step Wait 100 ms
  g_HIL_Bus_Swc_Set("VTS::VT2848_4_Ch22::DigitalOutput 1"); // 测试步骤 Step Set J_DI_BrakeSw2_HS Pressed
  g_HIL_Bus_Swc_Check("C_LDCU_SysSt::C_LDCU_BrkPedalStVD 1"); // 预期结果 Step Check C_LDCU_SysSt::C_LDCU_BrkPedalStVD 1//valid
  g_HIL_Bus_Swc_Set("VTS::VT2848_4_Ch17::DigitalOutput 1"); // 测试步骤 Step Set J_DI_BrakeSw1_HS Pressed
  g_HIL_Bus_Swc_Check("C_LDCU_SysSt::C_LDCU_BrkPedalSt 1 1 s"); // 预期结果 Step Check C_LDCU_SysSt::C_LDCU_BrkPedalSt 1 1 s//Pressed
  g_HIL_Bus_Swc_Set("C_Waehlhebel_04::C_WH_Fahrstufe 5"); // 测试步骤 Step Set C_Waehlhebel_04::C_WH_Fahrstufe 5//D
  g_HIL_Bus_Swc_Check("I_LDCU_State::I_KeySearchingSt 1 1 s"); // 预期结果 Step Check I_LDCU_State::I_KeySearchingSt 1 1 s//Initial Search
  g_HIL_Bus_Swc_Set("VTS::VT2848_4_Ch17::DigitalOutput 0"); // 测试步骤 Step Set J_DI_BrakeSw1_HS NotPressed
  g_HIL_Bus_Swc_Set("VTS::VT2848_4_Ch22::DigitalOutput 0"); // 测试步骤 Step Set J_DI_BrakeSw2_HS NotPressed
  g_HIL_Bus_Swc_Set("C_Waehlhebel_04::C_WH_Fahrstufe 0"); // 测试步骤 Step Set C_Waehlhebel_04::C_WH_Fahrstufe 0//Init
}

testcase SYS_LDCU_Powermode_0184()
{
  TestDescription("钥匙无效性状态进入钥匙扫描状态-14");
  g_HIL_XCP_Swc_Set_XCP("CalEn_Vcu_MO_Motor_laeuft 1"); // 测试步骤 Step Set_XCP CalEn_Vcu_MO_Motor_laeuft 1
  g_HIL_XCP_Swc_Set_XCP("CalVal_Vcu_MO_Motor_laeuft 0"); // 测试步骤 Step Set_XCP CalVal_Vcu_MO_Motor_laeuft 0
  g_HIL_Bus_Swc_Check("C_Motor_14::C_MO_Motor_laeuft 0"); // 预期结果 Step Check C_Motor_14::C_MO_Motor_laeuft 0//Motor_laeuft_nicht
  g_HIL_Bus_Swc_Set("C_Waehlhebel_04::C_WH_Fahrstufe 7"); // 测试步骤 Step Set C_Waehlhebel_04::C_WH_Fahrstufe 7//R
  g_HIL_Bus_Swc_Check("I_LDCU_BodySysSt2::I_LDCU_ReadyEnable 0"); // 预期结果 Step Check I_LDCU_BodySysSt2::I_LDCU_ReadyEnable 0//Disable
  g_HIL_Bus_Swc_Set("VTS::VT2848_4_Ch17::DigitalOutput 0"); // 测试步骤 Step Set J_DI_BrakeSw1_HS NotPressed
  g_HIL_Bus_Swc_Set("VTS::VT2848_4_Ch22::DigitalOutput 0"); // 测试步骤 Step Set J_DI_BrakeSw2_HS NotPressed
  g_HIL_Gen_Swc_Wait("100 ms"); // 测试步骤 Step Wait 100 ms
  g_HIL_Bus_Swc_Set("VTS::VT2848_4_Ch22::DigitalOutput 1"); // 测试步骤 Step Set J_DI_BrakeSw2_HS Pressed
  g_HIL_Bus_Swc_Check("C_LDCU_SysSt::C_LDCU_BrkPedalStVD 1"); // 预期结果 Step Check C_LDCU_SysSt::C_LDCU_BrkPedalStVD 1//valid
  g_HIL_Bus_Swc_Set("VTS::VT2848_4_Ch17::DigitalOutput 1"); // 测试步骤 Step Set J_DI_BrakeSw1_HS Pressed
  g_HIL_Bus_Swc_Check("C_LDCU_SysSt::C_LDCU_BrkPedalSt 1 1 s"); // 预期结果 Step Check C_LDCU_SysSt::C_LDCU_BrkPedalSt 1 1 s//Pressed
  g_HIL_Bus_Swc_Set("C_Waehlhebel_04::C_WH_Fahrstufe 5"); // 测试步骤 Step Set C_Waehlhebel_04::C_WH_Fahrstufe 5//D
  g_HIL_Bus_Swc_Check("I_LDCU_State::I_KeySearchingSt 1 1 s"); // 预期结果 Step Check I_LDCU_State::I_KeySearchingSt 1 1 s//Initial Search
  g_HIL_Bus_Swc_Set("VTS::VT2848_4_Ch17::DigitalOutput 0"); // 测试步骤 Step Set J_DI_BrakeSw1_HS NotPressed
  g_HIL_Bus_Swc_Set("VTS::VT2848_4_Ch22::DigitalOutput 0"); // 测试步骤 Step Set J_DI_BrakeSw2_HS NotPressed
  g_HIL_Bus_Swc_Set("C_Waehlhebel_04::C_WH_Fahrstufe 0"); // 测试步骤 Step Set C_Waehlhebel_04::C_WH_Fahrstufe 0//Init
}

testcase SYS_LDCU_Powermode_0185()
{
  TestDescription("钥匙无效性状态进入钥匙扫描状态-15");
  g_HIL_XCP_Swc_Set_XCP("CalEn_Vcu_MO_Motor_laeuft 1"); // 测试步骤 Step Set_XCP CalEn_Vcu_MO_Motor_laeuft 1
  g_HIL_XCP_Swc_Set_XCP("CalVal_Vcu_MO_Motor_laeuft 0"); // 测试步骤 Step Set_XCP CalVal_Vcu_MO_Motor_laeuft 0
  g_HIL_Bus_Swc_Check("C_Motor_14::C_MO_Motor_laeuft 0"); // 预期结果 Step Check C_Motor_14::C_MO_Motor_laeuft 0//Motor_laeuft_nicht
  g_HIL_Bus_Swc_Set("C_Waehlhebel_04::C_WH_Fahrstufe 6"); // 测试步骤 Step Set C_Waehlhebel_04::C_WH_Fahrstufe 6//N
  g_HIL_Bus_Swc_Check("I_LDCU_BodySysSt2::I_LDCU_ReadyEnable 0"); // 预期结果 Step Check I_LDCU_BodySysSt2::I_LDCU_ReadyEnable 0//Disable
  g_HIL_Bus_Swc_Set("VTS::VT2848_4_Ch17::DigitalOutput 0"); // 测试步骤 Step Set J_DI_BrakeSw1_HS NotPressed
  g_HIL_Bus_Swc_Set("VTS::VT2848_4_Ch22::DigitalOutput 0"); // 测试步骤 Step Set J_DI_BrakeSw2_HS NotPressed
  g_HIL_Gen_Swc_Wait("100 ms"); // 测试步骤 Step Wait 100 ms
  g_HIL_Bus_Swc_Set("VTS::VT2848_4_Ch22::DigitalOutput 1"); // 测试步骤 Step Set J_DI_BrakeSw2_HS Pressed
  g_HIL_Bus_Swc_Check("C_LDCU_SysSt::C_LDCU_BrkPedalStVD 1"); // 预期结果 Step Check C_LDCU_SysSt::C_LDCU_BrkPedalStVD 1//valid
  g_HIL_Bus_Swc_Set("VTS::VT2848_4_Ch17::DigitalOutput 1"); // 测试步骤 Step Set J_DI_BrakeSw1_HS Pressed
  g_HIL_Bus_Swc_Check("C_LDCU_SysSt::C_LDCU_BrkPedalSt 1 1 s"); // 预期结果 Step Check C_LDCU_SysSt::C_LDCU_BrkPedalSt 1 1 s//Pressed
  g_HIL_Bus_Swc_Set("C_Waehlhebel_04::C_WH_Fahrstufe 5"); // 测试步骤 Step Set C_Waehlhebel_04::C_WH_Fahrstufe 5//D
  g_HIL_Bus_Swc_Check("I_LDCU_State::I_KeySearchingSt 1 1 s"); // 预期结果 Step Check I_LDCU_State::I_KeySearchingSt 1 1 s//Initial Search
  g_HIL_Bus_Swc_Set("VTS::VT2848_4_Ch17::DigitalOutput 0"); // 测试步骤 Step Set J_DI_BrakeSw1_HS NotPressed
  g_HIL_Bus_Swc_Set("VTS::VT2848_4_Ch22::DigitalOutput 0"); // 测试步骤 Step Set J_DI_BrakeSw2_HS NotPressed
  g_HIL_Bus_Swc_Set("C_Waehlhebel_04::C_WH_Fahrstufe 0"); // 测试步骤 Step Set C_Waehlhebel_04::C_WH_Fahrstufe 0//Init
}

testcase SYS_LDCU_Powermode_0186()
{
  TestDescription("钥匙无效性状态进入钥匙扫描状态-16");
  g_HIL_XCP_Swc_Set_XCP("CalEn_Vcu_MO_Motor_laeuft 1"); // 测试步骤 Step Set_XCP CalEn_Vcu_MO_Motor_laeuft 1
  g_HIL_XCP_Swc_Set_XCP("CalVal_Vcu_MO_Motor_laeuft 0"); // 测试步骤 Step Set_XCP CalVal_Vcu_MO_Motor_laeuft 0
  g_HIL_Bus_Swc_Check("C_Motor_14::C_MO_Motor_laeuft 0"); // 预期结果 Step Check C_Motor_14::C_MO_Motor_laeuft 0//Motor_laeuft_nicht
  g_HIL_Bus_Swc_Set("C_Waehlhebel_04::C_WH_Fahrstufe 8"); // 测试步骤 Step Set C_Waehlhebel_04::C_WH_Fahrstufe 8//P
  g_HIL_Bus_Swc_Check("I_LDCU_BodySysSt2::I_LDCU_ReadyEnable 0"); // 预期结果 Step Check I_LDCU_BodySysSt2::I_LDCU_ReadyEnable 0//Disable
  g_HIL_Bus_Swc_Set("VTS::VT2848_4_Ch17::DigitalOutput 0"); // 测试步骤 Step Set J_DI_BrakeSw1_HS NotPressed
  g_HIL_Bus_Swc_Set("VTS::VT2848_4_Ch22::DigitalOutput 0"); // 测试步骤 Step Set J_DI_BrakeSw2_HS NotPressed
  g_HIL_Gen_Swc_Wait("100 ms"); // 测试步骤 Step Wait 100 ms
  g_HIL_Bus_Swc_Set("VTS::VT2848_4_Ch22::DigitalOutput 1"); // 测试步骤 Step Set J_DI_BrakeSw2_HS Pressed
  g_HIL_Bus_Swc_Check("C_LDCU_SysSt::C_LDCU_BrkPedalStVD 1"); // 预期结果 Step Check C_LDCU_SysSt::C_LDCU_BrkPedalStVD 1//valid
  g_HIL_Bus_Swc_Set("VTS::VT2848_4_Ch17::DigitalOutput 1"); // 测试步骤 Step Set J_DI_BrakeSw1_HS Pressed
  g_HIL_Bus_Swc_Check("C_LDCU_SysSt::C_LDCU_BrkPedalSt 1 1 s"); // 预期结果 Step Check C_LDCU_SysSt::C_LDCU_BrkPedalSt 1 1 s//Pressed
  g_HIL_Bus_Swc_Set("C_Waehlhebel_04::C_WH_Fahrstufe 5"); // 测试步骤 Step Set C_Waehlhebel_04::C_WH_Fahrstufe 5//D
  g_HIL_Bus_Swc_Check("I_LDCU_State::I_KeySearchingSt 1 1 s"); // 预期结果 Step Check I_LDCU_State::I_KeySearchingSt 1 1 s//Initial Search
  g_HIL_Bus_Swc_Set("VTS::VT2848_4_Ch17::DigitalOutput 0"); // 测试步骤 Step Set J_DI_BrakeSw1_HS NotPressed
  g_HIL_Bus_Swc_Set("VTS::VT2848_4_Ch22::DigitalOutput 0"); // 测试步骤 Step Set J_DI_BrakeSw2_HS NotPressed
  g_HIL_Bus_Swc_Set("C_Waehlhebel_04::C_WH_Fahrstufe 0"); // 测试步骤 Step Set C_Waehlhebel_04::C_WH_Fahrstufe 0//Init
}

testcase SYS_LDCU_Powermode_0187()
{
  TestDescription("钥匙无效性状态进入钥匙扫描状态-17");
  g_HIL_XCP_Swc_Set_XCP("CalEn_Vcu_MO_Motor_laeuft 1"); // 测试步骤 Step Set_XCP CalEn_Vcu_MO_Motor_laeuft 1
  g_HIL_XCP_Swc_Set_XCP("CalVal_Vcu_MO_Motor_laeuft 0"); // 测试步骤 Step Set_XCP CalVal_Vcu_MO_Motor_laeuft 0
  g_HIL_Bus_Swc_Check("C_Motor_14::C_MO_Motor_laeuft 0"); // 预期结果 Step Check C_Motor_14::C_MO_Motor_laeuft 0//Motor_laeuft_nicht
  g_HIL_Bus_Swc_Set("C_Waehlhebel_04::C_WH_Fahrstufe 9"); // 测试步骤 Step Set C_Waehlhebel_04::C_WH_Fahrstufe 9//N_ohne_Spotausleuchtung
  g_HIL_Bus_Swc_Check("I_LDCU_BodySysSt2::I_LDCU_ReadyEnable 0"); // 预期结果 Step Check I_LDCU_BodySysSt2::I_LDCU_ReadyEnable 0//Disable
  g_HIL_Bus_Swc_Set("VTS::VT2848_4_Ch17::DigitalOutput 0"); // 测试步骤 Step Set J_DI_BrakeSw1_HS NotPressed
  g_HIL_Bus_Swc_Set("VTS::VT2848_4_Ch22::DigitalOutput 0"); // 测试步骤 Step Set J_DI_BrakeSw2_HS NotPressed
  g_HIL_Gen_Swc_Wait("100 ms"); // 测试步骤 Step Wait 100 ms
  g_HIL_Bus_Swc_Set("VTS::VT2848_4_Ch22::DigitalOutput 1"); // 测试步骤 Step Set J_DI_BrakeSw2_HS Pressed
  g_HIL_Bus_Swc_Check("C_LDCU_SysSt::C_LDCU_BrkPedalStVD 1"); // 预期结果 Step Check C_LDCU_SysSt::C_LDCU_BrkPedalStVD 1//valid
  g_HIL_Bus_Swc_Set("VTS::VT2848_4_Ch17::DigitalOutput 1"); // 测试步骤 Step Set J_DI_BrakeSw1_HS Pressed
  g_HIL_Bus_Swc_Check("C_LDCU_SysSt::C_LDCU_BrkPedalSt 1 1 s"); // 预期结果 Step Check C_LDCU_SysSt::C_LDCU_BrkPedalSt 1 1 s//Pressed
  g_HIL_Bus_Swc_Set("C_Waehlhebel_04::C_WH_Fahrstufe 5"); // 测试步骤 Step Set C_Waehlhebel_04::C_WH_Fahrstufe 5//D
  g_HIL_Bus_Swc_Check("I_LDCU_State::I_KeySearchingSt 1 1 s"); // 预期结果 Step Check I_LDCU_State::I_KeySearchingSt 1 1 s//Initial Search
  g_HIL_Bus_Swc_Set("VTS::VT2848_4_Ch17::DigitalOutput 0"); // 测试步骤 Step Set J_DI_BrakeSw1_HS NotPressed
  g_HIL_Bus_Swc_Set("VTS::VT2848_4_Ch22::DigitalOutput 0"); // 测试步骤 Step Set J_DI_BrakeSw2_HS NotPressed
  g_HIL_Bus_Swc_Set("C_Waehlhebel_04::C_WH_Fahrstufe 0"); // 测试步骤 Step Set C_Waehlhebel_04::C_WH_Fahrstufe 0//Init
}

testcase SYS_LDCU_Powermode_0188()
{
  TestDescription("钥匙无效性状态进入钥匙扫描状态-18");
  g_HIL_XCP_Swc_Set_XCP("CalEn_Vcu_MO_Motor_laeuft 1"); // 测试步骤 Step Set_XCP CalEn_Vcu_MO_Motor_laeuft 1
  g_HIL_XCP_Swc_Set_XCP("CalVal_Vcu_MO_Motor_laeuft 0"); // 测试步骤 Step Set_XCP CalVal_Vcu_MO_Motor_laeuft 0
  g_HIL_Bus_Swc_Check("C_Motor_14::C_MO_Motor_laeuft 0"); // 预期结果 Step Check C_Motor_14::C_MO_Motor_laeuft 0//Motor_laeuft_nicht
  g_HIL_Bus_Swc_Set("C_Waehlhebel_04::C_WH_Fahrstufe 0xA"); // 测试步骤 Step Set C_Waehlhebel_04::C_WH_Fahrstufe 0xA//Tipp_Plus
  g_HIL_Bus_Swc_Check("I_LDCU_BodySysSt2::I_LDCU_ReadyEnable 0"); // 预期结果 Step Check I_LDCU_BodySysSt2::I_LDCU_ReadyEnable 0//Disable
  g_HIL_Bus_Swc_Set("VTS::VT2848_4_Ch17::DigitalOutput 0"); // 测试步骤 Step Set J_DI_BrakeSw1_HS NotPressed
  g_HIL_Bus_Swc_Set("VTS::VT2848_4_Ch22::DigitalOutput 0"); // 测试步骤 Step Set J_DI_BrakeSw2_HS NotPressed
  g_HIL_Gen_Swc_Wait("100 ms"); // 测试步骤 Step Wait 100 ms
  g_HIL_Bus_Swc_Set("VTS::VT2848_4_Ch22::DigitalOutput 1"); // 测试步骤 Step Set J_DI_BrakeSw2_HS Pressed
  g_HIL_Bus_Swc_Check("C_LDCU_SysSt::C_LDCU_BrkPedalStVD 1"); // 预期结果 Step Check C_LDCU_SysSt::C_LDCU_BrkPedalStVD 1//valid
  g_HIL_Bus_Swc_Set("VTS::VT2848_4_Ch17::DigitalOutput 1"); // 测试步骤 Step Set J_DI_BrakeSw1_HS Pressed
  g_HIL_Bus_Swc_Check("C_LDCU_SysSt::C_LDCU_BrkPedalSt 1 1 s"); // 预期结果 Step Check C_LDCU_SysSt::C_LDCU_BrkPedalSt 1 1 s//Pressed
  g_HIL_Bus_Swc_Set("C_Waehlhebel_04::C_WH_Fahrstufe 5"); // 测试步骤 Step Set C_Waehlhebel_04::C_WH_Fahrstufe 5//D
  g_HIL_Bus_Swc_Check("I_LDCU_State::I_KeySearchingSt 1 1 s"); // 预期结果 Step Check I_LDCU_State::I_KeySearchingSt 1 1 s//Initial Search
  g_HIL_Bus_Swc_Set("VTS::VT2848_4_Ch17::DigitalOutput 0"); // 测试步骤 Step Set J_DI_BrakeSw1_HS NotPressed
  g_HIL_Bus_Swc_Set("VTS::VT2848_4_Ch22::DigitalOutput 0"); // 测试步骤 Step Set J_DI_BrakeSw2_HS NotPressed
  g_HIL_Bus_Swc_Set("C_Waehlhebel_04::C_WH_Fahrstufe 0"); // 测试步骤 Step Set C_Waehlhebel_04::C_WH_Fahrstufe 0//Init
}

testcase SYS_LDCU_Powermode_0189()
{
  TestDescription("钥匙无效性状态进入钥匙扫描状态-19");
  g_HIL_XCP_Swc_Set_XCP("CalEn_Vcu_MO_Motor_laeuft 1"); // 测试步骤 Step Set_XCP CalEn_Vcu_MO_Motor_laeuft 1
  g_HIL_XCP_Swc_Set_XCP("CalVal_Vcu_MO_Motor_laeuft 0"); // 测试步骤 Step Set_XCP CalVal_Vcu_MO_Motor_laeuft 0
  g_HIL_Bus_Swc_Check("C_Motor_14::C_MO_Motor_laeuft 0"); // 预期结果 Step Check C_Motor_14::C_MO_Motor_laeuft 0//Motor_laeuft_nicht
  g_HIL_Bus_Swc_Set("C_Waehlhebel_04::C_WH_Fahrstufe 0xB"); // 测试步骤 Step Set C_Waehlhebel_04::C_WH_Fahrstufe 0xB//Tipp_Minus
  g_HIL_Bus_Swc_Check("I_LDCU_BodySysSt2::I_LDCU_ReadyEnable 0"); // 预期结果 Step Check I_LDCU_BodySysSt2::I_LDCU_ReadyEnable 0//Disable
  g_HIL_Bus_Swc_Set("VTS::VT2848_4_Ch17::DigitalOutput 0"); // 测试步骤 Step Set J_DI_BrakeSw1_HS NotPressed
  g_HIL_Bus_Swc_Set("VTS::VT2848_4_Ch22::DigitalOutput 0"); // 测试步骤 Step Set J_DI_BrakeSw2_HS NotPressed
  g_HIL_Gen_Swc_Wait("100 ms"); // 测试步骤 Step Wait 100 ms
  g_HIL_Bus_Swc_Set("VTS::VT2848_4_Ch22::DigitalOutput 1"); // 测试步骤 Step Set J_DI_BrakeSw2_HS Pressed
  g_HIL_Bus_Swc_Check("C_LDCU_SysSt::C_LDCU_BrkPedalStVD 1"); // 预期结果 Step Check C_LDCU_SysSt::C_LDCU_BrkPedalStVD 1//valid
  g_HIL_Bus_Swc_Set("VTS::VT2848_4_Ch17::DigitalOutput 1"); // 测试步骤 Step Set J_DI_BrakeSw1_HS Pressed
  g_HIL_Bus_Swc_Check("C_LDCU_SysSt::C_LDCU_BrkPedalSt 1 1 s"); // 预期结果 Step Check C_LDCU_SysSt::C_LDCU_BrkPedalSt 1 1 s//Pressed
  g_HIL_Bus_Swc_Set("C_Waehlhebel_04::C_WH_Fahrstufe 5"); // 测试步骤 Step Set C_Waehlhebel_04::C_WH_Fahrstufe 5//D
  g_HIL_Bus_Swc_Check("I_LDCU_State::I_KeySearchingSt 1 1 s"); // 预期结果 Step Check I_LDCU_State::I_KeySearchingSt 1 1 s//Initial Search
  g_HIL_Bus_Swc_Set("VTS::VT2848_4_Ch17::DigitalOutput 0"); // 测试步骤 Step Set J_DI_BrakeSw1_HS NotPressed
  g_HIL_Bus_Swc_Set("VTS::VT2848_4_Ch22::DigitalOutput 0"); // 测试步骤 Step Set J_DI_BrakeSw2_HS NotPressed
  g_HIL_Bus_Swc_Set("C_Waehlhebel_04::C_WH_Fahrstufe 0"); // 测试步骤 Step Set C_Waehlhebel_04::C_WH_Fahrstufe 0//Init
}

testcase SYS_LDCU_Powermode_0190()
{
  TestDescription("钥匙无效性状态进入钥匙扫描状态-20");
  g_HIL_XCP_Swc_Set_XCP("CalEn_Vcu_MO_Motor_laeuft 1"); // 测试步骤 Step Set_XCP CalEn_Vcu_MO_Motor_laeuft 1
  g_HIL_XCP_Swc_Set_XCP("CalVal_Vcu_MO_Motor_laeuft 0"); // 测试步骤 Step Set_XCP CalVal_Vcu_MO_Motor_laeuft 0
  g_HIL_Bus_Swc_Check("C_Motor_14::C_MO_Motor_laeuft 0"); // 预期结果 Step Check C_Motor_14::C_MO_Motor_laeuft 0//Motor_laeuft_nicht
  g_HIL_Bus_Swc_Set("C_Waehlhebel_04::C_WH_Fahrstufe 0xC"); // 测试步骤 Step Set C_Waehlhebel_04::C_WH_Fahrstufe 0xC//S
  g_HIL_Bus_Swc_Check("I_LDCU_BodySysSt2::I_LDCU_ReadyEnable 0"); // 预期结果 Step Check I_LDCU_BodySysSt2::I_LDCU_ReadyEnable 0//Disable
  g_HIL_Bus_Swc_Set("VTS::VT2848_4_Ch17::DigitalOutput 0"); // 测试步骤 Step Set J_DI_BrakeSw1_HS NotPressed
  g_HIL_Bus_Swc_Set("VTS::VT2848_4_Ch22::DigitalOutput 0"); // 测试步骤 Step Set J_DI_BrakeSw2_HS NotPressed
  g_HIL_Gen_Swc_Wait("100 ms"); // 测试步骤 Step Wait 100 ms
  g_HIL_Bus_Swc_Set("VTS::VT2848_4_Ch22::DigitalOutput 1"); // 测试步骤 Step Set J_DI_BrakeSw2_HS Pressed
  g_HIL_Bus_Swc_Check("C_LDCU_SysSt::C_LDCU_BrkPedalStVD 1"); // 预期结果 Step Check C_LDCU_SysSt::C_LDCU_BrkPedalStVD 1//valid
  g_HIL_Bus_Swc_Set("VTS::VT2848_4_Ch17::DigitalOutput 1"); // 测试步骤 Step Set J_DI_BrakeSw1_HS Pressed
  g_HIL_Bus_Swc_Check("C_LDCU_SysSt::C_LDCU_BrkPedalSt 1 1 s"); // 预期结果 Step Check C_LDCU_SysSt::C_LDCU_BrkPedalSt 1 1 s//Pressed
  g_HIL_Bus_Swc_Set("C_Waehlhebel_04::C_WH_Fahrstufe 5"); // 测试步骤 Step Set C_Waehlhebel_04::C_WH_Fahrstufe 5//D
  g_HIL_Bus_Swc_Check("I_LDCU_State::I_KeySearchingSt 1 1 s"); // 预期结果 Step Check I_LDCU_State::I_KeySearchingSt 1 1 s//Initial Search
  g_HIL_Bus_Swc_Set("VTS::VT2848_4_Ch17::DigitalOutput 0"); // 测试步骤 Step Set J_DI_BrakeSw1_HS NotPressed
  g_HIL_Bus_Swc_Set("VTS::VT2848_4_Ch22::DigitalOutput 0"); // 测试步骤 Step Set J_DI_BrakeSw2_HS NotPressed
  g_HIL_Bus_Swc_Set("C_Waehlhebel_04::C_WH_Fahrstufe 0"); // 测试步骤 Step Set C_Waehlhebel_04::C_WH_Fahrstufe 0//Init
}

testcase SYS_LDCU_Powermode_0191()
{
  TestDescription("钥匙无效性状态进入钥匙扫描状态-21");
  g_HIL_XCP_Swc_Set_XCP("CalEn_Vcu_MO_Motor_laeuft 1"); // 测试步骤 Step Set_XCP CalEn_Vcu_MO_Motor_laeuft 1
  g_HIL_XCP_Swc_Set_XCP("CalVal_Vcu_MO_Motor_laeuft 0"); // 测试步骤 Step Set_XCP CalVal_Vcu_MO_Motor_laeuft 0
  g_HIL_Bus_Swc_Check("C_Motor_14::C_MO_Motor_laeuft 0"); // 预期结果 Step Check C_Motor_14::C_MO_Motor_laeuft 0//Motor_laeuft_nicht
  g_HIL_Bus_Swc_Set("C_Waehlhebel_04::C_WH_Fahrstufe 0xE"); // 测试步骤 Step Set C_Waehlhebel_04::C_WH_Fahrstufe 0xE//Tipp_Gasse
  g_HIL_Bus_Swc_Check("I_LDCU_BodySysSt2::I_LDCU_ReadyEnable 0"); // 预期结果 Step Check I_LDCU_BodySysSt2::I_LDCU_ReadyEnable 0//Disable
  g_HIL_Bus_Swc_Set("VTS::VT2848_4_Ch17::DigitalOutput 0"); // 测试步骤 Step Set J_DI_BrakeSw1_HS NotPressed
  g_HIL_Bus_Swc_Set("VTS::VT2848_4_Ch22::DigitalOutput 0"); // 测试步骤 Step Set J_DI_BrakeSw2_HS NotPressed
  g_HIL_Gen_Swc_Wait("100 ms"); // 测试步骤 Step Wait 100 ms
  g_HIL_Bus_Swc_Set("VTS::VT2848_4_Ch22::DigitalOutput 1"); // 测试步骤 Step Set J_DI_BrakeSw2_HS Pressed
  g_HIL_Bus_Swc_Check("C_LDCU_SysSt::C_LDCU_BrkPedalStVD 1"); // 预期结果 Step Check C_LDCU_SysSt::C_LDCU_BrkPedalStVD 1//valid
  g_HIL_Bus_Swc_Set("VTS::VT2848_4_Ch17::DigitalOutput 1"); // 测试步骤 Step Set J_DI_BrakeSw1_HS Pressed
  g_HIL_Bus_Swc_Check("C_LDCU_SysSt::C_LDCU_BrkPedalSt 1 1 s"); // 预期结果 Step Check C_LDCU_SysSt::C_LDCU_BrkPedalSt 1 1 s//Pressed
  g_HIL_Bus_Swc_Set("C_Waehlhebel_04::C_WH_Fahrstufe 5"); // 测试步骤 Step Set C_Waehlhebel_04::C_WH_Fahrstufe 5//D
  g_HIL_Bus_Swc_Check("I_LDCU_State::I_KeySearchingSt 1 1 s"); // 预期结果 Step Check I_LDCU_State::I_KeySearchingSt 1 1 s//Initial Search
  g_HIL_Bus_Swc_Set("VTS::VT2848_4_Ch17::DigitalOutput 0"); // 测试步骤 Step Set J_DI_BrakeSw1_HS NotPressed
  g_HIL_Bus_Swc_Set("VTS::VT2848_4_Ch22::DigitalOutput 0"); // 测试步骤 Step Set J_DI_BrakeSw2_HS NotPressed
  g_HIL_Bus_Swc_Set("C_Waehlhebel_04::C_WH_Fahrstufe 0"); // 测试步骤 Step Set C_Waehlhebel_04::C_WH_Fahrstufe 0//Init
}

testcase SYS_LDCU_Powermode_0192()
{
  TestDescription("钥匙无效性状态进入钥匙扫描状态-22");
  g_HIL_XCP_Swc_Set_XCP("CalEn_Vcu_MO_Motor_laeuft 1"); // 测试步骤 Step Set_XCP CalEn_Vcu_MO_Motor_laeuft 1
  g_HIL_XCP_Swc_Set_XCP("CalVal_Vcu_MO_Motor_laeuft 0"); // 测试步骤 Step Set_XCP CalVal_Vcu_MO_Motor_laeuft 0
  g_HIL_Bus_Swc_Check("C_Motor_14::C_MO_Motor_laeuft 0"); // 预期结果 Step Check C_Motor_14::C_MO_Motor_laeuft 0//Motor_laeuft_nicht
  g_HIL_Bus_Swc_Set("C_Waehlhebel_04::C_WH_Fahrstufe 0xF"); // 测试步骤 Step Set C_Waehlhebel_04::C_WH_Fahrstufe 0xF//Fehler
  g_HIL_Bus_Swc_Check("I_LDCU_BodySysSt2::I_LDCU_ReadyEnable 0"); // 预期结果 Step Check I_LDCU_BodySysSt2::I_LDCU_ReadyEnable 0//Disable
  g_HIL_Bus_Swc_Set("VTS::VT2848_4_Ch17::DigitalOutput 0"); // 测试步骤 Step Set J_DI_BrakeSw1_HS NotPressed
  g_HIL_Bus_Swc_Set("VTS::VT2848_4_Ch22::DigitalOutput 0"); // 测试步骤 Step Set J_DI_BrakeSw2_HS NotPressed
  g_HIL_Gen_Swc_Wait("100 ms"); // 测试步骤 Step Wait 100 ms
  g_HIL_Bus_Swc_Set("VTS::VT2848_4_Ch22::DigitalOutput 1"); // 测试步骤 Step Set J_DI_BrakeSw2_HS Pressed
  g_HIL_Bus_Swc_Check("C_LDCU_SysSt::C_LDCU_BrkPedalStVD 1"); // 预期结果 Step Check C_LDCU_SysSt::C_LDCU_BrkPedalStVD 1//valid
  g_HIL_Bus_Swc_Set("VTS::VT2848_4_Ch17::DigitalOutput 1"); // 测试步骤 Step Set J_DI_BrakeSw1_HS Pressed
  g_HIL_Bus_Swc_Check("C_LDCU_SysSt::C_LDCU_BrkPedalSt 1 1 s"); // 预期结果 Step Check C_LDCU_SysSt::C_LDCU_BrkPedalSt 1 1 s//Pressed
  g_HIL_Bus_Swc_Set("C_Waehlhebel_04::C_WH_Fahrstufe 5"); // 测试步骤 Step Set C_Waehlhebel_04::C_WH_Fahrstufe 5//D
  g_HIL_Bus_Swc_Check("I_LDCU_State::I_KeySearchingSt 1 1 s"); // 预期结果 Step Check I_LDCU_State::I_KeySearchingSt 1 1 s//Initial Search
  g_HIL_Bus_Swc_Set("VTS::VT2848_4_Ch17::DigitalOutput 0"); // 测试步骤 Step Set J_DI_BrakeSw1_HS NotPressed
  g_HIL_Bus_Swc_Set("VTS::VT2848_4_Ch22::DigitalOutput 0"); // 测试步骤 Step Set J_DI_BrakeSw2_HS NotPressed
  g_HIL_Bus_Swc_Set("C_Waehlhebel_04::C_WH_Fahrstufe 0"); // 测试步骤 Step Set C_Waehlhebel_04::C_WH_Fahrstufe 0//Init
}

testcase SYS_LDCU_Powermode_0193()
{
  TestDescription("钥匙无效性状态进入钥匙扫描状态-23");
  g_HIL_XCP_Swc_Set_XCP("CalEn_Vcu_MO_Motor_laeuft 1"); // 测试步骤 Step Set_XCP CalEn_Vcu_MO_Motor_laeuft 1
  g_HIL_XCP_Swc_Set_XCP("CalVal_Vcu_MO_Motor_laeuft 0"); // 测试步骤 Step Set_XCP CalVal_Vcu_MO_Motor_laeuft 0
  g_HIL_Bus_Swc_Check("C_Motor_14::C_MO_Motor_laeuft 0"); // 预期结果 Step Check C_Motor_14::C_MO_Motor_laeuft 0//Motor_laeuft_nicht
  g_HIL_Bus_Swc_Set("VTS::VT2848_4_Ch27::DigitalOutput 0"); // 测试步骤 Step Set J_DI_SSBPin4SW_LS NotPressed
  g_HIL_Bus_Swc_Set("VTS::VT2848_4_Ch32::DigitalOutput 0"); // 测试步骤 Step Set J_DI_SSBPin6SW_LS NotPressed
  g_HIL_Gen_Swc_Wait("100 ms"); // 测试步骤 Step Wait 100 ms
  g_HIL_Bus_Swc_Set("VTS::VT2848_4_Ch27::DigitalOutput 1"); // 测试步骤 Step Set J_DI_SSBPin4SW_LS Pressed
  g_HIL_Bus_Swc_Set("VTS::VT2848_4_Ch32::DigitalOutput 1"); // 测试步骤 Step Set J_DI_SSBPin6SW_LS Pressed
  g_HIL_Bus_Swc_Check("I_LDCU_BodySysSt2::I_LDCU_ZATButtonSwSt 1 1 s"); // 预期结果 Step Check I_LDCU_BodySysSt2::I_LDCU_ZATButtonSwSt 1 1 s//pressed
  g_HIL_Bus_Swc_Check("I_LDCU_State::I_KeySearchingSt 1 1 s"); // 预期结果 Step Check I_LDCU_State::I_KeySearchingSt 1 1 s//Initial Search
  g_HIL_Bus_Swc_Set("VTS::VT2848_4_Ch27::DigitalOutput 0"); // 测试步骤 Step Set J_DI_SSBPin4SW_LS NotPressed
  g_HIL_Bus_Swc_Set("VTS::VT2848_4_Ch32::DigitalOutput 0"); // 测试步骤 Step Set J_DI_SSBPin6SW_LS NotPressed
  g_HIL_Bus_Swc_Check("I_LDCU_BodySysSt2::I_LDCU_ZATButtonSwSt 0 1 s"); // 预期结果 Step Check I_LDCU_BodySysSt2::I_LDCU_ZATButtonSwSt 0 1 s//notpressed
}

testcase SYS_LDCU_Powermode_0194()
{
  TestDescription("钥匙有效性记时状态进入在扫描状态");
  g_HIL_XCP_Swc_Set_XCP("CalEn_Vcu_MO_Motor_laeuft 1"); // 测试步骤 Step Set_XCP CalEn_Vcu_MO_Motor_laeuft 1
  g_HIL_XCP_Swc_Set_XCP("CalVal_Vcu_MO_Motor_laeuft 0"); // 测试步骤 Step Set_XCP CalVal_Vcu_MO_Motor_laeuft 0
  g_HIL_Bus_Swc_Check("C_Motor_14::C_MO_Motor_laeuft 0"); // 预期结果 Step Check C_Motor_14::C_MO_Motor_laeuft 0//Motor_laeuft_nicht
  g_HIL_XCP_Swc_Set_XCP("CalC_tPwMdKeyValidHold 2"); // 测试步骤 Step Set_XCP CalC_tPwMdKeyValidHold 2
  g_HIL_Bus_Swc_Set("VTS::VT2848_4_Ch17::DigitalOutput 0"); // 测试步骤 Step Set J_DI_BrakeSw1_HS NotPressed
  g_HIL_Bus_Swc_Set("VTS::VT2848_4_Ch22::DigitalOutput 0"); // 测试步骤 Step Set J_DI_BrakeSw2_HS NotPressed
  g_HIL_Gen_Swc_Wait("100 ms"); // 测试步骤 Step Wait 100 ms
  g_HIL_Bus_Swc_Set("VTS::VT2848_4_Ch22::DigitalOutput 1"); // 测试步骤 Step Set J_DI_BrakeSw2_HS Pressed
  g_HIL_Bus_Swc_Check("C_LDCU_SysSt::C_LDCU_BrkPedalStVD 1"); // 预期结果 Step Check C_LDCU_SysSt::C_LDCU_BrkPedalStVD 1//valid
  g_HIL_Bus_Swc_Set("VTS::VT2848_4_Ch17::DigitalOutput 1"); // 测试步骤 Step Set J_DI_BrakeSw1_HS Pressed
  g_HIL_Bus_Swc_Check("C_LDCU_SysSt::C_LDCU_BrkPedalSt 1 1 s"); // 预期结果 Step Check C_LDCU_SysSt::C_LDCU_BrkPedalSt 1 1 s//Pressed
  g_HIL_XCP_Swc_Set_XCP("CalC_tPwMdKeyValidHold 0"); // 测试步骤 Step Set_XCP CalC_tPwMdKeyValidHold 0
  g_HIL_Bus_Swc_Check("I_LDCU_State::I_KeySearchingSt 2 1 s"); // 预期结果 Step Check I_LDCU_State::I_KeySearchingSt 2 1 s//Timeout Research
  g_HIL_Bus_Swc_Set("VTS::VT2848_4_Ch17::DigitalOutput 0"); // 测试步骤 Step Set J_DI_BrakeSw1_HS NotPressed
  g_HIL_Bus_Swc_Set("VTS::VT2848_4_Ch22::DigitalOutput 0"); // 测试步骤 Step Set J_DI_BrakeSw2_HS NotPressed
}

testcase SYS_LDCU_Powermode_0207()
{
  TestDescription("射频钥匙搜索请求标志");
  g_HIL_XCP_Swc_Set_XCP("CalEn_Vcu_MO_Motor_laeuft 1"); // 测试步骤 Step Set_XCP CalEn_Vcu_MO_Motor_laeuft 1
  g_HIL_XCP_Swc_Set_XCP("CalVal_Vcu_MO_Motor_laeuft 0"); // 测试步骤 Step Set_XCP CalVal_Vcu_MO_Motor_laeuft 0
  g_HIL_Bus_Swc_Check("C_Motor_14::C_MO_Motor_laeuft 0"); // 预期结果 Step Check C_Motor_14::C_MO_Motor_laeuft 0//Motor_laeuft_nicht
  g_HIL_Bus_Swc_Set("VTS::VT2848_4_Ch17::DigitalOutput 0"); // 测试步骤 Step Set J_DI_BrakeSw1_HS NotPressed
  g_HIL_Bus_Swc_Set("VTS::VT2848_4_Ch22::DigitalOutput 0"); // 测试步骤 Step Set J_DI_BrakeSw2_HS NotPressed
  g_HIL_Gen_Swc_Wait("100 ms"); // 测试步骤 Step Wait 100 ms
  g_HIL_Bus_Swc_Check("I_LDCU_State::I_KeySearchingSt 0 1 s"); // 预期结果 Step Check I_LDCU_State::I_KeySearchingSt 0 1 s//Not Searching
  g_HIL_Bus_Swc_Set("VTS::VT2848_4_Ch22::DigitalOutput 1"); // 测试步骤 Step Set J_DI_BrakeSw2_HS Pressed
  g_HIL_Bus_Swc_Check("C_LDCU_SysSt::C_LDCU_BrkPedalStVD 1"); // 预期结果 Step Check C_LDCU_SysSt::C_LDCU_BrkPedalStVD 1//valid
  g_HIL_Bus_Swc_Set("VTS::VT2848_4_Ch17::DigitalOutput 1"); // 测试步骤 Step Set J_DI_BrakeSw1_HS Pressed
  g_HIL_Bus_Swc_Check("C_LDCU_SysSt::C_LDCU_BrkPedalSt 1 1 s"); // 预期结果 Step Check C_LDCU_SysSt::C_LDCU_BrkPedalSt 1 1 s//Pressed
  g_HIL_Bus_Swc_Check("I_LDCU_BodySysSt2::I_LDCU_BLEKeySeachReq 2"); // 预期结果 Step Check I_LDCU_BodySysSt2::I_LDCU_BLEKeySeachReq 2//Active;
  g_HIL_Bus_Swc_Set("BL_TBOX_DigitalKeyInfo::BL_IncarNFCPSAuthority 1"); // 测试步骤 Step Set BL_TBOX_DigitalKeyInfo::BL_IncarNFCPSAuthority 1//Disable
  g_HIL_Bus_Swc_Check("I_LDCU_State::I_KeySearchingSt 1"); // 预期结果 Step Check I_LDCU_State::I_KeySearchingSt 1//Initial Search
  g_HIL_Bus_Swc_Set("BL_TBOX_DigitalKeyInfo::BL_IncarNFCSt 0"); // 测试步骤 Step Set BL_TBOX_DigitalKeyInfo::BL_IncarNFCSt 0
  g_HIL_Bus_Swc_Check("I_LDCU_State::I_KeyScanReq 1"); // 预期结果 Step Check I_LDCU_State::I_KeyScanReq 1
  g_HIL_Gen_Swc_Wait("301 ms"); // 测试步骤 Step Wait 301 ms
  g_HIL_Bus_Swc_Check("I_LDCU_State::I_KeyScanReq 0"); // 预期结果 Step Check I_LDCU_State::I_KeyScanReq 0
  g_HIL_Bus_Swc_Set("VTS::VT2848_4_Ch17::DigitalOutput 0"); // 测试步骤 Step Set J_DI_BrakeSw1_HS NotPressed
  g_HIL_Bus_Swc_Set("VTS::VT2848_4_Ch22::DigitalOutput 0"); // 测试步骤 Step Set J_DI_BrakeSw2_HS NotPressed
}
