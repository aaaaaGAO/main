/*@!Encoding: 936*/

includes
{
}

variables
{
}

testcase SYS_CDCU_zhujiazuoyianmo_0001()
{
  TestDescription("初始化");
  teststep("warning","原始用例id为SYS-CDCU-主驾座椅按摩-0001");
  g_EM_Equipment_Swc_TC_PW("OFF"); // 测试步骤 TC_PW OFF
  g_CAN_Bus_Swc_AllCANDataDefaultAllCh(); // 测试步骤 TC_CANTest SET AllCANDataDefaultAllCh
  g_EM_Equipment_Swc_TC_IG("OFF"); // 测试步骤 TC_IG OFF
  g_EM_Equipment_Swc_TC_4G_Time_Delay_Second("1"); // 测试步骤 TC_Sleep 1
  g_EM_Equipment_Swc_TC_PW("ON"); // 测试步骤 TC_PW ON
  g_EM_Equipment_Swc_TC_IG("ON"); // 测试步骤 TC_IG ON
  g_CAN_Bus_Swc_Set("C_LDCU_SysSt.C_LDCU_EVSysReadySt 0"); // 测试步骤 TC_CANTest SET C_LDCU_SysSt.C_LDCU_EVSysReadySt 0
  g_EM_Equipment_Swc_TC_4G_Time_Delay_Second("2"); // 测试步骤 TC_Sleep 2
  gTC_CANTest_SOA_Set8001Delay("0"); // 测试步骤 TC_CANTest SOA Set8001Delay 0
  g_EM_SOAClient_Swc_SOA_SubPeriod("Veh_SeatCtrlService_ErrGrp 1"); // 测试步骤 TC_CANTest SOA SubPeriod Veh_SeatCtrlService_ErrGrp 1
  g_EM_SOAClient_Swc_SOA_SubPeriod("Veh_SeatSystemSt 1"); // 测试步骤 TC_CANTest SOA SubPeriod Veh_SeatSystemSt 1
  g_EM_SOAClient_Swc_SOA_SubPeriod("SOAEngineInterState 1"); // 测试步骤 TC_CANTest SOA SubPeriod SOAEngineInterState 1
  g_CAN_Bus_Swc_Set("I_LDCU_BodySysSt1.I_LDCU_PowerMode 1"); // 测试步骤 TC_CANTest SET I_LDCU_BodySysSt1.I_LDCU_PowerMode 1
  g_CAN_Bus_Swc_Set("C_LDCU_SysSt.C_LDCU_EVSysReadySt 2"); // 测试步骤 TC_CANTest SET C_LDCU_SysSt.C_LDCU_EVSysReadySt 2
}

testcase SYS_CDCU_zhujiazuoyianmo_0002()
{
  TestDescription("打开主驾座椅按摩-1");
  teststep("warning","原始用例id为SYS-CDCU-主驾座椅按摩-0002");
  g_CAN_Bus_Swc_CheckEventStart("I_CDCU_SeatCtrl.I_CDCU_DrvSeatMassgIntenCmd 1,I_CDCU_DrvSeatMassgProgCmd 2"); // 测试步骤 TC_CANTest CheckEventStart I_CDCU_SeatCtrl.I_CDCU_DrvSeatMassgIntenCmd 1,I_CDCU_DrvSeatMassgProgCmd 2
  g_EM_SOAClient_Swc_SOA_CHECK_Prepare("Veh_TurnOnDrvSeatMassageRespStruct.Veh_TurnOnDrvSeatMassageNRC 0 traceback5"); // 预期结果 TC_CANTest SOA check Veh_TurnOnDrvSeatMassageRespStruct.Veh_TurnOnDrvSeatMassageNRC 0 traceback5
  g_EM_SOAClient_Swc_SOA_CHECK_Prepare("Veh_SeatCtrlService_ErrStruct.OpeNRC 0 traceback11"); // 预期结果 TC_CANTest SOA check Veh_SeatCtrlService_ErrStruct.OpeNRC 0 traceback11
  g_EM_SOAClient_Swc_SOA_REQ("Veh_TurnOnDrvSeatMassageStruct.Veh_DrvSeatMassgIntenReq:1&Veh_DrvSeatMassgProgReq:2&ServiceExecuteFeedbackFlag:2"); // 测试步骤 TC_CANTest SOA REQ Veh_TurnOnDrvSeatMassageStruct.Veh_DrvSeatMassgIntenReq:1&Veh_DrvSeatMassgProgReq:2&ServiceExecuteFeedbackFlag:2
  g_CAN_Bus_Swc_CheckPeriod_FilterStarted("I_CDCU_SeatCtrl.I_CDCU_DrvSeatMassgIntenCmd,I_CDCU_DrvSeatMassgProgCmd 1:0,2:0 3;50;50"); // 预期结果 TC_CANTest CheckPeriod_FilterStarted I_CDCU_SeatCtrl.I_CDCU_DrvSeatMassgIntenCmd,I_CDCU_DrvSeatMassgProgCmd 1:0,2:0 3;50;50
  g_EM_SOAClient_Swc_SOA_CHECK("Veh_TurnOnDrvSeatMassageRespStruct.Veh_TurnOnDrvSeatMassageNRC 0 traceback5"); // 预期结果 TC_CANTest SOA check Veh_TurnOnDrvSeatMassageRespStruct.Veh_TurnOnDrvSeatMassageNRC 0 traceback5
  g_CAN_Bus_Swc_Set("I_LDCU_SeatSysSts.I_DrvSeatMassgIntenSts 0,I_DrvSeatMassgProgSts 1"); // 测试步骤 TC_CANTest SET I_LDCU_SeatSysSts.I_DrvSeatMassgIntenSts 0,I_DrvSeatMassgProgSts 1
  g_EM_SOAClient_Swc_SOA_CHECK("Veh_SeatCtrlService_ErrStruct.OpeNRC 0 traceback11"); // 预期结果 TC_CANTest SOA check Veh_SeatCtrlService_ErrStruct.OpeNRC 0 traceback11
  g_EM_Equipment_Swc_TC_4G_Time_Delay_Second("885"); // 测试步骤 TC_Sleep 885
  g_CAN_Bus_Swc_CheckEventStart("I_CDCU_SeatCtrl.I_CDCU_DrvSeatMassgProgCmd 1"); // 测试步骤 TC_CANTest CheckEventStart I_CDCU_SeatCtrl.I_CDCU_DrvSeatMassgProgCmd 1
  g_EM_Equipment_Swc_TC_4G_Time_Delay_Second("15"); // 测试步骤 TC_Sleep 15
  g_CAN_Bus_Swc_CheckPeriod_FilterStarted("I_CDCU_SeatCtrl.I_CDCU_DrvSeatMassgProgCmd 1:0 3;50;50"); // 预期结果 TC_CANTest CheckPeriod_FilterStarted I_CDCU_SeatCtrl.I_CDCU_DrvSeatMassgProgCmd 1:0 3;50;50
}

testcase SYS_CDCU_zhujiazuoyianmo_0003()
{
  TestDescription("打开主驾座椅按摩-2");
  teststep("warning","原始用例id为SYS-CDCU-主驾座椅按摩-0003");
  g_CAN_Bus_Swc_CheckEventStart("I_CDCU_SeatCtrl.I_CDCU_DrvSeatMassgIntenCmd 2,I_CDCU_DrvSeatMassgProgCmd 5"); // 测试步骤 TC_CANTest CheckEventStart I_CDCU_SeatCtrl.I_CDCU_DrvSeatMassgIntenCmd 2,I_CDCU_DrvSeatMassgProgCmd 5
  g_EM_SOAClient_Swc_SOA_CHECK_Prepare("Veh_TurnOnDrvSeatMassageRespStruct.Veh_TurnOnDrvSeatMassageNRC 0"); // 预期结果 TC_CANTest SOA check Veh_TurnOnDrvSeatMassageRespStruct.Veh_TurnOnDrvSeatMassageNRC 0
  g_EM_SOAClient_Swc_SOA_CHECK_Prepare("Veh_SeatCtrlService_ErrStruct.OpeNRC 0 traceback7"); // 预期结果 TC_CANTest SOA check Veh_SeatCtrlService_ErrStruct.OpeNRC 0 traceback7
  g_EM_SOAClient_Swc_SOA_REQ("Veh_TurnOnDrvSeatMassageStruct.Veh_DrvSeatMassgIntenReq:2&Veh_DrvSeatMassgProgReq:5&ServiceExecuteFeedbackFlag:2"); // 测试步骤 TC_CANTest SOA REQ Veh_TurnOnDrvSeatMassageStruct.Veh_DrvSeatMassgIntenReq:2&Veh_DrvSeatMassgProgReq:5&ServiceExecuteFeedbackFlag:2
  g_EM_SOAClient_Swc_SOA_CHECK("Veh_TurnOnDrvSeatMassageRespStruct.Veh_TurnOnDrvSeatMassageNRC 0"); // 预期结果 TC_CANTest SOA check Veh_TurnOnDrvSeatMassageRespStruct.Veh_TurnOnDrvSeatMassageNRC 0
  g_CAN_Bus_Swc_CheckPeriod_FilterStarted("I_CDCU_SeatCtrl.I_CDCU_DrvSeatMassgIntenCmd,I_CDCU_DrvSeatMassgProgCmd 2:0,5:0 3;50;50"); // 预期结果 TC_CANTest CheckPeriod_FilterStarted I_CDCU_SeatCtrl.I_CDCU_DrvSeatMassgIntenCmd,I_CDCU_DrvSeatMassgProgCmd 2:0,5:0 3;50;50
  g_CAN_Bus_Swc_Set("I_LDCU_SeatSysSts.I_DrvSeatMassgIntenSts 1,I_DrvSeatMassgProgSts 4"); // 测试步骤 TC_CANTest SET I_LDCU_SeatSysSts.I_DrvSeatMassgIntenSts 1,I_DrvSeatMassgProgSts 4
  g_EM_SOAClient_Swc_SOA_CHECK("Veh_SeatCtrlService_ErrStruct.OpeNRC 0 traceback7"); // 预期结果 TC_CANTest SOA check Veh_SeatCtrlService_ErrStruct.OpeNRC 0 traceback7
}

testcase SYS_CDCU_zhujiazuoyianmo_0004()
{
  TestDescription("打开主驾座椅按摩-3");
  teststep("warning","原始用例id为SYS-CDCU-主驾座椅按摩-0004");
  g_CAN_Bus_Swc_CheckEventStart("I_CDCU_SeatCtrl.I_CDCU_DrvSeatMassgIntenCmd 3,I_CDCU_DrvSeatMassgProgCmd 9"); // 测试步骤 TC_CANTest CheckEventStart I_CDCU_SeatCtrl.I_CDCU_DrvSeatMassgIntenCmd 3,I_CDCU_DrvSeatMassgProgCmd 9
  g_EM_SOAClient_Swc_SOA_CHECK_Prepare("Veh_TurnOnDrvSeatMassageRespStruct.Veh_TurnOnDrvSeatMassageNRC 0"); // 预期结果 TC_CANTest SOA check Veh_TurnOnDrvSeatMassageRespStruct.Veh_TurnOnDrvSeatMassageNRC 0
  g_EM_SOAClient_Swc_SOA_CHECK_Prepare("Veh_SeatCtrlService_ErrStruct.OpeNRC 0 traceback7"); // 预期结果 TC_CANTest SOA check Veh_SeatCtrlService_ErrStruct.OpeNRC 0 traceback7
  g_EM_SOAClient_Swc_SOA_REQ("Veh_TurnOnDrvSeatMassageStruct.Veh_DrvSeatMassgIntenReq:3&Veh_DrvSeatMassgProgReq:9&ServiceExecuteFeedbackFlag:2"); // 测试步骤 TC_CANTest SOA REQ Veh_TurnOnDrvSeatMassageStruct.Veh_DrvSeatMassgIntenReq:3&Veh_DrvSeatMassgProgReq:9&ServiceExecuteFeedbackFlag:2
  g_EM_SOAClient_Swc_SOA_CHECK("Veh_TurnOnDrvSeatMassageRespStruct.Veh_TurnOnDrvSeatMassageNRC 0"); // 预期结果 TC_CANTest SOA check Veh_TurnOnDrvSeatMassageRespStruct.Veh_TurnOnDrvSeatMassageNRC 0
  g_CAN_Bus_Swc_CheckPeriod_FilterStarted("I_CDCU_SeatCtrl.I_CDCU_DrvSeatMassgIntenCmd,I_CDCU_DrvSeatMassgProgCmd 3:0,9:0 3;50;50"); // 预期结果 TC_CANTest CheckPeriod_FilterStarted I_CDCU_SeatCtrl.I_CDCU_DrvSeatMassgIntenCmd,I_CDCU_DrvSeatMassgProgCmd 3:0,9:0 3;50;50
  g_CAN_Bus_Swc_Set("I_LDCU_SeatSysSts.I_DrvSeatMassgIntenSts 2,I_DrvSeatMassgProgSts 8"); // 测试步骤 TC_CANTest SET I_LDCU_SeatSysSts.I_DrvSeatMassgIntenSts 2,I_DrvSeatMassgProgSts 8
  g_EM_SOAClient_Swc_SOA_CHECK("Veh_SeatCtrlService_ErrStruct.OpeNRC 0 traceback7"); // 预期结果 TC_CANTest SOA check Veh_SeatCtrlService_ErrStruct.OpeNRC 0 traceback7
}

testcase SYS_CDCU_zhujiazuoyianmo_0005()
{
  TestDescription("关闭主驾座椅按摩-off");
  teststep("warning","原始用例id为SYS-CDCU-主驾座椅按摩-0005");
  g_CAN_Bus_Swc_CheckEventStart("I_CDCU_SeatCtrl.I_CDCU_DrvSeatMassgProgCmd 1"); // 测试步骤 TC_CANTest CheckEventStart I_CDCU_SeatCtrl.I_CDCU_DrvSeatMassgProgCmd 1
  g_EM_SOAClient_Swc_SOA_CHECK_Prepare("Veh_TurnOffDrvSeatMassageRespStruct.Veh_TurnOffDrvSeatMassageNRC 0 traceback5"); // 预期结果 TC_CANTest SOA check Veh_TurnOffDrvSeatMassageRespStruct.Veh_TurnOffDrvSeatMassageNRC 0 traceback5
  g_EM_SOAClient_Swc_SOA_CHECK_Prepare("Veh_SeatCtrlService_ErrStruct.OpeNRC 0 traceback7"); // 预期结果 TC_CANTest SOA check Veh_SeatCtrlService_ErrStruct.OpeNRC 0 traceback7
  g_EM_SOAClient_Swc_SOA_REQ("Veh_TurnOffDrvSeatMassageStruct.ServiceExecuteFeedbackFlag:2"); // 测试步骤 TC_CANTest SOA REQ Veh_TurnOffDrvSeatMassageStruct.ServiceExecuteFeedbackFlag:2
  g_CAN_Bus_Swc_CheckPeriod_FilterStarted("I_CDCU_SeatCtrl.I_CDCU_DrvSeatMassgProgCmd 1:0 3;50;10"); // 预期结果 TC_CANTest CheckPeriod_FilterStarted I_CDCU_SeatCtrl.I_CDCU_DrvSeatMassgProgCmd 1:0 3;50;10
  g_EM_SOAClient_Swc_SOA_CHECK("Veh_TurnOffDrvSeatMassageRespStruct.Veh_TurnOffDrvSeatMassageNRC 0 traceback5"); // 预期结果 TC_CANTest SOA check Veh_TurnOffDrvSeatMassageRespStruct.Veh_TurnOffDrvSeatMassageNRC 0 traceback5
  g_CAN_Bus_Swc_Set("I_LDCU_SeatSysSts.I_DrvSeatMassgProgSts 0"); // 测试步骤 TC_CANTest SET I_LDCU_SeatSysSts.I_DrvSeatMassgProgSts 0
  g_EM_SOAClient_Swc_SOA_CHECK("Veh_SeatCtrlService_ErrStruct.OpeNRC 0 traceback7"); // 预期结果 TC_CANTest SOA check Veh_SeatCtrlService_ErrStruct.OpeNRC 0 traceback7
}

testcase SYS_CDCU_zhujiazuoyianmo_0006()
{
  TestDescription("调节主驾座椅按摩力度-1");
  teststep("warning","原始用例id为SYS-CDCU-主驾座椅按摩-0006");
  g_CAN_Bus_Swc_CheckEventStart("I_CDCU_SeatCtrl.I_CDCU_DrvSeatMassgIntenCmd 1"); // 测试步骤 TC_CANTest CheckEventStart I_CDCU_SeatCtrl.I_CDCU_DrvSeatMassgIntenCmd 1
  g_EM_SOAClient_Swc_SOA_CHECK_Prepare("Veh_SetDrvSeatMassageIntensityRespStruct.Veh_SetDrvSeatMassageIntensityNRC 0"); // 预期结果 TC_CANTest SOA check Veh_SetDrvSeatMassageIntensityRespStruct.Veh_SetDrvSeatMassageIntensityNRC 0
  g_EM_SOAClient_Swc_SOA_CHECK_Prepare("Veh_SeatCtrlService_ErrStruct.OpeNRC 0 traceback7"); // 预期结果 TC_CANTest SOA check Veh_SeatCtrlService_ErrStruct.OpeNRC 0 traceback7
  g_EM_SOAClient_Swc_SOA_REQ("Veh_SetDrvSeatMassageIntensityStruct.Veh_DrvSeatMassgIntenReq:1&ServiceExecuteFeedbackFlag:2"); // 测试步骤 TC_CANTest SOA REQ Veh_SetDrvSeatMassageIntensityStruct.Veh_DrvSeatMassgIntenReq:1&ServiceExecuteFeedbackFlag:2
  g_EM_SOAClient_Swc_SOA_CHECK("Veh_SetDrvSeatMassageIntensityRespStruct.Veh_SetDrvSeatMassageIntensityNRC 0"); // 预期结果 TC_CANTest SOA check Veh_SetDrvSeatMassageIntensityRespStruct.Veh_SetDrvSeatMassageIntensityNRC 0
  g_CAN_Bus_Swc_CheckPeriod_FilterStarted("I_CDCU_SeatCtrl.I_CDCU_DrvSeatMassgIntenCmd 1:0 3;50;50"); // 预期结果 TC_CANTest CheckPeriod_FilterStarted I_CDCU_SeatCtrl.I_CDCU_DrvSeatMassgIntenCmd 1:0 3;50;50
  g_CAN_Bus_Swc_Set("I_LDCU_SeatSysSts.I_DrvSeatMassgIntenSts 0"); // 测试步骤 TC_CANTest SET I_LDCU_SeatSysSts.I_DrvSeatMassgIntenSts 0
  g_EM_SOAClient_Swc_SOA_CHECK("Veh_SeatCtrlService_ErrStruct.OpeNRC 0 traceback7"); // 预期结果 TC_CANTest SOA check Veh_SeatCtrlService_ErrStruct.OpeNRC 0 traceback7
  g_EM_Equipment_Swc_TC_4G_Time_Delay_Second("885"); // 测试步骤 TC_Sleep 885
  g_CAN_Bus_Swc_CheckEventStart("I_CDCU_SeatCtrl.I_CDCU_DrvSeatMassgProgCmd 1"); // 测试步骤 TC_CANTest CheckEventStart I_CDCU_SeatCtrl.I_CDCU_DrvSeatMassgProgCmd 1
  g_EM_Equipment_Swc_TC_4G_Time_Delay_Second("15"); // 测试步骤 TC_Sleep 15
  g_CAN_Bus_Swc_CheckPeriod_FilterStarted("I_CDCU_SeatCtrl.I_CDCU_DrvSeatMassgProgCmd 1:0 3;50;50"); // 预期结果 TC_CANTest CheckPeriod_FilterStarted I_CDCU_SeatCtrl.I_CDCU_DrvSeatMassgProgCmd 1:0 3;50;50
}

testcase SYS_CDCU_zhujiazuoyianmo_0007()
{
  TestDescription("调节主驾座椅按摩力度-2");
  teststep("warning","原始用例id为SYS-CDCU-主驾座椅按摩-0007");
  g_CAN_Bus_Swc_CheckEventStart("I_CDCU_SeatCtrl.I_CDCU_DrvSeatMassgIntenCmd 3"); // 测试步骤 TC_CANTest CheckEventStart I_CDCU_SeatCtrl.I_CDCU_DrvSeatMassgIntenCmd 3
  g_EM_SOAClient_Swc_SOA_CHECK_Prepare("Veh_SetDrvSeatMassageIntensityRespStruct.Veh_SetDrvSeatMassageIntensityNRC 0"); // 预期结果 TC_CANTest SOA check Veh_SetDrvSeatMassageIntensityRespStruct.Veh_SetDrvSeatMassageIntensityNRC 0
  g_EM_SOAClient_Swc_SOA_CHECK_Prepare("Veh_SeatCtrlService_ErrStruct.OpeNRC 0 traceback7"); // 预期结果 TC_CANTest SOA check Veh_SeatCtrlService_ErrStruct.OpeNRC 0 traceback7
  g_EM_SOAClient_Swc_SOA_REQ("Veh_SetDrvSeatMassageIntensityStruct.Veh_DrvSeatMassgIntenReq:3&ServiceExecuteFeedbackFlag:2"); // 测试步骤 TC_CANTest SOA REQ Veh_SetDrvSeatMassageIntensityStruct.Veh_DrvSeatMassgIntenReq:3&ServiceExecuteFeedbackFlag:2
  g_EM_SOAClient_Swc_SOA_CHECK("Veh_SetDrvSeatMassageIntensityRespStruct.Veh_SetDrvSeatMassageIntensityNRC 0"); // 预期结果 TC_CANTest SOA check Veh_SetDrvSeatMassageIntensityRespStruct.Veh_SetDrvSeatMassageIntensityNRC 0
  g_CAN_Bus_Swc_CheckPeriod_FilterStarted("I_CDCU_SeatCtrl.I_CDCU_DrvSeatMassgIntenCmd 3:0 3;50;50"); // 预期结果 TC_CANTest CheckPeriod_FilterStarted I_CDCU_SeatCtrl.I_CDCU_DrvSeatMassgIntenCmd 3:0 3;50;50
  g_CAN_Bus_Swc_Set("I_LDCU_SeatSysSts.I_DrvSeatMassgIntenSts 2"); // 测试步骤 TC_CANTest SET I_LDCU_SeatSysSts.I_DrvSeatMassgIntenSts 2
  g_EM_SOAClient_Swc_SOA_CHECK("Veh_SeatCtrlService_ErrStruct.OpeNRC 0 traceback7"); // 预期结果 TC_CANTest SOA check Veh_SeatCtrlService_ErrStruct.OpeNRC 0 traceback7
}

testcase SYS_CDCU_zhujiazuoyianmo_0008()
{
  TestDescription("关闭主驾座椅按摩-off");
  teststep("warning","原始用例id为SYS-CDCU-主驾座椅按摩-0008");
  g_CAN_Bus_Swc_CheckEventStart("I_CDCU_SeatCtrl.I_CDCU_DrvSeatMassgProgCmd 1"); // 测试步骤 TC_CANTest CheckEventStart I_CDCU_SeatCtrl.I_CDCU_DrvSeatMassgProgCmd 1
  g_EM_SOAClient_Swc_SOA_CHECK_Prepare("Veh_TurnOffDrvSeatMassageRespStruct.Veh_TurnOffDrvSeatMassageNRC 0 traceback5"); // 预期结果 TC_CANTest SOA check Veh_TurnOffDrvSeatMassageRespStruct.Veh_TurnOffDrvSeatMassageNRC 0 traceback5
  g_EM_SOAClient_Swc_SOA_CHECK_Prepare("Veh_SeatCtrlService_ErrStruct.OpeNRC 0 traceback7"); // 预期结果 TC_CANTest SOA check Veh_SeatCtrlService_ErrStruct.OpeNRC 0 traceback7
  g_EM_SOAClient_Swc_SOA_REQ("Veh_TurnOffDrvSeatMassageStruct.ServiceExecuteFeedbackFlag:2"); // 测试步骤 TC_CANTest SOA REQ Veh_TurnOffDrvSeatMassageStruct.ServiceExecuteFeedbackFlag:2
  g_CAN_Bus_Swc_CheckPeriod_FilterStarted("I_CDCU_SeatCtrl.I_CDCU_DrvSeatMassgProgCmd 1:0 3;50;10"); // 预期结果 TC_CANTest CheckPeriod_FilterStarted I_CDCU_SeatCtrl.I_CDCU_DrvSeatMassgProgCmd 1:0 3;50;10
  g_EM_SOAClient_Swc_SOA_CHECK("Veh_TurnOffDrvSeatMassageRespStruct.Veh_TurnOffDrvSeatMassageNRC 0 traceback5"); // 预期结果 TC_CANTest SOA check Veh_TurnOffDrvSeatMassageRespStruct.Veh_TurnOffDrvSeatMassageNRC 0 traceback5
  g_CAN_Bus_Swc_Set("I_LDCU_SeatSysSts.I_DrvSeatMassgProgSts 0"); // 测试步骤 TC_CANTest SET I_LDCU_SeatSysSts.I_DrvSeatMassgProgSts 0
  g_EM_SOAClient_Swc_SOA_CHECK("Veh_SeatCtrlService_ErrStruct.OpeNRC 0 traceback7"); // 预期结果 TC_CANTest SOA check Veh_SeatCtrlService_ErrStruct.OpeNRC 0 traceback7
}

testcase SYS_CDCU_zhujiazuoyianmo_0009()
{
  TestDescription("调节主驾座椅按摩模式-1");
  teststep("warning","原始用例id为SYS-CDCU-主驾座椅按摩-0009");
  g_CAN_Bus_Swc_CheckEventStart("I_CDCU_SeatCtrl.I_CDCU_DrvSeatMassgProgCmd 2"); // 测试步骤 TC_CANTest CheckEventStart I_CDCU_SeatCtrl.I_CDCU_DrvSeatMassgProgCmd 2
  g_EM_SOAClient_Swc_SOA_CHECK_Prepare("Veh_SetDrvSeatMassageModeRespStruct.Veh_SetDrvSeatMassageModeNRC 0"); // 预期结果 TC_CANTest SOA check Veh_SetDrvSeatMassageModeRespStruct.Veh_SetDrvSeatMassageModeNRC 0
  g_EM_SOAClient_Swc_SOA_CHECK_Prepare("Veh_SeatCtrlService_ErrStruct.OpeNRC 0 traceback7"); // 预期结果 TC_CANTest SOA check Veh_SeatCtrlService_ErrStruct.OpeNRC 0 traceback7
  g_EM_SOAClient_Swc_SOA_REQ("Veh_SetDrvSeatMassageModeStruct.Veh_DrvSeatMassgProgReq:2&ServiceExecuteFeedbackFlag:2"); // 测试步骤 TC_CANTest SOA REQ Veh_SetDrvSeatMassageModeStruct.Veh_DrvSeatMassgProgReq:2&ServiceExecuteFeedbackFlag:2
  g_EM_SOAClient_Swc_SOA_CHECK("Veh_SetDrvSeatMassageModeRespStruct.Veh_SetDrvSeatMassageModeNRC 0"); // 预期结果 TC_CANTest SOA check Veh_SetDrvSeatMassageModeRespStruct.Veh_SetDrvSeatMassageModeNRC 0
  g_CAN_Bus_Swc_CheckPeriod_FilterStarted("I_CDCU_SeatCtrl.I_CDCU_DrvSeatMassgProgCmd 2:0 3;50;50"); // 预期结果 TC_CANTest CheckPeriod_FilterStarted I_CDCU_SeatCtrl.I_CDCU_DrvSeatMassgProgCmd 2:0 3;50;50
  g_CAN_Bus_Swc_Set("I_LDCU_SeatSysSts.I_DrvSeatMassgProgSts 1"); // 测试步骤 TC_CANTest SET I_LDCU_SeatSysSts.I_DrvSeatMassgProgSts 1
  g_EM_SOAClient_Swc_SOA_CHECK("Veh_SeatCtrlService_ErrStruct.OpeNRC 0 traceback7"); // 预期结果 TC_CANTest SOA check Veh_SeatCtrlService_ErrStruct.OpeNRC 0 traceback7
  g_EM_Equipment_Swc_TC_4G_Time_Delay_Second("885"); // 测试步骤 TC_Sleep 885
  g_CAN_Bus_Swc_CheckEventStart("I_CDCU_SeatCtrl.I_CDCU_DrvSeatMassgProgCmd 1"); // 测试步骤 TC_CANTest CheckEventStart I_CDCU_SeatCtrl.I_CDCU_DrvSeatMassgProgCmd 1
  g_EM_Equipment_Swc_TC_4G_Time_Delay_Second("15"); // 测试步骤 TC_Sleep 15
  g_CAN_Bus_Swc_CheckPeriod_FilterStarted("I_CDCU_SeatCtrl.I_CDCU_DrvSeatMassgProgCmd 1:0 3;50;50"); // 预期结果 TC_CANTest CheckPeriod_FilterStarted I_CDCU_SeatCtrl.I_CDCU_DrvSeatMassgProgCmd 1:0 3;50;50
}

testcase SYS_CDCU_zhujiazuoyianmo_0010()
{
  TestDescription("调节主驾座椅按摩模式-2");
  teststep("warning","原始用例id为SYS-CDCU-主驾座椅按摩-0010");
  g_CAN_Bus_Swc_CheckEventStart("I_CDCU_SeatCtrl.I_CDCU_DrvSeatMassgProgCmd 6"); // 测试步骤 TC_CANTest CheckEventStart I_CDCU_SeatCtrl.I_CDCU_DrvSeatMassgProgCmd 6
  g_EM_SOAClient_Swc_SOA_CHECK_Prepare("Veh_SetDrvSeatMassageModeRespStruct.Veh_SetDrvSeatMassageModeNRC 0 traceback20"); // 预期结果 TC_CANTest SOA check Veh_SetDrvSeatMassageModeRespStruct.Veh_SetDrvSeatMassageModeNRC 0 traceback20
  g_EM_SOAClient_Swc_SOA_CHECK_Prepare("Veh_SeatCtrlService_ErrStruct.OpeNRC 0 traceback7"); // 预期结果 TC_CANTest SOA check Veh_SeatCtrlService_ErrStruct.OpeNRC 0 traceback7
  g_EM_SOAClient_Swc_SOA_REQ("Veh_SetDrvSeatMassageModeStruct.Veh_DrvSeatMassgProgReq:6&ServiceExecuteFeedbackFlag:2"); // 测试步骤 TC_CANTest SOA REQ Veh_SetDrvSeatMassageModeStruct.Veh_DrvSeatMassgProgReq:6&ServiceExecuteFeedbackFlag:2
  g_EM_SOAClient_Swc_SOA_CHECK("Veh_SetDrvSeatMassageModeRespStruct.Veh_SetDrvSeatMassageModeNRC 0 traceback20"); // 预期结果 TC_CANTest SOA check Veh_SetDrvSeatMassageModeRespStruct.Veh_SetDrvSeatMassageModeNRC 0 traceback20
  g_CAN_Bus_Swc_CheckPeriod_FilterStarted("I_CDCU_SeatCtrl.I_CDCU_DrvSeatMassgProgCmd 6:0 3;50;50"); // 预期结果 TC_CANTest CheckPeriod_FilterStarted I_CDCU_SeatCtrl.I_CDCU_DrvSeatMassgProgCmd 6:0 3;50;50
  g_CAN_Bus_Swc_Set("I_LDCU_SeatSysSts.I_DrvSeatMassgProgSts 5"); // 测试步骤 TC_CANTest SET I_LDCU_SeatSysSts.I_DrvSeatMassgProgSts 5
  g_EM_SOAClient_Swc_SOA_CHECK("Veh_SeatCtrlService_ErrStruct.OpeNRC 0 traceback7"); // 预期结果 TC_CANTest SOA check Veh_SeatCtrlService_ErrStruct.OpeNRC 0 traceback7
}

testcase SYS_CDCU_zhujiazuoyianmo_0011()
{
  TestDescription("调节主驾座椅按摩模式-3");
  teststep("warning","原始用例id为SYS-CDCU-主驾座椅按摩-0011");
  g_CAN_Bus_Swc_CheckEventStart("I_CDCU_SeatCtrl.I_CDCU_DrvSeatMassgProgCmd 12"); // 测试步骤 TC_CANTest CheckEventStart I_CDCU_SeatCtrl.I_CDCU_DrvSeatMassgProgCmd 12
  g_EM_SOAClient_Swc_SOA_CHECK_Prepare("Veh_SetDrvSeatMassageModeRespStruct.Veh_SetDrvSeatMassageModeNRC 0"); // 预期结果 TC_CANTest SOA check Veh_SetDrvSeatMassageModeRespStruct.Veh_SetDrvSeatMassageModeNRC 0
  g_EM_SOAClient_Swc_SOA_CHECK_Prepare("Veh_SeatCtrlService_ErrStruct.OpeNRC 0 traceback7"); // 预期结果 TC_CANTest SOA check Veh_SeatCtrlService_ErrStruct.OpeNRC 0 traceback7
  g_EM_SOAClient_Swc_SOA_REQ("Veh_SetDrvSeatMassageModeStruct.Veh_DrvSeatMassgProgReq:12&ServiceExecuteFeedbackFlag:2"); // 测试步骤 TC_CANTest SOA REQ Veh_SetDrvSeatMassageModeStruct.Veh_DrvSeatMassgProgReq:12&ServiceExecuteFeedbackFlag:2
  g_EM_SOAClient_Swc_SOA_CHECK("Veh_SetDrvSeatMassageModeRespStruct.Veh_SetDrvSeatMassageModeNRC 0"); // 预期结果 TC_CANTest SOA check Veh_SetDrvSeatMassageModeRespStruct.Veh_SetDrvSeatMassageModeNRC 0
  g_CAN_Bus_Swc_CheckPeriod_FilterStarted("I_CDCU_SeatCtrl.I_CDCU_DrvSeatMassgProgCmd 12:0 3;50;50"); // 预期结果 TC_CANTest CheckPeriod_FilterStarted I_CDCU_SeatCtrl.I_CDCU_DrvSeatMassgProgCmd 12:0 3;50;50
  g_CAN_Bus_Swc_Set("I_LDCU_SeatSysSts.I_DrvSeatMassgProgSts 11"); // 测试步骤 TC_CANTest SET I_LDCU_SeatSysSts.I_DrvSeatMassgProgSts 11
  g_EM_SOAClient_Swc_SOA_CHECK("Veh_SeatCtrlService_ErrStruct.OpeNRC 0 traceback7"); // 预期结果 TC_CANTest SOA check Veh_SeatCtrlService_ErrStruct.OpeNRC 0 traceback7
}

testcase SYS_CDCU_zhujiazuoyianmo_0012()
{
  TestDescription("关闭主驾座椅按摩-off");
  teststep("warning","原始用例id为SYS-CDCU-主驾座椅按摩-0012");
  g_CAN_Bus_Swc_CheckEventStart("I_CDCU_SeatCtrl.I_CDCU_DrvSeatMassgProgCmd 1"); // 测试步骤 TC_CANTest CheckEventStart I_CDCU_SeatCtrl.I_CDCU_DrvSeatMassgProgCmd 1
  g_EM_SOAClient_Swc_SOA_CHECK_Prepare("Veh_TurnOffDrvSeatMassageRespStruct.Veh_TurnOffDrvSeatMassageNRC 0 traceback5"); // 预期结果 TC_CANTest SOA check Veh_TurnOffDrvSeatMassageRespStruct.Veh_TurnOffDrvSeatMassageNRC 0 traceback5
  g_EM_SOAClient_Swc_SOA_CHECK_Prepare("Veh_SeatCtrlService_ErrStruct.OpeNRC 0 traceback7"); // 预期结果 TC_CANTest SOA check Veh_SeatCtrlService_ErrStruct.OpeNRC 0 traceback7
  g_EM_SOAClient_Swc_SOA_REQ("Veh_TurnOffDrvSeatMassageStruct.ServiceExecuteFeedbackFlag:2"); // 测试步骤 TC_CANTest SOA REQ Veh_TurnOffDrvSeatMassageStruct.ServiceExecuteFeedbackFlag:2
  g_CAN_Bus_Swc_CheckPeriod_FilterStarted("I_CDCU_SeatCtrl.I_CDCU_DrvSeatMassgProgCmd 1:0 3;50;10"); // 预期结果 TC_CANTest CheckPeriod_FilterStarted I_CDCU_SeatCtrl.I_CDCU_DrvSeatMassgProgCmd 1:0 3;50;10
  g_EM_SOAClient_Swc_SOA_CHECK("Veh_TurnOffDrvSeatMassageRespStruct.Veh_TurnOffDrvSeatMassageNRC 0 traceback5"); // 预期结果 TC_CANTest SOA check Veh_TurnOffDrvSeatMassageRespStruct.Veh_TurnOffDrvSeatMassageNRC 0 traceback5
  g_CAN_Bus_Swc_Set("I_LDCU_SeatSysSts.I_DrvSeatMassgProgSts 0"); // 测试步骤 TC_CANTest SET I_LDCU_SeatSysSts.I_DrvSeatMassgProgSts 0
  g_EM_SOAClient_Swc_SOA_CHECK("Veh_SeatCtrlService_ErrStruct.OpeNRC 0 traceback7"); // 预期结果 TC_CANTest SOA check Veh_SeatCtrlService_ErrStruct.OpeNRC 0 traceback7
}

testcase SYS_CDCU_fujiazuoyianmo_0013()
{
  TestDescription("打开副驾座椅按摩-1");
  teststep("warning","原始用例id为SYS-CDCU-副驾座椅按摩-0013");
  g_CAN_Bus_Swc_CheckEventStart("I_CDCU_SeatCtrl.I_CDCU_PsngrSeatMassgIntenCmd 1,I_CDCU_PsngrSeatMassgProgCmd 3"); // 测试步骤 TC_CANTest CheckEventStart I_CDCU_SeatCtrl.I_CDCU_PsngrSeatMassgIntenCmd 1,I_CDCU_PsngrSeatMassgProgCmd 3
  g_EM_SOAClient_Swc_SOA_CHECK_Prepare("Veh_TurnOnPsngrSeatMassageRespStruct.Veh_TurnOnPsngrSeatMassageNRC 0 traceback5"); // 预期结果 TC_CANTest SOA check Veh_TurnOnPsngrSeatMassageRespStruct.Veh_TurnOnPsngrSeatMassageNRC 0 traceback5
  g_EM_SOAClient_Swc_SOA_CHECK_Prepare("Veh_SeatCtrlService_ErrStruct.OpeNRC 0 traceback7"); // 预期结果 TC_CANTest SOA check Veh_SeatCtrlService_ErrStruct.OpeNRC 0 traceback7
  g_EM_SOAClient_Swc_SOA_REQ("Veh_TurnOnPsngrSeatMassageStruct.Veh_PsngrSeatMassgIntenReq:1&Veh_PsngrSeatMassgProgReq:3&ServiceExecuteFeedbackFlag:2"); // 测试步骤 TC_CANTest SOA REQ Veh_TurnOnPsngrSeatMassageStruct.Veh_PsngrSeatMassgIntenReq:1&Veh_PsngrSeatMassgProgReq:3&ServiceExecuteFeedbackFlag:2
  g_CAN_Bus_Swc_CheckPeriod_FilterStarted("I_CDCU_SeatCtrl.I_CDCU_PsngrSeatMassgIntenCmd,I_CDCU_PsngrSeatMassgProgCmd 1:0,3:0 3;50;50"); // 预期结果 TC_CANTest CheckPeriod_FilterStarted I_CDCU_SeatCtrl.I_CDCU_PsngrSeatMassgIntenCmd,I_CDCU_PsngrSeatMassgProgCmd 1:0,3:0 3;50;50
  g_EM_SOAClient_Swc_SOA_CHECK("Veh_TurnOnPsngrSeatMassageRespStruct.Veh_TurnOnPsngrSeatMassageNRC 0 traceback5"); // 预期结果 TC_CANTest SOA check Veh_TurnOnPsngrSeatMassageRespStruct.Veh_TurnOnPsngrSeatMassageNRC 0 traceback5
  g_CAN_Bus_Swc_Set("I_RDCU_SeatInfo2.I_PsngrSeatMassgIntenSts 0,I_PsngrSeatMassgProgSts 2"); // 测试步骤 TC_CANTest SET I_RDCU_SeatInfo2.I_PsngrSeatMassgIntenSts 0,I_PsngrSeatMassgProgSts 2
  g_EM_SOAClient_Swc_SOA_CHECK("Veh_SeatCtrlService_ErrStruct.OpeNRC 0 traceback7"); // 预期结果 TC_CANTest SOA check Veh_SeatCtrlService_ErrStruct.OpeNRC 0 traceback7
  g_EM_Equipment_Swc_TC_4G_Time_Delay_Second("885"); // 测试步骤 TC_Sleep 885
  g_CAN_Bus_Swc_CheckEventStart("I_CDCU_SeatCtrl.I_CDCU_PsngrSeatMassgProgCmd 1"); // 测试步骤 TC_CANTest CheckEventStart I_CDCU_SeatCtrl.I_CDCU_PsngrSeatMassgProgCmd 1
  g_EM_Equipment_Swc_TC_4G_Time_Delay_Second("15"); // 测试步骤 TC_Sleep 15
  g_CAN_Bus_Swc_CheckPeriod_FilterStarted("I_CDCU_SeatCtrl.I_CDCU_PsngrSeatMassgProgCmd 1:0 3;50;50"); // 预期结果 TC_CANTest CheckPeriod_FilterStarted I_CDCU_SeatCtrl.I_CDCU_PsngrSeatMassgProgCmd 1:0 3;50;50
}

testcase SYS_CDCU_fujiazuoyianmo_0014()
{
  TestDescription("打开副驾座椅按摩-2");
  teststep("warning","原始用例id为SYS-CDCU-副驾座椅按摩-0014");
  g_CAN_Bus_Swc_CheckEventStart("I_CDCU_SeatCtrl.I_CDCU_PsngrSeatMassgIntenCmd 2,I_CDCU_PsngrSeatMassgProgCmd 6"); // 测试步骤 TC_CANTest CheckEventStart I_CDCU_SeatCtrl.I_CDCU_PsngrSeatMassgIntenCmd 2,I_CDCU_PsngrSeatMassgProgCmd 6
  g_EM_SOAClient_Swc_SOA_CHECK_Prepare("Veh_TurnOnPsngrSeatMassageRespStruct.Veh_TurnOnPsngrSeatMassageNRC 0 traceback5"); // 预期结果 TC_CANTest SOA check Veh_TurnOnPsngrSeatMassageRespStruct.Veh_TurnOnPsngrSeatMassageNRC 0 traceback5
  g_EM_SOAClient_Swc_SOA_CHECK_Prepare("Veh_SeatCtrlService_ErrStruct.OpeNRC 0 traceback7"); // 预期结果 TC_CANTest SOA check Veh_SeatCtrlService_ErrStruct.OpeNRC 0 traceback7
  g_EM_SOAClient_Swc_SOA_REQ("Veh_TurnOnPsngrSeatMassageStruct.Veh_PsngrSeatMassgIntenReq:2&Veh_PsngrSeatMassgProgReq:6&ServiceExecuteFeedbackFlag:2"); // 测试步骤 TC_CANTest SOA REQ Veh_TurnOnPsngrSeatMassageStruct.Veh_PsngrSeatMassgIntenReq:2&Veh_PsngrSeatMassgProgReq:6&ServiceExecuteFeedbackFlag:2
  g_CAN_Bus_Swc_CheckPeriod_FilterStarted("I_CDCU_SeatCtrl.I_CDCU_PsngrSeatMassgIntenCmd,I_CDCU_PsngrSeatMassgProgCmd 2:0,6:0 3;50;50"); // 预期结果 TC_CANTest CheckPeriod_FilterStarted I_CDCU_SeatCtrl.I_CDCU_PsngrSeatMassgIntenCmd,I_CDCU_PsngrSeatMassgProgCmd 2:0,6:0 3;50;50
  g_EM_SOAClient_Swc_SOA_CHECK("Veh_TurnOnPsngrSeatMassageRespStruct.Veh_TurnOnPsngrSeatMassageNRC 0 traceback5"); // 预期结果 TC_CANTest SOA check Veh_TurnOnPsngrSeatMassageRespStruct.Veh_TurnOnPsngrSeatMassageNRC 0 traceback5
  g_CAN_Bus_Swc_Set("I_RDCU_SeatInfo2.I_PsngrSeatMassgIntenSts 1,I_PsngrSeatMassgProgSts 5"); // 测试步骤 TC_CANTest SET I_RDCU_SeatInfo2.I_PsngrSeatMassgIntenSts 1,I_PsngrSeatMassgProgSts 5
  g_EM_SOAClient_Swc_SOA_CHECK("Veh_SeatCtrlService_ErrStruct.OpeNRC 0 traceback7"); // 预期结果 TC_CANTest SOA check Veh_SeatCtrlService_ErrStruct.OpeNRC 0 traceback7
}

testcase SYS_CDCU_fujiazuoyianmo_0015()
{
  TestDescription("打开副驾座椅按摩-3");
  teststep("warning","原始用例id为SYS-CDCU-副驾座椅按摩-0015");
  g_CAN_Bus_Swc_CheckEventStart("I_CDCU_SeatCtrl.I_CDCU_PsngrSeatMassgIntenCmd 3,I_CDCU_PsngrSeatMassgProgCmd 10"); // 测试步骤 TC_CANTest CheckEventStart I_CDCU_SeatCtrl.I_CDCU_PsngrSeatMassgIntenCmd 3,I_CDCU_PsngrSeatMassgProgCmd 10
  g_EM_SOAClient_Swc_SOA_CHECK_Prepare("Veh_TurnOnPsngrSeatMassageRespStruct.Veh_TurnOnPsngrSeatMassageNRC 0 traceback5"); // 预期结果 TC_CANTest SOA check Veh_TurnOnPsngrSeatMassageRespStruct.Veh_TurnOnPsngrSeatMassageNRC 0 traceback5
  g_EM_SOAClient_Swc_SOA_CHECK_Prepare("Veh_SeatCtrlService_ErrStruct.OpeNRC 0 traceback7"); // 预期结果 TC_CANTest SOA check Veh_SeatCtrlService_ErrStruct.OpeNRC 0 traceback7
  g_EM_SOAClient_Swc_SOA_REQ("Veh_TurnOnPsngrSeatMassageStruct.Veh_PsngrSeatMassgIntenReq:3&Veh_PsngrSeatMassgProgReq:10&ServiceExecuteFeedbackFlag:2"); // 测试步骤 TC_CANTest SOA REQ Veh_TurnOnPsngrSeatMassageStruct.Veh_PsngrSeatMassgIntenReq:3&Veh_PsngrSeatMassgProgReq:10&ServiceExecuteFeedbackFlag:2
  g_CAN_Bus_Swc_CheckPeriod_FilterStarted("I_CDCU_SeatCtrl.I_CDCU_PsngrSeatMassgIntenCmd,I_CDCU_PsngrSeatMassgProgCmd 3:0,10:0 3;50;50"); // 预期结果 TC_CANTest CheckPeriod_FilterStarted I_CDCU_SeatCtrl.I_CDCU_PsngrSeatMassgIntenCmd,I_CDCU_PsngrSeatMassgProgCmd 3:0,10:0 3;50;50
  g_EM_SOAClient_Swc_SOA_CHECK("Veh_TurnOnPsngrSeatMassageRespStruct.Veh_TurnOnPsngrSeatMassageNRC 0 traceback5"); // 预期结果 TC_CANTest SOA check Veh_TurnOnPsngrSeatMassageRespStruct.Veh_TurnOnPsngrSeatMassageNRC 0 traceback5
  g_CAN_Bus_Swc_Set("I_RDCU_SeatInfo2.I_PsngrSeatMassgIntenSts 2,I_PsngrSeatMassgProgSts 9"); // 测试步骤 TC_CANTest SET I_RDCU_SeatInfo2.I_PsngrSeatMassgIntenSts 2,I_PsngrSeatMassgProgSts 9
  g_EM_SOAClient_Swc_SOA_CHECK("Veh_SeatCtrlService_ErrStruct.OpeNRC 0 traceback7"); // 预期结果 TC_CANTest SOA check Veh_SeatCtrlService_ErrStruct.OpeNRC 0 traceback7
}

testcase SYS_CDCU_fujiazuoyianmo_0016()
{
  TestDescription("关闭副驾座椅按摩-off");
  teststep("warning","原始用例id为SYS-CDCU-副驾座椅按摩-0016");
  g_CAN_Bus_Swc_CheckEventStart("I_CDCU_SeatCtrl.I_CDCU_PsngrSeatMassgProgCmd 1"); // 测试步骤 TC_CANTest CheckEventStart I_CDCU_SeatCtrl.I_CDCU_PsngrSeatMassgProgCmd 1
  g_EM_SOAClient_Swc_SOA_CHECK_Prepare("Veh_TurnOffPsngrSeatMassageRespStruct.Veh_TurnOffPsngrSeatMassageNRC 0 traceback5"); // 预期结果 TC_CANTest SOA check Veh_TurnOffPsngrSeatMassageRespStruct.Veh_TurnOffPsngrSeatMassageNRC 0 traceback5
  g_EM_SOAClient_Swc_SOA_CHECK_Prepare("Veh_SeatCtrlService_ErrStruct.OpeNRC 0 traceback7"); // 预期结果 TC_CANTest SOA check Veh_SeatCtrlService_ErrStruct.OpeNRC 0 traceback7
  g_EM_SOAClient_Swc_SOA_REQ("Veh_TurnOffPsngrSeatMassageStruct.ServiceExecuteFeedbackFlag:2"); // 测试步骤 TC_CANTest SOA REQ Veh_TurnOffPsngrSeatMassageStruct.ServiceExecuteFeedbackFlag:2
  g_CAN_Bus_Swc_CheckPeriod_FilterStarted("I_CDCU_SeatCtrl.I_CDCU_PsngrSeatMassgProgCmd 1:0 3;50;50"); // 预期结果 TC_CANTest CheckPeriod_FilterStarted I_CDCU_SeatCtrl.I_CDCU_PsngrSeatMassgProgCmd 1:0 3;50;50
  g_EM_SOAClient_Swc_SOA_CHECK("Veh_TurnOffPsngrSeatMassageRespStruct.Veh_TurnOffPsngrSeatMassageNRC 0 traceback5"); // 预期结果 TC_CANTest SOA check Veh_TurnOffPsngrSeatMassageRespStruct.Veh_TurnOffPsngrSeatMassageNRC 0 traceback5
  g_CAN_Bus_Swc_Set("I_RDCU_SeatInfo2.I_PsngrSeatMassgProgSts 0"); // 测试步骤 TC_CANTest SET I_RDCU_SeatInfo2.I_PsngrSeatMassgProgSts 0
  g_EM_SOAClient_Swc_SOA_CHECK("Veh_SeatCtrlService_ErrStruct.OpeNRC 0 traceback7"); // 预期结果 TC_CANTest SOA check Veh_SeatCtrlService_ErrStruct.OpeNRC 0 traceback7
}

testcase SYS_CDCU_fujiazuoyianmo_0017()
{
  TestDescription("调节副驾座椅按摩力度-1");
  teststep("warning","原始用例id为SYS-CDCU-副驾座椅按摩-0017");
  g_CAN_Bus_Swc_CheckEventStart("I_CDCU_SeatCtrl.I_CDCU_PsngrSeatMassgIntenCmd 1"); // 测试步骤 TC_CANTest CheckEventStart I_CDCU_SeatCtrl.I_CDCU_PsngrSeatMassgIntenCmd 1
  g_EM_SOAClient_Swc_SOA_CHECK_Prepare("Veh_SetPsngrSeatMassageIntensityRespStruct.Veh_SetPsngrSeatMassageIntensityNRC 0 traceback5"); // 预期结果 TC_CANTest SOA check Veh_SetPsngrSeatMassageIntensityRespStruct.Veh_SetPsngrSeatMassageIntensityNRC 0 traceback5
  g_EM_SOAClient_Swc_SOA_CHECK_Prepare("Veh_SeatCtrlService_ErrStruct.OpeNRC 0 traceback7"); // 预期结果 TC_CANTest SOA check Veh_SeatCtrlService_ErrStruct.OpeNRC 0 traceback7
  g_EM_SOAClient_Swc_SOA_REQ("Veh_SetPsngrSeatMassageIntensityStruct.Veh_PsngrSeatMassgIntenReq:1&ServiceExecuteFeedbackFlag:2"); // 测试步骤 TC_CANTest SOA REQ Veh_SetPsngrSeatMassageIntensityStruct.Veh_PsngrSeatMassgIntenReq:1&ServiceExecuteFeedbackFlag:2
  g_CAN_Bus_Swc_CheckPeriod_FilterStarted("I_CDCU_SeatCtrl.I_CDCU_PsngrSeatMassgIntenCmd 1:0 3;50;50"); // 预期结果 TC_CANTest CheckPeriod_FilterStarted I_CDCU_SeatCtrl.I_CDCU_PsngrSeatMassgIntenCmd 1:0 3;50;50
  g_EM_SOAClient_Swc_SOA_CHECK("Veh_SetPsngrSeatMassageIntensityRespStruct.Veh_SetPsngrSeatMassageIntensityNRC 0 traceback5"); // 预期结果 TC_CANTest SOA check Veh_SetPsngrSeatMassageIntensityRespStruct.Veh_SetPsngrSeatMassageIntensityNRC 0 traceback5
  g_CAN_Bus_Swc_Set("I_RDCU_SeatInfo2.I_PsngrSeatMassgIntenSts 0"); // 测试步骤 TC_CANTest SET I_RDCU_SeatInfo2.I_PsngrSeatMassgIntenSts 0
  g_EM_SOAClient_Swc_SOA_CHECK("Veh_SeatCtrlService_ErrStruct.OpeNRC 0 traceback7"); // 预期结果 TC_CANTest SOA check Veh_SeatCtrlService_ErrStruct.OpeNRC 0 traceback7
  g_EM_Equipment_Swc_TC_4G_Time_Delay_Second("885"); // 测试步骤 TC_Sleep 885
  g_CAN_Bus_Swc_CheckEventStart("I_CDCU_SeatCtrl.I_CDCU_PsngrSeatMassgProgCmd 1"); // 测试步骤 TC_CANTest CheckEventStart I_CDCU_SeatCtrl.I_CDCU_PsngrSeatMassgProgCmd 1
  g_EM_Equipment_Swc_TC_4G_Time_Delay_Second("15"); // 测试步骤 TC_Sleep 15
  g_CAN_Bus_Swc_CheckPeriod_FilterStarted("I_CDCU_SeatCtrl.I_CDCU_PsngrSeatMassgProgCmd 1:0 3;50;50"); // 预期结果 TC_CANTest CheckPeriod_FilterStarted I_CDCU_SeatCtrl.I_CDCU_PsngrSeatMassgProgCmd 1:0 3;50;50
}

testcase SYS_CDCU_fujiazuoyianmo_0018()
{
  TestDescription("调节副驾座椅按摩力度-2");
  teststep("warning","原始用例id为SYS-CDCU-副驾座椅按摩-0018");
  g_CAN_Bus_Swc_CheckEventStart("I_CDCU_SeatCtrl.I_CDCU_PsngrSeatMassgIntenCmd 2"); // 测试步骤 TC_CANTest CheckEventStart I_CDCU_SeatCtrl.I_CDCU_PsngrSeatMassgIntenCmd 2
  g_EM_SOAClient_Swc_SOA_CHECK_Prepare("Veh_SetPsngrSeatMassageIntensityRespStruct.Veh_SetPsngrSeatMassageIntensityNRC 0 traceback5"); // 预期结果 TC_CANTest SOA check Veh_SetPsngrSeatMassageIntensityRespStruct.Veh_SetPsngrSeatMassageIntensityNRC 0 traceback5
  g_EM_SOAClient_Swc_SOA_CHECK_Prepare("Veh_SeatCtrlService_ErrStruct.OpeNRC 0 traceback7"); // 预期结果 TC_CANTest SOA check Veh_SeatCtrlService_ErrStruct.OpeNRC 0 traceback7
  g_EM_SOAClient_Swc_SOA_REQ("Veh_SetPsngrSeatMassageIntensityStruct.Veh_PsngrSeatMassgIntenReq:2&ServiceExecuteFeedbackFlag:2"); // 测试步骤 TC_CANTest SOA REQ Veh_SetPsngrSeatMassageIntensityStruct.Veh_PsngrSeatMassgIntenReq:2&ServiceExecuteFeedbackFlag:2
  g_CAN_Bus_Swc_CheckPeriod_FilterStarted("I_CDCU_SeatCtrl.I_CDCU_PsngrSeatMassgIntenCmd 2:0 3;50;50"); // 预期结果 TC_CANTest CheckPeriod_FilterStarted I_CDCU_SeatCtrl.I_CDCU_PsngrSeatMassgIntenCmd 2:0 3;50;50
  g_EM_SOAClient_Swc_SOA_CHECK("Veh_SetPsngrSeatMassageIntensityRespStruct.Veh_SetPsngrSeatMassageIntensityNRC 0 traceback5"); // 预期结果 TC_CANTest SOA check Veh_SetPsngrSeatMassageIntensityRespStruct.Veh_SetPsngrSeatMassageIntensityNRC 0 traceback5
  g_CAN_Bus_Swc_Set("I_RDCU_SeatInfo2.I_PsngrSeatMassgIntenSts 1"); // 测试步骤 TC_CANTest SET I_RDCU_SeatInfo2.I_PsngrSeatMassgIntenSts 1
  g_EM_SOAClient_Swc_SOA_CHECK("Veh_SeatCtrlService_ErrStruct.OpeNRC 0 traceback7"); // 预期结果 TC_CANTest SOA check Veh_SeatCtrlService_ErrStruct.OpeNRC 0 traceback7
}

testcase SYS_CDCU_fujiazuoyianmo_0019()
{
  TestDescription("关闭副驾座椅按摩-off");
  teststep("warning","原始用例id为SYS-CDCU-副驾座椅按摩-0019");
  g_CAN_Bus_Swc_CheckEventStart("I_CDCU_SeatCtrl.I_CDCU_PsngrSeatMassgProgCmd 1"); // 测试步骤 TC_CANTest CheckEventStart I_CDCU_SeatCtrl.I_CDCU_PsngrSeatMassgProgCmd 1
  g_EM_SOAClient_Swc_SOA_CHECK_Prepare("Veh_TurnOffPsngrSeatMassageRespStruct.Veh_TurnOffPsngrSeatMassageNRC 0 traceback5"); // 预期结果 TC_CANTest SOA check Veh_TurnOffPsngrSeatMassageRespStruct.Veh_TurnOffPsngrSeatMassageNRC 0 traceback5
  g_EM_SOAClient_Swc_SOA_CHECK_Prepare("Veh_SeatCtrlService_ErrStruct.OpeNRC 0 traceback7"); // 预期结果 TC_CANTest SOA check Veh_SeatCtrlService_ErrStruct.OpeNRC 0 traceback7
  g_EM_SOAClient_Swc_SOA_REQ("Veh_TurnOffPsngrSeatMassageStruct.ServiceExecuteFeedbackFlag:2"); // 测试步骤 TC_CANTest SOA REQ Veh_TurnOffPsngrSeatMassageStruct.ServiceExecuteFeedbackFlag:2
  g_CAN_Bus_Swc_CheckPeriod_FilterStarted("I_CDCU_SeatCtrl.I_CDCU_PsngrSeatMassgProgCmd 1:0 3;50;50"); // 预期结果 TC_CANTest CheckPeriod_FilterStarted I_CDCU_SeatCtrl.I_CDCU_PsngrSeatMassgProgCmd 1:0 3;50;50
  g_EM_SOAClient_Swc_SOA_CHECK("Veh_TurnOffPsngrSeatMassageRespStruct.Veh_TurnOffPsngrSeatMassageNRC 0 traceback5"); // 预期结果 TC_CANTest SOA check Veh_TurnOffPsngrSeatMassageRespStruct.Veh_TurnOffPsngrSeatMassageNRC 0 traceback5
  g_CAN_Bus_Swc_Set("I_RDCU_SeatInfo2.I_PsngrSeatMassgProgSts 0"); // 测试步骤 TC_CANTest SET I_RDCU_SeatInfo2.I_PsngrSeatMassgProgSts 0
  g_EM_SOAClient_Swc_SOA_CHECK("Veh_SeatCtrlService_ErrStruct.OpeNRC 0 traceback7"); // 预期结果 TC_CANTest SOA check Veh_SeatCtrlService_ErrStruct.OpeNRC 0 traceback7
}

testcase SYS_CDCU_fujiazuoyianmo_0020()
{
  TestDescription("调节副驾座椅按摩模式-1");
  teststep("warning","原始用例id为SYS-CDCU-副驾座椅按摩-0020");
  g_CAN_Bus_Swc_CheckEventStart("I_CDCU_SeatCtrl.I_CDCU_PsngrSeatMassgProgCmd 3"); // 测试步骤 TC_CANTest CheckEventStart I_CDCU_SeatCtrl.I_CDCU_PsngrSeatMassgProgCmd 3
  g_EM_SOAClient_Swc_SOA_CHECK_Prepare("Veh_SetPsngrSeatMassageModeRespStruct.Veh_SetPsngrSeatMassageModeNRC 0 traceback5"); // 预期结果 TC_CANTest SOA check Veh_SetPsngrSeatMassageModeRespStruct.Veh_SetPsngrSeatMassageModeNRC 0 traceback5
  g_EM_SOAClient_Swc_SOA_CHECK_Prepare("Veh_SeatCtrlService_ErrStruct.OpeNRC 0 traceback7"); // 预期结果 TC_CANTest SOA check Veh_SeatCtrlService_ErrStruct.OpeNRC 0 traceback7
  g_EM_SOAClient_Swc_SOA_REQ("Veh_SetPsngrSeatMassageModeStruct.Veh_PsngrSeatMassgProgReq:3&ServiceExecuteFeedbackFlag:2"); // 测试步骤 TC_CANTest SOA REQ Veh_SetPsngrSeatMassageModeStruct.Veh_PsngrSeatMassgProgReq:3&ServiceExecuteFeedbackFlag:2
  g_CAN_Bus_Swc_CheckPeriod_FilterStarted("I_CDCU_SeatCtrl.I_CDCU_PsngrSeatMassgProgCmd 3:0 3;50;50"); // 预期结果 TC_CANTest CheckPeriod_FilterStarted I_CDCU_SeatCtrl.I_CDCU_PsngrSeatMassgProgCmd 3:0 3;50;50
  g_EM_SOAClient_Swc_SOA_CHECK("Veh_SetPsngrSeatMassageModeRespStruct.Veh_SetPsngrSeatMassageModeNRC 0 traceback5"); // 预期结果 TC_CANTest SOA check Veh_SetPsngrSeatMassageModeRespStruct.Veh_SetPsngrSeatMassageModeNRC 0 traceback5
  g_CAN_Bus_Swc_Set("I_RDCU_SeatInfo2.I_PsngrSeatMassgProgSts 2"); // 测试步骤 TC_CANTest SET I_RDCU_SeatInfo2.I_PsngrSeatMassgProgSts 2
  g_EM_SOAClient_Swc_SOA_CHECK("Veh_SeatCtrlService_ErrStruct.OpeNRC 0 traceback7"); // 预期结果 TC_CANTest SOA check Veh_SeatCtrlService_ErrStruct.OpeNRC 0 traceback7
  g_EM_Equipment_Swc_TC_4G_Time_Delay_Second("885"); // 测试步骤 TC_Sleep 885
  g_CAN_Bus_Swc_CheckEventStart("I_CDCU_SeatCtrl.I_CDCU_PsngrSeatMassgProgCmd 1"); // 测试步骤 TC_CANTest CheckEventStart I_CDCU_SeatCtrl.I_CDCU_PsngrSeatMassgProgCmd 1
  g_EM_Equipment_Swc_TC_4G_Time_Delay_Second("15"); // 测试步骤 TC_Sleep 15
  g_CAN_Bus_Swc_CheckPeriod_FilterStarted("I_CDCU_SeatCtrl.I_CDCU_PsngrSeatMassgProgCmd 1:0 3;50;50"); // 预期结果 TC_CANTest CheckPeriod_FilterStarted I_CDCU_SeatCtrl.I_CDCU_PsngrSeatMassgProgCmd 1:0 3;50;50
}

testcase SYS_CDCU_fujiazuoyianmo_0021()
{
  TestDescription("调节副驾座椅按摩模式-2");
  teststep("warning","原始用例id为SYS-CDCU-副驾座椅按摩-0021");
  g_CAN_Bus_Swc_CheckEventStart("I_CDCU_SeatCtrl.I_CDCU_PsngrSeatMassgProgCmd 7"); // 测试步骤 TC_CANTest CheckEventStart I_CDCU_SeatCtrl.I_CDCU_PsngrSeatMassgProgCmd 7
  g_EM_SOAClient_Swc_SOA_CHECK_Prepare("Veh_SetPsngrSeatMassageModeRespStruct.Veh_SetPsngrSeatMassageModeNRC 0 traceback5"); // 预期结果 TC_CANTest SOA check Veh_SetPsngrSeatMassageModeRespStruct.Veh_SetPsngrSeatMassageModeNRC 0 traceback5
  g_EM_SOAClient_Swc_SOA_CHECK_Prepare("Veh_SeatCtrlService_ErrStruct.OpeNRC 0 traceback7"); // 预期结果 TC_CANTest SOA check Veh_SeatCtrlService_ErrStruct.OpeNRC 0 traceback7
  g_EM_SOAClient_Swc_SOA_REQ("Veh_SetPsngrSeatMassageModeStruct.Veh_PsngrSeatMassgProgReq:7&ServiceExecuteFeedbackFlag:2"); // 测试步骤 TC_CANTest SOA REQ Veh_SetPsngrSeatMassageModeStruct.Veh_PsngrSeatMassgProgReq:7&ServiceExecuteFeedbackFlag:2
  g_CAN_Bus_Swc_CheckPeriod_FilterStarted("I_CDCU_SeatCtrl.I_CDCU_PsngrSeatMassgProgCmd 7:0 3;50;50"); // 预期结果 TC_CANTest CheckPeriod_FilterStarted I_CDCU_SeatCtrl.I_CDCU_PsngrSeatMassgProgCmd 7:0 3;50;50
  g_EM_SOAClient_Swc_SOA_CHECK("Veh_SetPsngrSeatMassageModeRespStruct.Veh_SetPsngrSeatMassageModeNRC 0 traceback5"); // 预期结果 TC_CANTest SOA check Veh_SetPsngrSeatMassageModeRespStruct.Veh_SetPsngrSeatMassageModeNRC 0 traceback5
  g_CAN_Bus_Swc_Set("I_RDCU_SeatInfo2.I_PsngrSeatMassgProgSts 6"); // 测试步骤 TC_CANTest SET I_RDCU_SeatInfo2.I_PsngrSeatMassgProgSts 6
  g_EM_SOAClient_Swc_SOA_CHECK("Veh_SeatCtrlService_ErrStruct.OpeNRC 0 traceback7"); // 预期结果 TC_CANTest SOA check Veh_SeatCtrlService_ErrStruct.OpeNRC 0 traceback7
}

testcase SYS_CDCU_fujiazuoyianmo_0022()
{
  TestDescription("调节副驾座椅按摩模式-3");
  teststep("warning","原始用例id为SYS-CDCU-副驾座椅按摩-0022");
  g_CAN_Bus_Swc_CheckEventStart("I_CDCU_SeatCtrl.I_CDCU_PsngrSeatMassgProgCmd 13"); // 测试步骤 TC_CANTest CheckEventStart I_CDCU_SeatCtrl.I_CDCU_PsngrSeatMassgProgCmd 13
  g_EM_SOAClient_Swc_SOA_CHECK_Prepare("Veh_SetPsngrSeatMassageModeRespStruct.Veh_SetPsngrSeatMassageModeNRC 0 traceback5"); // 预期结果 TC_CANTest SOA check Veh_SetPsngrSeatMassageModeRespStruct.Veh_SetPsngrSeatMassageModeNRC 0 traceback5
  g_EM_SOAClient_Swc_SOA_CHECK_Prepare("Veh_SeatCtrlService_ErrStruct.OpeNRC 0 traceback7"); // 预期结果 TC_CANTest SOA check Veh_SeatCtrlService_ErrStruct.OpeNRC 0 traceback7
  g_EM_SOAClient_Swc_SOA_REQ("Veh_SetPsngrSeatMassageModeStruct.Veh_PsngrSeatMassgProgReq:13&ServiceExecuteFeedbackFlag:2"); // 测试步骤 TC_CANTest SOA REQ Veh_SetPsngrSeatMassageModeStruct.Veh_PsngrSeatMassgProgReq:13&ServiceExecuteFeedbackFlag:2
  g_CAN_Bus_Swc_CheckPeriod_FilterStarted("I_CDCU_SeatCtrl.I_CDCU_PsngrSeatMassgProgCmd 13:0 3;50;50"); // 预期结果 TC_CANTest CheckPeriod_FilterStarted I_CDCU_SeatCtrl.I_CDCU_PsngrSeatMassgProgCmd 13:0 3;50;50
  g_EM_SOAClient_Swc_SOA_CHECK("Veh_SetPsngrSeatMassageModeRespStruct.Veh_SetPsngrSeatMassageModeNRC 0 traceback5"); // 预期结果 TC_CANTest SOA check Veh_SetPsngrSeatMassageModeRespStruct.Veh_SetPsngrSeatMassageModeNRC 0 traceback5
  g_CAN_Bus_Swc_Set("I_RDCU_SeatInfo2.I_PsngrSeatMassgProgSts 12"); // 测试步骤 TC_CANTest SET I_RDCU_SeatInfo2.I_PsngrSeatMassgProgSts 12
  g_EM_SOAClient_Swc_SOA_CHECK("Veh_SeatCtrlService_ErrStruct.OpeNRC 0 traceback7"); // 预期结果 TC_CANTest SOA check Veh_SeatCtrlService_ErrStruct.OpeNRC 0 traceback7
}

testcase SYS_CDCU_fujiazuoyianmo_0023()
{
  TestDescription("关闭副驾座椅按摩-off");
  teststep("warning","原始用例id为SYS-CDCU-副驾座椅按摩-0023");
  g_CAN_Bus_Swc_CheckEventStart("I_CDCU_SeatCtrl.I_CDCU_PsngrSeatMassgProgCmd 1"); // 测试步骤 TC_CANTest CheckEventStart I_CDCU_SeatCtrl.I_CDCU_PsngrSeatMassgProgCmd 1
  g_EM_SOAClient_Swc_SOA_CHECK_Prepare("Veh_TurnOffPsngrSeatMassageRespStruct.Veh_TurnOffPsngrSeatMassageNRC 0 traceback5"); // 预期结果 TC_CANTest SOA check Veh_TurnOffPsngrSeatMassageRespStruct.Veh_TurnOffPsngrSeatMassageNRC 0 traceback5
  g_EM_SOAClient_Swc_SOA_CHECK_Prepare("Veh_SeatCtrlService_ErrStruct.OpeNRC 0 traceback7"); // 预期结果 TC_CANTest SOA check Veh_SeatCtrlService_ErrStruct.OpeNRC 0 traceback7
  g_EM_SOAClient_Swc_SOA_REQ("Veh_TurnOffPsngrSeatMassageStruct.ServiceExecuteFeedbackFlag:2"); // 测试步骤 TC_CANTest SOA REQ Veh_TurnOffPsngrSeatMassageStruct.ServiceExecuteFeedbackFlag:2
  g_CAN_Bus_Swc_CheckPeriod_FilterStarted("I_CDCU_SeatCtrl.I_CDCU_PsngrSeatMassgProgCmd 1:0 3;50;50"); // 预期结果 TC_CANTest CheckPeriod_FilterStarted I_CDCU_SeatCtrl.I_CDCU_PsngrSeatMassgProgCmd 1:0 3;50;50
  g_EM_SOAClient_Swc_SOA_CHECK("Veh_TurnOffPsngrSeatMassageRespStruct.Veh_TurnOffPsngrSeatMassageNRC 0 traceback5"); // 预期结果 TC_CANTest SOA check Veh_TurnOffPsngrSeatMassageRespStruct.Veh_TurnOffPsngrSeatMassageNRC 0 traceback5
  g_CAN_Bus_Swc_Set("I_RDCU_SeatInfo2.I_PsngrSeatMassgProgSts 0"); // 测试步骤 TC_CANTest SET I_RDCU_SeatInfo2.I_PsngrSeatMassgProgSts 0
  g_EM_SOAClient_Swc_SOA_CHECK("Veh_SeatCtrlService_ErrStruct.OpeNRC 0 traceback7"); // 预期结果 TC_CANTest SOA check Veh_SeatCtrlService_ErrStruct.OpeNRC 0 traceback7
}

testcase SYS_CDCU_erpaizuocezuoyianmo_0024()
{
  TestDescription("打开二排左侧座椅按摩-1");
  teststep("warning","原始用例id为SYS-CDCU-二排左侧座椅按摩-0024");
  g_CAN_Bus_Swc_CheckEventStart("I_CDCU_SeatCtrl.I_CDCU_SecRowLtSeatMassgIntenCmd 1,I_CDCU_SecRowLtSeatMassgProgCmd 2"); // 测试步骤 TC_CANTest CheckEventStart I_CDCU_SeatCtrl.I_CDCU_SecRowLtSeatMassgIntenCmd 1,I_CDCU_SecRowLtSeatMassgProgCmd 2
  g_EM_SOAClient_Swc_SOA_CHECK_Prepare("Veh_TurnOnSecRowLtSeatMassageRespStruct.Veh_TurnOnSecRowLtSeatMassageNRC 0 traceback5"); // 预期结果 TC_CANTest SOA check Veh_TurnOnSecRowLtSeatMassageRespStruct.Veh_TurnOnSecRowLtSeatMassageNRC 0 traceback5
  g_EM_SOAClient_Swc_SOA_CHECK_Prepare("Veh_SeatCtrlService_ErrStruct.OpeNRC 0 traceback7"); // 预期结果 TC_CANTest SOA check Veh_SeatCtrlService_ErrStruct.OpeNRC 0 traceback7
  g_EM_SOAClient_Swc_SOA_REQ("Veh_TurnOnSecRowLtSeatMassageStruct.Veh_SecRowLtSeatMassgIntenReq:1&Veh_SecRowLtSeatMassgProgReq:2&ServiceExecuteFeedbackFlag:2"); // 测试步骤 TC_CANTest SOA REQ Veh_TurnOnSecRowLtSeatMassageStruct.Veh_SecRowLtSeatMassgIntenReq:1&Veh_SecRowLtSeatMassgProgReq:2&ServiceExecuteFeedbackFlag:2
  g_CAN_Bus_Swc_CheckPeriod_FilterStarted("I_CDCU_SeatCtrl.I_CDCU_SecRowLtSeatMassgIntenCmd,I_CDCU_SecRowLtSeatMassgProgCmd 1:0,2:0 3;50;50"); // 预期结果 TC_CANTest CheckPeriod_FilterStarted I_CDCU_SeatCtrl.I_CDCU_SecRowLtSeatMassgIntenCmd,I_CDCU_SecRowLtSeatMassgProgCmd 1:0,2:0 3;50;50
  g_EM_SOAClient_Swc_SOA_CHECK("Veh_TurnOnSecRowLtSeatMassageRespStruct.Veh_TurnOnSecRowLtSeatMassageNRC 0 traceback5"); // 预期结果 TC_CANTest SOA check Veh_TurnOnSecRowLtSeatMassageRespStruct.Veh_TurnOnSecRowLtSeatMassageNRC 0 traceback5
  g_CAN_Bus_Swc_Set("I_LDCU_SeatSysSts.I_LDCU_SecRowLtSeatMassgIntenSts 0,I_LDCU_SecRowLtSeatMassgProgSts 1"); // 测试步骤 TC_CANTest SET I_LDCU_SeatSysSts.I_LDCU_SecRowLtSeatMassgIntenSts 0,I_LDCU_SecRowLtSeatMassgProgSts 1
  g_EM_SOAClient_Swc_SOA_CHECK("Veh_SeatCtrlService_ErrStruct.OpeNRC 0 traceback7"); // 预期结果 TC_CANTest SOA check Veh_SeatCtrlService_ErrStruct.OpeNRC 0 traceback7
  g_EM_Equipment_Swc_TC_4G_Time_Delay_Second("885"); // 测试步骤 TC_Sleep 885
  g_CAN_Bus_Swc_CheckEventStart("I_CDCU_SeatCtrl.I_CDCU_SecRowLtSeatMassgProgCmd 1"); // 测试步骤 TC_CANTest CheckEventStart I_CDCU_SeatCtrl.I_CDCU_SecRowLtSeatMassgProgCmd 1
  g_EM_Equipment_Swc_TC_4G_Time_Delay_Second("15"); // 测试步骤 TC_Sleep 15
  g_CAN_Bus_Swc_CheckPeriod_FilterStarted("I_CDCU_SeatCtrl.I_CDCU_SecRowLtSeatMassgProgCmd 1:0 3;50;50"); // 预期结果 TC_CANTest CheckPeriod_FilterStarted I_CDCU_SeatCtrl.I_CDCU_SecRowLtSeatMassgProgCmd 1:0 3;50;50
}

testcase SYS_CDCU_erpaizuocezuoyianmo_0025()
{
  TestDescription("打开二排左侧座椅按摩-2");
  teststep("warning","原始用例id为SYS-CDCU-二排左侧座椅按摩-0025");
  g_CAN_Bus_Swc_CheckEventStart("I_CDCU_SeatCtrl.I_CDCU_SecRowLtSeatMassgIntenCmd 2,I_CDCU_SecRowLtSeatMassgProgCmd 4"); // 测试步骤 TC_CANTest CheckEventStart I_CDCU_SeatCtrl.I_CDCU_SecRowLtSeatMassgIntenCmd 2,I_CDCU_SecRowLtSeatMassgProgCmd 4
  g_EM_SOAClient_Swc_SOA_CHECK_Prepare("Veh_TurnOnSecRowLtSeatMassageRespStruct.Veh_TurnOnSecRowLtSeatMassageNRC 0 traceback5"); // 预期结果 TC_CANTest SOA check Veh_TurnOnSecRowLtSeatMassageRespStruct.Veh_TurnOnSecRowLtSeatMassageNRC 0 traceback5
  g_EM_SOAClient_Swc_SOA_CHECK_Prepare("Veh_SeatCtrlService_ErrStruct.OpeNRC 0 traceback7"); // 预期结果 TC_CANTest SOA check Veh_SeatCtrlService_ErrStruct.OpeNRC 0 traceback7
  g_EM_SOAClient_Swc_SOA_REQ("Veh_TurnOnSecRowLtSeatMassageStruct.Veh_SecRowLtSeatMassgIntenReq:2&Veh_SecRowLtSeatMassgProgReq:4&ServiceExecuteFeedbackFlag:2"); // 测试步骤 TC_CANTest SOA REQ Veh_TurnOnSecRowLtSeatMassageStruct.Veh_SecRowLtSeatMassgIntenReq:2&Veh_SecRowLtSeatMassgProgReq:4&ServiceExecuteFeedbackFlag:2
  g_CAN_Bus_Swc_CheckPeriod_FilterStarted("I_CDCU_SeatCtrl.I_CDCU_SecRowLtSeatMassgIntenCmd,I_CDCU_SecRowLtSeatMassgProgCmd 2:0,4:0 3;50;50"); // 预期结果 TC_CANTest CheckPeriod_FilterStarted I_CDCU_SeatCtrl.I_CDCU_SecRowLtSeatMassgIntenCmd,I_CDCU_SecRowLtSeatMassgProgCmd 2:0,4:0 3;50;50
  g_EM_SOAClient_Swc_SOA_CHECK("Veh_TurnOnSecRowLtSeatMassageRespStruct.Veh_TurnOnSecRowLtSeatMassageNRC 0 traceback5"); // 预期结果 TC_CANTest SOA check Veh_TurnOnSecRowLtSeatMassageRespStruct.Veh_TurnOnSecRowLtSeatMassageNRC 0 traceback5
  g_CAN_Bus_Swc_Set("I_LDCU_SeatSysSts.I_LDCU_SecRowLtSeatMassgIntenSts 1,I_LDCU_SecRowLtSeatMassgProgSts 3"); // 测试步骤 TC_CANTest SET I_LDCU_SeatSysSts.I_LDCU_SecRowLtSeatMassgIntenSts 1,I_LDCU_SecRowLtSeatMassgProgSts 3
  g_EM_SOAClient_Swc_SOA_CHECK("Veh_SeatCtrlService_ErrStruct.OpeNRC 0 traceback7"); // 预期结果 TC_CANTest SOA check Veh_SeatCtrlService_ErrStruct.OpeNRC 0 traceback7
}

testcase SYS_CDCU_erpaizuocezuoyianmo_0026()
{
  TestDescription("打开二排左侧座椅按摩-3");
  teststep("warning","原始用例id为SYS-CDCU-二排左侧座椅按摩-0026");
  g_CAN_Bus_Swc_CheckEventStart("I_CDCU_SeatCtrl.I_CDCU_SecRowLtSeatMassgIntenCmd 3,I_CDCU_SecRowLtSeatMassgProgCmd 12"); // 测试步骤 TC_CANTest CheckEventStart I_CDCU_SeatCtrl.I_CDCU_SecRowLtSeatMassgIntenCmd 3,I_CDCU_SecRowLtSeatMassgProgCmd 12
  g_EM_SOAClient_Swc_SOA_CHECK_Prepare("Veh_TurnOnSecRowLtSeatMassageRespStruct.Veh_TurnOnSecRowLtSeatMassageNRC 0"); // 预期结果 TC_CANTest SOA check Veh_TurnOnSecRowLtSeatMassageRespStruct.Veh_TurnOnSecRowLtSeatMassageNRC 0
  g_EM_SOAClient_Swc_SOA_CHECK_Prepare("Veh_SeatCtrlService_ErrStruct.OpeNRC 0 traceback7"); // 预期结果 TC_CANTest SOA check Veh_SeatCtrlService_ErrStruct.OpeNRC 0 traceback7
  g_EM_SOAClient_Swc_SOA_REQ("Veh_TurnOnSecRowLtSeatMassageStruct.Veh_SecRowLtSeatMassgIntenReq:3&Veh_SecRowLtSeatMassgProgReq:12&ServiceExecuteFeedbackFlag:2"); // 测试步骤 TC_CANTest SOA REQ Veh_TurnOnSecRowLtSeatMassageStruct.Veh_SecRowLtSeatMassgIntenReq:3&Veh_SecRowLtSeatMassgProgReq:12&ServiceExecuteFeedbackFlag:2
  g_EM_SOAClient_Swc_SOA_CHECK("Veh_TurnOnSecRowLtSeatMassageRespStruct.Veh_TurnOnSecRowLtSeatMassageNRC 0"); // 预期结果 TC_CANTest SOA check Veh_TurnOnSecRowLtSeatMassageRespStruct.Veh_TurnOnSecRowLtSeatMassageNRC 0
  g_CAN_Bus_Swc_CheckPeriod_FilterStarted("I_CDCU_SeatCtrl.I_CDCU_SecRowLtSeatMassgIntenCmd,I_CDCU_SecRowLtSeatMassgProgCmd 3:0,12:0 3;50;50"); // 预期结果 TC_CANTest CheckPeriod_FilterStarted I_CDCU_SeatCtrl.I_CDCU_SecRowLtSeatMassgIntenCmd,I_CDCU_SecRowLtSeatMassgProgCmd 3:0,12:0 3;50;50
  g_CAN_Bus_Swc_Set("I_LDCU_SeatSysSts.I_LDCU_SecRowLtSeatMassgIntenSts 2,I_LDCU_SecRowLtSeatMassgProgSts 11"); // 测试步骤 TC_CANTest SET I_LDCU_SeatSysSts.I_LDCU_SecRowLtSeatMassgIntenSts 2,I_LDCU_SecRowLtSeatMassgProgSts 11
  g_EM_SOAClient_Swc_SOA_CHECK("Veh_SeatCtrlService_ErrStruct.OpeNRC 0 traceback7"); // 预期结果 TC_CANTest SOA check Veh_SeatCtrlService_ErrStruct.OpeNRC 0 traceback7
}

testcase SYS_CDCU_erpaizuocezuoyianmo_0027()
{
  TestDescription("关闭二排左侧座椅按摩-off");
  teststep("warning","原始用例id为SYS-CDCU-二排左侧座椅按摩-0027");
  g_CAN_Bus_Swc_CheckEventStart("I_CDCU_SeatCtrl.I_CDCU_SecRowLtSeatMassgProgCmd 1"); // 测试步骤 TC_CANTest CheckEventStart I_CDCU_SeatCtrl.I_CDCU_SecRowLtSeatMassgProgCmd 1
  g_EM_SOAClient_Swc_SOA_CHECK_Prepare("Veh_TurnOffSecRowLtSeatMassageRespStruct.Veh_TurnOffSecRowLtSeatMassageNRC 0"); // 预期结果 TC_CANTest SOA check Veh_TurnOffSecRowLtSeatMassageRespStruct.Veh_TurnOffSecRowLtSeatMassageNRC 0
  g_EM_SOAClient_Swc_SOA_CHECK_Prepare("Veh_SeatCtrlService_ErrStruct.OpeNRC 0 traceback7"); // 预期结果 TC_CANTest SOA check Veh_SeatCtrlService_ErrStruct.OpeNRC 0 traceback7
  g_EM_SOAClient_Swc_SOA_REQ("Veh_TurnOffSecRowLtSeatMassageStruct.Veh_SecRowLtSeatMassgProgReq:1&ServiceExecuteFeedbackFlag:2"); // 测试步骤 TC_CANTest SOA REQ Veh_TurnOffSecRowLtSeatMassageStruct.Veh_SecRowLtSeatMassgProgReq:1&ServiceExecuteFeedbackFlag:2
  g_EM_SOAClient_Swc_SOA_CHECK("Veh_TurnOffSecRowLtSeatMassageRespStruct.Veh_TurnOffSecRowLtSeatMassageNRC 0"); // 预期结果 TC_CANTest SOA check Veh_TurnOffSecRowLtSeatMassageRespStruct.Veh_TurnOffSecRowLtSeatMassageNRC 0
  g_CAN_Bus_Swc_CheckPeriod_FilterStarted("I_CDCU_SeatCtrl.I_CDCU_SecRowLtSeatMassgProgCmd 1:0 3;50;50"); // 预期结果 TC_CANTest CheckPeriod_FilterStarted I_CDCU_SeatCtrl.I_CDCU_SecRowLtSeatMassgProgCmd 1:0 3;50;50
  g_CAN_Bus_Swc_Set("I_LDCU_SeatSysSts.I_LDCU_SecRowLtSeatMassgProgSts 0"); // 测试步骤 TC_CANTest SET I_LDCU_SeatSysSts.I_LDCU_SecRowLtSeatMassgProgSts 0
  g_EM_SOAClient_Swc_SOA_CHECK("Veh_SeatCtrlService_ErrStruct.OpeNRC 0 traceback7"); // 预期结果 TC_CANTest SOA check Veh_SeatCtrlService_ErrStruct.OpeNRC 0 traceback7
}

testcase SYS_CDCU_erpaizuocezuoyianmo_0028()
{
  TestDescription("调节二排左侧座椅按摩力度-1");
  teststep("warning","原始用例id为SYS-CDCU-二排左侧座椅按摩-0028");
  g_CAN_Bus_Swc_CheckEventStart("I_CDCU_SeatCtrl.I_CDCU_SecRowLtSeatMassgIntenCmd 1"); // 测试步骤 TC_CANTest CheckEventStart I_CDCU_SeatCtrl.I_CDCU_SecRowLtSeatMassgIntenCmd 1
  g_EM_SOAClient_Swc_SOA_CHECK_Prepare("Veh_SetSecRowLtSeatMassageIntensityRespStruct.Veh_SetSecRowLtSeatMassageIntensityNRC 0"); // 预期结果 TC_CANTest SOA check Veh_SetSecRowLtSeatMassageIntensityRespStruct.Veh_SetSecRowLtSeatMassageIntensityNRC 0
  g_EM_SOAClient_Swc_SOA_CHECK_Prepare("Veh_SeatCtrlService_ErrStruct.OpeNRC 0 traceback7"); // 预期结果 TC_CANTest SOA check Veh_SeatCtrlService_ErrStruct.OpeNRC 0 traceback7
  g_EM_SOAClient_Swc_SOA_REQ("Veh_SetSecRowLtSeatMassageIntensityStruct.Veh_SecRowLtSeatMassgIntenReq:1&ServiceExecuteFeedbackFlag:2"); // 测试步骤 TC_CANTest SOA REQ Veh_SetSecRowLtSeatMassageIntensityStruct.Veh_SecRowLtSeatMassgIntenReq:1&ServiceExecuteFeedbackFlag:2
  g_EM_SOAClient_Swc_SOA_CHECK("Veh_SetSecRowLtSeatMassageIntensityRespStruct.Veh_SetSecRowLtSeatMassageIntensityNRC 0"); // 预期结果 TC_CANTest SOA check Veh_SetSecRowLtSeatMassageIntensityRespStruct.Veh_SetSecRowLtSeatMassageIntensityNRC 0
  g_CAN_Bus_Swc_CheckPeriod_FilterStarted("I_CDCU_SeatCtrl.I_CDCU_SecRowLtSeatMassgIntenCmd 1:0 3;50;50"); // 预期结果 TC_CANTest CheckPeriod_FilterStarted I_CDCU_SeatCtrl.I_CDCU_SecRowLtSeatMassgIntenCmd 1:0 3;50;50
  g_CAN_Bus_Swc_Set("I_LDCU_SeatSysSts.I_LDCU_SecRowLtSeatMassgIntenSts 0"); // 测试步骤 TC_CANTest SET I_LDCU_SeatSysSts.I_LDCU_SecRowLtSeatMassgIntenSts 0
  g_EM_SOAClient_Swc_SOA_CHECK("Veh_SeatCtrlService_ErrStruct.OpeNRC 0 traceback7"); // 预期结果 TC_CANTest SOA check Veh_SeatCtrlService_ErrStruct.OpeNRC 0 traceback7
  g_EM_Equipment_Swc_TC_4G_Time_Delay_Second("885"); // 测试步骤 TC_Sleep 885
  g_CAN_Bus_Swc_CheckEventStart("I_CDCU_SeatCtrl.I_CDCU_SecRowLtSeatMassgProgCmd 1"); // 测试步骤 TC_CANTest CheckEventStart I_CDCU_SeatCtrl.I_CDCU_SecRowLtSeatMassgProgCmd 1
  g_EM_Equipment_Swc_TC_4G_Time_Delay_Second("15"); // 测试步骤 TC_Sleep 15
  g_CAN_Bus_Swc_CheckPeriod_FilterStarted("I_CDCU_SeatCtrl.I_CDCU_SecRowLtSeatMassgProgCmd 1:0 3;50;50"); // 预期结果 TC_CANTest CheckPeriod_FilterStarted I_CDCU_SeatCtrl.I_CDCU_SecRowLtSeatMassgProgCmd 1:0 3;50;50
}

testcase SYS_CDCU_erpaizuocezuoyianmo_0029()
{
  TestDescription("调节二排左侧座椅按摩力度-2");
  teststep("warning","原始用例id为SYS-CDCU-二排左侧座椅按摩-0029");
  g_CAN_Bus_Swc_CheckEventStart("I_CDCU_SeatCtrl.I_CDCU_SecRowLtSeatMassgIntenCmd 2"); // 测试步骤 TC_CANTest CheckEventStart I_CDCU_SeatCtrl.I_CDCU_SecRowLtSeatMassgIntenCmd 2
  g_EM_SOAClient_Swc_SOA_CHECK_Prepare("Veh_SetSecRowLtSeatMassageIntensityRespStruct.Veh_SetSecRowLtSeatMassageIntensityNRC 0"); // 预期结果 TC_CANTest SOA check Veh_SetSecRowLtSeatMassageIntensityRespStruct.Veh_SetSecRowLtSeatMassageIntensityNRC 0
  g_EM_SOAClient_Swc_SOA_CHECK_Prepare("Veh_SeatCtrlService_ErrStruct.OpeNRC 0 traceback7"); // 预期结果 TC_CANTest SOA check Veh_SeatCtrlService_ErrStruct.OpeNRC 0 traceback7
  g_EM_SOAClient_Swc_SOA_REQ("Veh_SetSecRowLtSeatMassageIntensityStruct.Veh_SecRowLtSeatMassgIntenReq:2&ServiceExecuteFeedbackFlag:2"); // 测试步骤 TC_CANTest SOA REQ Veh_SetSecRowLtSeatMassageIntensityStruct.Veh_SecRowLtSeatMassgIntenReq:2&ServiceExecuteFeedbackFlag:2
  g_EM_SOAClient_Swc_SOA_CHECK("Veh_SetSecRowLtSeatMassageIntensityRespStruct.Veh_SetSecRowLtSeatMassageIntensityNRC 0"); // 预期结果 TC_CANTest SOA check Veh_SetSecRowLtSeatMassageIntensityRespStruct.Veh_SetSecRowLtSeatMassageIntensityNRC 0
  g_CAN_Bus_Swc_CheckPeriod_FilterStarted("I_CDCU_SeatCtrl.I_CDCU_SecRowLtSeatMassgIntenCmd 2:0 3;50;50"); // 预期结果 TC_CANTest CheckPeriod_FilterStarted I_CDCU_SeatCtrl.I_CDCU_SecRowLtSeatMassgIntenCmd 2:0 3;50;50
  g_CAN_Bus_Swc_Set("I_LDCU_SeatSysSts.I_LDCU_SecRowLtSeatMassgIntenSts 1"); // 测试步骤 TC_CANTest SET I_LDCU_SeatSysSts.I_LDCU_SecRowLtSeatMassgIntenSts 1
  g_EM_SOAClient_Swc_SOA_CHECK("Veh_SeatCtrlService_ErrStruct.OpeNRC 0 traceback7"); // 预期结果 TC_CANTest SOA check Veh_SeatCtrlService_ErrStruct.OpeNRC 0 traceback7
}

testcase SYS_CDCU_erpaizuocezuoyianmo_0030()
{
  TestDescription("关闭二排左侧座椅按摩-off");
  teststep("warning","原始用例id为SYS-CDCU-二排左侧座椅按摩-0030");
  g_CAN_Bus_Swc_CheckEventStart("I_CDCU_SeatCtrl.I_CDCU_SecRowLtSeatMassgProgCmd 1"); // 测试步骤 TC_CANTest CheckEventStart I_CDCU_SeatCtrl.I_CDCU_SecRowLtSeatMassgProgCmd 1
  g_EM_SOAClient_Swc_SOA_CHECK_Prepare("Veh_TurnOffSecRowLtSeatMassageRespStruct.Veh_TurnOffSecRowLtSeatMassageNRC 0"); // 预期结果 TC_CANTest SOA check Veh_TurnOffSecRowLtSeatMassageRespStruct.Veh_TurnOffSecRowLtSeatMassageNRC 0
  g_EM_SOAClient_Swc_SOA_CHECK_Prepare("Veh_SeatCtrlService_ErrStruct.OpeNRC 0 traceback7"); // 预期结果 TC_CANTest SOA check Veh_SeatCtrlService_ErrStruct.OpeNRC 0 traceback7
  g_EM_SOAClient_Swc_SOA_REQ("Veh_TurnOffSecRowLtSeatMassageStruct.Veh_SecRowLtSeatMassgProgReq:1&ServiceExecuteFeedbackFlag:2"); // 测试步骤 TC_CANTest SOA REQ Veh_TurnOffSecRowLtSeatMassageStruct.Veh_SecRowLtSeatMassgProgReq:1&ServiceExecuteFeedbackFlag:2
  g_EM_SOAClient_Swc_SOA_CHECK("Veh_TurnOffSecRowLtSeatMassageRespStruct.Veh_TurnOffSecRowLtSeatMassageNRC 0"); // 预期结果 TC_CANTest SOA check Veh_TurnOffSecRowLtSeatMassageRespStruct.Veh_TurnOffSecRowLtSeatMassageNRC 0
  g_CAN_Bus_Swc_CheckPeriod_FilterStarted("I_CDCU_SeatCtrl.I_CDCU_SecRowLtSeatMassgProgCmd 1:0 3;50;50"); // 预期结果 TC_CANTest CheckPeriod_FilterStarted I_CDCU_SeatCtrl.I_CDCU_SecRowLtSeatMassgProgCmd 1:0 3;50;50
  g_CAN_Bus_Swc_Set("I_LDCU_SeatSysSts.I_LDCU_SecRowLtSeatMassgProgSts 0"); // 测试步骤 TC_CANTest SET I_LDCU_SeatSysSts.I_LDCU_SecRowLtSeatMassgProgSts 0
  g_EM_SOAClient_Swc_SOA_CHECK("Veh_SeatCtrlService_ErrStruct.OpeNRC 0 traceback7"); // 预期结果 TC_CANTest SOA check Veh_SeatCtrlService_ErrStruct.OpeNRC 0 traceback7
}

testcase SYS_CDCU_erpaizuocezuoyianmo_0031()
{
  TestDescription("打开二排左侧座椅按摩模式-1");
  teststep("warning","原始用例id为SYS-CDCU-二排左侧座椅按摩-0031");
  g_CAN_Bus_Swc_CheckEventStart("I_CDCU_SeatCtrl.I_CDCU_SecRowLtSeatMassgProgCmd 3"); // 测试步骤 TC_CANTest CheckEventStart I_CDCU_SeatCtrl.I_CDCU_SecRowLtSeatMassgProgCmd 3
  g_EM_SOAClient_Swc_SOA_CHECK_Prepare("Veh_SetSecRowLtSeatMassageModeRespStruct.Veh_SetSecRowLtSeatMassageModeNRC 0"); // 预期结果 TC_CANTest SOA check Veh_SetSecRowLtSeatMassageModeRespStruct.Veh_SetSecRowLtSeatMassageModeNRC 0
  g_EM_SOAClient_Swc_SOA_CHECK_Prepare("Veh_SeatCtrlService_ErrStruct.OpeNRC 0 traceback7"); // 预期结果 TC_CANTest SOA check Veh_SeatCtrlService_ErrStruct.OpeNRC 0 traceback7
  g_EM_SOAClient_Swc_SOA_REQ("Veh_SetSecRowLtSeatMassageModeStruct.Veh_SecRowLtSeatMassgProgReq:3&ServiceExecuteFeedbackFlag:2"); // 测试步骤 TC_CANTest SOA REQ Veh_SetSecRowLtSeatMassageModeStruct.Veh_SecRowLtSeatMassgProgReq:3&ServiceExecuteFeedbackFlag:2
  g_EM_SOAClient_Swc_SOA_CHECK("Veh_SetSecRowLtSeatMassageModeRespStruct.Veh_SetSecRowLtSeatMassageModeNRC 0"); // 预期结果 TC_CANTest SOA check Veh_SetSecRowLtSeatMassageModeRespStruct.Veh_SetSecRowLtSeatMassageModeNRC 0
  g_CAN_Bus_Swc_CheckPeriod_FilterStarted("I_CDCU_SeatCtrl.I_CDCU_SecRowLtSeatMassgProgCmd 3:0 3;50;50"); // 预期结果 TC_CANTest CheckPeriod_FilterStarted I_CDCU_SeatCtrl.I_CDCU_SecRowLtSeatMassgProgCmd 3:0 3;50;50
  g_CAN_Bus_Swc_Set("I_LDCU_SeatSysSts.I_LDCU_SecRowLtSeatMassgProgSts 2"); // 测试步骤 TC_CANTest SET I_LDCU_SeatSysSts.I_LDCU_SecRowLtSeatMassgProgSts 2
  g_EM_SOAClient_Swc_SOA_CHECK("Veh_SeatCtrlService_ErrStruct.OpeNRC 0 traceback7"); // 预期结果 TC_CANTest SOA check Veh_SeatCtrlService_ErrStruct.OpeNRC 0 traceback7
  g_EM_Equipment_Swc_TC_4G_Time_Delay_Second("885"); // 测试步骤 TC_Sleep 885
  g_CAN_Bus_Swc_CheckEventStart("I_CDCU_SeatCtrl.I_CDCU_SecRowLtSeatMassgProgCmd 1"); // 测试步骤 TC_CANTest CheckEventStart I_CDCU_SeatCtrl.I_CDCU_SecRowLtSeatMassgProgCmd 1
  g_EM_Equipment_Swc_TC_4G_Time_Delay_Second("15"); // 测试步骤 TC_Sleep 15
  g_CAN_Bus_Swc_CheckPeriod_FilterStarted("I_CDCU_SeatCtrl.I_CDCU_SecRowLtSeatMassgProgCmd 1:0 3;50;50"); // 预期结果 TC_CANTest CheckPeriod_FilterStarted I_CDCU_SeatCtrl.I_CDCU_SecRowLtSeatMassgProgCmd 1:0 3;50;50
}

testcase SYS_CDCU_erpaizuocezuoyianmo_0032()
{
  TestDescription("打开二排左侧座椅按摩模式-2");
  teststep("warning","原始用例id为SYS-CDCU-二排左侧座椅按摩-0032");
  g_CAN_Bus_Swc_CheckEventStart("I_CDCU_SeatCtrl.I_CDCU_SecRowLtSeatMassgProgCmd 8"); // 测试步骤 TC_CANTest CheckEventStart I_CDCU_SeatCtrl.I_CDCU_SecRowLtSeatMassgProgCmd 8
  g_EM_SOAClient_Swc_SOA_CHECK_Prepare("Veh_SetSecRowLtSeatMassageModeRespStruct.Veh_SetSecRowLtSeatMassageModeNRC 0"); // 预期结果 TC_CANTest SOA check Veh_SetSecRowLtSeatMassageModeRespStruct.Veh_SetSecRowLtSeatMassageModeNRC 0
  g_EM_SOAClient_Swc_SOA_CHECK_Prepare("Veh_SeatCtrlService_ErrStruct.OpeNRC 0 traceback7"); // 预期结果 TC_CANTest SOA check Veh_SeatCtrlService_ErrStruct.OpeNRC 0 traceback7
  g_EM_SOAClient_Swc_SOA_REQ("Veh_SetSecRowLtSeatMassageModeStruct.Veh_SecRowLtSeatMassgProgReq:8&ServiceExecuteFeedbackFlag:2"); // 测试步骤 TC_CANTest SOA REQ Veh_SetSecRowLtSeatMassageModeStruct.Veh_SecRowLtSeatMassgProgReq:8&ServiceExecuteFeedbackFlag:2
  g_EM_SOAClient_Swc_SOA_CHECK("Veh_SetSecRowLtSeatMassageModeRespStruct.Veh_SetSecRowLtSeatMassageModeNRC 0"); // 预期结果 TC_CANTest SOA check Veh_SetSecRowLtSeatMassageModeRespStruct.Veh_SetSecRowLtSeatMassageModeNRC 0
  g_CAN_Bus_Swc_CheckPeriod_FilterStarted("I_CDCU_SeatCtrl.I_CDCU_SecRowLtSeatMassgProgCmd 8:0 3;50;50"); // 预期结果 TC_CANTest CheckPeriod_FilterStarted I_CDCU_SeatCtrl.I_CDCU_SecRowLtSeatMassgProgCmd 8:0 3;50;50
  g_CAN_Bus_Swc_Set("I_LDCU_SeatSysSts.I_LDCU_SecRowLtSeatMassgProgSts 7"); // 测试步骤 TC_CANTest SET I_LDCU_SeatSysSts.I_LDCU_SecRowLtSeatMassgProgSts 7
  g_EM_SOAClient_Swc_SOA_CHECK("Veh_SeatCtrlService_ErrStruct.OpeNRC 0 traceback7"); // 预期结果 TC_CANTest SOA check Veh_SeatCtrlService_ErrStruct.OpeNRC 0 traceback7
}

testcase SYS_CDCU_erpaizuocezuoyianmo_0033()
{
  TestDescription("打开二排左侧座椅按摩模式-3");
  teststep("warning","原始用例id为SYS-CDCU-二排左侧座椅按摩-0033");
  g_CAN_Bus_Swc_CheckEventStart("I_CDCU_SeatCtrl.I_CDCU_SecRowLtSeatMassgProgCmd 13"); // 测试步骤 TC_CANTest CheckEventStart I_CDCU_SeatCtrl.I_CDCU_SecRowLtSeatMassgProgCmd 13
  g_EM_SOAClient_Swc_SOA_CHECK_Prepare("Veh_SetSecRowLtSeatMassageModeRespStruct.Veh_SetSecRowLtSeatMassageModeNRC 0"); // 预期结果 TC_CANTest SOA check Veh_SetSecRowLtSeatMassageModeRespStruct.Veh_SetSecRowLtSeatMassageModeNRC 0
  g_EM_SOAClient_Swc_SOA_CHECK_Prepare("Veh_SeatCtrlService_ErrStruct.OpeNRC 0 traceback7"); // 预期结果 TC_CANTest SOA check Veh_SeatCtrlService_ErrStruct.OpeNRC 0 traceback7
  g_EM_SOAClient_Swc_SOA_REQ("Veh_SetSecRowLtSeatMassageModeStruct.Veh_SecRowLtSeatMassgProgReq:13&ServiceExecuteFeedbackFlag:2"); // 测试步骤 TC_CANTest SOA REQ Veh_SetSecRowLtSeatMassageModeStruct.Veh_SecRowLtSeatMassgProgReq:13&ServiceExecuteFeedbackFlag:2
  g_EM_SOAClient_Swc_SOA_CHECK("Veh_SetSecRowLtSeatMassageModeRespStruct.Veh_SetSecRowLtSeatMassageModeNRC 0"); // 预期结果 TC_CANTest SOA check Veh_SetSecRowLtSeatMassageModeRespStruct.Veh_SetSecRowLtSeatMassageModeNRC 0
  g_CAN_Bus_Swc_CheckPeriod_FilterStarted("I_CDCU_SeatCtrl.I_CDCU_SecRowLtSeatMassgProgCmd 13:0 3;50;50"); // 预期结果 TC_CANTest CheckPeriod_FilterStarted I_CDCU_SeatCtrl.I_CDCU_SecRowLtSeatMassgProgCmd 13:0 3;50;50
  g_CAN_Bus_Swc_Set("I_LDCU_SeatSysSts.I_LDCU_SecRowLtSeatMassgProgSts 12"); // 测试步骤 TC_CANTest SET I_LDCU_SeatSysSts.I_LDCU_SecRowLtSeatMassgProgSts 12
  g_EM_SOAClient_Swc_SOA_CHECK("Veh_SeatCtrlService_ErrStruct.OpeNRC 0 traceback7"); // 预期结果 TC_CANTest SOA check Veh_SeatCtrlService_ErrStruct.OpeNRC 0 traceback7
}

testcase SYS_CDCU_erpaizuocezuoyianmo_0034()
{
  TestDescription("关闭二排左侧座椅按摩-off");
  teststep("warning","原始用例id为SYS-CDCU-二排左侧座椅按摩-0034");
  g_CAN_Bus_Swc_CheckEventStart("I_CDCU_SeatCtrl.I_CDCU_SecRowLtSeatMassgProgCmd 1"); // 测试步骤 TC_CANTest CheckEventStart I_CDCU_SeatCtrl.I_CDCU_SecRowLtSeatMassgProgCmd 1
  g_EM_SOAClient_Swc_SOA_CHECK_Prepare("Veh_TurnOffSecRowLtSeatMassageRespStruct.Veh_TurnOffSecRowLtSeatMassageNRC 0"); // 预期结果 TC_CANTest SOA check Veh_TurnOffSecRowLtSeatMassageRespStruct.Veh_TurnOffSecRowLtSeatMassageNRC 0
  g_EM_SOAClient_Swc_SOA_CHECK_Prepare("Veh_SeatCtrlService_ErrStruct.OpeNRC 0 traceback7"); // 预期结果 TC_CANTest SOA check Veh_SeatCtrlService_ErrStruct.OpeNRC 0 traceback7
  g_EM_SOAClient_Swc_SOA_REQ("Veh_TurnOffSecRowLtSeatMassageStruct.Veh_SecRowLtSeatMassgProgReq:1&ServiceExecuteFeedbackFlag:2"); // 测试步骤 TC_CANTest SOA REQ Veh_TurnOffSecRowLtSeatMassageStruct.Veh_SecRowLtSeatMassgProgReq:1&ServiceExecuteFeedbackFlag:2
  g_EM_SOAClient_Swc_SOA_CHECK("Veh_TurnOffSecRowLtSeatMassageRespStruct.Veh_TurnOffSecRowLtSeatMassageNRC 0"); // 预期结果 TC_CANTest SOA check Veh_TurnOffSecRowLtSeatMassageRespStruct.Veh_TurnOffSecRowLtSeatMassageNRC 0
  g_CAN_Bus_Swc_CheckPeriod_FilterStarted("I_CDCU_SeatCtrl.I_CDCU_SecRowLtSeatMassgProgCmd 1:0 3;50;50"); // 预期结果 TC_CANTest CheckPeriod_FilterStarted I_CDCU_SeatCtrl.I_CDCU_SecRowLtSeatMassgProgCmd 1:0 3;50;50
  g_CAN_Bus_Swc_Set("I_LDCU_SeatSysSts.I_LDCU_SecRowLtSeatMassgProgSts 0"); // 测试步骤 TC_CANTest SET I_LDCU_SeatSysSts.I_LDCU_SecRowLtSeatMassgProgSts 0
  g_EM_SOAClient_Swc_SOA_CHECK("Veh_SeatCtrlService_ErrStruct.OpeNRC 0 traceback7"); // 预期结果 TC_CANTest SOA check Veh_SeatCtrlService_ErrStruct.OpeNRC 0 traceback7
}

testcase SYS_CDCU_erpaiyoucezuoyianmo_0035()
{
  TestDescription("打开二排右侧座椅按摩-1");
  teststep("warning","原始用例id为SYS-CDCU-二排右侧座椅按摩-0035");
  g_CAN_Bus_Swc_CheckEventStart("I_CDCU_SeatCtrl.I_CDCU_SecRowRtSeatMassgIntenCmd 1,I_CDCU_SecRowRtSeatMassgProgCmd 2"); // 测试步骤 TC_CANTest CheckEventStart I_CDCU_SeatCtrl.I_CDCU_SecRowRtSeatMassgIntenCmd 1,I_CDCU_SecRowRtSeatMassgProgCmd 2
  g_EM_SOAClient_Swc_SOA_CHECK_Prepare("Veh_TurnOnSecRowRtSeatMassageRespStruct.Veh_TurnOnSecRowRtSeatMassageNRC 0 traceback5"); // 预期结果 TC_CANTest SOA check Veh_TurnOnSecRowRtSeatMassageRespStruct.Veh_TurnOnSecRowRtSeatMassageNRC 0 traceback5
  g_EM_SOAClient_Swc_SOA_CHECK_Prepare("Veh_SeatCtrlService_ErrStruct.OpeNRC 0 traceback7"); // 预期结果 TC_CANTest SOA check Veh_SeatCtrlService_ErrStruct.OpeNRC 0 traceback7
  g_EM_SOAClient_Swc_SOA_REQ("Veh_TurnOnSecRowRtSeatMassageStruct.Veh_SecRowRtSeatMassgIntenReq:1&Veh_SecRowRtSeatMassgProgReq:2&ServiceExecuteFeedbackFlag:2"); // 测试步骤 TC_CANTest SOA REQ Veh_TurnOnSecRowRtSeatMassageStruct.Veh_SecRowRtSeatMassgIntenReq:1&Veh_SecRowRtSeatMassgProgReq:2&ServiceExecuteFeedbackFlag:2
  g_CAN_Bus_Swc_CheckPeriod_FilterStarted("I_CDCU_SeatCtrl.I_CDCU_SecRowRtSeatMassgIntenCmd,I_CDCU_SecRowRtSeatMassgProgCmd 1:0,2:0 3;50;50"); // 预期结果 TC_CANTest CheckPeriod_FilterStarted I_CDCU_SeatCtrl.I_CDCU_SecRowRtSeatMassgIntenCmd,I_CDCU_SecRowRtSeatMassgProgCmd 1:0,2:0 3;50;50
  g_EM_SOAClient_Swc_SOA_CHECK("Veh_TurnOnSecRowRtSeatMassageRespStruct.Veh_TurnOnSecRowRtSeatMassageNRC 0 traceback5"); // 预期结果 TC_CANTest SOA check Veh_TurnOnSecRowRtSeatMassageRespStruct.Veh_TurnOnSecRowRtSeatMassageNRC 0 traceback5
  g_CAN_Bus_Swc_Set("I_RDCU_SeatInfo2.I_RDCU_SecRowRtSeatMassgIntenSts 0,I_RDCU_SecRowRtSeatMassgProgSts 1"); // 测试步骤 TC_CANTest SET I_RDCU_SeatInfo2.I_RDCU_SecRowRtSeatMassgIntenSts 0,I_RDCU_SecRowRtSeatMassgProgSts 1
  g_EM_SOAClient_Swc_SOA_CHECK("Veh_SeatCtrlService_ErrStruct.OpeNRC 0 traceback7"); // 预期结果 TC_CANTest SOA check Veh_SeatCtrlService_ErrStruct.OpeNRC 0 traceback7
}

testcase SYS_CDCU_erpaiyoucezuoyianmo_0036()
{
  TestDescription("打开二排右侧座椅按摩-2");
  teststep("warning","原始用例id为SYS-CDCU-二排右侧座椅按摩-0036");
  g_CAN_Bus_Swc_CheckEventStart("I_CDCU_SeatCtrl.I_CDCU_SecRowRtSeatMassgIntenCmd 2,I_CDCU_SecRowRtSeatMassgProgCmd 7"); // 测试步骤 TC_CANTest CheckEventStart I_CDCU_SeatCtrl.I_CDCU_SecRowRtSeatMassgIntenCmd 2,I_CDCU_SecRowRtSeatMassgProgCmd 7
  g_EM_SOAClient_Swc_SOA_CHECK_Prepare("Veh_TurnOnSecRowRtSeatMassageRespStruct.Veh_TurnOnSecRowRtSeatMassageNRC 0 traceback5"); // 预期结果 TC_CANTest SOA check Veh_TurnOnSecRowRtSeatMassageRespStruct.Veh_TurnOnSecRowRtSeatMassageNRC 0 traceback5
  g_EM_SOAClient_Swc_SOA_CHECK_Prepare("Veh_SeatCtrlService_ErrStruct.OpeNRC 0 traceback7"); // 预期结果 TC_CANTest SOA check Veh_SeatCtrlService_ErrStruct.OpeNRC 0 traceback7
  g_EM_SOAClient_Swc_SOA_REQ("Veh_TurnOnSecRowRtSeatMassageStruct.Veh_SecRowRtSeatMassgIntenReq:2&Veh_SecRowRtSeatMassgProgReq:7&ServiceExecuteFeedbackFlag:2"); // 测试步骤 TC_CANTest SOA REQ Veh_TurnOnSecRowRtSeatMassageStruct.Veh_SecRowRtSeatMassgIntenReq:2&Veh_SecRowRtSeatMassgProgReq:7&ServiceExecuteFeedbackFlag:2
  g_CAN_Bus_Swc_CheckPeriod_FilterStarted("I_CDCU_SeatCtrl.I_CDCU_SecRowRtSeatMassgIntenCmd,I_CDCU_SecRowRtSeatMassgProgCmd 2:0,7:0 3;50;50"); // 预期结果 TC_CANTest CheckPeriod_FilterStarted I_CDCU_SeatCtrl.I_CDCU_SecRowRtSeatMassgIntenCmd,I_CDCU_SecRowRtSeatMassgProgCmd 2:0,7:0 3;50;50
  g_EM_SOAClient_Swc_SOA_CHECK("Veh_TurnOnSecRowRtSeatMassageRespStruct.Veh_TurnOnSecRowRtSeatMassageNRC 0 traceback5"); // 预期结果 TC_CANTest SOA check Veh_TurnOnSecRowRtSeatMassageRespStruct.Veh_TurnOnSecRowRtSeatMassageNRC 0 traceback5
  g_CAN_Bus_Swc_Set("I_RDCU_SeatInfo2.I_RDCU_SecRowRtSeatMassgIntenSts 1,I_RDCU_SecRowRtSeatMassgProgSts 6"); // 测试步骤 TC_CANTest SET I_RDCU_SeatInfo2.I_RDCU_SecRowRtSeatMassgIntenSts 1,I_RDCU_SecRowRtSeatMassgProgSts 6
  g_EM_SOAClient_Swc_SOA_CHECK("Veh_SeatCtrlService_ErrStruct.OpeNRC 0 traceback7"); // 预期结果 TC_CANTest SOA check Veh_SeatCtrlService_ErrStruct.OpeNRC 0 traceback7
}

testcase SYS_CDCU_erpaiyoucezuoyianmo_0037()
{
  TestDescription("打开二排右侧座椅按摩-3");
  teststep("warning","原始用例id为SYS-CDCU-二排右侧座椅按摩-0037");
  g_CAN_Bus_Swc_CheckEventStart("I_CDCU_SeatCtrl.I_CDCU_SecRowRtSeatMassgIntenCmd 3,I_CDCU_SecRowRtSeatMassgProgCmd 11"); // 测试步骤 TC_CANTest CheckEventStart I_CDCU_SeatCtrl.I_CDCU_SecRowRtSeatMassgIntenCmd 3,I_CDCU_SecRowRtSeatMassgProgCmd 11
  g_EM_SOAClient_Swc_SOA_CHECK_Prepare("Veh_TurnOnSecRowRtSeatMassageRespStruct.Veh_TurnOnSecRowRtSeatMassageNRC 0 traceback5"); // 预期结果 TC_CANTest SOA check Veh_TurnOnSecRowRtSeatMassageRespStruct.Veh_TurnOnSecRowRtSeatMassageNRC 0 traceback5
  g_EM_SOAClient_Swc_SOA_CHECK_Prepare("Veh_SeatCtrlService_ErrStruct.OpeNRC 0 traceback7"); // 预期结果 TC_CANTest SOA check Veh_SeatCtrlService_ErrStruct.OpeNRC 0 traceback7
  g_EM_SOAClient_Swc_SOA_REQ("Veh_TurnOnSecRowRtSeatMassageStruct.Veh_SecRowRtSeatMassgIntenReq:3&Veh_SecRowRtSeatMassgProgReq:11&ServiceExecuteFeedbackFlag:2"); // 测试步骤 TC_CANTest SOA REQ Veh_TurnOnSecRowRtSeatMassageStruct.Veh_SecRowRtSeatMassgIntenReq:3&Veh_SecRowRtSeatMassgProgReq:11&ServiceExecuteFeedbackFlag:2
  g_CAN_Bus_Swc_CheckPeriod_FilterStarted("I_CDCU_SeatCtrl.I_CDCU_SecRowRtSeatMassgIntenCmd,I_CDCU_SecRowRtSeatMassgProgCmd 3:0,11:0 3;50;50"); // 预期结果 TC_CANTest CheckPeriod_FilterStarted I_CDCU_SeatCtrl.I_CDCU_SecRowRtSeatMassgIntenCmd,I_CDCU_SecRowRtSeatMassgProgCmd 3:0,11:0 3;50;50
  g_EM_SOAClient_Swc_SOA_CHECK("Veh_TurnOnSecRowRtSeatMassageRespStruct.Veh_TurnOnSecRowRtSeatMassageNRC 0 traceback5"); // 预期结果 TC_CANTest SOA check Veh_TurnOnSecRowRtSeatMassageRespStruct.Veh_TurnOnSecRowRtSeatMassageNRC 0 traceback5
  g_CAN_Bus_Swc_Set("I_RDCU_SeatInfo2.I_RDCU_SecRowRtSeatMassgIntenSts 2,I_RDCU_SecRowRtSeatMassgProgSts 10"); // 测试步骤 TC_CANTest SET I_RDCU_SeatInfo2.I_RDCU_SecRowRtSeatMassgIntenSts 2,I_RDCU_SecRowRtSeatMassgProgSts 10
  g_EM_SOAClient_Swc_SOA_CHECK("Veh_SeatCtrlService_ErrStruct.OpeNRC 0 traceback7"); // 预期结果 TC_CANTest SOA check Veh_SeatCtrlService_ErrStruct.OpeNRC 0 traceback7
}

testcase SYS_CDCU_erpaiyoucezuoyianmo_0038()
{
  TestDescription("调节二排右侧座椅按摩力度-1");
  teststep("warning","原始用例id为SYS-CDCU-二排右侧座椅按摩-0038");
  g_CAN_Bus_Swc_CheckEventStart("I_CDCU_SeatCtrl.I_CDCU_SecRowRtSeatMassgIntenCmd 1"); // 测试步骤 TC_CANTest CheckEventStart I_CDCU_SeatCtrl.I_CDCU_SecRowRtSeatMassgIntenCmd 1
  g_EM_SOAClient_Swc_SOA_CHECK_Prepare("Veh_SetSecRowRtSeatMassageIntensityRespStruct.Veh_SetSecRowRtSeatMassageIntensityNRC 0 traceback5"); // 预期结果 TC_CANTest SOA check Veh_SetSecRowRtSeatMassageIntensityRespStruct.Veh_SetSecRowRtSeatMassageIntensityNRC 0 traceback5
  g_EM_SOAClient_Swc_SOA_CHECK_Prepare("Veh_SeatCtrlService_ErrStruct.OpeNRC 0 traceback7"); // 预期结果 TC_CANTest SOA check Veh_SeatCtrlService_ErrStruct.OpeNRC 0 traceback7
  g_EM_SOAClient_Swc_SOA_REQ("Veh_SetSecRowRtSeatMassageIntensityStruct.Veh_SecRowRtSeatMassgIntenReq:1&ServiceExecuteFeedbackFlag:2"); // 测试步骤 TC_CANTest SOA REQ Veh_SetSecRowRtSeatMassageIntensityStruct.Veh_SecRowRtSeatMassgIntenReq:1&ServiceExecuteFeedbackFlag:2
  g_CAN_Bus_Swc_CheckPeriod_FilterStarted("I_CDCU_SeatCtrl.I_CDCU_SecRowRtSeatMassgIntenCmd 1:0 3;50;50"); // 预期结果 TC_CANTest CheckPeriod_FilterStarted I_CDCU_SeatCtrl.I_CDCU_SecRowRtSeatMassgIntenCmd 1:0 3;50;50
  g_EM_SOAClient_Swc_SOA_CHECK("Veh_SetSecRowRtSeatMassageIntensityRespStruct.Veh_SetSecRowRtSeatMassageIntensityNRC 0 traceback5"); // 预期结果 TC_CANTest SOA check Veh_SetSecRowRtSeatMassageIntensityRespStruct.Veh_SetSecRowRtSeatMassageIntensityNRC 0 traceback5
  g_CAN_Bus_Swc_Set("I_RDCU_SeatInfo2.I_RDCU_SecRowRtSeatMassgIntenSts 0"); // 测试步骤 TC_CANTest SET I_RDCU_SeatInfo2.I_RDCU_SecRowRtSeatMassgIntenSts 0
  g_EM_SOAClient_Swc_SOA_CHECK("Veh_SeatCtrlService_ErrStruct.OpeNRC 0 traceback7"); // 预期结果 TC_CANTest SOA check Veh_SeatCtrlService_ErrStruct.OpeNRC 0 traceback7
}

testcase SYS_CDCU_erpaiyoucezuoyianmo_0039()
{
  TestDescription("调节二排右侧座椅按摩力度-2");
  teststep("warning","原始用例id为SYS-CDCU-二排右侧座椅按摩-0039");
  g_CAN_Bus_Swc_CheckEventStart("I_CDCU_SeatCtrl.I_CDCU_SecRowRtSeatMassgIntenCmd 3"); // 测试步骤 TC_CANTest CheckEventStart I_CDCU_SeatCtrl.I_CDCU_SecRowRtSeatMassgIntenCmd 3
  g_EM_SOAClient_Swc_SOA_CHECK_Prepare("Veh_SetSecRowRtSeatMassageIntensityRespStruct.Veh_SetSecRowRtSeatMassageIntensityNRC 0 traceback5"); // 预期结果 TC_CANTest SOA check Veh_SetSecRowRtSeatMassageIntensityRespStruct.Veh_SetSecRowRtSeatMassageIntensityNRC 0 traceback5
  g_EM_SOAClient_Swc_SOA_CHECK_Prepare("Veh_SeatCtrlService_ErrStruct.OpeNRC 0 traceback7"); // 预期结果 TC_CANTest SOA check Veh_SeatCtrlService_ErrStruct.OpeNRC 0 traceback7
  g_EM_SOAClient_Swc_SOA_REQ("Veh_SetSecRowRtSeatMassageIntensityStruct.Veh_SecRowRtSeatMassgIntenReq:3&ServiceExecuteFeedbackFlag:2"); // 测试步骤 TC_CANTest SOA REQ Veh_SetSecRowRtSeatMassageIntensityStruct.Veh_SecRowRtSeatMassgIntenReq:3&ServiceExecuteFeedbackFlag:2
  g_CAN_Bus_Swc_CheckPeriod_FilterStarted("I_CDCU_SeatCtrl.I_CDCU_SecRowRtSeatMassgIntenCmd 3:0 3;50;50"); // 预期结果 TC_CANTest CheckPeriod_FilterStarted I_CDCU_SeatCtrl.I_CDCU_SecRowRtSeatMassgIntenCmd 3:0 3;50;50
  g_EM_SOAClient_Swc_SOA_CHECK("Veh_SetSecRowRtSeatMassageIntensityRespStruct.Veh_SetSecRowRtSeatMassageIntensityNRC 0 traceback5"); // 预期结果 TC_CANTest SOA check Veh_SetSecRowRtSeatMassageIntensityRespStruct.Veh_SetSecRowRtSeatMassageIntensityNRC 0 traceback5
  g_CAN_Bus_Swc_Set("I_RDCU_SeatInfo2.I_RDCU_SecRowRtSeatMassgIntenSts 2"); // 测试步骤 TC_CANTest SET I_RDCU_SeatInfo2.I_RDCU_SecRowRtSeatMassgIntenSts 2
  g_EM_SOAClient_Swc_SOA_CHECK("Veh_SeatCtrlService_ErrStruct.OpeNRC 0 traceback7"); // 预期结果 TC_CANTest SOA check Veh_SeatCtrlService_ErrStruct.OpeNRC 0 traceback7
}

testcase SYS_CDCU_erpaiyoucezuoyianmo_0040()
{
  TestDescription("调节二排右侧座椅按摩模式-1");
  teststep("warning","原始用例id为SYS-CDCU-二排右侧座椅按摩-0040");
  g_CAN_Bus_Swc_CheckEventStart("I_CDCU_SeatCtrl.I_CDCU_SecRowRtSeatMassgProgCmd 2"); // 测试步骤 TC_CANTest CheckEventStart I_CDCU_SeatCtrl.I_CDCU_SecRowRtSeatMassgProgCmd 2
  g_EM_SOAClient_Swc_SOA_CHECK_Prepare("Veh_SetSecRowRtSeatMassageModeRespStruct.Veh_SetSecRowRtSeatMassageModeNRC 0 traceback5"); // 预期结果 TC_CANTest SOA check Veh_SetSecRowRtSeatMassageModeRespStruct.Veh_SetSecRowRtSeatMassageModeNRC 0 traceback5
  g_EM_SOAClient_Swc_SOA_CHECK_Prepare("Veh_SeatCtrlService_ErrStruct.OpeNRC 0 traceback7"); // 预期结果 TC_CANTest SOA check Veh_SeatCtrlService_ErrStruct.OpeNRC 0 traceback7
  g_EM_SOAClient_Swc_SOA_REQ("Veh_SetSecRowRtSeatMassageModeStruct.Veh_SecRowRtSeatMassgProgReq:2&ServiceExecuteFeedbackFlag:2"); // 测试步骤 TC_CANTest SOA REQ Veh_SetSecRowRtSeatMassageModeStruct.Veh_SecRowRtSeatMassgProgReq:2&ServiceExecuteFeedbackFlag:2
  g_CAN_Bus_Swc_CheckPeriod_FilterStarted("I_CDCU_SeatCtrl.I_CDCU_SecRowRtSeatMassgProgCmd 2:0 3;50;50"); // 预期结果 TC_CANTest CheckPeriod_FilterStarted I_CDCU_SeatCtrl.I_CDCU_SecRowRtSeatMassgProgCmd 2:0 3;50;50
  g_EM_SOAClient_Swc_SOA_CHECK("Veh_SetSecRowRtSeatMassageModeRespStruct.Veh_SetSecRowRtSeatMassageModeNRC 0 traceback5"); // 预期结果 TC_CANTest SOA check Veh_SetSecRowRtSeatMassageModeRespStruct.Veh_SetSecRowRtSeatMassageModeNRC 0 traceback5
  g_CAN_Bus_Swc_Set("I_RDCU_SeatInfo2.I_RDCU_SecRowRtSeatMassgProgSts 1"); // 测试步骤 TC_CANTest SET I_RDCU_SeatInfo2.I_RDCU_SecRowRtSeatMassgProgSts 1
  g_EM_SOAClient_Swc_SOA_CHECK("Veh_SeatCtrlService_ErrStruct.OpeNRC 0 traceback7"); // 预期结果 TC_CANTest SOA check Veh_SeatCtrlService_ErrStruct.OpeNRC 0 traceback7
}

testcase SYS_CDCU_erpaiyoucezuoyianmo_0041()
{
  TestDescription("调节二排右侧座椅按摩模式-2");
  teststep("warning","原始用例id为SYS-CDCU-二排右侧座椅按摩-0041");
  g_CAN_Bus_Swc_CheckEventStart("I_CDCU_SeatCtrl.I_CDCU_SecRowRtSeatMassgProgCmd 4"); // 测试步骤 TC_CANTest CheckEventStart I_CDCU_SeatCtrl.I_CDCU_SecRowRtSeatMassgProgCmd 4
  g_EM_SOAClient_Swc_SOA_CHECK_Prepare("Veh_SetSecRowRtSeatMassageModeRespStruct.Veh_SetSecRowRtSeatMassageModeNRC 0 traceback5"); // 预期结果 TC_CANTest SOA check Veh_SetSecRowRtSeatMassageModeRespStruct.Veh_SetSecRowRtSeatMassageModeNRC 0 traceback5
  g_EM_SOAClient_Swc_SOA_CHECK_Prepare("Veh_SeatCtrlService_ErrStruct.OpeNRC 0 traceback7"); // 预期结果 TC_CANTest SOA check Veh_SeatCtrlService_ErrStruct.OpeNRC 0 traceback7
  g_EM_SOAClient_Swc_SOA_REQ("Veh_SetSecRowRtSeatMassageModeStruct.Veh_SecRowRtSeatMassgProgReq:4&ServiceExecuteFeedbackFlag:2"); // 测试步骤 TC_CANTest SOA REQ Veh_SetSecRowRtSeatMassageModeStruct.Veh_SecRowRtSeatMassgProgReq:4&ServiceExecuteFeedbackFlag:2
  g_CAN_Bus_Swc_CheckPeriod_FilterStarted("I_CDCU_SeatCtrl.I_CDCU_SecRowRtSeatMassgProgCmd 4:0 3;50;50"); // 预期结果 TC_CANTest CheckPeriod_FilterStarted I_CDCU_SeatCtrl.I_CDCU_SecRowRtSeatMassgProgCmd 4:0 3;50;50
  g_EM_SOAClient_Swc_SOA_CHECK("Veh_SetSecRowRtSeatMassageModeRespStruct.Veh_SetSecRowRtSeatMassageModeNRC 0 traceback5"); // 预期结果 TC_CANTest SOA check Veh_SetSecRowRtSeatMassageModeRespStruct.Veh_SetSecRowRtSeatMassageModeNRC 0 traceback5
  g_CAN_Bus_Swc_Set("I_RDCU_SeatInfo2.I_RDCU_SecRowRtSeatMassgProgSts 3"); // 测试步骤 TC_CANTest SET I_RDCU_SeatInfo2.I_RDCU_SecRowRtSeatMassgProgSts 3
  g_EM_SOAClient_Swc_SOA_CHECK("Veh_SeatCtrlService_ErrStruct.OpeNRC 0 traceback7"); // 预期结果 TC_CANTest SOA check Veh_SeatCtrlService_ErrStruct.OpeNRC 0 traceback7
}

testcase SYS_CDCU_erpaiyoucezuoyianmo_0042()
{
  TestDescription("调节二排右侧座椅按摩模式-3");
  teststep("warning","原始用例id为SYS-CDCU-二排右侧座椅按摩-0042");
  g_CAN_Bus_Swc_CheckEventStart("I_CDCU_SeatCtrl.I_CDCU_SecRowRtSeatMassgProgCmd 9"); // 测试步骤 TC_CANTest CheckEventStart I_CDCU_SeatCtrl.I_CDCU_SecRowRtSeatMassgProgCmd 9
  g_EM_SOAClient_Swc_SOA_CHECK_Prepare("Veh_SetSecRowRtSeatMassageModeRespStruct.Veh_SetSecRowRtSeatMassageModeNRC 0 traceback5"); // 预期结果 TC_CANTest SOA check Veh_SetSecRowRtSeatMassageModeRespStruct.Veh_SetSecRowRtSeatMassageModeNRC 0 traceback5
  g_EM_SOAClient_Swc_SOA_CHECK_Prepare("Veh_SeatCtrlService_ErrStruct.OpeNRC 0 traceback7"); // 预期结果 TC_CANTest SOA check Veh_SeatCtrlService_ErrStruct.OpeNRC 0 traceback7
  g_EM_SOAClient_Swc_SOA_REQ("Veh_SetSecRowRtSeatMassageModeStruct.Veh_SecRowRtSeatMassgProgReq:9&ServiceExecuteFeedbackFlag:2"); // 测试步骤 TC_CANTest SOA REQ Veh_SetSecRowRtSeatMassageModeStruct.Veh_SecRowRtSeatMassgProgReq:9&ServiceExecuteFeedbackFlag:2
  g_CAN_Bus_Swc_CheckPeriod_FilterStarted("I_CDCU_SeatCtrl.I_CDCU_SecRowRtSeatMassgProgCmd 9:0 3;50;50"); // 预期结果 TC_CANTest CheckPeriod_FilterStarted I_CDCU_SeatCtrl.I_CDCU_SecRowRtSeatMassgProgCmd 9:0 3;50;50
  g_EM_SOAClient_Swc_SOA_CHECK("Veh_SetSecRowRtSeatMassageModeRespStruct.Veh_SetSecRowRtSeatMassageModeNRC 0 traceback5"); // 预期结果 TC_CANTest SOA check Veh_SetSecRowRtSeatMassageModeRespStruct.Veh_SetSecRowRtSeatMassageModeNRC 0 traceback5
  g_CAN_Bus_Swc_Set("I_RDCU_SeatInfo2.I_RDCU_SecRowRtSeatMassgProgSts 8"); // 测试步骤 TC_CANTest SET I_RDCU_SeatInfo2.I_RDCU_SecRowRtSeatMassgProgSts 8
  g_EM_SOAClient_Swc_SOA_CHECK("Veh_SeatCtrlService_ErrStruct.OpeNRC 0 traceback7"); // 预期结果 TC_CANTest SOA check Veh_SeatCtrlService_ErrStruct.OpeNRC 0 traceback7
}

testcase SYS_CDCU_erpaiyoucezuoyianmo_0043()
{
  TestDescription("二排右侧座椅按摩-off");
  teststep("warning","原始用例id为SYS-CDCU-二排右侧座椅按摩-0043");
  g_CAN_Bus_Swc_CheckEventStart("I_CDCU_SeatCtrl.I_CDCU_SecRowRtSeatMassgProgCmd 1"); // 测试步骤 TC_CANTest CheckEventStart I_CDCU_SeatCtrl.I_CDCU_SecRowRtSeatMassgProgCmd 1
  g_EM_SOAClient_Swc_SOA_CHECK_Prepare("Veh_TurnOffSecRowRtSeatMassageRespStruct.Veh_TurnOffSecRowRtSeatMassageNRC 0"); // 预期结果 TC_CANTest SOA check Veh_TurnOffSecRowRtSeatMassageRespStruct.Veh_TurnOffSecRowRtSeatMassageNRC 0
  g_EM_SOAClient_Swc_SOA_CHECK_Prepare("Veh_SeatCtrlService_ErrStruct.OpeNRC 0 traceback7"); // 预期结果 TC_CANTest SOA check Veh_SeatCtrlService_ErrStruct.OpeNRC 0 traceback7
  g_EM_SOAClient_Swc_SOA_REQ("Veh_TurnOffSecRowRtSeatMassageStruct.Veh_SecRowRtSeatMassgProgReq:1&ServiceExecuteFeedbackFlag:2"); // 测试步骤 TC_CANTest SOA REQ Veh_TurnOffSecRowRtSeatMassageStruct.Veh_SecRowRtSeatMassgProgReq:1&ServiceExecuteFeedbackFlag:2
  g_EM_SOAClient_Swc_SOA_CHECK("Veh_TurnOffSecRowRtSeatMassageRespStruct.Veh_TurnOffSecRowRtSeatMassageNRC 0"); // 预期结果 TC_CANTest SOA check Veh_TurnOffSecRowRtSeatMassageRespStruct.Veh_TurnOffSecRowRtSeatMassageNRC 0
  g_CAN_Bus_Swc_CheckPeriod_FilterStarted("I_CDCU_SeatCtrl.I_CDCU_SecRowRtSeatMassgProgCmd 1:0 3;50;50"); // 预期结果 TC_CANTest CheckPeriod_FilterStarted I_CDCU_SeatCtrl.I_CDCU_SecRowRtSeatMassgProgCmd 1:0 3;50;50
  g_CAN_Bus_Swc_Set("I_RDCU_SeatInfo2.I_RDCU_SecRowRtSeatMassgProgSts 0"); // 测试步骤 TC_CANTest SET I_RDCU_SeatInfo2.I_RDCU_SecRowRtSeatMassgProgSts 0
  g_EM_SOAClient_Swc_SOA_CHECK("Veh_SeatCtrlService_ErrStruct.OpeNRC 0 traceback7"); // 预期结果 TC_CANTest SOA check Veh_SeatCtrlService_ErrStruct.OpeNRC 0 traceback7
}

testcase SYS_CDCU_guanbizhujiazuoyijiare_0044()
{
  TestDescription("主驾座椅加热-1");
  teststep("warning","原始用例id为SYS-CDCU-关闭主驾座椅加热-0044");
  g_EM_Equipment_Swc_TC_PW("ON"); // 测试步骤 TC_PW ON
  g_EM_Equipment_Swc_TC_IG("OFF"); // 测试步骤 TC_IG OFF
  g_CAN_Bus_Swc_Set("I_LDCU_BodySysSt1.I_LDCU_PowerMode 1"); // 测试步骤 TC_CANTest SET I_LDCU_BodySysSt1.I_LDCU_PowerMode 1
  g_EM_Equipment_Swc_TC_4G_Time_Delay_Second("1"); // 测试步骤 TC_Sleep 1
  g_CAN_Bus_Swc_Set("I_LDCU_BodySysSt1.I_LDCU_PowerMode 0"); // 测试步骤 TC_CANTest SET I_LDCU_BodySysSt1.I_LDCU_PowerMode 0
  g_CAN_Bus_Swc_Set("I_LDCU_NM.I_LDCU_NMRepeatMsgReqBit 1"); // 测试步骤 TC_CANTest SET I_LDCU_NM.I_LDCU_NMRepeatMsgReqBit 1 //网络唤醒维持帧
  g_CAN_Bus_Swc_Set("C_LDCU_SysSt.C_LDCU_EVSysReadySt 0"); // 测试步骤 TC_CANTest SET C_LDCU_SysSt.C_LDCU_EVSysReadySt 0//Not ready
  gTC_CANTest_SOA_CheckReq_Prepare("HighVoltageCtrlStruct.HighVoltageCtrl 2"); // 预期结果 TC_CANTest SOA CheckReq HighVoltageCtrlStruct.HighVoltageCtrl 2
  g_EM_SOAClient_Swc_SOA_CHECK_Prepare("Veh_SeatCtrlService_ErrStruct.OpeNRC 0 traceback7"); // 预期结果 TC_CANTest SOA check Veh_SeatCtrlService_ErrStruct.OpeNRC 0 traceback7
  g_EM_SOAClient_Swc_SOA_REQ("Veh_SetDrvSeatHeatingStruct.Veh_DrvSeatHeatingReq:1&UserID:0x01010001&ServiceExecuteFeedbackFlag:2"); // 测试步骤 TC_CANTest SOA REQ Veh_SetDrvSeatHeatingStruct.Veh_DrvSeatHeatingReq:1&UserID:0x01010001&ServiceExecuteFeedbackFlag:2
  gTC_CANTest_SOA_CheckReq("HighVoltageCtrlStruct.HighVoltageCtrl 2"); // 预期结果 TC_CANTest SOA CheckReq HighVoltageCtrlStruct.HighVoltageCtrl 2
  gTC_CANTest_SOA_CheckReq_Prepare("SetDrvSeatHeatingStruct.DrvSeatHeatingReq 1&ServiceExecuteFeedbackFlag 2"); // 预期结果 TC_CANTest SOA CheckReq SetDrvSeatHeatingStruct.DrvSeatHeatingReq 1&ServiceExecuteFeedbackFlag 2
  g_EM_SOAClient_Swc_SOA_CHECK_Prepare("SOAEngineInterSignalStruct.SeatHeatHVReq 1"); // 预期结果 TC_CANTest SOA Check SOAEngineInterSignalStruct.SeatHeatHVReq 1
  g_EM_SOAClient_Swc_SOA_CHECK_Prepare("Veh_SetDrvSeatHeatingRespStruct.Veh_SetDrvSeatHeatingNRC 0"); // 预期结果 TC_CANTest SOA check Veh_SetDrvSeatHeatingRespStruct.Veh_SetDrvSeatHeatingNRC 0
  g_CAN_Bus_Swc_Set("C_LDCU_SysSt.C_LDCU_EVSysReadySt 2"); // 测试步骤 TC_CANTest SET C_LDCU_SysSt.C_LDCU_EVSysReadySt 2//Not ready
  gTC_CANTest_SOA_CheckReq("SetDrvSeatHeatingStruct.DrvSeatHeatingReq 1&ServiceExecuteFeedbackFlag 2"); // 预期结果 TC_CANTest SOA CheckReq SetDrvSeatHeatingStruct.DrvSeatHeatingReq 1&ServiceExecuteFeedbackFlag 2
  g_EM_SOAClient_Swc_SOA_CHECK("SOAEngineInterSignalStruct.SeatHeatHVReq 1"); // 预期结果 TC_CANTest SOA Check SOAEngineInterSignalStruct.SeatHeatHVReq 1
  g_EM_SOAClient_Swc_SOA_CHECK("Veh_SetDrvSeatHeatingRespStruct.Veh_SetDrvSeatHeatingNRC 0"); // 预期结果 TC_CANTest SOA check Veh_SetDrvSeatHeatingRespStruct.Veh_SetDrvSeatHeatingNRC 0
  g_EM_SOAClient_Swc_SOA_CHECK("Veh_SeatCtrlService_ErrStruct.OpeNRC 0 traceback7"); // 预期结果 TC_CANTest SOA check Veh_SeatCtrlService_ErrStruct.OpeNRC 0 traceback7
  g_CAN_Bus_Swc_Set("I_LDCU_BodySysSt1.I_LDCU_PowerMode 1"); // 测试步骤 TC_CANTest SET I_LDCU_BodySysSt1.I_LDCU_PowerMode 1
  g_EM_SOAClient_Swc_SOA_CHECK_Prepare("SOAEngineInterSignalStruct.SeatHeatHVReq 0"); // 预期结果 TC_CANTest SOA Check SOAEngineInterSignalStruct.SeatHeatHVReq 0
  g_EM_Equipment_Swc_TC_IG("ON"); // 测试步骤 TC_IG ON
  g_EM_SOAClient_Swc_SOA_CHECK("SOAEngineInterSignalStruct.SeatHeatHVReq 0"); // 预期结果 TC_CANTest SOA Check SOAEngineInterSignalStruct.SeatHeatHVReq 0
}

testcase SYS_CDCU_guanbizhujiazuoyijiare_0045()
{
  TestDescription("主驾座椅加热-2");
  teststep("warning","原始用例id为SYS-CDCU-关闭主驾座椅加热-0045");
  g_EM_Equipment_Swc_TC_IG("OFF"); // 测试步骤 TC_IG OFF
  g_EM_Equipment_Swc_TC_4G_Time_Delay_Second("1"); // 测试步骤 TC_Sleep 1
  g_CAN_Bus_Swc_Set("I_LDCU_BodySysSt1.I_LDCU_PowerMode 1"); // 测试步骤 TC_CANTest SET I_LDCU_BodySysSt1.I_LDCU_PowerMode 1
  g_EM_Equipment_Swc_TC_4G_Time_Delay_Second("1"); // 测试步骤 TC_Sleep 1
  g_CAN_Bus_Swc_Set("I_LDCU_BodySysSt1.I_LDCU_PowerMode 0"); // 测试步骤 TC_CANTest SET I_LDCU_BodySysSt1.I_LDCU_PowerMode 0
  g_CAN_Bus_Swc_Set("I_LDCU_NM.I_LDCU_NMRepeatMsgReqBit 1"); // 测试步骤 TC_CANTest SET I_LDCU_NM.I_LDCU_NMRepeatMsgReqBit 1 //网络唤醒维持帧
  g_CAN_Bus_Swc_Set("C_LDCU_SysSt.C_LDCU_EVSysReadySt 1"); // 测试步骤 TC_CANTest SET C_LDCU_SysSt.C_LDCU_EVSysReadySt 1//HV ON
  gTC_CANTest_SOA_CheckReq_Prepare("SetDrvSeatHeatingStruct.DrvSeatHeatingReq 1&ServiceExecuteFeedbackFlag 2"); // 预期结果 TC_CANTest SOA CheckReq SetDrvSeatHeatingStruct.DrvSeatHeatingReq 1&ServiceExecuteFeedbackFlag 2
  g_EM_SOAClient_Swc_SOA_CHECK_Prepare("Veh_SeatCtrlService_ErrStruct.OpeNRC 0 traceback7"); // 预期结果 TC_CANTest SOA check Veh_SeatCtrlService_ErrStruct.OpeNRC 0 traceback7
  g_EM_SOAClient_Swc_SOA_REQ("Veh_SetDrvSeatHeatingStruct.Veh_DrvSeatHeatingReq:1&UserID:0x01010001&ServiceExecuteFeedbackFlag:2"); // 测试步骤 TC_CANTest SOA REQ Veh_SetDrvSeatHeatingStruct.Veh_DrvSeatHeatingReq:1&UserID:0x01010001&ServiceExecuteFeedbackFlag:2
  gTC_CANTest_SOA_CheckReq("SetDrvSeatHeatingStruct.DrvSeatHeatingReq 1&ServiceExecuteFeedbackFlag 2"); // 预期结果 TC_CANTest SOA CheckReq SetDrvSeatHeatingStruct.DrvSeatHeatingReq 1&ServiceExecuteFeedbackFlag 2
  g_EM_SOAClient_Swc_SOA_CHECK_Prepare("Veh_SetDrvSeatHeatingRespStruct.Veh_SetDrvSeatHeatingNRC 0"); // 预期结果 TC_CANTest SOA check Veh_SetDrvSeatHeatingRespStruct.Veh_SetDrvSeatHeatingNRC 0
  g_CAN_Bus_Swc_Set("C_LDCU_SysSt.C_LDCU_EVSysReadySt 2"); // 测试步骤 TC_CANTest SET C_LDCU_SysSt.C_LDCU_EVSysReadySt 2//Not ready
  g_EM_SOAClient_Swc_SOA_CHECK("Veh_SetDrvSeatHeatingRespStruct.Veh_SetDrvSeatHeatingNRC 0"); // 预期结果 TC_CANTest SOA check Veh_SetDrvSeatHeatingRespStruct.Veh_SetDrvSeatHeatingNRC 0
  g_EM_SOAClient_Swc_SOA_CHECK("Veh_SeatCtrlService_ErrStruct.OpeNRC 0 traceback7"); // 预期结果 TC_CANTest SOA check Veh_SeatCtrlService_ErrStruct.OpeNRC 0 traceback7
}

testcase SYS_CDCU_guanbizhujiazuoyijiare_0046()
{
  TestDescription("主驾座椅加热-3");
  teststep("warning","原始用例id为SYS-CDCU-关闭主驾座椅加热-0046");
  g_EM_Equipment_Swc_TC_IG("OFF"); // 测试步骤 TC_IG OFF
  g_CAN_Bus_Swc_Set("I_LDCU_BodySysSt1.I_LDCU_PowerMode 1"); // 测试步骤 TC_CANTest SET I_LDCU_BodySysSt1.I_LDCU_PowerMode 1
  g_EM_Equipment_Swc_TC_4G_Time_Delay_Second("1"); // 测试步骤 TC_Sleep 1
  g_CAN_Bus_Swc_Set("I_LDCU_BodySysSt1.I_LDCU_PowerMode 0"); // 测试步骤 TC_CANTest SET I_LDCU_BodySysSt1.I_LDCU_PowerMode 0
  g_CAN_Bus_Swc_Set("I_LDCU_NM.I_LDCU_NMRepeatMsgReqBit 1"); // 测试步骤 TC_CANTest SET I_LDCU_NM.I_LDCU_NMRepeatMsgReqBit 1 //网络唤醒维持帧
  g_CAN_Bus_Swc_Set("C_LDCU_SysSt.C_LDCU_EVSysReadySt 2"); // 测试步骤 TC_CANTest SET C_LDCU_SysSt.C_LDCU_EVSysReadySt 2//HV ON
  gTC_CANTest_SOA_CheckReq_Prepare("SetDrvSeatHeatingStruct.DrvSeatHeatingReq 1&ServiceExecuteFeedbackFlag 2"); // 预期结果 TC_CANTest SOA CheckReq SetDrvSeatHeatingStruct.DrvSeatHeatingReq 1&ServiceExecuteFeedbackFlag 2
  g_EM_SOAClient_Swc_SOA_CHECK_Prepare("Veh_SeatCtrlService_ErrStruct.OpeNRC 0 traceback7"); // 预期结果 TC_CANTest SOA check Veh_SeatCtrlService_ErrStruct.OpeNRC 0 traceback7
  g_EM_SOAClient_Swc_SOA_REQ("Veh_SetDrvSeatHeatingStruct.Veh_DrvSeatHeatingReq:1&UserID:0x01010001&ServiceExecuteFeedbackFlag:2"); // 测试步骤 TC_CANTest SOA REQ Veh_SetDrvSeatHeatingStruct.Veh_DrvSeatHeatingReq:1&UserID:0x01010001&ServiceExecuteFeedbackFlag:2
  gTC_CANTest_SOA_CheckReq("SetDrvSeatHeatingStruct.DrvSeatHeatingReq 1&ServiceExecuteFeedbackFlag 2"); // 预期结果 TC_CANTest SOA CheckReq SetDrvSeatHeatingStruct.DrvSeatHeatingReq 1&ServiceExecuteFeedbackFlag 2
  g_EM_SOAClient_Swc_SOA_CHECK_Prepare("Veh_SetDrvSeatHeatingRespStruct.Veh_SetDrvSeatHeatingNRC 0"); // 预期结果 TC_CANTest SOA check Veh_SetDrvSeatHeatingRespStruct.Veh_SetDrvSeatHeatingNRC 0
  g_CAN_Bus_Swc_Set("C_LDCU_SysSt.C_LDCU_EVSysReadySt 2"); // 测试步骤 TC_CANTest SET C_LDCU_SysSt.C_LDCU_EVSysReadySt 2//Not ready
  g_EM_SOAClient_Swc_SOA_CHECK("Veh_SetDrvSeatHeatingRespStruct.Veh_SetDrvSeatHeatingNRC 0"); // 预期结果 TC_CANTest SOA check Veh_SetDrvSeatHeatingRespStruct.Veh_SetDrvSeatHeatingNRC 0
  g_EM_SOAClient_Swc_SOA_CHECK("Veh_SeatCtrlService_ErrStruct.OpeNRC 0 traceback7"); // 预期结果 TC_CANTest SOA check Veh_SeatCtrlService_ErrStruct.OpeNRC 0 traceback7
  g_EM_Equipment_Swc_TC_IG("ON"); // 测试步骤 TC_IG ON
}

testcase SYS_CDCU_guanbizhujiazuoyijiare_0047()
{
  TestDescription("主驾座椅加热-5");
  teststep("warning","原始用例id为SYS-CDCU-关闭主驾座椅加热-0047");
  g_CAN_Bus_Swc_Set("I_LDCU_BodySysSt1.I_LDCU_PowerMode 1"); // 测试步骤 TC_CANTest SET I_LDCU_BodySysSt1.I_LDCU_PowerMode 1
  g_CAN_Bus_Swc_Set("I_LDCU_NM.I_LDCU_NMRepeatMsgReqBit 1"); // 测试步骤 TC_CANTest SET I_LDCU_NM.I_LDCU_NMRepeatMsgReqBit 1 //网络唤醒维持帧
  g_CAN_Bus_Swc_Set("C_LDCU_SysSt.C_LDCU_EVSysReadySt 1"); // 测试步骤 TC_CANTest SET C_LDCU_SysSt.C_LDCU_EVSysReadySt 1//Not ready
  gTC_CANTest_SOA_CheckReq_Prepare("SetDrvSeatHeatingStruct.DrvSeatHeatingReq 1&ServiceExecuteFeedbackFlag 2"); // 预期结果 TC_CANTest SOA CheckReq SetDrvSeatHeatingStruct.DrvSeatHeatingReq 1&ServiceExecuteFeedbackFlag 2
  g_EM_SOAClient_Swc_SOA_CHECK_Prepare("Veh_SeatCtrlService_ErrStruct.OpeNRC 0 traceback7"); // 预期结果 TC_CANTest SOA check Veh_SeatCtrlService_ErrStruct.OpeNRC 0 traceback7
  g_EM_SOAClient_Swc_SOA_REQ("Veh_SetDrvSeatHeatingStruct.Veh_DrvSeatHeatingReq:1&ServiceExecuteFeedbackFlag:2"); // 测试步骤 TC_CANTest SOA REQ Veh_SetDrvSeatHeatingStruct.Veh_DrvSeatHeatingReq:1&ServiceExecuteFeedbackFlag:2
  gTC_CANTest_SOA_CheckReq("SetDrvSeatHeatingStruct.DrvSeatHeatingReq 1&ServiceExecuteFeedbackFlag 2"); // 预期结果 TC_CANTest SOA CheckReq SetDrvSeatHeatingStruct.DrvSeatHeatingReq 1&ServiceExecuteFeedbackFlag 2
  g_CAN_Bus_Swc_Set("C_LDCU_SysSt.C_LDCU_EVSysReadySt 2"); // 测试步骤 TC_CANTest SET C_LDCU_SysSt.C_LDCU_EVSysReadySt 2//Not ready
  g_EM_SOAClient_Swc_SOA_CHECK("Veh_SeatCtrlService_ErrStruct.OpeNRC 0 traceback7"); // 预期结果 TC_CANTest SOA check Veh_SeatCtrlService_ErrStruct.OpeNRC 0 traceback7
}

testcase SYS_CDCU_guanbizhujiazuoyijiare_0048()
{
  TestDescription("主驾座椅加热-6");
  teststep("warning","原始用例id为SYS-CDCU-关闭主驾座椅加热-0048");
  g_CAN_Bus_Swc_Set("I_LDCU_BodySysSt1.I_LDCU_PowerMode 1"); // 测试步骤 TC_CANTest SET I_LDCU_BodySysSt1.I_LDCU_PowerMode 1
  g_CAN_Bus_Swc_Set("I_LDCU_NM.I_LDCU_NMRepeatMsgReqBit 1"); // 测试步骤 TC_CANTest SET I_LDCU_NM.I_LDCU_NMRepeatMsgReqBit 1 //网络唤醒维持帧
  g_CAN_Bus_Swc_Set("C_LDCU_SysSt.C_LDCU_EVSysReadySt 2"); // 测试步骤 TC_CANTest SET C_LDCU_SysSt.C_LDCU_EVSysReadySt 2//Not ready
  gTC_CANTest_SOA_CheckReq_Prepare("SetDrvSeatHeatingStruct.DrvSeatHeatingReq 1&ServiceExecuteFeedbackFlag 2"); // 预期结果 TC_CANTest SOA CheckReq SetDrvSeatHeatingStruct.DrvSeatHeatingReq 1&ServiceExecuteFeedbackFlag 2
  g_EM_SOAClient_Swc_SOA_CHECK_Prepare("Veh_SeatCtrlService_ErrStruct.OpeNRC 0 traceback7"); // 预期结果 TC_CANTest SOA check Veh_SeatCtrlService_ErrStruct.OpeNRC 0 traceback7
  g_EM_SOAClient_Swc_SOA_REQ("Veh_SetDrvSeatHeatingStruct.Veh_DrvSeatHeatingReq:1&ServiceExecuteFeedbackFlag:2"); // 测试步骤 TC_CANTest SOA REQ Veh_SetDrvSeatHeatingStruct.Veh_DrvSeatHeatingReq:1&ServiceExecuteFeedbackFlag:2
  gTC_CANTest_SOA_CheckReq("SetDrvSeatHeatingStruct.DrvSeatHeatingReq 1&ServiceExecuteFeedbackFlag 2"); // 预期结果 TC_CANTest SOA CheckReq SetDrvSeatHeatingStruct.DrvSeatHeatingReq 1&ServiceExecuteFeedbackFlag 2
  g_EM_SOAClient_Swc_SOA_CHECK("Veh_SeatCtrlService_ErrStruct.OpeNRC 0 traceback7"); // 预期结果 TC_CANTest SOA check Veh_SeatCtrlService_ErrStruct.OpeNRC 0 traceback7
}

testcase SYS_CDCU_guanbizhujiazuoyijiare_0049()
{
  TestDescription("主驾座椅加热-7");
  teststep("warning","原始用例id为SYS-CDCU-关闭主驾座椅加热-0049");
  gTC_CANTest_SOA_CheckReq_Prepare("SetDrvSeatHeatingStruct.DrvSeatHeatingReq 2&ServiceExecuteFeedbackFlag 2"); // 预期结果 TC_CANTest SOA CheckReq SetDrvSeatHeatingStruct.DrvSeatHeatingReq 2&ServiceExecuteFeedbackFlag 2
  g_EM_SOAClient_Swc_SOA_CHECK_Prepare("Veh_SeatCtrlService_ErrStruct.OpeNRC 0 traceback7"); // 预期结果 TC_CANTest SOA check Veh_SeatCtrlService_ErrStruct.OpeNRC 0 traceback7
  g_EM_SOAClient_Swc_SOA_REQ("Veh_SetDrvSeatHeatingStruct.Veh_DrvSeatHeatingReq:2&ServiceExecuteFeedbackFlag:2"); // 测试步骤 TC_CANTest SOA REQ Veh_SetDrvSeatHeatingStruct.Veh_DrvSeatHeatingReq:2&ServiceExecuteFeedbackFlag:2
  gTC_CANTest_SOA_CheckReq("SetDrvSeatHeatingStruct.DrvSeatHeatingReq 2&ServiceExecuteFeedbackFlag 2"); // 预期结果 TC_CANTest SOA CheckReq SetDrvSeatHeatingStruct.DrvSeatHeatingReq 2&ServiceExecuteFeedbackFlag 2
  g_EM_SOAClient_Swc_SOA_CHECK("Veh_SeatCtrlService_ErrStruct.OpeNRC 0 traceback7"); // 预期结果 TC_CANTest SOA check Veh_SeatCtrlService_ErrStruct.OpeNRC 0 traceback7
}

testcase SYS_CDCU_guanbizhujiazuoyijiare_0050()
{
  TestDescription("主驾座椅加热-8");
  teststep("warning","原始用例id为SYS-CDCU-关闭主驾座椅加热-0050");
  gTC_CANTest_SOA_CheckReq_Prepare("SetDrvSeatHeatingStruct.DrvSeatHeatingReq 3&ServiceExecuteFeedbackFlag 2"); // 预期结果 TC_CANTest SOA CheckReq SetDrvSeatHeatingStruct.DrvSeatHeatingReq 3&ServiceExecuteFeedbackFlag 2
  g_EM_SOAClient_Swc_SOA_CHECK_Prepare("Veh_SeatCtrlService_ErrStruct.OpeNRC 0 traceback7"); // 预期结果 TC_CANTest SOA check Veh_SeatCtrlService_ErrStruct.OpeNRC 0 traceback7
  g_EM_SOAClient_Swc_SOA_REQ("Veh_SetDrvSeatHeatingStruct.Veh_DrvSeatHeatingReq:3&ServiceExecuteFeedbackFlag:2"); // 测试步骤 TC_CANTest SOA REQ Veh_SetDrvSeatHeatingStruct.Veh_DrvSeatHeatingReq:3&ServiceExecuteFeedbackFlag:2
  gTC_CANTest_SOA_CheckReq("SetDrvSeatHeatingStruct.DrvSeatHeatingReq 3&ServiceExecuteFeedbackFlag 2"); // 预期结果 TC_CANTest SOA CheckReq SetDrvSeatHeatingStruct.DrvSeatHeatingReq 3&ServiceExecuteFeedbackFlag 2
  g_EM_SOAClient_Swc_SOA_CHECK("Veh_SeatCtrlService_ErrStruct.OpeNRC 0 traceback7"); // 预期结果 TC_CANTest SOA check Veh_SeatCtrlService_ErrStruct.OpeNRC 0 traceback7
}

testcase SYS_CDCU_guanbizhujiazuoyijiare_0051()
{
  TestDescription("主驾座椅加热-9");
  teststep("warning","原始用例id为SYS-CDCU-关闭主驾座椅加热-0051");
  g_CAN_Bus_Swc_Set("C_LDCU_SysSt.C_LDCU_EVSysReadySt 0"); // 测试步骤 TC_CANTest SET C_LDCU_SysSt.C_LDCU_EVSysReadySt 0
  gTC_CANTest_SOA_CheckReq_Prepare("SetDrvSeatHeatingStruct.DrvSeatHeatingReq 4&ServiceExecuteFeedbackFlag 2"); // 预期结果 TC_CANTest SOA CheckReq SetDrvSeatHeatingStruct.DrvSeatHeatingReq 4&ServiceExecuteFeedbackFlag 2
  g_EM_SOAClient_Swc_SOA_CHECK_Prepare("Veh_SeatCtrlService_ErrStruct.OpeNRC 0 traceback7"); // 预期结果 TC_CANTest SOA check Veh_SeatCtrlService_ErrStruct.OpeNRC 0 traceback7
  g_EM_SOAClient_Swc_SOA_REQ("Veh_SetDrvSeatHeatingStruct.Veh_DrvSeatHeatingReq:4&ServiceExecuteFeedbackFlag:2"); // 测试步骤 TC_CANTest SOA REQ Veh_SetDrvSeatHeatingStruct.Veh_DrvSeatHeatingReq:4&ServiceExecuteFeedbackFlag:2
  gTC_CANTest_SOA_CheckReq("SetDrvSeatHeatingStruct.DrvSeatHeatingReq 4&ServiceExecuteFeedbackFlag 2"); // 预期结果 TC_CANTest SOA CheckReq SetDrvSeatHeatingStruct.DrvSeatHeatingReq 4&ServiceExecuteFeedbackFlag 2
  g_EM_SOAClient_Swc_SOA_CHECK("Veh_SeatCtrlService_ErrStruct.OpeNRC 0 traceback7"); // 预期结果 TC_CANTest SOA check Veh_SeatCtrlService_ErrStruct.OpeNRC 0 traceback7
}

testcase SYS_CDCU_guanbizhujiazuoyijiare_0052()
{
  TestDescription("主驾座椅加热-10");
  teststep("warning","原始用例id为SYS-CDCU-关闭主驾座椅加热-0052");
  g_CAN_Bus_Swc_Set("I_LDCU_BodySysSt1.I_LDCU_PowerMode 1"); // 测试步骤 TC_CANTest SET I_LDCU_BodySysSt1.I_LDCU_PowerMode 1
  g_EM_Equipment_Swc_TC_4G_Time_Delay_Second("5"); // 测试步骤 TC_Sleep 5
  g_CAN_Bus_Swc_Set("I_LDCU_BodySysSt1.I_LDCU_PowerMode 2"); // 测试步骤 TC_CANTest SET I_LDCU_BodySysSt1.I_LDCU_PowerMode 2
  g_CAN_Bus_Swc_Set("I_LDCU_NM.I_LDCU_NMRepeatMsgReqBit 1"); // 测试步骤 TC_CANTest SET I_LDCU_NM.I_LDCU_NMRepeatMsgReqBit 1 //网络唤醒维持帧
  g_CAN_Bus_Swc_Set("C_LDCU_SysSt.C_LDCU_EVSysReadySt 0"); // 测试步骤 TC_CANTest SET C_LDCU_SysSt.C_LDCU_EVSysReadySt 0//Not ready
  gTC_CANTest_SOA_CheckReq_Prepare("HighVoltageCtrlStruct.HighVoltageCtrl 2"); // 预期结果 TC_CANTest SOA CheckReq HighVoltageCtrlStruct.HighVoltageCtrl 2
  g_EM_SOAClient_Swc_SOA_CHECK_Prepare("Veh_SeatCtrlService_ErrStruct.OpeNRC 0 traceback7"); // 预期结果 TC_CANTest SOA check Veh_SeatCtrlService_ErrStruct.OpeNRC 0 traceback7
  g_EM_SOAClient_Swc_SOA_REQ("Veh_SetDrvSeatHeatingStruct.Veh_DrvSeatHeatingReq:1&ServiceExecuteFeedbackFlag:2"); // 测试步骤 TC_CANTest SOA REQ Veh_SetDrvSeatHeatingStruct.Veh_DrvSeatHeatingReq:1&ServiceExecuteFeedbackFlag:2
  gTC_CANTest_SOA_CheckReq("HighVoltageCtrlStruct.HighVoltageCtrl 2"); // 预期结果 TC_CANTest SOA CheckReq HighVoltageCtrlStruct.HighVoltageCtrl 2
  gTC_CANTest_SOA_CheckReq_Prepare("SetDrvSeatHeatingStruct.DrvSeatHeatingReq 1&ServiceExecuteFeedbackFlag 2"); // 预期结果 TC_CANTest SOA CheckReq SetDrvSeatHeatingStruct.DrvSeatHeatingReq 1&ServiceExecuteFeedbackFlag 2
  g_EM_SOAClient_Swc_SOA_CHECK_Prepare("Veh_SetDrvSeatHeatingRespStruct.Veh_SetDrvSeatHeatingNRC 0"); // 预期结果 TC_CANTest SOA check Veh_SetDrvSeatHeatingRespStruct.Veh_SetDrvSeatHeatingNRC 0
  g_CAN_Bus_Swc_Set("C_LDCU_SysSt.C_LDCU_EVSysReadySt 2"); // 测试步骤 TC_CANTest SET C_LDCU_SysSt.C_LDCU_EVSysReadySt 2//Not ready
  gTC_CANTest_SOA_CheckReq("SetDrvSeatHeatingStruct.DrvSeatHeatingReq 1&ServiceExecuteFeedbackFlag 2"); // 预期结果 TC_CANTest SOA CheckReq SetDrvSeatHeatingStruct.DrvSeatHeatingReq 1&ServiceExecuteFeedbackFlag 2
  g_EM_SOAClient_Swc_SOA_CHECK("Veh_SetDrvSeatHeatingRespStruct.Veh_SetDrvSeatHeatingNRC 0"); // 预期结果 TC_CANTest SOA check Veh_SetDrvSeatHeatingRespStruct.Veh_SetDrvSeatHeatingNRC 0
  g_EM_SOAClient_Swc_SOA_CHECK("Veh_SeatCtrlService_ErrStruct.OpeNRC 0 traceback7"); // 预期结果 TC_CANTest SOA check Veh_SeatCtrlService_ErrStruct.OpeNRC 0 traceback7
  g_EM_Equipment_Swc_TC_IG("ON"); // 测试步骤 TC_IG ON
  g_EM_Equipment_Swc_TC_4G_Time_Delay_Second("2"); // 测试步骤 TC_Sleep 2
}

testcase SYS_CDCU_guanbizhujiazuoyijiare_0053()
{
  TestDescription("主驾座椅加热-11");
  teststep("warning","原始用例id为SYS-CDCU-关闭主驾座椅加热-0053");
  g_CAN_Bus_Swc_Set("I_LDCU_BodySysSt1.I_LDCU_PowerMode 1"); // 测试步骤 TC_CANTest SET I_LDCU_BodySysSt1.I_LDCU_PowerMode 1
  g_EM_Equipment_Swc_TC_4G_Time_Delay_Second("1"); // 测试步骤 TC_Sleep 1
  g_CAN_Bus_Swc_Set("I_LDCU_BodySysSt1.I_LDCU_PowerMode 2"); // 测试步骤 TC_CANTest SET I_LDCU_BodySysSt1.I_LDCU_PowerMode 2
  g_CAN_Bus_Swc_Set("I_LDCU_NM.I_LDCU_NMRepeatMsgReqBit 1"); // 测试步骤 TC_CANTest SET I_LDCU_NM.I_LDCU_NMRepeatMsgReqBit 1 //网络唤醒维持帧
  g_CAN_Bus_Swc_Set("C_LDCU_SysSt.C_LDCU_EVSysReadySt 1"); // 测试步骤 TC_CANTest SET C_LDCU_SysSt.C_LDCU_EVSysReadySt 1//HV ON
  gTC_CANTest_SOA_CheckReq_Prepare("SetDrvSeatHeatingStruct.DrvSeatHeatingReq 1&ServiceExecuteFeedbackFlag 2"); // 预期结果 TC_CANTest SOA CheckReq SetDrvSeatHeatingStruct.DrvSeatHeatingReq 1&ServiceExecuteFeedbackFlag 2
  g_EM_SOAClient_Swc_SOA_CHECK_Prepare("Veh_SeatCtrlService_ErrStruct.OpeNRC 0 traceback7"); // 预期结果 TC_CANTest SOA check Veh_SeatCtrlService_ErrStruct.OpeNRC 0 traceback7
  g_EM_SOAClient_Swc_SOA_REQ("Veh_SetDrvSeatHeatingStruct.Veh_DrvSeatHeatingReq:1&ServiceExecuteFeedbackFlag:2"); // 测试步骤 TC_CANTest SOA REQ Veh_SetDrvSeatHeatingStruct.Veh_DrvSeatHeatingReq:1&ServiceExecuteFeedbackFlag:2
  gTC_CANTest_SOA_CheckReq("SetDrvSeatHeatingStruct.DrvSeatHeatingReq 1&ServiceExecuteFeedbackFlag 2"); // 预期结果 TC_CANTest SOA CheckReq SetDrvSeatHeatingStruct.DrvSeatHeatingReq 1&ServiceExecuteFeedbackFlag 2
  g_EM_SOAClient_Swc_SOA_CHECK_Prepare("Veh_SetDrvSeatHeatingRespStruct.Veh_SetDrvSeatHeatingNRC 0"); // 预期结果 TC_CANTest SOA check Veh_SetDrvSeatHeatingRespStruct.Veh_SetDrvSeatHeatingNRC 0
  g_CAN_Bus_Swc_Set("C_LDCU_SysSt.C_LDCU_EVSysReadySt 2"); // 测试步骤 TC_CANTest SET C_LDCU_SysSt.C_LDCU_EVSysReadySt 2//Not ready
  g_EM_SOAClient_Swc_SOA_CHECK("Veh_SetDrvSeatHeatingRespStruct.Veh_SetDrvSeatHeatingNRC 0"); // 预期结果 TC_CANTest SOA check Veh_SetDrvSeatHeatingRespStruct.Veh_SetDrvSeatHeatingNRC 0
  g_EM_SOAClient_Swc_SOA_CHECK("Veh_SeatCtrlService_ErrStruct.OpeNRC 0 traceback7"); // 预期结果 TC_CANTest SOA check Veh_SeatCtrlService_ErrStruct.OpeNRC 0 traceback7
  g_EM_Equipment_Swc_TC_IG("ON"); // 测试步骤 TC_IG ON
  g_EM_Equipment_Swc_TC_4G_Time_Delay_Second("2"); // 测试步骤 TC_Sleep 2
}

testcase SYS_CDCU_guanbizhujiazuoyijiare_0054()
{
  TestDescription("主驾座椅加热-12");
  teststep("warning","原始用例id为SYS-CDCU-关闭主驾座椅加热-0054");
  g_CAN_Bus_Swc_Set("I_LDCU_BodySysSt1.I_LDCU_PowerMode 1"); // 测试步骤 TC_CANTest SET I_LDCU_BodySysSt1.I_LDCU_PowerMode 1
  g_EM_Equipment_Swc_TC_4G_Time_Delay_Second("1"); // 测试步骤 TC_Sleep 1
  g_CAN_Bus_Swc_Set("I_LDCU_BodySysSt1.I_LDCU_PowerMode 2"); // 测试步骤 TC_CANTest SET I_LDCU_BodySysSt1.I_LDCU_PowerMode 2
  g_CAN_Bus_Swc_Set("I_LDCU_NM.I_LDCU_NMRepeatMsgReqBit 1"); // 测试步骤 TC_CANTest SET I_LDCU_NM.I_LDCU_NMRepeatMsgReqBit 1 //网络唤醒维持帧
  g_CAN_Bus_Swc_Set("C_LDCU_SysSt.C_LDCU_EVSysReadySt 2"); // 测试步骤 TC_CANTest SET C_LDCU_SysSt.C_LDCU_EVSysReadySt 2//HV ON
  gTC_CANTest_SOA_CheckReq_Prepare("SetDrvSeatHeatingStruct.DrvSeatHeatingReq 1&ServiceExecuteFeedbackFlag 2"); // 预期结果 TC_CANTest SOA CheckReq SetDrvSeatHeatingStruct.DrvSeatHeatingReq 1&ServiceExecuteFeedbackFlag 2
  g_EM_SOAClient_Swc_SOA_CHECK_Prepare("Veh_SetDrvSeatHeatingRespStruct.Veh_SetDrvSeatHeatingNRC 0"); // 预期结果 TC_CANTest SOA check Veh_SetDrvSeatHeatingRespStruct.Veh_SetDrvSeatHeatingNRC 0
  g_EM_SOAClient_Swc_SOA_CHECK_Prepare("Veh_SeatCtrlService_ErrStruct.OpeNRC 0 traceback7"); // 预期结果 TC_CANTest SOA check Veh_SeatCtrlService_ErrStruct.OpeNRC 0 traceback7
  g_EM_SOAClient_Swc_SOA_REQ("Veh_SetDrvSeatHeatingStruct.Veh_DrvSeatHeatingReq:1&ServiceExecuteFeedbackFlag:2"); // 测试步骤 TC_CANTest SOA REQ Veh_SetDrvSeatHeatingStruct.Veh_DrvSeatHeatingReq:1&ServiceExecuteFeedbackFlag:2
  gTC_CANTest_SOA_CheckReq("SetDrvSeatHeatingStruct.DrvSeatHeatingReq 1&ServiceExecuteFeedbackFlag 2"); // 预期结果 TC_CANTest SOA CheckReq SetDrvSeatHeatingStruct.DrvSeatHeatingReq 1&ServiceExecuteFeedbackFlag 2
  g_EM_SOAClient_Swc_SOA_CHECK("Veh_SetDrvSeatHeatingRespStruct.Veh_SetDrvSeatHeatingNRC 0"); // 预期结果 TC_CANTest SOA check Veh_SetDrvSeatHeatingRespStruct.Veh_SetDrvSeatHeatingNRC 0
  g_EM_SOAClient_Swc_SOA_CHECK("Veh_SeatCtrlService_ErrStruct.OpeNRC 0 traceback7"); // 预期结果 TC_CANTest SOA check Veh_SeatCtrlService_ErrStruct.OpeNRC 0 traceback7
  g_EM_Equipment_Swc_TC_IG("ON"); // 测试步骤 TC_IG ON
  g_EM_Equipment_Swc_TC_4G_Time_Delay_Second("2"); // 测试步骤 TC_Sleep 2
}

testcase SYS_CDCU_guanbizhujiazuoyijiare_0055()
{
  TestDescription("主驾座椅加热-13");
  teststep("warning","原始用例id为SYS-CDCU-关闭主驾座椅加热-0055");
  gTC_CANTest_SOA_CheckReq_Prepare("SetDrvSeatHeatingStruct.DrvSeatHeatingReq 2&ServiceExecuteFeedbackFlag 2"); // 预期结果 TC_CANTest SOA CheckReq SetDrvSeatHeatingStruct.DrvSeatHeatingReq 2&ServiceExecuteFeedbackFlag 2
  g_EM_SOAClient_Swc_SOA_CHECK_Prepare("Veh_SeatCtrlService_ErrStruct.OpeNRC 0 traceback7"); // 预期结果 TC_CANTest SOA check Veh_SeatCtrlService_ErrStruct.OpeNRC 0 traceback7
  g_EM_SOAClient_Swc_SOA_REQ("Veh_SetDrvSeatHeatingStruct.Veh_DrvSeatHeatingReq:2&ServiceExecuteFeedbackFlag:2"); // 测试步骤 TC_CANTest SOA REQ Veh_SetDrvSeatHeatingStruct.Veh_DrvSeatHeatingReq:2&ServiceExecuteFeedbackFlag:2
  gTC_CANTest_SOA_CheckReq("SetDrvSeatHeatingStruct.DrvSeatHeatingReq 2&ServiceExecuteFeedbackFlag 2"); // 预期结果 TC_CANTest SOA CheckReq SetDrvSeatHeatingStruct.DrvSeatHeatingReq 2&ServiceExecuteFeedbackFlag 2
  g_EM_SOAClient_Swc_SOA_CHECK("Veh_SeatCtrlService_ErrStruct.OpeNRC 0 traceback7"); // 预期结果 TC_CANTest SOA check Veh_SeatCtrlService_ErrStruct.OpeNRC 0 traceback7
}

testcase SYS_CDCU_guanbizhujiazuoyijiare_0056()
{
  TestDescription("主驾座椅加热-14");
  teststep("warning","原始用例id为SYS-CDCU-关闭主驾座椅加热-0056");
  gTC_CANTest_SOA_CheckReq_Prepare("SetDrvSeatHeatingStruct.DrvSeatHeatingReq 3&ServiceExecuteFeedbackFlag 2"); // 预期结果 TC_CANTest SOA CheckReq SetDrvSeatHeatingStruct.DrvSeatHeatingReq 3&ServiceExecuteFeedbackFlag 2
  g_EM_SOAClient_Swc_SOA_CHECK_Prepare("Veh_SeatCtrlService_ErrStruct.OpeNRC 0 traceback7"); // 预期结果 TC_CANTest SOA check Veh_SeatCtrlService_ErrStruct.OpeNRC 0 traceback7
  g_EM_SOAClient_Swc_SOA_REQ("Veh_SetDrvSeatHeatingStruct.Veh_DrvSeatHeatingReq:3&ServiceExecuteFeedbackFlag:2"); // 测试步骤 TC_CANTest SOA REQ Veh_SetDrvSeatHeatingStruct.Veh_DrvSeatHeatingReq:3&ServiceExecuteFeedbackFlag:2
  gTC_CANTest_SOA_CheckReq("SetDrvSeatHeatingStruct.DrvSeatHeatingReq 3&ServiceExecuteFeedbackFlag 2"); // 预期结果 TC_CANTest SOA CheckReq SetDrvSeatHeatingStruct.DrvSeatHeatingReq 3&ServiceExecuteFeedbackFlag 2
  g_EM_SOAClient_Swc_SOA_CHECK("Veh_SeatCtrlService_ErrStruct.OpeNRC 0 traceback7"); // 预期结果 TC_CANTest SOA check Veh_SeatCtrlService_ErrStruct.OpeNRC 0 traceback7
}

testcase SYS_CDCU_guanbizhujiazuoyijiare_0057()
{
  TestDescription("主驾座椅加热-15");
  teststep("warning","原始用例id为SYS-CDCU-关闭主驾座椅加热-0057");
  g_CAN_Bus_Swc_Set("C_LDCU_SysSt.C_LDCU_EVSysReadySt 0"); // 测试步骤 TC_CANTest SET C_LDCU_SysSt.C_LDCU_EVSysReadySt 0
  gTC_CANTest_SOA_CheckReq_Prepare("SetDrvSeatHeatingStruct.DrvSeatHeatingReq 4&ServiceExecuteFeedbackFlag 2"); // 预期结果 TC_CANTest SOA CheckReq SetDrvSeatHeatingStruct.DrvSeatHeatingReq 4&ServiceExecuteFeedbackFlag 2
  g_EM_SOAClient_Swc_SOA_CHECK_Prepare("Veh_SeatCtrlService_ErrStruct.OpeNRC 0 traceback7"); // 预期结果 TC_CANTest SOA check Veh_SeatCtrlService_ErrStruct.OpeNRC 0 traceback7
  g_EM_SOAClient_Swc_SOA_REQ("Veh_SetDrvSeatHeatingStruct.Veh_DrvSeatHeatingReq:4&ServiceExecuteFeedbackFlag:2"); // 测试步骤 TC_CANTest SOA REQ Veh_SetDrvSeatHeatingStruct.Veh_DrvSeatHeatingReq:4&ServiceExecuteFeedbackFlag:2
  gTC_CANTest_SOA_CheckReq("SetDrvSeatHeatingStruct.DrvSeatHeatingReq 4&ServiceExecuteFeedbackFlag 2"); // 预期结果 TC_CANTest SOA CheckReq SetDrvSeatHeatingStruct.DrvSeatHeatingReq 4&ServiceExecuteFeedbackFlag 2
  g_EM_SOAClient_Swc_SOA_CHECK("Veh_SeatCtrlService_ErrStruct.OpeNRC 0 traceback7"); // 预期结果 TC_CANTest SOA check Veh_SeatCtrlService_ErrStruct.OpeNRC 0 traceback7
}

testcase SYS_CDCU_guanbifujiazuoyijiare_0058()
{
  TestDescription("副驾座椅加热-1");
  teststep("warning","原始用例id为SYS-CDCU-关闭副驾座椅加热-0058");
  g_EM_Equipment_Swc_TC_PW("OFF"); // 测试步骤 TC_PW OFF
  g_EM_Equipment_Swc_TC_IG("OFF"); // 测试步骤 TC_IG OFF
  g_EM_Equipment_Swc_TC_4G_Time_Delay_Second("1"); // 测试步骤 TC_Sleep 1
  g_EM_Equipment_Swc_TC_PW("ON"); // 测试步骤 TC_PW ON
  g_EM_Equipment_Swc_TC_IG("ON"); // 测试步骤 TC_IG ON
  g_EM_Equipment_Swc_TC_4G_Time_Delay_Second("2"); // 测试步骤 TC_Sleep 2
}

testcase SYS_CDCU_guanbifujiazuoyijiare_0059()
{
  TestDescription("副驾座椅加热-2");
  teststep("warning","原始用例id为SYS-CDCU-关闭副驾座椅加热-0059");
  g_EM_Equipment_Swc_TC_IG("OFF"); // 测试步骤 TC_IG OFF
  g_CAN_Bus_Swc_Set("I_LDCU_BodySysSt1.I_LDCU_PowerMode 1"); // 测试步骤 TC_CANTest SET I_LDCU_BodySysSt1.I_LDCU_PowerMode 1
  g_EM_Equipment_Swc_TC_4G_Time_Delay_Second("1"); // 测试步骤 TC_Sleep 1
  g_CAN_Bus_Swc_Set("I_LDCU_BodySysSt1.I_LDCU_PowerMode 0"); // 测试步骤 TC_CANTest SET I_LDCU_BodySysSt1.I_LDCU_PowerMode 0
  g_CAN_Bus_Swc_Set("I_LDCU_NM.I_LDCU_NMRepeatMsgReqBit 1"); // 测试步骤 TC_CANTest SET I_LDCU_NM.I_LDCU_NMRepeatMsgReqBit 1 //网络唤醒维持帧
  g_CAN_Bus_Swc_Set("C_LDCU_SysSt.C_LDCU_EVSysReadySt 0"); // 测试步骤 TC_CANTest SET C_LDCU_SysSt.C_LDCU_EVSysReadySt 0//Not ready
  gTC_CANTest_SOA_CheckReq_Prepare("HighVoltageCtrlStruct.HighVoltageCtrl 2"); // 预期结果 TC_CANTest SOA CheckReq HighVoltageCtrlStruct.HighVoltageCtrl 2
  g_EM_SOAClient_Swc_SOA_CHECK_Prepare("Veh_SeatCtrlService_ErrStruct.OpeNRC 0 traceback7"); // 预期结果 TC_CANTest SOA check Veh_SeatCtrlService_ErrStruct.OpeNRC 0 traceback7
  g_EM_SOAClient_Swc_SOA_REQ("Veh_SetPsngrSeatHeatingStruct.Veh_PsngrSeatHeatingReq:1&UserID:0x01010001&ServiceExecuteFeedbackFlag:2"); // 测试步骤 TC_CANTest SOA REQ Veh_SetPsngrSeatHeatingStruct.Veh_PsngrSeatHeatingReq:1&UserID:0x01010001&ServiceExecuteFeedbackFlag:2
  gTC_CANTest_SOA_CheckReq("HighVoltageCtrlStruct.HighVoltageCtrl 2"); // 预期结果 TC_CANTest SOA CheckReq HighVoltageCtrlStruct.HighVoltageCtrl 2
  gTC_CANTest_SOA_CheckReq_Prepare("SetPsngrSeatHeatingStruct.PsngrSeatHeatingReq 1&ServiceExecuteFeedbackFlag 2"); // 预期结果 TC_CANTest SOA CheckReq SetPsngrSeatHeatingStruct.PsngrSeatHeatingReq 1&ServiceExecuteFeedbackFlag 2
  g_EM_SOAClient_Swc_SOA_CHECK_Prepare("Veh_SetPsngrSeatHeatingRespStruct.Veh_SetPsngrSeatHeatingNRC 0"); // 预期结果 TC_CANTest SOA check Veh_SetPsngrSeatHeatingRespStruct.Veh_SetPsngrSeatHeatingNRC 0
  g_CAN_Bus_Swc_Set("C_LDCU_SysSt.C_LDCU_EVSysReadySt 2"); // 测试步骤 TC_CANTest SET C_LDCU_SysSt.C_LDCU_EVSysReadySt 2//Not ready
  gTC_CANTest_SOA_CheckReq("SetPsngrSeatHeatingStruct.PsngrSeatHeatingReq 1&ServiceExecuteFeedbackFlag 2"); // 预期结果 TC_CANTest SOA CheckReq SetPsngrSeatHeatingStruct.PsngrSeatHeatingReq 1&ServiceExecuteFeedbackFlag 2
  g_EM_SOAClient_Swc_SOA_CHECK("Veh_SetPsngrSeatHeatingRespStruct.Veh_SetPsngrSeatHeatingNRC 0"); // 预期结果 TC_CANTest SOA check Veh_SetPsngrSeatHeatingRespStruct.Veh_SetPsngrSeatHeatingNRC 0
  g_EM_SOAClient_Swc_SOA_CHECK("Veh_SeatCtrlService_ErrStruct.OpeNRC 0 traceback7"); // 预期结果 TC_CANTest SOA check Veh_SeatCtrlService_ErrStruct.OpeNRC 0 traceback7
  g_EM_Equipment_Swc_TC_IG("ON"); // 测试步骤 TC_IG ON
  g_EM_SOAClient_Swc_SOA_CHECK_Prepare("SOAEngineInterSignalStruct.SeatHeatHVReq 0"); // 预期结果 TC_CANTest SOA check SOAEngineInterSignalStruct.SeatHeatHVReq 0
  g_CAN_Bus_Swc_Set("I_LDCU_BodySysSt1.I_LDCU_PowerMode 1"); // 测试步骤 TC_CANTest SET I_LDCU_BodySysSt1.I_LDCU_PowerMode 1
  g_EM_SOAClient_Swc_SOA_CHECK("SOAEngineInterSignalStruct.SeatHeatHVReq 0"); // 预期结果 TC_CANTest SOA check SOAEngineInterSignalStruct.SeatHeatHVReq 0
  g_EM_Equipment_Swc_TC_4G_Time_Delay_Second("2"); // 测试步骤 TC_Sleep 2
}

testcase SYS_CDCU_guanbifujiazuoyijiare_0060()
{
  TestDescription("副驾座椅加热-3");
  teststep("warning","原始用例id为SYS-CDCU-关闭副驾座椅加热-0060");
  g_EM_Equipment_Swc_TC_IG("OFF"); // 测试步骤 TC_IG OFF
  g_CAN_Bus_Swc_Set("I_LDCU_BodySysSt1.I_LDCU_PowerMode 1"); // 测试步骤 TC_CANTest SET I_LDCU_BodySysSt1.I_LDCU_PowerMode 1
  g_EM_Equipment_Swc_TC_4G_Time_Delay_Second("1"); // 测试步骤 TC_Sleep 1
  g_CAN_Bus_Swc_Set("I_LDCU_BodySysSt1.I_LDCU_PowerMode 0"); // 测试步骤 TC_CANTest SET I_LDCU_BodySysSt1.I_LDCU_PowerMode 0
  g_CAN_Bus_Swc_Set("I_LDCU_NM.I_LDCU_NMRepeatMsgReqBit 1"); // 测试步骤 TC_CANTest SET I_LDCU_NM.I_LDCU_NMRepeatMsgReqBit 1 //网络唤醒维持帧
  g_CAN_Bus_Swc_Set("C_LDCU_SysSt.C_LDCU_EVSysReadySt 1"); // 测试步骤 TC_CANTest SET C_LDCU_SysSt.C_LDCU_EVSysReadySt 1//HV ON
  g_EM_SOAClient_Swc_SOA_CHECK_Prepare("Veh_SeatCtrlService_ErrStruct.OpeNRC 0 traceback7"); // 预期结果 TC_CANTest SOA check Veh_SeatCtrlService_ErrStruct.OpeNRC 0 traceback7
  g_EM_SOAClient_Swc_SOA_REQ("Veh_SetPsngrSeatHeatingStruct.Veh_PsngrSeatHeatingReq:1&UserID:0x01010001&ServiceExecuteFeedbackFlag:2"); // 测试步骤 TC_CANTest SOA REQ Veh_SetPsngrSeatHeatingStruct.Veh_PsngrSeatHeatingReq:1&UserID:0x01010001&ServiceExecuteFeedbackFlag:2
  gTC_CANTest_SOA_CheckReq_Prepare("SetPsngrSeatHeatingStruct.PsngrSeatHeatingReq 1&ServiceExecuteFeedbackFlag 2"); // 预期结果 TC_CANTest SOA CheckReq SetPsngrSeatHeatingStruct.PsngrSeatHeatingReq 1&ServiceExecuteFeedbackFlag 2
  g_EM_SOAClient_Swc_SOA_CHECK_Prepare("Veh_SetPsngrSeatHeatingRespStruct.Veh_SetPsngrSeatHeatingNRC 0"); // 预期结果 TC_CANTest SOA check Veh_SetPsngrSeatHeatingRespStruct.Veh_SetPsngrSeatHeatingNRC 0
  g_CAN_Bus_Swc_Set("C_LDCU_SysSt.C_LDCU_EVSysReadySt 2"); // 测试步骤 TC_CANTest SET C_LDCU_SysSt.C_LDCU_EVSysReadySt 2//Not ready
  gTC_CANTest_SOA_CheckReq("SetPsngrSeatHeatingStruct.PsngrSeatHeatingReq 1&ServiceExecuteFeedbackFlag 2"); // 预期结果 TC_CANTest SOA CheckReq SetPsngrSeatHeatingStruct.PsngrSeatHeatingReq 1&ServiceExecuteFeedbackFlag 2
  g_EM_SOAClient_Swc_SOA_CHECK("Veh_SetPsngrSeatHeatingRespStruct.Veh_SetPsngrSeatHeatingNRC 0"); // 预期结果 TC_CANTest SOA check Veh_SetPsngrSeatHeatingRespStruct.Veh_SetPsngrSeatHeatingNRC 0
  g_EM_Equipment_Swc_TC_IG("ON"); // 测试步骤 TC_IG ON
  g_EM_SOAClient_Swc_SOA_CHECK("Veh_SeatCtrlService_ErrStruct.OpeNRC 0 traceback7"); // 预期结果 TC_CANTest SOA check Veh_SeatCtrlService_ErrStruct.OpeNRC 0 traceback7
  g_EM_Equipment_Swc_TC_4G_Time_Delay_Second("2"); // 测试步骤 TC_Sleep 2
}

testcase SYS_CDCU_guanbifujiazuoyijiare_0061()
{
  TestDescription("副驾座椅加热-4");
  teststep("warning","原始用例id为SYS-CDCU-关闭副驾座椅加热-0061");
  g_EM_Equipment_Swc_TC_IG("OFF"); // 测试步骤 TC_IG OFF
  g_CAN_Bus_Swc_Set("I_LDCU_BodySysSt1.I_LDCU_PowerMode 1"); // 测试步骤 TC_CANTest SET I_LDCU_BodySysSt1.I_LDCU_PowerMode 1
  g_EM_Equipment_Swc_TC_4G_Time_Delay_Second("1"); // 测试步骤 TC_Sleep 1
  g_CAN_Bus_Swc_Set("I_LDCU_BodySysSt1.I_LDCU_PowerMode 0"); // 测试步骤 TC_CANTest SET I_LDCU_BodySysSt1.I_LDCU_PowerMode 0
  g_CAN_Bus_Swc_Set("I_LDCU_NM.I_LDCU_NMRepeatMsgReqBit 1"); // 测试步骤 TC_CANTest SET I_LDCU_NM.I_LDCU_NMRepeatMsgReqBit 1 //网络唤醒维持帧
  g_CAN_Bus_Swc_Set("C_LDCU_SysSt.C_LDCU_EVSysReadySt 2"); // 测试步骤 TC_CANTest SET C_LDCU_SysSt.C_LDCU_EVSysReadySt 2//HV ON
  g_EM_SOAClient_Swc_SOA_CHECK_Prepare("Veh_SeatCtrlService_ErrStruct.OpeNRC 0 traceback7"); // 预期结果 TC_CANTest SOA check Veh_SeatCtrlService_ErrStruct.OpeNRC 0 traceback7
  g_EM_SOAClient_Swc_SOA_REQ("Veh_SetPsngrSeatHeatingStruct.Veh_PsngrSeatHeatingReq:1&UserID:0x01010001&ServiceExecuteFeedbackFlag:2"); // 测试步骤 TC_CANTest SOA REQ Veh_SetPsngrSeatHeatingStruct.Veh_PsngrSeatHeatingReq:1&UserID:0x01010001&ServiceExecuteFeedbackFlag:2
  gTC_CANTest_SOA_CheckReq_Prepare("SetPsngrSeatHeatingStruct.PsngrSeatHeatingReq 1&ServiceExecuteFeedbackFlag 2"); // 预期结果 TC_CANTest SOA CheckReq SetPsngrSeatHeatingStruct.PsngrSeatHeatingReq 1&ServiceExecuteFeedbackFlag 2
  g_EM_SOAClient_Swc_SOA_CHECK_Prepare("Veh_SetPsngrSeatHeatingRespStruct.Veh_SetPsngrSeatHeatingNRC 0"); // 预期结果 TC_CANTest SOA check Veh_SetPsngrSeatHeatingRespStruct.Veh_SetPsngrSeatHeatingNRC 0
  g_CAN_Bus_Swc_Set("C_LDCU_SysSt.C_LDCU_EVSysReadySt 2"); // 测试步骤 TC_CANTest SET C_LDCU_SysSt.C_LDCU_EVSysReadySt 2//Not ready
  gTC_CANTest_SOA_CheckReq("SetPsngrSeatHeatingStruct.PsngrSeatHeatingReq 1&ServiceExecuteFeedbackFlag 2"); // 预期结果 TC_CANTest SOA CheckReq SetPsngrSeatHeatingStruct.PsngrSeatHeatingReq 1&ServiceExecuteFeedbackFlag 2
  g_EM_SOAClient_Swc_SOA_CHECK("Veh_SetPsngrSeatHeatingRespStruct.Veh_SetPsngrSeatHeatingNRC 0"); // 预期结果 TC_CANTest SOA check Veh_SetPsngrSeatHeatingRespStruct.Veh_SetPsngrSeatHeatingNRC 0
  g_EM_Equipment_Swc_TC_IG("ON"); // 测试步骤 TC_IG ON
  g_EM_SOAClient_Swc_SOA_CHECK("Veh_SeatCtrlService_ErrStruct.OpeNRC 0 traceback7"); // 预期结果 TC_CANTest SOA check Veh_SeatCtrlService_ErrStruct.OpeNRC 0 traceback7
  g_EM_Equipment_Swc_TC_4G_Time_Delay_Second("2"); // 测试步骤 TC_Sleep 2
}

testcase SYS_CDCU_guanbifujiazuoyijiare_0062()
{
  TestDescription("副驾座椅加热-6");
  teststep("warning","原始用例id为SYS-CDCU-关闭副驾座椅加热-0062");
  g_CAN_Bus_Swc_Set("I_LDCU_BodySysSt1.I_LDCU_PowerMode 1"); // 测试步骤 TC_CANTest SET I_LDCU_BodySysSt1.I_LDCU_PowerMode 1
  g_CAN_Bus_Swc_Set("I_LDCU_NM.I_LDCU_NMRepeatMsgReqBit 1"); // 测试步骤 TC_CANTest SET I_LDCU_NM.I_LDCU_NMRepeatMsgReqBit 1 //网络唤醒维持帧
  g_CAN_Bus_Swc_Set("C_LDCU_SysSt.C_LDCU_EVSysReadySt 1"); // 测试步骤 TC_CANTest SET C_LDCU_SysSt.C_LDCU_EVSysReadySt 1//Not ready
  gTC_CANTest_SOA_CheckReq_Prepare("SetPsngrSeatHeatingStruct.PsngrSeatHeatingReq 1&ServiceExecuteFeedbackFlag 2"); // 预期结果 TC_CANTest SOA CheckReq SetPsngrSeatHeatingStruct.PsngrSeatHeatingReq 1&ServiceExecuteFeedbackFlag 2
  g_EM_SOAClient_Swc_SOA_CHECK_Prepare("Veh_SeatCtrlService_ErrStruct.OpeNRC 0 traceback7"); // 预期结果 TC_CANTest SOA check Veh_SeatCtrlService_ErrStruct.OpeNRC 0 traceback7
  g_EM_SOAClient_Swc_SOA_REQ("Veh_SetPsngrSeatHeatingStruct.Veh_PsngrSeatHeatingReq:1&ServiceExecuteFeedbackFlag:2"); // 测试步骤 TC_CANTest SOA REQ Veh_SetPsngrSeatHeatingStruct.Veh_PsngrSeatHeatingReq:1&ServiceExecuteFeedbackFlag:2
  gTC_CANTest_SOA_CheckReq("SetPsngrSeatHeatingStruct.PsngrSeatHeatingReq 1&ServiceExecuteFeedbackFlag 2"); // 预期结果 TC_CANTest SOA CheckReq SetPsngrSeatHeatingStruct.PsngrSeatHeatingReq 1&ServiceExecuteFeedbackFlag 2
  g_EM_SOAClient_Swc_SOA_CHECK_Prepare("Veh_SetPsngrSeatHeatingRespStruct.Veh_SetPsngrSeatHeatingNRC 0"); // 预期结果 TC_CANTest SOA check Veh_SetPsngrSeatHeatingRespStruct.Veh_SetPsngrSeatHeatingNRC 0
  g_CAN_Bus_Swc_Set("C_LDCU_SysSt.C_LDCU_EVSysReadySt 2"); // 测试步骤 TC_CANTest SET C_LDCU_SysSt.C_LDCU_EVSysReadySt 2//Not ready
  g_EM_SOAClient_Swc_SOA_CHECK("Veh_SetPsngrSeatHeatingRespStruct.Veh_SetPsngrSeatHeatingNRC 0"); // 预期结果 TC_CANTest SOA check Veh_SetPsngrSeatHeatingRespStruct.Veh_SetPsngrSeatHeatingNRC 0
  g_EM_SOAClient_Swc_SOA_CHECK("Veh_SeatCtrlService_ErrStruct.OpeNRC 0 traceback7"); // 预期结果 TC_CANTest SOA check Veh_SeatCtrlService_ErrStruct.OpeNRC 0 traceback7
}

testcase SYS_CDCU_guanbifujiazuoyijiare_0063()
{
  TestDescription("副驾座椅加热-7");
  teststep("warning","原始用例id为SYS-CDCU-关闭副驾座椅加热-0063");
  g_CAN_Bus_Swc_Set("I_LDCU_BodySysSt1.I_LDCU_PowerMode 1"); // 测试步骤 TC_CANTest SET I_LDCU_BodySysSt1.I_LDCU_PowerMode 1
  g_CAN_Bus_Swc_Set("I_LDCU_NM.I_LDCU_NMRepeatMsgReqBit 1"); // 测试步骤 TC_CANTest SET I_LDCU_NM.I_LDCU_NMRepeatMsgReqBit 1 //网络唤醒维持帧
  g_CAN_Bus_Swc_Set("C_LDCU_SysSt.C_LDCU_EVSysReadySt 2"); // 测试步骤 TC_CANTest SET C_LDCU_SysSt.C_LDCU_EVSysReadySt 2//Not ready
  gTC_CANTest_SOA_CheckReq_Prepare("SetPsngrSeatHeatingStruct.PsngrSeatHeatingReq 1&ServiceExecuteFeedbackFlag 2"); // 预期结果 TC_CANTest SOA CheckReq SetPsngrSeatHeatingStruct.PsngrSeatHeatingReq 1&ServiceExecuteFeedbackFlag 2
  g_EM_SOAClient_Swc_SOA_CHECK_Prepare("Veh_SeatCtrlService_ErrStruct.OpeNRC 0 traceback7"); // 预期结果 TC_CANTest SOA check Veh_SeatCtrlService_ErrStruct.OpeNRC 0 traceback7
  g_EM_SOAClient_Swc_SOA_REQ("Veh_SetPsngrSeatHeatingStruct.Veh_PsngrSeatHeatingReq:1&ServiceExecuteFeedbackFlag:2"); // 测试步骤 TC_CANTest SOA REQ Veh_SetPsngrSeatHeatingStruct.Veh_PsngrSeatHeatingReq:1&ServiceExecuteFeedbackFlag:2
  gTC_CANTest_SOA_CheckReq("SetPsngrSeatHeatingStruct.PsngrSeatHeatingReq 1&ServiceExecuteFeedbackFlag 2"); // 预期结果 TC_CANTest SOA CheckReq SetPsngrSeatHeatingStruct.PsngrSeatHeatingReq 1&ServiceExecuteFeedbackFlag 2
  g_EM_SOAClient_Swc_SOA_CHECK_Prepare("Veh_SetPsngrSeatHeatingRespStruct.Veh_SetPsngrSeatHeatingNRC 0"); // 预期结果 TC_CANTest SOA check Veh_SetPsngrSeatHeatingRespStruct.Veh_SetPsngrSeatHeatingNRC 0
  g_CAN_Bus_Swc_Set("C_LDCU_SysSt.C_LDCU_EVSysReadySt 2"); // 测试步骤 TC_CANTest SET C_LDCU_SysSt.C_LDCU_EVSysReadySt 2//Not ready
  g_EM_SOAClient_Swc_SOA_CHECK("Veh_SetPsngrSeatHeatingRespStruct.Veh_SetPsngrSeatHeatingNRC 0"); // 预期结果 TC_CANTest SOA check Veh_SetPsngrSeatHeatingRespStruct.Veh_SetPsngrSeatHeatingNRC 0
  g_EM_SOAClient_Swc_SOA_CHECK("Veh_SeatCtrlService_ErrStruct.OpeNRC 0 traceback7"); // 预期结果 TC_CANTest SOA check Veh_SeatCtrlService_ErrStruct.OpeNRC 0 traceback7
}

testcase SYS_CDCU_guanbifujiazuoyijiare_0064()
{
  TestDescription("副驾座椅加热-8");
  teststep("warning","原始用例id为SYS-CDCU-关闭副驾座椅加热-0064");
  gTC_CANTest_SOA_CheckReq_Prepare("SetPsngrSeatHeatingStruct.PsngrSeatHeatingReq 2&ServiceExecuteFeedbackFlag 2"); // 预期结果 TC_CANTest SOA CheckReq SetPsngrSeatHeatingStruct.PsngrSeatHeatingReq 2&ServiceExecuteFeedbackFlag 2
  g_EM_SOAClient_Swc_SOA_CHECK_Prepare("Veh_SetPsngrSeatHeatingRespStruct.Veh_SetPsngrSeatHeatingNRC 0"); // 预期结果 TC_CANTest SOA check Veh_SetPsngrSeatHeatingRespStruct.Veh_SetPsngrSeatHeatingNRC 0
  g_EM_SOAClient_Swc_SOA_CHECK_Prepare("Veh_SeatCtrlService_ErrStruct.OpeNRC 0 traceback7"); // 预期结果 TC_CANTest SOA check Veh_SeatCtrlService_ErrStruct.OpeNRC 0 traceback7
  g_EM_SOAClient_Swc_SOA_REQ("Veh_SetPsngrSeatHeatingStruct.Veh_PsngrSeatHeatingReq:2&ServiceExecuteFeedbackFlag:2"); // 测试步骤 TC_CANTest SOA REQ Veh_SetPsngrSeatHeatingStruct.Veh_PsngrSeatHeatingReq:2&ServiceExecuteFeedbackFlag:2
  gTC_CANTest_SOA_CheckReq("SetPsngrSeatHeatingStruct.PsngrSeatHeatingReq 2&ServiceExecuteFeedbackFlag 2"); // 预期结果 TC_CANTest SOA CheckReq SetPsngrSeatHeatingStruct.PsngrSeatHeatingReq 2&ServiceExecuteFeedbackFlag 2
  g_EM_SOAClient_Swc_SOA_CHECK("Veh_SetPsngrSeatHeatingRespStruct.Veh_SetPsngrSeatHeatingNRC 0"); // 预期结果 TC_CANTest SOA check Veh_SetPsngrSeatHeatingRespStruct.Veh_SetPsngrSeatHeatingNRC 0
  g_EM_SOAClient_Swc_SOA_CHECK("Veh_SeatCtrlService_ErrStruct.OpeNRC 0 traceback7"); // 预期结果 TC_CANTest SOA check Veh_SeatCtrlService_ErrStruct.OpeNRC 0 traceback7
  g_EM_Equipment_Swc_TC_4G_Time_Delay_Second("5"); // 测试步骤 TC_Sleep 5
}

testcase SYS_CDCU_guanbifujiazuoyijiare_0065()
{
  TestDescription("副驾座椅加热-9");
  teststep("warning","原始用例id为SYS-CDCU-关闭副驾座椅加热-0065");
  gTC_CANTest_SOA_CheckReq_Prepare("SetPsngrSeatHeatingStruct.PsngrSeatHeatingReq 3&ServiceExecuteFeedbackFlag 2"); // 预期结果 TC_CANTest SOA CheckReq SetPsngrSeatHeatingStruct.PsngrSeatHeatingReq 3&ServiceExecuteFeedbackFlag 2
  g_EM_SOAClient_Swc_SOA_CHECK_Prepare("Veh_SetPsngrSeatHeatingRespStruct.Veh_SetPsngrSeatHeatingNRC 0"); // 预期结果 TC_CANTest SOA check Veh_SetPsngrSeatHeatingRespStruct.Veh_SetPsngrSeatHeatingNRC 0
  g_EM_SOAClient_Swc_SOA_CHECK_Prepare("Veh_SeatCtrlService_ErrStruct.OpeNRC 0 traceback7"); // 预期结果 TC_CANTest SOA check Veh_SeatCtrlService_ErrStruct.OpeNRC 0 traceback7
  g_EM_SOAClient_Swc_SOA_REQ("Veh_SetPsngrSeatHeatingStruct.Veh_PsngrSeatHeatingReq:3&ServiceExecuteFeedbackFlag:2"); // 测试步骤 TC_CANTest SOA REQ Veh_SetPsngrSeatHeatingStruct.Veh_PsngrSeatHeatingReq:3&ServiceExecuteFeedbackFlag:2
  gTC_CANTest_SOA_CheckReq("SetPsngrSeatHeatingStruct.PsngrSeatHeatingReq 3&ServiceExecuteFeedbackFlag 2"); // 预期结果 TC_CANTest SOA CheckReq SetPsngrSeatHeatingStruct.PsngrSeatHeatingReq 3&ServiceExecuteFeedbackFlag 2
  g_EM_SOAClient_Swc_SOA_CHECK("Veh_SetPsngrSeatHeatingRespStruct.Veh_SetPsngrSeatHeatingNRC 0"); // 预期结果 TC_CANTest SOA check Veh_SetPsngrSeatHeatingRespStruct.Veh_SetPsngrSeatHeatingNRC 0
  g_EM_SOAClient_Swc_SOA_CHECK("Veh_SeatCtrlService_ErrStruct.OpeNRC 0 traceback7"); // 预期结果 TC_CANTest SOA check Veh_SeatCtrlService_ErrStruct.OpeNRC 0 traceback7
  g_EM_Equipment_Swc_TC_4G_Time_Delay_Second("5"); // 测试步骤 TC_Sleep 5
}

testcase SYS_CDCU_guanbifujiazuoyijiare_0066()
{
  TestDescription("副驾座椅加热-10");
  teststep("warning","原始用例id为SYS-CDCU-关闭副驾座椅加热-0066");
  g_CAN_Bus_Swc_Set("C_LDCU_SysSt.C_LDCU_EVSysReadySt 0"); // 测试步骤 TC_CANTest SET C_LDCU_SysSt.C_LDCU_EVSysReadySt 0
  gTC_CANTest_SOA_CheckReq_Prepare("SetPsngrSeatHeatingStruct.PsngrSeatHeatingReq 4&ServiceExecuteFeedbackFlag 2"); // 预期结果 TC_CANTest SOA CheckReq SetPsngrSeatHeatingStruct.PsngrSeatHeatingReq 4&ServiceExecuteFeedbackFlag 2
  g_EM_SOAClient_Swc_SOA_CHECK_Prepare("Veh_SetPsngrSeatHeatingRespStruct.Veh_SetPsngrSeatHeatingNRC 0"); // 预期结果 TC_CANTest SOA check Veh_SetPsngrSeatHeatingRespStruct.Veh_SetPsngrSeatHeatingNRC 0
  g_EM_SOAClient_Swc_SOA_CHECK_Prepare("Veh_SeatCtrlService_ErrStruct.OpeNRC 0 traceback7"); // 预期结果 TC_CANTest SOA check Veh_SeatCtrlService_ErrStruct.OpeNRC 0 traceback7
  g_EM_SOAClient_Swc_SOA_REQ("Veh_SetPsngrSeatHeatingStruct.Veh_PsngrSeatHeatingReq:4&ServiceExecuteFeedbackFlag:2"); // 测试步骤 TC_CANTest SOA REQ Veh_SetPsngrSeatHeatingStruct.Veh_PsngrSeatHeatingReq:4&ServiceExecuteFeedbackFlag:2
  gTC_CANTest_SOA_CheckReq("SetPsngrSeatHeatingStruct.PsngrSeatHeatingReq 4&ServiceExecuteFeedbackFlag 2"); // 预期结果 TC_CANTest SOA CheckReq SetPsngrSeatHeatingStruct.PsngrSeatHeatingReq 4&ServiceExecuteFeedbackFlag 2
  g_EM_SOAClient_Swc_SOA_CHECK("Veh_SetPsngrSeatHeatingRespStruct.Veh_SetPsngrSeatHeatingNRC 0"); // 预期结果 TC_CANTest SOA check Veh_SetPsngrSeatHeatingRespStruct.Veh_SetPsngrSeatHeatingNRC 0
  g_EM_SOAClient_Swc_SOA_CHECK("Veh_SeatCtrlService_ErrStruct.OpeNRC 0 traceback7"); // 预期结果 TC_CANTest SOA check Veh_SeatCtrlService_ErrStruct.OpeNRC 0 traceback7
}

testcase SYS_CDCU_guanbifujiazuoyijiare_0067()
{
  TestDescription("副驾座椅加热-11");
  teststep("warning","原始用例id为SYS-CDCU-关闭副驾座椅加热-0067");
  g_EM_Equipment_Swc_TC_PW("ON"); // 测试步骤 TC_PW ON
  g_EM_Equipment_Swc_TC_IG("OFF"); // 测试步骤 TC_IG OFF
  g_CAN_Bus_Swc_Set("I_LDCU_BodySysSt1.I_LDCU_PowerMode 1"); // 测试步骤 TC_CANTest SET I_LDCU_BodySysSt1.I_LDCU_PowerMode 1
  g_EM_Equipment_Swc_TC_4G_Time_Delay_Second("1"); // 测试步骤 TC_Sleep 1
  g_CAN_Bus_Swc_Set("I_LDCU_BodySysSt1.I_LDCU_PowerMode 2"); // 测试步骤 TC_CANTest SET I_LDCU_BodySysSt1.I_LDCU_PowerMode 2
  g_CAN_Bus_Swc_Set("I_LDCU_NM.I_LDCU_NMRepeatMsgReqBit 1"); // 测试步骤 TC_CANTest SET I_LDCU_NM.I_LDCU_NMRepeatMsgReqBit 1 //网络唤醒维持帧
  g_CAN_Bus_Swc_Set("C_LDCU_SysSt.C_LDCU_EVSysReadySt 0"); // 测试步骤 TC_CANTest SET C_LDCU_SysSt.C_LDCU_EVSysReadySt 0//Not ready
  gTC_CANTest_SOA_CheckReq_Prepare("HighVoltageCtrlStruct.HighVoltageCtrl 2"); // 预期结果 TC_CANTest SOA CheckReq HighVoltageCtrlStruct.HighVoltageCtrl 2
  g_EM_SOAClient_Swc_SOA_CHECK_Prepare("Veh_SeatCtrlService_ErrStruct.OpeNRC 0 traceback7"); // 预期结果 TC_CANTest SOA check Veh_SeatCtrlService_ErrStruct.OpeNRC 0 traceback7
  g_EM_SOAClient_Swc_SOA_REQ("Veh_SetPsngrSeatHeatingStruct.Veh_PsngrSeatHeatingReq:1&UserID:0x01010001&ServiceExecuteFeedbackFlag:2"); // 测试步骤 TC_CANTest SOA REQ Veh_SetPsngrSeatHeatingStruct.Veh_PsngrSeatHeatingReq:1&UserID:0x01010001&ServiceExecuteFeedbackFlag:2
  gTC_CANTest_SOA_CheckReq("HighVoltageCtrlStruct.HighVoltageCtrl 2"); // 预期结果 TC_CANTest SOA CheckReq HighVoltageCtrlStruct.HighVoltageCtrl 2
  gTC_CANTest_SOA_CheckReq_Prepare("SetPsngrSeatHeatingStruct.PsngrSeatHeatingReq 1&ServiceExecuteFeedbackFlag 2"); // 预期结果 TC_CANTest SOA CheckReq SetPsngrSeatHeatingStruct.PsngrSeatHeatingReq 1&ServiceExecuteFeedbackFlag 2
  g_EM_SOAClient_Swc_SOA_CHECK_Prepare("Veh_SetPsngrSeatHeatingRespStruct.Veh_SetPsngrSeatHeatingNRC 0"); // 预期结果 TC_CANTest SOA check Veh_SetPsngrSeatHeatingRespStruct.Veh_SetPsngrSeatHeatingNRC 0
  g_CAN_Bus_Swc_Set("C_LDCU_SysSt.C_LDCU_EVSysReadySt 2"); // 测试步骤 TC_CANTest SET C_LDCU_SysSt.C_LDCU_EVSysReadySt 2//Not ready
  gTC_CANTest_SOA_CheckReq("SetPsngrSeatHeatingStruct.PsngrSeatHeatingReq 1&ServiceExecuteFeedbackFlag 2"); // 预期结果 TC_CANTest SOA CheckReq SetPsngrSeatHeatingStruct.PsngrSeatHeatingReq 1&ServiceExecuteFeedbackFlag 2
  g_EM_SOAClient_Swc_SOA_CHECK("Veh_SetPsngrSeatHeatingRespStruct.Veh_SetPsngrSeatHeatingNRC 0"); // 预期结果 TC_CANTest SOA check Veh_SetPsngrSeatHeatingRespStruct.Veh_SetPsngrSeatHeatingNRC 0
  g_EM_Equipment_Swc_TC_IG("ON"); // 测试步骤 TC_IG ON
  g_EM_SOAClient_Swc_SOA_CHECK("Veh_SeatCtrlService_ErrStruct.OpeNRC 0 traceback7"); // 预期结果 TC_CANTest SOA check Veh_SeatCtrlService_ErrStruct.OpeNRC 0 traceback7
}

testcase SYS_CDCU_guanbifujiazuoyijiare_0068()
{
  TestDescription("副驾座椅加热-12");
  teststep("warning","原始用例id为SYS-CDCU-关闭副驾座椅加热-0068");
  g_EM_Equipment_Swc_TC_IG("OFF"); // 测试步骤 TC_IG OFF
  g_CAN_Bus_Swc_Set("I_LDCU_BodySysSt1.I_LDCU_PowerMode 1"); // 测试步骤 TC_CANTest SET I_LDCU_BodySysSt1.I_LDCU_PowerMode 1
  g_EM_Equipment_Swc_TC_4G_Time_Delay_Second("1"); // 测试步骤 TC_Sleep 1
  g_CAN_Bus_Swc_Set("I_LDCU_BodySysSt1.I_LDCU_PowerMode 2"); // 测试步骤 TC_CANTest SET I_LDCU_BodySysSt1.I_LDCU_PowerMode 2
  g_CAN_Bus_Swc_Set("I_LDCU_NM.I_LDCU_NMRepeatMsgReqBit 1"); // 测试步骤 TC_CANTest SET I_LDCU_NM.I_LDCU_NMRepeatMsgReqBit 1 //网络唤醒维持帧
  g_CAN_Bus_Swc_Set("C_LDCU_SysSt.C_LDCU_EVSysReadySt 1"); // 测试步骤 TC_CANTest SET C_LDCU_SysSt.C_LDCU_EVSysReadySt 1//HV ON
  gTC_CANTest_SOA_CheckReq_Prepare("SetPsngrSeatHeatingStruct.PsngrSeatHeatingReq 1&ServiceExecuteFeedbackFlag 2"); // 预期结果 TC_CANTest SOA CheckReq SetPsngrSeatHeatingStruct.PsngrSeatHeatingReq 1&ServiceExecuteFeedbackFlag 2
  g_EM_SOAClient_Swc_SOA_CHECK_Prepare("Veh_SeatCtrlService_ErrStruct.OpeNRC 0 traceback7"); // 预期结果 TC_CANTest SOA check Veh_SeatCtrlService_ErrStruct.OpeNRC 0 traceback7
  g_EM_SOAClient_Swc_SOA_REQ("Veh_SetPsngrSeatHeatingStruct.Veh_PsngrSeatHeatingReq:1&UserID:0x01010001&ServiceExecuteFeedbackFlag:2"); // 测试步骤 TC_CANTest SOA REQ Veh_SetPsngrSeatHeatingStruct.Veh_PsngrSeatHeatingReq:1&UserID:0x01010001&ServiceExecuteFeedbackFlag:2
  gTC_CANTest_SOA_CheckReq("SetPsngrSeatHeatingStruct.PsngrSeatHeatingReq 1&ServiceExecuteFeedbackFlag 2"); // 预期结果 TC_CANTest SOA CheckReq SetPsngrSeatHeatingStruct.PsngrSeatHeatingReq 1&ServiceExecuteFeedbackFlag 2
  g_EM_SOAClient_Swc_SOA_CHECK_Prepare("Veh_SetPsngrSeatHeatingRespStruct.Veh_SetPsngrSeatHeatingNRC 0"); // 预期结果 TC_CANTest SOA check Veh_SetPsngrSeatHeatingRespStruct.Veh_SetPsngrSeatHeatingNRC 0
  g_CAN_Bus_Swc_Set("C_LDCU_SysSt.C_LDCU_EVSysReadySt 2"); // 测试步骤 TC_CANTest SET C_LDCU_SysSt.C_LDCU_EVSysReadySt 2//Not ready
  g_EM_SOAClient_Swc_SOA_CHECK("Veh_SetPsngrSeatHeatingRespStruct.Veh_SetPsngrSeatHeatingNRC 0"); // 预期结果 TC_CANTest SOA check Veh_SetPsngrSeatHeatingRespStruct.Veh_SetPsngrSeatHeatingNRC 0
  g_EM_SOAClient_Swc_SOA_CHECK("Veh_SeatCtrlService_ErrStruct.OpeNRC 0 traceback7"); // 预期结果 TC_CANTest SOA check Veh_SeatCtrlService_ErrStruct.OpeNRC 0 traceback7
  g_EM_Equipment_Swc_TC_IG("ON"); // 测试步骤 TC_IG ON
}

testcase SYS_CDCU_guanbifujiazuoyijiare_0069()
{
  TestDescription("副驾座椅加热-13");
  teststep("warning","原始用例id为SYS-CDCU-关闭副驾座椅加热-0069");
  g_EM_Equipment_Swc_TC_IG("OFF"); // 测试步骤 TC_IG OFF
  g_CAN_Bus_Swc_Set("I_LDCU_BodySysSt1.I_LDCU_PowerMode 1"); // 测试步骤 TC_CANTest SET I_LDCU_BodySysSt1.I_LDCU_PowerMode 1
  g_EM_Equipment_Swc_TC_4G_Time_Delay_Second("1"); // 测试步骤 TC_Sleep 1
  g_CAN_Bus_Swc_Set("I_LDCU_BodySysSt1.I_LDCU_PowerMode 2"); // 测试步骤 TC_CANTest SET I_LDCU_BodySysSt1.I_LDCU_PowerMode 2
  g_CAN_Bus_Swc_Set("I_LDCU_NM.I_LDCU_NMRepeatMsgReqBit 1"); // 测试步骤 TC_CANTest SET I_LDCU_NM.I_LDCU_NMRepeatMsgReqBit 1 //网络唤醒维持帧
  g_CAN_Bus_Swc_Set("C_LDCU_SysSt.C_LDCU_EVSysReadySt 2"); // 测试步骤 TC_CANTest SET C_LDCU_SysSt.C_LDCU_EVSysReadySt 2//HV ON
  gTC_CANTest_SOA_CheckReq_Prepare("SetPsngrSeatHeatingStruct.PsngrSeatHeatingReq 1&ServiceExecuteFeedbackFlag 2"); // 预期结果 TC_CANTest SOA CheckReq SetPsngrSeatHeatingStruct.PsngrSeatHeatingReq 1&ServiceExecuteFeedbackFlag 2
  g_EM_SOAClient_Swc_SOA_CHECK_Prepare("Veh_SetPsngrSeatHeatingRespStruct.Veh_SetPsngrSeatHeatingNRC 0"); // 预期结果 TC_CANTest SOA check Veh_SetPsngrSeatHeatingRespStruct.Veh_SetPsngrSeatHeatingNRC 0
  g_EM_SOAClient_Swc_SOA_CHECK_Prepare("Veh_SeatCtrlService_ErrStruct.OpeNRC 0 traceback7"); // 预期结果 TC_CANTest SOA check Veh_SeatCtrlService_ErrStruct.OpeNRC 0 traceback7
  g_EM_SOAClient_Swc_SOA_REQ("Veh_SetPsngrSeatHeatingStruct.Veh_PsngrSeatHeatingReq:1&UserID:0x01010001&ServiceExecuteFeedbackFlag:2"); // 测试步骤 TC_CANTest SOA REQ Veh_SetPsngrSeatHeatingStruct.Veh_PsngrSeatHeatingReq:1&UserID:0x01010001&ServiceExecuteFeedbackFlag:2
  gTC_CANTest_SOA_CheckReq("SetPsngrSeatHeatingStruct.PsngrSeatHeatingReq 1&ServiceExecuteFeedbackFlag 2"); // 预期结果 TC_CANTest SOA CheckReq SetPsngrSeatHeatingStruct.PsngrSeatHeatingReq 1&ServiceExecuteFeedbackFlag 2
  g_EM_SOAClient_Swc_SOA_CHECK("Veh_SetPsngrSeatHeatingRespStruct.Veh_SetPsngrSeatHeatingNRC 0"); // 预期结果 TC_CANTest SOA check Veh_SetPsngrSeatHeatingRespStruct.Veh_SetPsngrSeatHeatingNRC 0
  g_EM_Equipment_Swc_TC_IG("ON"); // 测试步骤 TC_IG ON
  g_EM_SOAClient_Swc_SOA_CHECK("Veh_SeatCtrlService_ErrStruct.OpeNRC 0 traceback7"); // 预期结果 TC_CANTest SOA check Veh_SeatCtrlService_ErrStruct.OpeNRC 0 traceback7
}

testcase SYS_CDCU_guanbifujiazuoyijiare_0070()
{
  TestDescription("副驾座椅加热-14");
  teststep("warning","原始用例id为SYS-CDCU-关闭副驾座椅加热-0070");
  gTC_CANTest_SOA_CheckReq_Prepare("SetPsngrSeatHeatingStruct.PsngrSeatHeatingReq 2&ServiceExecuteFeedbackFlag 2"); // 预期结果 TC_CANTest SOA CheckReq SetPsngrSeatHeatingStruct.PsngrSeatHeatingReq 2&ServiceExecuteFeedbackFlag 2
  g_EM_SOAClient_Swc_SOA_CHECK_Prepare("Veh_SetPsngrSeatHeatingRespStruct.Veh_SetPsngrSeatHeatingNRC 0"); // 预期结果 TC_CANTest SOA check Veh_SetPsngrSeatHeatingRespStruct.Veh_SetPsngrSeatHeatingNRC 0
  g_EM_SOAClient_Swc_SOA_CHECK_Prepare("Veh_SeatCtrlService_ErrStruct.OpeNRC 0 traceback7"); // 预期结果 TC_CANTest SOA check Veh_SeatCtrlService_ErrStruct.OpeNRC 0 traceback7
  g_EM_SOAClient_Swc_SOA_REQ("Veh_SetPsngrSeatHeatingStruct.Veh_PsngrSeatHeatingReq:2&UserID:0x01010001&ServiceExecuteFeedbackFlag:2"); // 测试步骤 TC_CANTest SOA REQ Veh_SetPsngrSeatHeatingStruct.Veh_PsngrSeatHeatingReq:2&UserID:0x01010001&ServiceExecuteFeedbackFlag:2
  gTC_CANTest_SOA_CheckReq("SetPsngrSeatHeatingStruct.PsngrSeatHeatingReq 2&ServiceExecuteFeedbackFlag 2"); // 预期结果 TC_CANTest SOA CheckReq SetPsngrSeatHeatingStruct.PsngrSeatHeatingReq 2&ServiceExecuteFeedbackFlag 2
  g_EM_SOAClient_Swc_SOA_CHECK("Veh_SetPsngrSeatHeatingRespStruct.Veh_SetPsngrSeatHeatingNRC 0"); // 预期结果 TC_CANTest SOA check Veh_SetPsngrSeatHeatingRespStruct.Veh_SetPsngrSeatHeatingNRC 0
  g_EM_SOAClient_Swc_SOA_CHECK("Veh_SeatCtrlService_ErrStruct.OpeNRC 0 traceback7"); // 预期结果 TC_CANTest SOA check Veh_SeatCtrlService_ErrStruct.OpeNRC 0 traceback7
  g_EM_Equipment_Swc_TC_4G_Time_Delay_Second("5"); // 测试步骤 TC_Sleep 5
}

testcase SYS_CDCU_guanbifujiazuoyijiare_0071()
{
  TestDescription("副驾座椅加热-15");
  teststep("warning","原始用例id为SYS-CDCU-关闭副驾座椅加热-0071");
  gTC_CANTest_SOA_CheckReq_Prepare("SetPsngrSeatHeatingStruct.PsngrSeatHeatingReq 3&ServiceExecuteFeedbackFlag 2"); // 预期结果 TC_CANTest SOA CheckReq SetPsngrSeatHeatingStruct.PsngrSeatHeatingReq 3&ServiceExecuteFeedbackFlag 2
  g_EM_SOAClient_Swc_SOA_CHECK_Prepare("Veh_SetPsngrSeatHeatingRespStruct.Veh_SetPsngrSeatHeatingNRC 0"); // 预期结果 TC_CANTest SOA check Veh_SetPsngrSeatHeatingRespStruct.Veh_SetPsngrSeatHeatingNRC 0
  g_EM_SOAClient_Swc_SOA_CHECK_Prepare("Veh_SeatCtrlService_ErrStruct.OpeNRC 0 traceback7"); // 预期结果 TC_CANTest SOA check Veh_SeatCtrlService_ErrStruct.OpeNRC 0 traceback7
  g_EM_SOAClient_Swc_SOA_REQ("Veh_SetPsngrSeatHeatingStruct.Veh_PsngrSeatHeatingReq:3&UserID:0x01010001&ServiceExecuteFeedbackFlag:2"); // 测试步骤 TC_CANTest SOA REQ Veh_SetPsngrSeatHeatingStruct.Veh_PsngrSeatHeatingReq:3&UserID:0x01010001&ServiceExecuteFeedbackFlag:2
  gTC_CANTest_SOA_CheckReq("SetPsngrSeatHeatingStruct.PsngrSeatHeatingReq 3&ServiceExecuteFeedbackFlag 2"); // 预期结果 TC_CANTest SOA CheckReq SetPsngrSeatHeatingStruct.PsngrSeatHeatingReq 3&ServiceExecuteFeedbackFlag 2
  g_EM_SOAClient_Swc_SOA_CHECK("Veh_SetPsngrSeatHeatingRespStruct.Veh_SetPsngrSeatHeatingNRC 0"); // 预期结果 TC_CANTest SOA check Veh_SetPsngrSeatHeatingRespStruct.Veh_SetPsngrSeatHeatingNRC 0
  g_EM_SOAClient_Swc_SOA_CHECK("Veh_SeatCtrlService_ErrStruct.OpeNRC 0 traceback7"); // 预期结果 TC_CANTest SOA check Veh_SeatCtrlService_ErrStruct.OpeNRC 0 traceback7
  g_EM_Equipment_Swc_TC_4G_Time_Delay_Second("5"); // 测试步骤 TC_Sleep 5
}

testcase SYS_CDCU_guanbifujiazuoyijiare_0072()
{
  TestDescription("副驾座椅加热-16");
  teststep("warning","原始用例id为SYS-CDCU-关闭副驾座椅加热-0072");
  g_CAN_Bus_Swc_Set("C_LDCU_SysSt.C_LDCU_EVSysReadySt 0"); // 测试步骤 TC_CANTest SET C_LDCU_SysSt.C_LDCU_EVSysReadySt 0
  gTC_CANTest_SOA_CheckReq_Prepare("SetPsngrSeatHeatingStruct.PsngrSeatHeatingReq 4&ServiceExecuteFeedbackFlag 2"); // 预期结果 TC_CANTest SOA CheckReq SetPsngrSeatHeatingStruct.PsngrSeatHeatingReq 4&ServiceExecuteFeedbackFlag 2
  g_EM_SOAClient_Swc_SOA_CHECK_Prepare("Veh_SetPsngrSeatHeatingRespStruct.Veh_SetPsngrSeatHeatingNRC 0"); // 预期结果 TC_CANTest SOA check Veh_SetPsngrSeatHeatingRespStruct.Veh_SetPsngrSeatHeatingNRC 0
  g_EM_SOAClient_Swc_SOA_CHECK_Prepare("Veh_SeatCtrlService_ErrStruct.OpeNRC 0 traceback7"); // 预期结果 TC_CANTest SOA check Veh_SeatCtrlService_ErrStruct.OpeNRC 0 traceback7
  g_EM_SOAClient_Swc_SOA_REQ("Veh_SetPsngrSeatHeatingStruct.Veh_PsngrSeatHeatingReq:4&UserID:0x01010001&ServiceExecuteFeedbackFlag:2"); // 测试步骤 TC_CANTest SOA REQ Veh_SetPsngrSeatHeatingStruct.Veh_PsngrSeatHeatingReq:4&UserID:0x01010001&ServiceExecuteFeedbackFlag:2
  gTC_CANTest_SOA_CheckReq("SetPsngrSeatHeatingStruct.PsngrSeatHeatingReq 4&ServiceExecuteFeedbackFlag 2"); // 预期结果 TC_CANTest SOA CheckReq SetPsngrSeatHeatingStruct.PsngrSeatHeatingReq 4&ServiceExecuteFeedbackFlag 2
  g_EM_SOAClient_Swc_SOA_CHECK("Veh_SetPsngrSeatHeatingRespStruct.Veh_SetPsngrSeatHeatingNRC 0"); // 预期结果 TC_CANTest SOA check Veh_SetPsngrSeatHeatingRespStruct.Veh_SetPsngrSeatHeatingNRC 0
  g_EM_SOAClient_Swc_SOA_CHECK("Veh_SeatCtrlService_ErrStruct.OpeNRC 0 traceback7"); // 预期结果 TC_CANTest SOA check Veh_SeatCtrlService_ErrStruct.OpeNRC 0 traceback7
}

testcase SYS_CDCU_erpaizuocezuoyijiare_0073()
{
  TestDescription("前提条件初始化");
  teststep("warning","原始用例id为SYS-CDCU-二排左侧座椅加热-0073");
  g_EM_Equipment_Swc_TC_PW("OFF"); // 测试步骤 TC_PW OFF
  g_EM_Equipment_Swc_TC_IG("OFF"); // 测试步骤 TC_IG OFF
  g_EM_Equipment_Swc_TC_4G_Time_Delay_Second("1"); // 测试步骤 TC_Sleep 1
  g_EM_Equipment_Swc_TC_PW("ON"); // 测试步骤 TC_PW ON
  g_EM_Equipment_Swc_TC_IG("ON"); // 测试步骤 TC_IG ON
  g_EM_Equipment_Swc_TC_4G_Time_Delay_Second("5"); // 测试步骤 TC_Sleep 5
}

testcase SYS_CDCU_erpaizuocezuoyijiare_0074()
{
  TestDescription("二排左侧座椅加热-1");
  teststep("warning","原始用例id为SYS-CDCU-二排左侧座椅加热-0074");
  g_EM_Equipment_Swc_TC_IG("OFF"); // 测试步骤 TC_IG OFF
  g_CAN_Bus_Swc_Set("I_LDCU_BodySysSt1.I_LDCU_PowerMode 1"); // 测试步骤 TC_CANTest SET I_LDCU_BodySysSt1.I_LDCU_PowerMode 1
  g_EM_Equipment_Swc_TC_4G_Time_Delay_Second("1"); // 测试步骤 TC_Sleep 1
  g_CAN_Bus_Swc_Set("I_LDCU_BodySysSt1.I_LDCU_PowerMode 0"); // 测试步骤 TC_CANTest SET I_LDCU_BodySysSt1.I_LDCU_PowerMode 0
  g_CAN_Bus_Swc_Set("I_LDCU_NM.I_LDCU_NMRepeatMsgReqBit 1"); // 测试步骤 TC_CANTest SET I_LDCU_NM.I_LDCU_NMRepeatMsgReqBit 1 //网络唤醒维持帧
  g_CAN_Bus_Swc_Set("C_LDCU_SysSt.C_LDCU_EVSysReadySt 0"); // 测试步骤 TC_CANTest SET C_LDCU_SysSt.C_LDCU_EVSysReadySt 0//Not ready
  gTC_CANTest_SOA_CheckReq_Prepare("HighVoltageCtrlStruct.HighVoltageCtrl 2"); // 预期结果 TC_CANTest SOA CheckReq HighVoltageCtrlStruct.HighVoltageCtrl 2
  g_EM_SOAClient_Swc_SOA_CHECK_Prepare("Veh_SeatCtrlService_ErrStruct.OpeNRC 0 traceback7"); // 预期结果 TC_CANTest SOA check Veh_SeatCtrlService_ErrStruct.OpeNRC 0 traceback7
  g_EM_SOAClient_Swc_SOA_REQ("Veh_SetSecRowLtSeatHeatingStruct.Veh_SecRowLtSeatHeatingReq:1&UserID:0x01010001&ServiceExecuteFeedbackFlag:2"); // 测试步骤 TC_CANTest SOA REQ Veh_SetSecRowLtSeatHeatingStruct.Veh_SecRowLtSeatHeatingReq:1&UserID:0x01010001&ServiceExecuteFeedbackFlag:2
  gTC_CANTest_SOA_CheckReq("HighVoltageCtrlStruct.HighVoltageCtrl 2"); // 预期结果 TC_CANTest SOA CheckReq HighVoltageCtrlStruct.HighVoltageCtrl 2
  gTC_CANTest_SOA_CheckReq_Prepare("SetSecRowLtSeatHeatingStruct.SecRowLtSeatHeatingReq 1&ServiceExecuteFeedbackFlag 2"); // 预期结果 TC_CANTest SOA CheckReq SetSecRowLtSeatHeatingStruct.SecRowLtSeatHeatingReq 1&ServiceExecuteFeedbackFlag 2
  g_EM_SOAClient_Swc_SOA_CHECK_Prepare("Veh_SetSecRowLtSeatHeatingRespStruct.Veh_SetSecRowLtSeatHeatingNRC 0"); // 预期结果 TC_CANTest SOA check Veh_SetSecRowLtSeatHeatingRespStruct.Veh_SetSecRowLtSeatHeatingNRC 0
  g_CAN_Bus_Swc_Set("C_LDCU_SysSt.C_LDCU_EVSysReadySt 2"); // 测试步骤 TC_CANTest SET C_LDCU_SysSt.C_LDCU_EVSysReadySt 2//Not ready
  gTC_CANTest_SOA_CheckReq("SetSecRowLtSeatHeatingStruct.SecRowLtSeatHeatingReq 1&ServiceExecuteFeedbackFlag 2"); // 预期结果 TC_CANTest SOA CheckReq SetSecRowLtSeatHeatingStruct.SecRowLtSeatHeatingReq 1&ServiceExecuteFeedbackFlag 2
  g_EM_SOAClient_Swc_SOA_CHECK("Veh_SetSecRowLtSeatHeatingRespStruct.Veh_SetSecRowLtSeatHeatingNRC 0"); // 预期结果 TC_CANTest SOA check Veh_SetSecRowLtSeatHeatingRespStruct.Veh_SetSecRowLtSeatHeatingNRC 0
  g_EM_SOAClient_Swc_SOA_CHECK("Veh_SeatCtrlService_ErrStruct.OpeNRC 0 traceback7"); // 预期结果 TC_CANTest SOA check Veh_SeatCtrlService_ErrStruct.OpeNRC 0 traceback7
  g_EM_Equipment_Swc_TC_IG("ON"); // 测试步骤 TC_IG ON
  g_EM_Equipment_Swc_TC_4G_Time_Delay_Second("2"); // 测试步骤 TC_Sleep 2
}

testcase SYS_CDCU_erpaizuocezuoyijiare_0075()
{
  TestDescription("二排左侧座椅加热-2");
  teststep("warning","原始用例id为SYS-CDCU-二排左侧座椅加热-0075");
  g_EM_Equipment_Swc_TC_IG("OFF"); // 测试步骤 TC_IG OFF
  g_CAN_Bus_Swc_Set("I_LDCU_BodySysSt1.I_LDCU_PowerMode 1"); // 测试步骤 TC_CANTest SET I_LDCU_BodySysSt1.I_LDCU_PowerMode 1
  g_EM_Equipment_Swc_TC_4G_Time_Delay_Second("1"); // 测试步骤 TC_Sleep 1
  g_CAN_Bus_Swc_Set("I_LDCU_BodySysSt1.I_LDCU_PowerMode 0"); // 测试步骤 TC_CANTest SET I_LDCU_BodySysSt1.I_LDCU_PowerMode 0
  g_CAN_Bus_Swc_Set("I_LDCU_NM.I_LDCU_NMRepeatMsgReqBit 1"); // 测试步骤 TC_CANTest SET I_LDCU_NM.I_LDCU_NMRepeatMsgReqBit 1 //网络唤醒维持帧
  g_CAN_Bus_Swc_Set("C_LDCU_SysSt.C_LDCU_EVSysReadySt 1"); // 测试步骤 TC_CANTest SET C_LDCU_SysSt.C_LDCU_EVSysReadySt 1//HV ON
  g_EM_SOAClient_Swc_SOA_CHECK_Prepare("Veh_SeatCtrlService_ErrStruct.OpeNRC 0 traceback7"); // 预期结果 TC_CANTest SOA check Veh_SeatCtrlService_ErrStruct.OpeNRC 0 traceback7
  g_EM_SOAClient_Swc_SOA_REQ("Veh_SetSecRowLtSeatHeatingStruct.Veh_SecRowLtSeatHeatingReq:1&UserID:0x01010001&ServiceExecuteFeedbackFlag:2"); // 测试步骤 TC_CANTest SOA REQ Veh_SetSecRowLtSeatHeatingStruct.Veh_SecRowLtSeatHeatingReq:1&UserID:0x01010001&ServiceExecuteFeedbackFlag:2
  gTC_CANTest_SOA_CheckReq_Prepare("SetSecRowLtSeatHeatingStruct.SecRowLtSeatHeatingReq 1&ServiceExecuteFeedbackFlag 2"); // 预期结果 TC_CANTest SOA CheckReq SetSecRowLtSeatHeatingStruct.SecRowLtSeatHeatingReq 1&ServiceExecuteFeedbackFlag 2
  g_EM_SOAClient_Swc_SOA_CHECK_Prepare("Veh_SetSecRowLtSeatHeatingRespStruct.Veh_SetSecRowLtSeatHeatingNRC 0"); // 预期结果 TC_CANTest SOA check Veh_SetSecRowLtSeatHeatingRespStruct.Veh_SetSecRowLtSeatHeatingNRC 0
  g_CAN_Bus_Swc_Set("C_LDCU_SysSt.C_LDCU_EVSysReadySt 2"); // 测试步骤 TC_CANTest SET C_LDCU_SysSt.C_LDCU_EVSysReadySt 2//Not ready
  gTC_CANTest_SOA_CheckReq("SetSecRowLtSeatHeatingStruct.SecRowLtSeatHeatingReq 1&ServiceExecuteFeedbackFlag 2"); // 预期结果 TC_CANTest SOA CheckReq SetSecRowLtSeatHeatingStruct.SecRowLtSeatHeatingReq 1&ServiceExecuteFeedbackFlag 2
  g_EM_SOAClient_Swc_SOA_CHECK("Veh_SetSecRowLtSeatHeatingRespStruct.Veh_SetSecRowLtSeatHeatingNRC 0"); // 预期结果 TC_CANTest SOA check Veh_SetSecRowLtSeatHeatingRespStruct.Veh_SetSecRowLtSeatHeatingNRC 0
  g_EM_SOAClient_Swc_SOA_CHECK("Veh_SeatCtrlService_ErrStruct.OpeNRC 0 traceback7"); // 预期结果 TC_CANTest SOA check Veh_SeatCtrlService_ErrStruct.OpeNRC 0 traceback7
  g_EM_Equipment_Swc_TC_IG("ON"); // 测试步骤 TC_IG ON
  g_EM_Equipment_Swc_TC_4G_Time_Delay_Second("2"); // 测试步骤 TC_Sleep 2
}

testcase SYS_CDCU_erpaizuocezuoyijiare_0076()
{
  TestDescription("二排左侧座椅加热-3");
  teststep("warning","原始用例id为SYS-CDCU-二排左侧座椅加热-0076");
  g_EM_Equipment_Swc_TC_IG("OFF"); // 测试步骤 TC_IG OFF
  g_CAN_Bus_Swc_Set("I_LDCU_BodySysSt1.I_LDCU_PowerMode 1"); // 测试步骤 TC_CANTest SET I_LDCU_BodySysSt1.I_LDCU_PowerMode 1
  g_EM_Equipment_Swc_TC_4G_Time_Delay_Second("1"); // 测试步骤 TC_Sleep 1
  g_CAN_Bus_Swc_Set("I_LDCU_BodySysSt1.I_LDCU_PowerMode 0"); // 测试步骤 TC_CANTest SET I_LDCU_BodySysSt1.I_LDCU_PowerMode 0
  g_CAN_Bus_Swc_Set("I_LDCU_NM.I_LDCU_NMRepeatMsgReqBit 1"); // 测试步骤 TC_CANTest SET I_LDCU_NM.I_LDCU_NMRepeatMsgReqBit 1 //网络唤醒维持帧
  g_CAN_Bus_Swc_Set("C_LDCU_SysSt.C_LDCU_EVSysReadySt 2"); // 测试步骤 TC_CANTest SET C_LDCU_SysSt.C_LDCU_EVSysReadySt 2//HV ON
  g_EM_SOAClient_Swc_SOA_CHECK_Prepare("Veh_SeatCtrlService_ErrStruct.OpeNRC 0 traceback7"); // 预期结果 TC_CANTest SOA check Veh_SeatCtrlService_ErrStruct.OpeNRC 0 traceback7
  g_EM_SOAClient_Swc_SOA_REQ("Veh_SetSecRowLtSeatHeatingStruct.Veh_SecRowLtSeatHeatingReq:1&UserID:0x01010001&ServiceExecuteFeedbackFlag:2"); // 测试步骤 TC_CANTest SOA REQ Veh_SetSecRowLtSeatHeatingStruct.Veh_SecRowLtSeatHeatingReq:1&UserID:0x01010001&ServiceExecuteFeedbackFlag:2
  gTC_CANTest_SOA_CheckReq_Prepare("SetSecRowLtSeatHeatingStruct.SecRowLtSeatHeatingReq 1&ServiceExecuteFeedbackFlag 2"); // 预期结果 TC_CANTest SOA CheckReq SetSecRowLtSeatHeatingStruct.SecRowLtSeatHeatingReq 1&ServiceExecuteFeedbackFlag 2
  g_EM_SOAClient_Swc_SOA_CHECK_Prepare("Veh_SetSecRowLtSeatHeatingRespStruct.Veh_SetSecRowLtSeatHeatingNRC 0"); // 预期结果 TC_CANTest SOA check Veh_SetSecRowLtSeatHeatingRespStruct.Veh_SetSecRowLtSeatHeatingNRC 0
  g_CAN_Bus_Swc_Set("C_LDCU_SysSt.C_LDCU_EVSysReadySt 2"); // 测试步骤 TC_CANTest SET C_LDCU_SysSt.C_LDCU_EVSysReadySt 2//Not ready
  gTC_CANTest_SOA_CheckReq("SetSecRowLtSeatHeatingStruct.SecRowLtSeatHeatingReq 1&ServiceExecuteFeedbackFlag 2"); // 预期结果 TC_CANTest SOA CheckReq SetSecRowLtSeatHeatingStruct.SecRowLtSeatHeatingReq 1&ServiceExecuteFeedbackFlag 2
  g_EM_SOAClient_Swc_SOA_CHECK("Veh_SetSecRowLtSeatHeatingRespStruct.Veh_SetSecRowLtSeatHeatingNRC 0"); // 预期结果 TC_CANTest SOA check Veh_SetSecRowLtSeatHeatingRespStruct.Veh_SetSecRowLtSeatHeatingNRC 0
  g_EM_SOAClient_Swc_SOA_CHECK("Veh_SeatCtrlService_ErrStruct.OpeNRC 0 traceback7"); // 预期结果 TC_CANTest SOA check Veh_SeatCtrlService_ErrStruct.OpeNRC 0 traceback7
  g_EM_Equipment_Swc_TC_IG("ON"); // 测试步骤 TC_IG ON
  g_EM_Equipment_Swc_TC_4G_Time_Delay_Second("2"); // 测试步骤 TC_Sleep 2
}

testcase SYS_CDCU_erpaizuocezuoyijiare_0077()
{
  TestDescription("二排左侧座椅加热-4");
  teststep("warning","原始用例id为SYS-CDCU-二排左侧座椅加热-0077");
  g_CAN_Bus_Swc_Set("I_LDCU_BodySysSt1.I_LDCU_PowerMode 1"); // 测试步骤 TC_CANTest SET I_LDCU_BodySysSt1.I_LDCU_PowerMode 1
  g_CAN_Bus_Swc_Set("I_LDCU_NM.I_LDCU_NMRepeatMsgReqBit 1"); // 测试步骤 TC_CANTest SET I_LDCU_NM.I_LDCU_NMRepeatMsgReqBit 1 //网络唤醒维持帧
  g_CAN_Bus_Swc_Set("C_LDCU_SysSt.C_LDCU_EVSysReadySt 2"); // 测试步骤 TC_CANTest SET C_LDCU_SysSt.C_LDCU_EVSysReadySt 2//ready
  gTC_CANTest_SOA_CheckReq_Prepare("SetSecRowLtSeatHeatingStruct.SecRowLtSeatHeatingReq 1&ServiceExecuteFeedbackFlag 2"); // 预期结果 TC_CANTest SOA CheckReq SetSecRowLtSeatHeatingStruct.SecRowLtSeatHeatingReq 1&ServiceExecuteFeedbackFlag 2
  g_EM_SOAClient_Swc_SOA_CHECK_Prepare("Veh_SeatCtrlService_ErrStruct.OpeNRC 0 traceback7"); // 预期结果 TC_CANTest SOA check Veh_SeatCtrlService_ErrStruct.OpeNRC 0 traceback7
  g_EM_SOAClient_Swc_SOA_REQ("Veh_SetSecRowLtSeatHeatingStruct.Veh_SecRowLtSeatHeatingReq:1&ServiceExecuteFeedbackFlag:2"); // 测试步骤 TC_CANTest SOA REQ Veh_SetSecRowLtSeatHeatingStruct.Veh_SecRowLtSeatHeatingReq:1&ServiceExecuteFeedbackFlag:2
  gTC_CANTest_SOA_CheckReq("SetSecRowLtSeatHeatingStruct.SecRowLtSeatHeatingReq 1&ServiceExecuteFeedbackFlag 2"); // 预期结果 TC_CANTest SOA CheckReq SetSecRowLtSeatHeatingStruct.SecRowLtSeatHeatingReq 1&ServiceExecuteFeedbackFlag 2
  g_CAN_Bus_Swc_Set("C_LDCU_SysSt.C_LDCU_EVSysReadySt 2"); // 测试步骤 TC_CANTest SET C_LDCU_SysSt.C_LDCU_EVSysReadySt 2//Not ready
  g_EM_SOAClient_Swc_SOA_CHECK("Veh_SeatCtrlService_ErrStruct.OpeNRC 0 traceback7"); // 预期结果 TC_CANTest SOA check Veh_SeatCtrlService_ErrStruct.OpeNRC 0 traceback7
}

testcase SYS_CDCU_erpaizuocezuoyijiare_0078()
{
  TestDescription("二排左侧座椅加热-5");
  teststep("warning","原始用例id为SYS-CDCU-二排左侧座椅加热-0078");
  g_CAN_Bus_Swc_Set("I_LDCU_BodySysSt1.I_LDCU_PowerMode 1"); // 测试步骤 TC_CANTest SET I_LDCU_BodySysSt1.I_LDCU_PowerMode 1
  g_CAN_Bus_Swc_Set("I_LDCU_NM.I_LDCU_NMRepeatMsgReqBit 1"); // 测试步骤 TC_CANTest SET I_LDCU_NM.I_LDCU_NMRepeatMsgReqBit 1 //网络唤醒维持帧
  g_CAN_Bus_Swc_Set("C_LDCU_SysSt.C_LDCU_EVSysReadySt 1"); // 测试步骤 TC_CANTest SET C_LDCU_SysSt.C_LDCU_EVSysReadySt 1//Not ready
  gTC_CANTest_SOA_CheckReq_Prepare("SetSecRowLtSeatHeatingStruct.SecRowLtSeatHeatingReq 1&ServiceExecuteFeedbackFlag 2"); // 预期结果 TC_CANTest SOA CheckReq SetSecRowLtSeatHeatingStruct.SecRowLtSeatHeatingReq 1&ServiceExecuteFeedbackFlag 2
  g_EM_SOAClient_Swc_SOA_CHECK_Prepare("Veh_SeatCtrlService_ErrStruct.OpeNRC 0 traceback7"); // 预期结果 TC_CANTest SOA check Veh_SeatCtrlService_ErrStruct.OpeNRC 0 traceback7
  g_EM_SOAClient_Swc_SOA_REQ("Veh_SetSecRowLtSeatHeatingStruct.Veh_SecRowLtSeatHeatingReq:1&ServiceExecuteFeedbackFlag:2"); // 测试步骤 TC_CANTest SOA REQ Veh_SetSecRowLtSeatHeatingStruct.Veh_SecRowLtSeatHeatingReq:1&ServiceExecuteFeedbackFlag:2
  gTC_CANTest_SOA_CheckReq("SetSecRowLtSeatHeatingStruct.SecRowLtSeatHeatingReq 1&ServiceExecuteFeedbackFlag 2"); // 预期结果 TC_CANTest SOA CheckReq SetSecRowLtSeatHeatingStruct.SecRowLtSeatHeatingReq 1&ServiceExecuteFeedbackFlag 2
  g_CAN_Bus_Swc_Set("C_LDCU_SysSt.C_LDCU_EVSysReadySt 2"); // 测试步骤 TC_CANTest SET C_LDCU_SysSt.C_LDCU_EVSysReadySt 2//Not ready
  g_EM_SOAClient_Swc_SOA_CHECK("Veh_SeatCtrlService_ErrStruct.OpeNRC 0 traceback7"); // 预期结果 TC_CANTest SOA check Veh_SeatCtrlService_ErrStruct.OpeNRC 0 traceback7
}

testcase SYS_CDCU_erpaizuocezuoyijiare_0079()
{
  TestDescription("二排左侧座椅加热-6");
  teststep("warning","原始用例id为SYS-CDCU-二排左侧座椅加热-0079");
  g_CAN_Bus_Swc_Set("I_LDCU_BodySysSt1.I_LDCU_PowerMode 1"); // 测试步骤 TC_CANTest SET I_LDCU_BodySysSt1.I_LDCU_PowerMode 1
  g_CAN_Bus_Swc_Set("I_LDCU_NM.I_LDCU_NMRepeatMsgReqBit 1"); // 测试步骤 TC_CANTest SET I_LDCU_NM.I_LDCU_NMRepeatMsgReqBit 1 //网络唤醒维持帧
  g_CAN_Bus_Swc_Set("C_LDCU_SysSt.C_LDCU_EVSysReadySt 2"); // 测试步骤 TC_CANTest SET C_LDCU_SysSt.C_LDCU_EVSysReadySt 2//Not ready
  gTC_CANTest_SOA_CheckReq_Prepare("SetSecRowLtSeatHeatingStruct.SecRowLtSeatHeatingReq 1&ServiceExecuteFeedbackFlag 2"); // 预期结果 TC_CANTest SOA CheckReq SetSecRowLtSeatHeatingStruct.SecRowLtSeatHeatingReq 1&ServiceExecuteFeedbackFlag 2
  g_EM_SOAClient_Swc_SOA_CHECK_Prepare("Veh_SeatCtrlService_ErrStruct.OpeNRC 0 traceback7"); // 预期结果 TC_CANTest SOA check Veh_SeatCtrlService_ErrStruct.OpeNRC 0 traceback7
  g_EM_SOAClient_Swc_SOA_REQ("Veh_SetSecRowLtSeatHeatingStruct.Veh_SecRowLtSeatHeatingReq:1&ServiceExecuteFeedbackFlag:2"); // 测试步骤 TC_CANTest SOA REQ Veh_SetSecRowLtSeatHeatingStruct.Veh_SecRowLtSeatHeatingReq:1&ServiceExecuteFeedbackFlag:2
  gTC_CANTest_SOA_CheckReq("SetSecRowLtSeatHeatingStruct.SecRowLtSeatHeatingReq 1&ServiceExecuteFeedbackFlag 2"); // 预期结果 TC_CANTest SOA CheckReq SetSecRowLtSeatHeatingStruct.SecRowLtSeatHeatingReq 1&ServiceExecuteFeedbackFlag 2
  g_CAN_Bus_Swc_Set("C_LDCU_SysSt.C_LDCU_EVSysReadySt 2"); // 测试步骤 TC_CANTest SET C_LDCU_SysSt.C_LDCU_EVSysReadySt 2//Not ready
  g_EM_SOAClient_Swc_SOA_CHECK("Veh_SeatCtrlService_ErrStruct.OpeNRC 0 traceback7"); // 预期结果 TC_CANTest SOA check Veh_SeatCtrlService_ErrStruct.OpeNRC 0 traceback7
}

testcase SYS_CDCU_erpaizuocezuoyijiare_0080()
{
  TestDescription("二排左侧座椅加热-7");
  teststep("warning","原始用例id为SYS-CDCU-二排左侧座椅加热-0080");
  gTC_CANTest_SOA_CheckReq_Prepare("SetSecRowLtSeatHeatingStruct.SecRowLtSeatHeatingReq 2&ServiceExecuteFeedbackFlag 2"); // 预期结果 TC_CANTest SOA CheckReq SetSecRowLtSeatHeatingStruct.SecRowLtSeatHeatingReq 2&ServiceExecuteFeedbackFlag 2
  g_EM_SOAClient_Swc_SOA_CHECK_Prepare("Veh_SeatCtrlService_ErrStruct.OpeNRC 0 traceback7"); // 预期结果 TC_CANTest SOA check Veh_SeatCtrlService_ErrStruct.OpeNRC 0 traceback7
  g_EM_SOAClient_Swc_SOA_REQ("Veh_SetSecRowLtSeatHeatingStruct.Veh_SecRowLtSeatHeatingReq:2&ServiceExecuteFeedbackFlag:2"); // 测试步骤 TC_CANTest SOA REQ Veh_SetSecRowLtSeatHeatingStruct.Veh_SecRowLtSeatHeatingReq:2&ServiceExecuteFeedbackFlag:2
  gTC_CANTest_SOA_CheckReq("SetSecRowLtSeatHeatingStruct.SecRowLtSeatHeatingReq 2&ServiceExecuteFeedbackFlag 2"); // 预期结果 TC_CANTest SOA CheckReq SetSecRowLtSeatHeatingStruct.SecRowLtSeatHeatingReq 2&ServiceExecuteFeedbackFlag 2
  g_EM_SOAClient_Swc_SOA_CHECK("Veh_SeatCtrlService_ErrStruct.OpeNRC 0 traceback7"); // 预期结果 TC_CANTest SOA check Veh_SeatCtrlService_ErrStruct.OpeNRC 0 traceback7
  g_EM_Equipment_Swc_TC_4G_Time_Delay_Second("5"); // 测试步骤 TC_Sleep 5
}

testcase SYS_CDCU_erpaizuocezuoyijiare_0081()
{
  TestDescription("二排左侧座椅加热-8");
  teststep("warning","原始用例id为SYS-CDCU-二排左侧座椅加热-0081");
  gTC_CANTest_SOA_CheckReq_Prepare("SetSecRowLtSeatHeatingStruct.SecRowLtSeatHeatingReq 3&ServiceExecuteFeedbackFlag 2"); // 预期结果 TC_CANTest SOA CheckReq SetSecRowLtSeatHeatingStruct.SecRowLtSeatHeatingReq 3&ServiceExecuteFeedbackFlag 2
  g_EM_SOAClient_Swc_SOA_CHECK_Prepare("Veh_SeatCtrlService_ErrStruct.OpeNRC 0 traceback7"); // 预期结果 TC_CANTest SOA check Veh_SeatCtrlService_ErrStruct.OpeNRC 0 traceback7
  g_EM_SOAClient_Swc_SOA_REQ("Veh_SetSecRowLtSeatHeatingStruct.Veh_SecRowLtSeatHeatingReq:3&ServiceExecuteFeedbackFlag:2"); // 测试步骤 TC_CANTest SOA REQ Veh_SetSecRowLtSeatHeatingStruct.Veh_SecRowLtSeatHeatingReq:3&ServiceExecuteFeedbackFlag:2
  gTC_CANTest_SOA_CheckReq("SetSecRowLtSeatHeatingStruct.SecRowLtSeatHeatingReq 3&ServiceExecuteFeedbackFlag 2"); // 预期结果 TC_CANTest SOA CheckReq SetSecRowLtSeatHeatingStruct.SecRowLtSeatHeatingReq 3&ServiceExecuteFeedbackFlag 2
  g_EM_SOAClient_Swc_SOA_CHECK("Veh_SeatCtrlService_ErrStruct.OpeNRC 0 traceback7"); // 预期结果 TC_CANTest SOA check Veh_SeatCtrlService_ErrStruct.OpeNRC 0 traceback7
  g_EM_Equipment_Swc_TC_4G_Time_Delay_Second("5"); // 测试步骤 TC_Sleep 5
}

testcase SYS_CDCU_erpaizuocezuoyijiare_0082()
{
  TestDescription("二排左侧座椅加热-9");
  teststep("warning","原始用例id为SYS-CDCU-二排左侧座椅加热-0082");
  g_CAN_Bus_Swc_Set("C_LDCU_SysSt.C_LDCU_EVSysReadySt 0"); // 测试步骤 TC_CANTest SET C_LDCU_SysSt.C_LDCU_EVSysReadySt 0
  gTC_CANTest_SOA_CheckReq_Prepare("SetSecRowLtSeatHeatingStruct.SecRowLtSeatHeatingReq 4&ServiceExecuteFeedbackFlag 2"); // 预期结果 TC_CANTest SOA CheckReq SetSecRowLtSeatHeatingStruct.SecRowLtSeatHeatingReq 4&ServiceExecuteFeedbackFlag 2
  g_EM_SOAClient_Swc_SOA_CHECK_Prepare("Veh_SeatCtrlService_ErrStruct.OpeNRC 0 traceback7"); // 预期结果 TC_CANTest SOA check Veh_SeatCtrlService_ErrStruct.OpeNRC 0 traceback7
  g_EM_SOAClient_Swc_SOA_REQ("Veh_SetSecRowLtSeatHeatingStruct.Veh_SecRowLtSeatHeatingReq:4&ServiceExecuteFeedbackFlag:2"); // 测试步骤 TC_CANTest SOA REQ Veh_SetSecRowLtSeatHeatingStruct.Veh_SecRowLtSeatHeatingReq:4&ServiceExecuteFeedbackFlag:2
  gTC_CANTest_SOA_CheckReq("SetSecRowLtSeatHeatingStruct.SecRowLtSeatHeatingReq 4&ServiceExecuteFeedbackFlag 2"); // 预期结果 TC_CANTest SOA CheckReq SetSecRowLtSeatHeatingStruct.SecRowLtSeatHeatingReq 4&ServiceExecuteFeedbackFlag 2
  g_EM_SOAClient_Swc_SOA_CHECK("Veh_SeatCtrlService_ErrStruct.OpeNRC 0 traceback7"); // 预期结果 TC_CANTest SOA check Veh_SeatCtrlService_ErrStruct.OpeNRC 0 traceback7
}

testcase SYS_CDCU_erpaizuocezuoyijiare_0083()
{
  TestDescription("二排左侧座椅加热-10");
  teststep("warning","原始用例id为SYS-CDCU-二排左侧座椅加热-0083");
  g_EM_Equipment_Swc_TC_IG("OFF"); // 测试步骤 TC_IG OFF
  g_CAN_Bus_Swc_Set("I_LDCU_BodySysSt1.I_LDCU_PowerMode 1"); // 测试步骤 TC_CANTest SET I_LDCU_BodySysSt1.I_LDCU_PowerMode 1
  g_EM_Equipment_Swc_TC_4G_Time_Delay_Second("1"); // 测试步骤 TC_Sleep 1
  g_CAN_Bus_Swc_Set("I_LDCU_BodySysSt1.I_LDCU_PowerMode 2"); // 测试步骤 TC_CANTest SET I_LDCU_BodySysSt1.I_LDCU_PowerMode 2
  g_CAN_Bus_Swc_Set("I_LDCU_NM.I_LDCU_NMRepeatMsgReqBit 1"); // 测试步骤 TC_CANTest SET I_LDCU_NM.I_LDCU_NMRepeatMsgReqBit 1 //网络唤醒维持帧
  g_CAN_Bus_Swc_Set("C_LDCU_SysSt.C_LDCU_EVSysReadySt 0"); // 测试步骤 TC_CANTest SET C_LDCU_SysSt.C_LDCU_EVSysReadySt 0//Not ready
  gTC_CANTest_SOA_CheckReq_Prepare("HighVoltageCtrlStruct.HighVoltageCtrl 2"); // 预期结果 TC_CANTest SOA CheckReq HighVoltageCtrlStruct.HighVoltageCtrl 2
  g_EM_SOAClient_Swc_SOA_CHECK_Prepare("Veh_SeatCtrlService_ErrStruct.OpeNRC 0 traceback7"); // 预期结果 TC_CANTest SOA check Veh_SeatCtrlService_ErrStruct.OpeNRC 0 traceback7
  g_EM_SOAClient_Swc_SOA_REQ("Veh_SetSecRowLtSeatHeatingStruct.Veh_SecRowLtSeatHeatingReq:1&UserID:0x01010001&ServiceExecuteFeedbackFlag:2"); // 测试步骤 TC_CANTest SOA REQ Veh_SetSecRowLtSeatHeatingStruct.Veh_SecRowLtSeatHeatingReq:1&UserID:0x01010001&ServiceExecuteFeedbackFlag:2
  gTC_CANTest_SOA_CheckReq("HighVoltageCtrlStruct.HighVoltageCtrl 2"); // 预期结果 TC_CANTest SOA CheckReq HighVoltageCtrlStruct.HighVoltageCtrl 2
  gTC_CANTest_SOA_CheckReq_Prepare("SetSecRowLtSeatHeatingStruct.SecRowLtSeatHeatingReq 1&ServiceExecuteFeedbackFlag 2"); // 预期结果 TC_CANTest SOA CheckReq SetSecRowLtSeatHeatingStruct.SecRowLtSeatHeatingReq 1&ServiceExecuteFeedbackFlag 2
  g_EM_SOAClient_Swc_SOA_CHECK_Prepare("Veh_SetSecRowLtSeatHeatingRespStruct.Veh_SetSecRowLtSeatHeatingNRC 0"); // 预期结果 TC_CANTest SOA check Veh_SetSecRowLtSeatHeatingRespStruct.Veh_SetSecRowLtSeatHeatingNRC 0
  g_CAN_Bus_Swc_Set("C_LDCU_SysSt.C_LDCU_EVSysReadySt 2"); // 测试步骤 TC_CANTest SET C_LDCU_SysSt.C_LDCU_EVSysReadySt 2//Not ready
  gTC_CANTest_SOA_CheckReq("SetSecRowLtSeatHeatingStruct.SecRowLtSeatHeatingReq 1&ServiceExecuteFeedbackFlag 2"); // 预期结果 TC_CANTest SOA CheckReq SetSecRowLtSeatHeatingStruct.SecRowLtSeatHeatingReq 1&ServiceExecuteFeedbackFlag 2
  g_EM_SOAClient_Swc_SOA_CHECK("Veh_SetSecRowLtSeatHeatingRespStruct.Veh_SetSecRowLtSeatHeatingNRC 0"); // 预期结果 TC_CANTest SOA check Veh_SetSecRowLtSeatHeatingRespStruct.Veh_SetSecRowLtSeatHeatingNRC 0
  g_EM_SOAClient_Swc_SOA_CHECK("Veh_SeatCtrlService_ErrStruct.OpeNRC 0 traceback7"); // 预期结果 TC_CANTest SOA check Veh_SeatCtrlService_ErrStruct.OpeNRC 0 traceback7
  g_EM_Equipment_Swc_TC_IG("ON"); // 测试步骤 TC_IG ON
  g_EM_Equipment_Swc_TC_4G_Time_Delay_Second("2"); // 测试步骤 TC_Sleep 2
}

testcase SYS_CDCU_erpaizuocezuoyijiare_0084()
{
  TestDescription("二排左侧座椅加热-11");
  teststep("warning","原始用例id为SYS-CDCU-二排左侧座椅加热-0084");
  g_EM_Equipment_Swc_TC_IG("OFF"); // 测试步骤 TC_IG OFF
  g_CAN_Bus_Swc_Set("I_LDCU_BodySysSt1.I_LDCU_PowerMode 1"); // 测试步骤 TC_CANTest SET I_LDCU_BodySysSt1.I_LDCU_PowerMode 1
  g_EM_Equipment_Swc_TC_4G_Time_Delay_Second("1"); // 测试步骤 TC_Sleep 1
  g_CAN_Bus_Swc_Set("I_LDCU_BodySysSt1.I_LDCU_PowerMode 2"); // 测试步骤 TC_CANTest SET I_LDCU_BodySysSt1.I_LDCU_PowerMode 2
  g_CAN_Bus_Swc_Set("I_LDCU_NM.I_LDCU_NMRepeatMsgReqBit 1"); // 测试步骤 TC_CANTest SET I_LDCU_NM.I_LDCU_NMRepeatMsgReqBit 1 //网络唤醒维持帧
  g_CAN_Bus_Swc_Set("C_LDCU_SysSt.C_LDCU_EVSysReadySt 1"); // 测试步骤 TC_CANTest SET C_LDCU_SysSt.C_LDCU_EVSysReadySt 1//HV ON
  gTC_CANTest_SOA_CheckReq_Prepare("SetSecRowLtSeatHeatingStruct.SecRowLtSeatHeatingReq 1&ServiceExecuteFeedbackFlag 2"); // 预期结果 TC_CANTest SOA CheckReq SetSecRowLtSeatHeatingStruct.SecRowLtSeatHeatingReq 1&ServiceExecuteFeedbackFlag 2
  g_EM_SOAClient_Swc_SOA_CHECK_Prepare("Veh_SeatCtrlService_ErrStruct.OpeNRC 0 traceback7"); // 预期结果 TC_CANTest SOA check Veh_SeatCtrlService_ErrStruct.OpeNRC 0 traceback7
  g_EM_SOAClient_Swc_SOA_REQ("Veh_SetSecRowLtSeatHeatingStruct.Veh_SecRowLtSeatHeatingReq:1&UserID:0x01010001&ServiceExecuteFeedbackFlag:2"); // 测试步骤 TC_CANTest SOA REQ Veh_SetSecRowLtSeatHeatingStruct.Veh_SecRowLtSeatHeatingReq:1&UserID:0x01010001&ServiceExecuteFeedbackFlag:2
  gTC_CANTest_SOA_CheckReq("SetSecRowLtSeatHeatingStruct.SecRowLtSeatHeatingReq 1&ServiceExecuteFeedbackFlag 2"); // 预期结果 TC_CANTest SOA CheckReq SetSecRowLtSeatHeatingStruct.SecRowLtSeatHeatingReq 1&ServiceExecuteFeedbackFlag 2
  g_EM_SOAClient_Swc_SOA_CHECK_Prepare("Veh_SetSecRowLtSeatHeatingRespStruct.Veh_SetSecRowLtSeatHeatingNRC 0"); // 预期结果 TC_CANTest SOA check Veh_SetSecRowLtSeatHeatingRespStruct.Veh_SetSecRowLtSeatHeatingNRC 0
  g_CAN_Bus_Swc_Set("C_LDCU_SysSt.C_LDCU_EVSysReadySt 2"); // 测试步骤 TC_CANTest SET C_LDCU_SysSt.C_LDCU_EVSysReadySt 2//Not ready
  g_EM_SOAClient_Swc_SOA_CHECK("Veh_SetSecRowLtSeatHeatingRespStruct.Veh_SetSecRowLtSeatHeatingNRC 0"); // 预期结果 TC_CANTest SOA check Veh_SetSecRowLtSeatHeatingRespStruct.Veh_SetSecRowLtSeatHeatingNRC 0
  g_EM_SOAClient_Swc_SOA_CHECK("Veh_SeatCtrlService_ErrStruct.OpeNRC 0 traceback7"); // 预期结果 TC_CANTest SOA check Veh_SeatCtrlService_ErrStruct.OpeNRC 0 traceback7
  g_EM_Equipment_Swc_TC_IG("ON"); // 测试步骤 TC_IG ON
  g_EM_Equipment_Swc_TC_4G_Time_Delay_Second("2"); // 测试步骤 TC_Sleep 2
}

testcase SYS_CDCU_erpaizuocezuoyijiare_0085()
{
  TestDescription("二排左侧座椅加热-12");
  teststep("warning","原始用例id为SYS-CDCU-二排左侧座椅加热-0085");
  g_EM_Equipment_Swc_TC_IG("OFF"); // 测试步骤 TC_IG OFF
  g_CAN_Bus_Swc_Set("I_LDCU_BodySysSt1.I_LDCU_PowerMode 1"); // 测试步骤 TC_CANTest SET I_LDCU_BodySysSt1.I_LDCU_PowerMode 1
  g_EM_Equipment_Swc_TC_4G_Time_Delay_Second("1"); // 测试步骤 TC_Sleep 1
  g_CAN_Bus_Swc_Set("I_LDCU_BodySysSt1.I_LDCU_PowerMode 2"); // 测试步骤 TC_CANTest SET I_LDCU_BodySysSt1.I_LDCU_PowerMode 2
  g_CAN_Bus_Swc_Set("I_LDCU_NM.I_LDCU_NMRepeatMsgReqBit 1"); // 测试步骤 TC_CANTest SET I_LDCU_NM.I_LDCU_NMRepeatMsgReqBit 1 //网络唤醒维持帧
  g_CAN_Bus_Swc_Set("C_LDCU_SysSt.C_LDCU_EVSysReadySt 2"); // 测试步骤 TC_CANTest SET C_LDCU_SysSt.C_LDCU_EVSysReadySt 2//HV ON
  gTC_CANTest_SOA_CheckReq_Prepare("SetSecRowLtSeatHeatingStruct.SecRowLtSeatHeatingReq 1&ServiceExecuteFeedbackFlag 2"); // 预期结果 TC_CANTest SOA CheckReq SetSecRowLtSeatHeatingStruct.SecRowLtSeatHeatingReq 1&ServiceExecuteFeedbackFlag 2
  g_EM_SOAClient_Swc_SOA_CHECK_Prepare("Veh_SetSecRowLtSeatHeatingRespStruct.Veh_SetSecRowLtSeatHeatingNRC 0"); // 预期结果 TC_CANTest SOA check Veh_SetSecRowLtSeatHeatingRespStruct.Veh_SetSecRowLtSeatHeatingNRC 0
  g_EM_SOAClient_Swc_SOA_CHECK_Prepare("Veh_SeatCtrlService_ErrStruct.OpeNRC 0 traceback7"); // 预期结果 TC_CANTest SOA check Veh_SeatCtrlService_ErrStruct.OpeNRC 0 traceback7
  g_EM_SOAClient_Swc_SOA_REQ("Veh_SetSecRowLtSeatHeatingStruct.Veh_SecRowLtSeatHeatingReq:1&UserID:0x01010001&ServiceExecuteFeedbackFlag:2"); // 测试步骤 TC_CANTest SOA REQ Veh_SetSecRowLtSeatHeatingStruct.Veh_SecRowLtSeatHeatingReq:1&UserID:0x01010001&ServiceExecuteFeedbackFlag:2
  gTC_CANTest_SOA_CheckReq("SetSecRowLtSeatHeatingStruct.SecRowLtSeatHeatingReq 1&ServiceExecuteFeedbackFlag 2"); // 预期结果 TC_CANTest SOA CheckReq SetSecRowLtSeatHeatingStruct.SecRowLtSeatHeatingReq 1&ServiceExecuteFeedbackFlag 2
  g_EM_SOAClient_Swc_SOA_CHECK("Veh_SetSecRowLtSeatHeatingRespStruct.Veh_SetSecRowLtSeatHeatingNRC 0"); // 预期结果 TC_CANTest SOA check Veh_SetSecRowLtSeatHeatingRespStruct.Veh_SetSecRowLtSeatHeatingNRC 0
  g_EM_SOAClient_Swc_SOA_CHECK("Veh_SeatCtrlService_ErrStruct.OpeNRC 0 traceback7"); // 预期结果 TC_CANTest SOA check Veh_SeatCtrlService_ErrStruct.OpeNRC 0 traceback7
  g_EM_Equipment_Swc_TC_IG("ON"); // 测试步骤 TC_IG ON
  g_EM_Equipment_Swc_TC_4G_Time_Delay_Second("2"); // 测试步骤 TC_Sleep 2
}

testcase SYS_CDCU_erpaizuocezuoyijiare_0086()
{
  TestDescription("二排左侧座椅加热-13");
  teststep("warning","原始用例id为SYS-CDCU-二排左侧座椅加热-0086");
  gTC_CANTest_SOA_CheckReq_Prepare("SetSecRowLtSeatHeatingStruct.SecRowLtSeatHeatingReq 2&ServiceExecuteFeedbackFlag 2"); // 预期结果 TC_CANTest SOA CheckReq SetSecRowLtSeatHeatingStruct.SecRowLtSeatHeatingReq 2&ServiceExecuteFeedbackFlag 2
  g_EM_SOAClient_Swc_SOA_CHECK_Prepare("Veh_SeatCtrlService_ErrStruct.OpeNRC 0 traceback7"); // 预期结果 TC_CANTest SOA check Veh_SeatCtrlService_ErrStruct.OpeNRC 0 traceback7
  g_EM_SOAClient_Swc_SOA_REQ("Veh_SetSecRowLtSeatHeatingStruct.Veh_SecRowLtSeatHeatingReq:2&ServiceExecuteFeedbackFlag:2"); // 测试步骤 TC_CANTest SOA REQ Veh_SetSecRowLtSeatHeatingStruct.Veh_SecRowLtSeatHeatingReq:2&ServiceExecuteFeedbackFlag:2
  gTC_CANTest_SOA_CheckReq("SetSecRowLtSeatHeatingStruct.SecRowLtSeatHeatingReq 2&ServiceExecuteFeedbackFlag 2"); // 预期结果 TC_CANTest SOA CheckReq SetSecRowLtSeatHeatingStruct.SecRowLtSeatHeatingReq 2&ServiceExecuteFeedbackFlag 2
  g_EM_SOAClient_Swc_SOA_CHECK("Veh_SeatCtrlService_ErrStruct.OpeNRC 0 traceback7"); // 预期结果 TC_CANTest SOA check Veh_SeatCtrlService_ErrStruct.OpeNRC 0 traceback7
  g_EM_Equipment_Swc_TC_4G_Time_Delay_Second("5"); // 测试步骤 TC_Sleep 5
}

testcase SYS_CDCU_erpaizuocezuoyijiare_0087()
{
  TestDescription("二排左侧座椅加热-14");
  teststep("warning","原始用例id为SYS-CDCU-二排左侧座椅加热-0087");
  gTC_CANTest_SOA_CheckReq_Prepare("SetSecRowLtSeatHeatingStruct.SecRowLtSeatHeatingReq 3&ServiceExecuteFeedbackFlag 2"); // 预期结果 TC_CANTest SOA CheckReq SetSecRowLtSeatHeatingStruct.SecRowLtSeatHeatingReq 3&ServiceExecuteFeedbackFlag 2
  g_EM_SOAClient_Swc_SOA_CHECK_Prepare("Veh_SeatCtrlService_ErrStruct.OpeNRC 0 traceback7"); // 预期结果 TC_CANTest SOA check Veh_SeatCtrlService_ErrStruct.OpeNRC 0 traceback7
  g_EM_SOAClient_Swc_SOA_REQ("Veh_SetSecRowLtSeatHeatingStruct.Veh_SecRowLtSeatHeatingReq:3&ServiceExecuteFeedbackFlag:2"); // 测试步骤 TC_CANTest SOA REQ Veh_SetSecRowLtSeatHeatingStruct.Veh_SecRowLtSeatHeatingReq:3&ServiceExecuteFeedbackFlag:2
  gTC_CANTest_SOA_CheckReq("SetSecRowLtSeatHeatingStruct.SecRowLtSeatHeatingReq 3&ServiceExecuteFeedbackFlag 2"); // 预期结果 TC_CANTest SOA CheckReq SetSecRowLtSeatHeatingStruct.SecRowLtSeatHeatingReq 3&ServiceExecuteFeedbackFlag 2
  g_EM_SOAClient_Swc_SOA_CHECK("Veh_SeatCtrlService_ErrStruct.OpeNRC 0 traceback7"); // 预期结果 TC_CANTest SOA check Veh_SeatCtrlService_ErrStruct.OpeNRC 0 traceback7
  g_EM_Equipment_Swc_TC_4G_Time_Delay_Second("5"); // 测试步骤 TC_Sleep 5
}

testcase SYS_CDCU_erpaizuocezuoyijiare_0088()
{
  TestDescription("二排左侧座椅加热-15");
  teststep("warning","原始用例id为SYS-CDCU-二排左侧座椅加热-0088");
  g_CAN_Bus_Swc_Set("C_LDCU_SysSt.C_LDCU_EVSysReadySt 0"); // 测试步骤 TC_CANTest SET C_LDCU_SysSt.C_LDCU_EVSysReadySt 0
  gTC_CANTest_SOA_CheckReq_Prepare("SetSecRowLtSeatHeatingStruct.SecRowLtSeatHeatingReq 4&ServiceExecuteFeedbackFlag 2"); // 预期结果 TC_CANTest SOA CheckReq SetSecRowLtSeatHeatingStruct.SecRowLtSeatHeatingReq 4&ServiceExecuteFeedbackFlag 2
  g_EM_SOAClient_Swc_SOA_CHECK_Prepare("Veh_SeatCtrlService_ErrStruct.OpeNRC 0 traceback7"); // 预期结果 TC_CANTest SOA check Veh_SeatCtrlService_ErrStruct.OpeNRC 0 traceback7
  g_EM_SOAClient_Swc_SOA_REQ("Veh_SetSecRowLtSeatHeatingStruct.Veh_SecRowLtSeatHeatingReq:4&ServiceExecuteFeedbackFlag:2"); // 测试步骤 TC_CANTest SOA REQ Veh_SetSecRowLtSeatHeatingStruct.Veh_SecRowLtSeatHeatingReq:4&ServiceExecuteFeedbackFlag:2
  gTC_CANTest_SOA_CheckReq("SetSecRowLtSeatHeatingStruct.SecRowLtSeatHeatingReq 4&ServiceExecuteFeedbackFlag 2"); // 预期结果 TC_CANTest SOA CheckReq SetSecRowLtSeatHeatingStruct.SecRowLtSeatHeatingReq 4&ServiceExecuteFeedbackFlag 2
  g_EM_SOAClient_Swc_SOA_CHECK("Veh_SeatCtrlService_ErrStruct.OpeNRC 0 traceback7"); // 预期结果 TC_CANTest SOA check Veh_SeatCtrlService_ErrStruct.OpeNRC 0 traceback7
}

testcase SYS_CDCU_erpaiyoucezuoyijiare_0089()
{
  TestDescription("前提条件初始化");
  teststep("warning","原始用例id为SYS-CDCU-二排右侧座椅加热-0089");
  g_EM_Equipment_Swc_TC_PW("OFF"); // 测试步骤 TC_PW OFF
  g_EM_Equipment_Swc_TC_IG("OFF"); // 测试步骤 TC_IG OFF
  g_EM_Equipment_Swc_TC_4G_Time_Delay_Second("1"); // 测试步骤 TC_Sleep 1
  g_EM_Equipment_Swc_TC_PW("ON"); // 测试步骤 TC_PW ON
  g_EM_Equipment_Swc_TC_IG("ON"); // 测试步骤 TC_IG ON
  g_EM_Equipment_Swc_TC_4G_Time_Delay_Second("5"); // 测试步骤 TC_Sleep 5
}

testcase SYS_CDCU_erpaiyoucezuoyijiare_0090()
{
  TestDescription("二排右侧座椅加热-1");
  teststep("warning","原始用例id为SYS-CDCU-二排右侧座椅加热-0090");
  g_EM_Equipment_Swc_TC_IG("OFF"); // 测试步骤 TC_IG OFF
  g_CAN_Bus_Swc_Set("I_LDCU_BodySysSt1.I_LDCU_PowerMode 1"); // 测试步骤 TC_CANTest SET I_LDCU_BodySysSt1.I_LDCU_PowerMode 1
  g_EM_Equipment_Swc_TC_4G_Time_Delay_Second("1"); // 测试步骤 TC_Sleep 1
  g_CAN_Bus_Swc_Set("I_LDCU_BodySysSt1.I_LDCU_PowerMode 0"); // 测试步骤 TC_CANTest SET I_LDCU_BodySysSt1.I_LDCU_PowerMode 0
  g_CAN_Bus_Swc_Set("I_LDCU_NM.I_LDCU_NMRepeatMsgReqBit 1"); // 测试步骤 TC_CANTest SET I_LDCU_NM.I_LDCU_NMRepeatMsgReqBit 1 //网络唤醒维持帧
  g_CAN_Bus_Swc_Set("C_LDCU_SysSt.C_LDCU_EVSysReadySt 0"); // 测试步骤 TC_CANTest SET C_LDCU_SysSt.C_LDCU_EVSysReadySt 0//Not ready
  gTC_CANTest_SOA_CheckReq_Prepare("HighVoltageCtrlStruct.HighVoltageCtrl 2"); // 预期结果 TC_CANTest SOA CheckReq HighVoltageCtrlStruct.HighVoltageCtrl 2
  g_EM_SOAClient_Swc_SOA_CHECK_Prepare("Veh_SeatCtrlService_ErrStruct.OpeNRC 0 traceback7"); // 预期结果 TC_CANTest SOA check Veh_SeatCtrlService_ErrStruct.OpeNRC 0 traceback7
  g_EM_SOAClient_Swc_SOA_REQ("Veh_SetSecRowRtSeatHeatingStruct.Veh_SecRowRtSeatHeatingReq:1&UserID:0x01010001&ServiceExecuteFeedbackFlag:2"); // 测试步骤 TC_CANTest SOA REQ Veh_SetSecRowRtSeatHeatingStruct.Veh_SecRowRtSeatHeatingReq:1&UserID:0x01010001&ServiceExecuteFeedbackFlag:2
  gTC_CANTest_SOA_CheckReq("HighVoltageCtrlStruct.HighVoltageCtrl 2"); // 预期结果 TC_CANTest SOA CheckReq HighVoltageCtrlStruct.HighVoltageCtrl 2
  gTC_CANTest_SOA_CheckReq_Prepare("SetSecRowRtSeatHeatingStruct.SecRowRtSeatHeatingReq 1&ServiceExecuteFeedbackFlag 2"); // 预期结果 TC_CANTest SOA CheckReq SetSecRowRtSeatHeatingStruct.SecRowRtSeatHeatingReq 1&ServiceExecuteFeedbackFlag 2
  g_EM_SOAClient_Swc_SOA_CHECK_Prepare("Veh_SetSecRowRtSeatHeatingRespStruct.Veh_SetSecRowRtSeatHeatingNRC 0"); // 预期结果 TC_CANTest SOA check Veh_SetSecRowRtSeatHeatingRespStruct.Veh_SetSecRowRtSeatHeatingNRC 0
  g_CAN_Bus_Swc_Set("C_LDCU_SysSt.C_LDCU_EVSysReadySt 2"); // 测试步骤 TC_CANTest SET C_LDCU_SysSt.C_LDCU_EVSysReadySt 2//Not ready
  gTC_CANTest_SOA_CheckReq("SetSecRowRtSeatHeatingStruct.SecRowRtSeatHeatingReq 1&ServiceExecuteFeedbackFlag 2"); // 预期结果 TC_CANTest SOA CheckReq SetSecRowRtSeatHeatingStruct.SecRowRtSeatHeatingReq 1&ServiceExecuteFeedbackFlag 2
  g_EM_SOAClient_Swc_SOA_CHECK("Veh_SetSecRowRtSeatHeatingRespStruct.Veh_SetSecRowRtSeatHeatingNRC 0"); // 预期结果 TC_CANTest SOA check Veh_SetSecRowRtSeatHeatingRespStruct.Veh_SetSecRowRtSeatHeatingNRC 0
  g_EM_Equipment_Swc_TC_IG("ON"); // 测试步骤 TC_IG ON
  g_EM_SOAClient_Swc_SOA_CHECK("Veh_SeatCtrlService_ErrStruct.OpeNRC 0 traceback7"); // 预期结果 TC_CANTest SOA check Veh_SeatCtrlService_ErrStruct.OpeNRC 0 traceback7
  g_EM_Equipment_Swc_TC_4G_Time_Delay_Second("2"); // 测试步骤 TC_Sleep 2
}

testcase SYS_CDCU_erpaiyoucezuoyijiare_0091()
{
  TestDescription("二排右侧座椅加热-2");
  teststep("warning","原始用例id为SYS-CDCU-二排右侧座椅加热-0091");
  g_EM_Equipment_Swc_TC_IG("OFF"); // 测试步骤 TC_IG OFF
  g_CAN_Bus_Swc_Set("I_LDCU_BodySysSt1.I_LDCU_PowerMode 1"); // 测试步骤 TC_CANTest SET I_LDCU_BodySysSt1.I_LDCU_PowerMode 1
  g_EM_Equipment_Swc_TC_4G_Time_Delay_Second("1"); // 测试步骤 TC_Sleep 1
  g_CAN_Bus_Swc_Set("I_LDCU_BodySysSt1.I_LDCU_PowerMode 0"); // 测试步骤 TC_CANTest SET I_LDCU_BodySysSt1.I_LDCU_PowerMode 0
  g_CAN_Bus_Swc_Set("I_LDCU_NM.I_LDCU_NMRepeatMsgReqBit 1"); // 测试步骤 TC_CANTest SET I_LDCU_NM.I_LDCU_NMRepeatMsgReqBit 1 //网络唤醒维持帧
  g_CAN_Bus_Swc_Set("C_LDCU_SysSt.C_LDCU_EVSysReadySt 1"); // 测试步骤 TC_CANTest SET C_LDCU_SysSt.C_LDCU_EVSysReadySt 1//HV ON
  gTC_CANTest_SOA_CheckReq_Prepare("SetSecRowRtSeatHeatingStruct.SecRowRtSeatHeatingReq 1&ServiceExecuteFeedbackFlag 2"); // 预期结果 TC_CANTest SOA CheckReq SetSecRowRtSeatHeatingStruct.SecRowRtSeatHeatingReq 1&ServiceExecuteFeedbackFlag 2
  g_EM_SOAClient_Swc_SOA_CHECK_Prepare("Veh_SeatCtrlService_ErrStruct.OpeNRC 0 traceback7"); // 预期结果 TC_CANTest SOA check Veh_SeatCtrlService_ErrStruct.OpeNRC 0 traceback7
  g_EM_SOAClient_Swc_SOA_REQ("Veh_SetSecRowRtSeatHeatingStruct.Veh_SecRowRtSeatHeatingReq:1&UserID:0x01010001&ServiceExecuteFeedbackFlag:2"); // 测试步骤 TC_CANTest SOA REQ Veh_SetSecRowRtSeatHeatingStruct.Veh_SecRowRtSeatHeatingReq:1&UserID:0x01010001&ServiceExecuteFeedbackFlag:2
  gTC_CANTest_SOA_CheckReq("SetSecRowRtSeatHeatingStruct.SecRowRtSeatHeatingReq 1&ServiceExecuteFeedbackFlag 2"); // 预期结果 TC_CANTest SOA CheckReq SetSecRowRtSeatHeatingStruct.SecRowRtSeatHeatingReq 1&ServiceExecuteFeedbackFlag 2
  g_EM_SOAClient_Swc_SOA_CHECK_Prepare("Veh_SetSecRowRtSeatHeatingRespStruct.Veh_SetSecRowRtSeatHeatingNRC 0"); // 预期结果 TC_CANTest SOA check Veh_SetSecRowRtSeatHeatingRespStruct.Veh_SetSecRowRtSeatHeatingNRC 0
  g_CAN_Bus_Swc_Set("C_LDCU_SysSt.C_LDCU_EVSysReadySt 2"); // 测试步骤 TC_CANTest SET C_LDCU_SysSt.C_LDCU_EVSysReadySt 2//Not ready
  g_EM_SOAClient_Swc_SOA_CHECK("Veh_SetSecRowRtSeatHeatingRespStruct.Veh_SetSecRowRtSeatHeatingNRC 0"); // 预期结果 TC_CANTest SOA check Veh_SetSecRowRtSeatHeatingRespStruct.Veh_SetSecRowRtSeatHeatingNRC 0
  g_EM_SOAClient_Swc_SOA_CHECK("Veh_SeatCtrlService_ErrStruct.OpeNRC 0 traceback7"); // 预期结果 TC_CANTest SOA check Veh_SeatCtrlService_ErrStruct.OpeNRC 0 traceback7
  g_EM_Equipment_Swc_TC_IG("ON"); // 测试步骤 TC_IG ON
  g_EM_Equipment_Swc_TC_4G_Time_Delay_Second("2"); // 测试步骤 TC_Sleep 2
}

testcase SYS_CDCU_erpaiyoucezuoyijiare_0092()
{
  TestDescription("二排右侧座椅加热-3");
  teststep("warning","原始用例id为SYS-CDCU-二排右侧座椅加热-0092");
  g_EM_Equipment_Swc_TC_IG("OFF"); // 测试步骤 TC_IG OFF
  g_CAN_Bus_Swc_Set("I_LDCU_BodySysSt1.I_LDCU_PowerMode 1"); // 测试步骤 TC_CANTest SET I_LDCU_BodySysSt1.I_LDCU_PowerMode 1
  g_EM_Equipment_Swc_TC_4G_Time_Delay_Second("1"); // 测试步骤 TC_Sleep 1
  g_CAN_Bus_Swc_Set("I_LDCU_BodySysSt1.I_LDCU_PowerMode 0"); // 测试步骤 TC_CANTest SET I_LDCU_BodySysSt1.I_LDCU_PowerMode 0
  g_CAN_Bus_Swc_Set("I_LDCU_NM.I_LDCU_NMRepeatMsgReqBit 1"); // 测试步骤 TC_CANTest SET I_LDCU_NM.I_LDCU_NMRepeatMsgReqBit 1 //网络唤醒维持帧
  g_CAN_Bus_Swc_Set("C_LDCU_SysSt.C_LDCU_EVSysReadySt 2"); // 测试步骤 TC_CANTest SET C_LDCU_SysSt.C_LDCU_EVSysReadySt 2//HV ON
  g_EM_SOAClient_Swc_SOA_CHECK_Prepare("Veh_SeatCtrlService_ErrStruct.OpeNRC 0 traceback7"); // 预期结果 TC_CANTest SOA check Veh_SeatCtrlService_ErrStruct.OpeNRC 0 traceback7
  g_EM_SOAClient_Swc_SOA_REQ("Veh_SetSecRowRtSeatHeatingStruct.Veh_SecRowRtSeatHeatingReq:1&UserID:0x01010001&ServiceExecuteFeedbackFlag:2"); // 测试步骤 TC_CANTest SOA REQ Veh_SetSecRowRtSeatHeatingStruct.Veh_SecRowRtSeatHeatingReq:1&UserID:0x01010001&ServiceExecuteFeedbackFlag:2
  gTC_CANTest_SOA_CheckReq_Prepare("SetSecRowRtSeatHeatingStruct.SecRowRtSeatHeatingReq 1&ServiceExecuteFeedbackFlag 2"); // 预期结果 TC_CANTest SOA CheckReq SetSecRowRtSeatHeatingStruct.SecRowRtSeatHeatingReq 1&ServiceExecuteFeedbackFlag 2
  g_EM_SOAClient_Swc_SOA_CHECK_Prepare("Veh_SetSecRowRtSeatHeatingRespStruct.Veh_SetSecRowRtSeatHeatingNRC 0"); // 预期结果 TC_CANTest SOA check Veh_SetSecRowRtSeatHeatingRespStruct.Veh_SetSecRowRtSeatHeatingNRC 0
  g_CAN_Bus_Swc_Set("C_LDCU_SysSt.C_LDCU_EVSysReadySt 2"); // 测试步骤 TC_CANTest SET C_LDCU_SysSt.C_LDCU_EVSysReadySt 2//Not ready
  gTC_CANTest_SOA_CheckReq("SetSecRowRtSeatHeatingStruct.SecRowRtSeatHeatingReq 1&ServiceExecuteFeedbackFlag 2"); // 预期结果 TC_CANTest SOA CheckReq SetSecRowRtSeatHeatingStruct.SecRowRtSeatHeatingReq 1&ServiceExecuteFeedbackFlag 2
  g_EM_SOAClient_Swc_SOA_CHECK("Veh_SetSecRowRtSeatHeatingRespStruct.Veh_SetSecRowRtSeatHeatingNRC 0"); // 预期结果 TC_CANTest SOA check Veh_SetSecRowRtSeatHeatingRespStruct.Veh_SetSecRowRtSeatHeatingNRC 0
  g_EM_SOAClient_Swc_SOA_CHECK("Veh_SeatCtrlService_ErrStruct.OpeNRC 0 traceback7"); // 预期结果 TC_CANTest SOA check Veh_SeatCtrlService_ErrStruct.OpeNRC 0 traceback7
  g_EM_Equipment_Swc_TC_IG("ON"); // 测试步骤 TC_IG ON
  g_EM_Equipment_Swc_TC_4G_Time_Delay_Second("2"); // 测试步骤 TC_Sleep 2
}

testcase SYS_CDCU_erpaiyoucezuoyijiare_0093()
{
  TestDescription("二排右侧座椅加热-4");
  teststep("warning","原始用例id为SYS-CDCU-二排右侧座椅加热-0093");
  g_CAN_Bus_Swc_Set("I_LDCU_BodySysSt1.I_LDCU_PowerMode 1"); // 测试步骤 TC_CANTest SET I_LDCU_BodySysSt1.I_LDCU_PowerMode 1
  g_CAN_Bus_Swc_Set("I_LDCU_NM.I_LDCU_NMRepeatMsgReqBit 1"); // 测试步骤 TC_CANTest SET I_LDCU_NM.I_LDCU_NMRepeatMsgReqBit 1 //网络唤醒维持帧
  g_CAN_Bus_Swc_Set("C_LDCU_SysSt.C_LDCU_EVSysReadySt 2"); // 测试步骤 TC_CANTest SET C_LDCU_SysSt.C_LDCU_EVSysReadySt 2//ready
  gTC_CANTest_SOA_CheckReq_Prepare("SetSecRowRtSeatHeatingStruct.SecRowRtSeatHeatingReq 1&ServiceExecuteFeedbackFlag 2"); // 预期结果 TC_CANTest SOA CheckReq SetSecRowRtSeatHeatingStruct.SecRowRtSeatHeatingReq 1&ServiceExecuteFeedbackFlag 2
  g_EM_SOAClient_Swc_SOA_CHECK_Prepare("Veh_SeatCtrlService_ErrStruct.OpeNRC 0 traceback7"); // 预期结果 TC_CANTest SOA check Veh_SeatCtrlService_ErrStruct.OpeNRC 0 traceback7
  g_EM_SOAClient_Swc_SOA_REQ("Veh_SetSecRowRtSeatHeatingStruct.Veh_SecRowRtSeatHeatingReq:1&ServiceExecuteFeedbackFlag:2"); // 测试步骤 TC_CANTest SOA REQ Veh_SetSecRowRtSeatHeatingStruct.Veh_SecRowRtSeatHeatingReq:1&ServiceExecuteFeedbackFlag:2
  gTC_CANTest_SOA_CheckReq("SetSecRowRtSeatHeatingStruct.SecRowRtSeatHeatingReq 1&ServiceExecuteFeedbackFlag 2"); // 预期结果 TC_CANTest SOA CheckReq SetSecRowRtSeatHeatingStruct.SecRowRtSeatHeatingReq 1&ServiceExecuteFeedbackFlag 2
  g_CAN_Bus_Swc_Set("C_LDCU_SysSt.C_LDCU_EVSysReadySt 2"); // 测试步骤 TC_CANTest SET C_LDCU_SysSt.C_LDCU_EVSysReadySt 2//Not ready
  g_EM_SOAClient_Swc_SOA_CHECK("Veh_SeatCtrlService_ErrStruct.OpeNRC 0 traceback7"); // 预期结果 TC_CANTest SOA check Veh_SeatCtrlService_ErrStruct.OpeNRC 0 traceback7
}

testcase SYS_CDCU_erpaiyoucezuoyijiare_0094()
{
  TestDescription("二排右侧座椅加热-5");
  teststep("warning","原始用例id为SYS-CDCU-二排右侧座椅加热-0094");
  g_CAN_Bus_Swc_Set("I_LDCU_BodySysSt1.I_LDCU_PowerMode 1"); // 测试步骤 TC_CANTest SET I_LDCU_BodySysSt1.I_LDCU_PowerMode 1
  g_CAN_Bus_Swc_Set("I_LDCU_NM.I_LDCU_NMRepeatMsgReqBit 1"); // 测试步骤 TC_CANTest SET I_LDCU_NM.I_LDCU_NMRepeatMsgReqBit 1 //网络唤醒维持帧
  g_CAN_Bus_Swc_Set("C_LDCU_SysSt.C_LDCU_EVSysReadySt 1"); // 测试步骤 TC_CANTest SET C_LDCU_SysSt.C_LDCU_EVSysReadySt 1//Not ready
  gTC_CANTest_SOA_CheckReq_Prepare("SetSecRowRtSeatHeatingStruct.SecRowRtSeatHeatingReq 1&ServiceExecuteFeedbackFlag 2"); // 预期结果 TC_CANTest SOA CheckReq SetSecRowRtSeatHeatingStruct.SecRowRtSeatHeatingReq 1&ServiceExecuteFeedbackFlag 2
  g_EM_SOAClient_Swc_SOA_CHECK_Prepare("Veh_SeatCtrlService_ErrStruct.OpeNRC 0 traceback7"); // 预期结果 TC_CANTest SOA check Veh_SeatCtrlService_ErrStruct.OpeNRC 0 traceback7
  g_EM_SOAClient_Swc_SOA_REQ("Veh_SetSecRowRtSeatHeatingStruct.Veh_SecRowRtSeatHeatingReq:1&ServiceExecuteFeedbackFlag:2"); // 测试步骤 TC_CANTest SOA REQ Veh_SetSecRowRtSeatHeatingStruct.Veh_SecRowRtSeatHeatingReq:1&ServiceExecuteFeedbackFlag:2
  gTC_CANTest_SOA_CheckReq("SetSecRowRtSeatHeatingStruct.SecRowRtSeatHeatingReq 1&ServiceExecuteFeedbackFlag 2"); // 预期结果 TC_CANTest SOA CheckReq SetSecRowRtSeatHeatingStruct.SecRowRtSeatHeatingReq 1&ServiceExecuteFeedbackFlag 2
  g_CAN_Bus_Swc_Set("C_LDCU_SysSt.C_LDCU_EVSysReadySt 2"); // 测试步骤 TC_CANTest SET C_LDCU_SysSt.C_LDCU_EVSysReadySt 2//Not ready
  g_EM_SOAClient_Swc_SOA_CHECK("Veh_SeatCtrlService_ErrStruct.OpeNRC 0 traceback7"); // 预期结果 TC_CANTest SOA check Veh_SeatCtrlService_ErrStruct.OpeNRC 0 traceback7
}

testcase SYS_CDCU_erpaiyoucezuoyijiare_0095()
{
  TestDescription("二排右侧座椅加热-6");
  teststep("warning","原始用例id为SYS-CDCU-二排右侧座椅加热-0095");
  g_CAN_Bus_Swc_Set("I_LDCU_BodySysSt1.I_LDCU_PowerMode 1"); // 测试步骤 TC_CANTest SET I_LDCU_BodySysSt1.I_LDCU_PowerMode 1
  g_CAN_Bus_Swc_Set("I_LDCU_NM.I_LDCU_NMRepeatMsgReqBit 1"); // 测试步骤 TC_CANTest SET I_LDCU_NM.I_LDCU_NMRepeatMsgReqBit 1 //网络唤醒维持帧
  g_CAN_Bus_Swc_Set("C_LDCU_SysSt.C_LDCU_EVSysReadySt 2"); // 测试步骤 TC_CANTest SET C_LDCU_SysSt.C_LDCU_EVSysReadySt 2//Not ready
  gTC_CANTest_SOA_CheckReq_Prepare("SetSecRowRtSeatHeatingStruct.SecRowRtSeatHeatingReq 1&ServiceExecuteFeedbackFlag 2"); // 预期结果 TC_CANTest SOA CheckReq SetSecRowRtSeatHeatingStruct.SecRowRtSeatHeatingReq 1&ServiceExecuteFeedbackFlag 2
  g_EM_SOAClient_Swc_SOA_CHECK_Prepare("Veh_SeatCtrlService_ErrStruct.OpeNRC 0 traceback7"); // 预期结果 TC_CANTest SOA check Veh_SeatCtrlService_ErrStruct.OpeNRC 0 traceback7
  g_EM_SOAClient_Swc_SOA_REQ("Veh_SetSecRowRtSeatHeatingStruct.Veh_SecRowRtSeatHeatingReq:1&ServiceExecuteFeedbackFlag:2"); // 测试步骤 TC_CANTest SOA REQ Veh_SetSecRowRtSeatHeatingStruct.Veh_SecRowRtSeatHeatingReq:1&ServiceExecuteFeedbackFlag:2
  gTC_CANTest_SOA_CheckReq("SetSecRowRtSeatHeatingStruct.SecRowRtSeatHeatingReq 1&ServiceExecuteFeedbackFlag 2"); // 预期结果 TC_CANTest SOA CheckReq SetSecRowRtSeatHeatingStruct.SecRowRtSeatHeatingReq 1&ServiceExecuteFeedbackFlag 2
  g_CAN_Bus_Swc_Set("C_LDCU_SysSt.C_LDCU_EVSysReadySt 2"); // 测试步骤 TC_CANTest SET C_LDCU_SysSt.C_LDCU_EVSysReadySt 2//Not ready
  g_EM_SOAClient_Swc_SOA_CHECK("Veh_SeatCtrlService_ErrStruct.OpeNRC 0 traceback7"); // 预期结果 TC_CANTest SOA check Veh_SeatCtrlService_ErrStruct.OpeNRC 0 traceback7
}

testcase SYS_CDCU_erpaiyoucezuoyijiare_0096()
{
  TestDescription("二排右侧座椅加热-7");
  teststep("warning","原始用例id为SYS-CDCU-二排右侧座椅加热-0096");
  gTC_CANTest_SOA_CheckReq_Prepare("SetSecRowRtSeatHeatingStruct.SecRowRtSeatHeatingReq 2&ServiceExecuteFeedbackFlag 2"); // 预期结果 TC_CANTest SOA CheckReq SetSecRowRtSeatHeatingStruct.SecRowRtSeatHeatingReq 2&ServiceExecuteFeedbackFlag 2
  g_EM_SOAClient_Swc_SOA_CHECK_Prepare("Veh_SeatCtrlService_ErrStruct.OpeNRC 0 traceback7"); // 预期结果 TC_CANTest SOA check Veh_SeatCtrlService_ErrStruct.OpeNRC 0 traceback7
  g_EM_SOAClient_Swc_SOA_REQ("Veh_SetSecRowRtSeatHeatingStruct.Veh_SecRowRtSeatHeatingReq:2&ServiceExecuteFeedbackFlag:2"); // 测试步骤 TC_CANTest SOA REQ Veh_SetSecRowRtSeatHeatingStruct.Veh_SecRowRtSeatHeatingReq:2&ServiceExecuteFeedbackFlag:2
  gTC_CANTest_SOA_CheckReq("SetSecRowRtSeatHeatingStruct.SecRowRtSeatHeatingReq 2&ServiceExecuteFeedbackFlag 2"); // 预期结果 TC_CANTest SOA CheckReq SetSecRowRtSeatHeatingStruct.SecRowRtSeatHeatingReq 2&ServiceExecuteFeedbackFlag 2
  g_EM_SOAClient_Swc_SOA_CHECK("Veh_SeatCtrlService_ErrStruct.OpeNRC 0 traceback7"); // 预期结果 TC_CANTest SOA check Veh_SeatCtrlService_ErrStruct.OpeNRC 0 traceback7
  g_EM_Equipment_Swc_TC_4G_Time_Delay_Second("5"); // 测试步骤 TC_Sleep 5
}

testcase SYS_CDCU_erpaiyoucezuoyijiare_0097()
{
  TestDescription("二排右侧座椅加热-8");
  teststep("warning","原始用例id为SYS-CDCU-二排右侧座椅加热-0097");
  gTC_CANTest_SOA_CheckReq_Prepare("SetSecRowRtSeatHeatingStruct.SecRowRtSeatHeatingReq 3&ServiceExecuteFeedbackFlag 2"); // 预期结果 TC_CANTest SOA CheckReq SetSecRowRtSeatHeatingStruct.SecRowRtSeatHeatingReq 3&ServiceExecuteFeedbackFlag 2
  g_EM_SOAClient_Swc_SOA_CHECK_Prepare("Veh_SeatCtrlService_ErrStruct.OpeNRC 0 traceback7"); // 预期结果 TC_CANTest SOA check Veh_SeatCtrlService_ErrStruct.OpeNRC 0 traceback7
  g_EM_SOAClient_Swc_SOA_REQ("Veh_SetSecRowRtSeatHeatingStruct.Veh_SecRowRtSeatHeatingReq:3&ServiceExecuteFeedbackFlag:2"); // 测试步骤 TC_CANTest SOA REQ Veh_SetSecRowRtSeatHeatingStruct.Veh_SecRowRtSeatHeatingReq:3&ServiceExecuteFeedbackFlag:2
  gTC_CANTest_SOA_CheckReq("SetSecRowRtSeatHeatingStruct.SecRowRtSeatHeatingReq 3&ServiceExecuteFeedbackFlag 2"); // 预期结果 TC_CANTest SOA CheckReq SetSecRowRtSeatHeatingStruct.SecRowRtSeatHeatingReq 3&ServiceExecuteFeedbackFlag 2
  g_EM_SOAClient_Swc_SOA_CHECK("Veh_SeatCtrlService_ErrStruct.OpeNRC 0 traceback7"); // 预期结果 TC_CANTest SOA check Veh_SeatCtrlService_ErrStruct.OpeNRC 0 traceback7
  g_EM_Equipment_Swc_TC_4G_Time_Delay_Second("5"); // 测试步骤 TC_Sleep 5
}

testcase SYS_CDCU_erpaiyoucezuoyijiare_0098()
{
  TestDescription("二排右侧座椅加热-9");
  teststep("warning","原始用例id为SYS-CDCU-二排右侧座椅加热-0098");
  g_CAN_Bus_Swc_Set("C_LDCU_SysSt.C_LDCU_EVSysReadySt 0"); // 测试步骤 TC_CANTest SET C_LDCU_SysSt.C_LDCU_EVSysReadySt 0
  gTC_CANTest_SOA_CheckReq_Prepare("SetSecRowRtSeatHeatingStruct.SecRowRtSeatHeatingReq 4&ServiceExecuteFeedbackFlag 2"); // 预期结果 TC_CANTest SOA CheckReq SetSecRowRtSeatHeatingStruct.SecRowRtSeatHeatingReq 4&ServiceExecuteFeedbackFlag 2
  g_EM_SOAClient_Swc_SOA_CHECK_Prepare("Veh_SeatCtrlService_ErrStruct.OpeNRC 0 traceback7"); // 预期结果 TC_CANTest SOA check Veh_SeatCtrlService_ErrStruct.OpeNRC 0 traceback7
  g_EM_SOAClient_Swc_SOA_REQ("Veh_SetSecRowRtSeatHeatingStruct.Veh_SecRowRtSeatHeatingReq:4&ServiceExecuteFeedbackFlag:2"); // 测试步骤 TC_CANTest SOA REQ Veh_SetSecRowRtSeatHeatingStruct.Veh_SecRowRtSeatHeatingReq:4&ServiceExecuteFeedbackFlag:2
  gTC_CANTest_SOA_CheckReq("SetSecRowRtSeatHeatingStruct.SecRowRtSeatHeatingReq 4&ServiceExecuteFeedbackFlag 2"); // 预期结果 TC_CANTest SOA CheckReq SetSecRowRtSeatHeatingStruct.SecRowRtSeatHeatingReq 4&ServiceExecuteFeedbackFlag 2
  g_EM_SOAClient_Swc_SOA_CHECK("Veh_SeatCtrlService_ErrStruct.OpeNRC 0 traceback7"); // 预期结果 TC_CANTest SOA check Veh_SeatCtrlService_ErrStruct.OpeNRC 0 traceback7
}

testcase SYS_CDCU_erpaiyoucezuoyijiare_0099()
{
  TestDescription("二排右侧座椅加热-10");
  teststep("warning","原始用例id为SYS-CDCU-二排右侧座椅加热-0099");
  g_EM_Equipment_Swc_TC_IG("OFF"); // 测试步骤 TC_IG OFF
  g_CAN_Bus_Swc_Set("I_LDCU_BodySysSt1.I_LDCU_PowerMode 1"); // 测试步骤 TC_CANTest SET I_LDCU_BodySysSt1.I_LDCU_PowerMode 1
  g_EM_Equipment_Swc_TC_4G_Time_Delay_Second("1"); // 测试步骤 TC_Sleep 1
  g_CAN_Bus_Swc_Set("I_LDCU_BodySysSt1.I_LDCU_PowerMode 2"); // 测试步骤 TC_CANTest SET I_LDCU_BodySysSt1.I_LDCU_PowerMode 2
  g_CAN_Bus_Swc_Set("I_LDCU_NM.I_LDCU_NMRepeatMsgReqBit 1"); // 测试步骤 TC_CANTest SET I_LDCU_NM.I_LDCU_NMRepeatMsgReqBit 1 //网络唤醒维持帧
  g_CAN_Bus_Swc_Set("C_LDCU_SysSt.C_LDCU_EVSysReadySt 0"); // 测试步骤 TC_CANTest SET C_LDCU_SysSt.C_LDCU_EVSysReadySt 0//Not ready
  gTC_CANTest_SOA_CheckReq_Prepare("HighVoltageCtrlStruct.HighVoltageCtrl 2"); // 预期结果 TC_CANTest SOA CheckReq HighVoltageCtrlStruct.HighVoltageCtrl 2
  g_EM_SOAClient_Swc_SOA_CHECK_Prepare("Veh_SeatCtrlService_ErrStruct.OpeNRC 0 traceback7"); // 预期结果 TC_CANTest SOA check Veh_SeatCtrlService_ErrStruct.OpeNRC 0 traceback7
  g_EM_SOAClient_Swc_SOA_REQ("Veh_SetSecRowRtSeatHeatingStruct.Veh_SecRowRtSeatHeatingReq:1&UserID:0x01010001&ServiceExecuteFeedbackFlag:2"); // 测试步骤 TC_CANTest SOA REQ Veh_SetSecRowRtSeatHeatingStruct.Veh_SecRowRtSeatHeatingReq:1&UserID:0x01010001&ServiceExecuteFeedbackFlag:2
  gTC_CANTest_SOA_CheckReq("HighVoltageCtrlStruct.HighVoltageCtrl 2"); // 预期结果 TC_CANTest SOA CheckReq HighVoltageCtrlStruct.HighVoltageCtrl 2
  gTC_CANTest_SOA_CheckReq_Prepare("SetSecRowRtSeatHeatingStruct.SecRowRtSeatHeatingReq 1&ServiceExecuteFeedbackFlag 2"); // 预期结果 TC_CANTest SOA CheckReq SetSecRowRtSeatHeatingStruct.SecRowRtSeatHeatingReq 1&ServiceExecuteFeedbackFlag 2
  g_EM_SOAClient_Swc_SOA_CHECK_Prepare("Veh_SetSecRowRtSeatHeatingRespStruct.Veh_SetSecRowRtSeatHeatingNRC 0"); // 预期结果 TC_CANTest SOA check Veh_SetSecRowRtSeatHeatingRespStruct.Veh_SetSecRowRtSeatHeatingNRC 0
  g_CAN_Bus_Swc_Set("C_LDCU_SysSt.C_LDCU_EVSysReadySt 2"); // 测试步骤 TC_CANTest SET C_LDCU_SysSt.C_LDCU_EVSysReadySt 2//Not ready
  gTC_CANTest_SOA_CheckReq("SetSecRowRtSeatHeatingStruct.SecRowRtSeatHeatingReq 1&ServiceExecuteFeedbackFlag 2"); // 预期结果 TC_CANTest SOA CheckReq SetSecRowRtSeatHeatingStruct.SecRowRtSeatHeatingReq 1&ServiceExecuteFeedbackFlag 2
  g_EM_SOAClient_Swc_SOA_CHECK("Veh_SetSecRowRtSeatHeatingRespStruct.Veh_SetSecRowRtSeatHeatingNRC 0"); // 预期结果 TC_CANTest SOA check Veh_SetSecRowRtSeatHeatingRespStruct.Veh_SetSecRowRtSeatHeatingNRC 0
  g_EM_SOAClient_Swc_SOA_CHECK("Veh_SeatCtrlService_ErrStruct.OpeNRC 0 traceback7"); // 预期结果 TC_CANTest SOA check Veh_SeatCtrlService_ErrStruct.OpeNRC 0 traceback7
  g_EM_Equipment_Swc_TC_IG("ON"); // 测试步骤 TC_IG ON
  g_EM_Equipment_Swc_TC_4G_Time_Delay_Second("2"); // 测试步骤 TC_Sleep 2
}

testcase SYS_CDCU_erpaiyoucezuoyijiare_0100()
{
  TestDescription("二排右侧座椅加热-11");
  teststep("warning","原始用例id为SYS-CDCU-二排右侧座椅加热-0100");
  g_EM_Equipment_Swc_TC_IG("OFF"); // 测试步骤 TC_IG OFF
  g_CAN_Bus_Swc_Set("I_LDCU_BodySysSt1.I_LDCU_PowerMode 1"); // 测试步骤 TC_CANTest SET I_LDCU_BodySysSt1.I_LDCU_PowerMode 1
  g_EM_Equipment_Swc_TC_4G_Time_Delay_Second("1"); // 测试步骤 TC_Sleep 1
  g_CAN_Bus_Swc_Set("I_LDCU_BodySysSt1.I_LDCU_PowerMode 2"); // 测试步骤 TC_CANTest SET I_LDCU_BodySysSt1.I_LDCU_PowerMode 2
  g_CAN_Bus_Swc_Set("I_LDCU_NM.I_LDCU_NMRepeatMsgReqBit 1"); // 测试步骤 TC_CANTest SET I_LDCU_NM.I_LDCU_NMRepeatMsgReqBit 1 //网络唤醒维持帧
  g_CAN_Bus_Swc_Set("C_LDCU_SysSt.C_LDCU_EVSysReadySt 1"); // 测试步骤 TC_CANTest SET C_LDCU_SysSt.C_LDCU_EVSysReadySt 1//HV ON
  gTC_CANTest_SOA_CheckReq_Prepare("SetSecRowRtSeatHeatingStruct.SecRowRtSeatHeatingReq 1&ServiceExecuteFeedbackFlag 2"); // 预期结果 TC_CANTest SOA CheckReq SetSecRowRtSeatHeatingStruct.SecRowRtSeatHeatingReq 1&ServiceExecuteFeedbackFlag 2
  g_EM_SOAClient_Swc_SOA_CHECK_Prepare("Veh_SeatCtrlService_ErrStruct.OpeNRC 0 traceback7"); // 预期结果 TC_CANTest SOA check Veh_SeatCtrlService_ErrStruct.OpeNRC 0 traceback7
  g_EM_SOAClient_Swc_SOA_REQ("Veh_SetSecRowRtSeatHeatingStruct.Veh_SecRowRtSeatHeatingReq:1&UserID:0x01010001&ServiceExecuteFeedbackFlag:2"); // 测试步骤 TC_CANTest SOA REQ Veh_SetSecRowRtSeatHeatingStruct.Veh_SecRowRtSeatHeatingReq:1&UserID:0x01010001&ServiceExecuteFeedbackFlag:2
  gTC_CANTest_SOA_CheckReq("SetSecRowRtSeatHeatingStruct.SecRowRtSeatHeatingReq 1&ServiceExecuteFeedbackFlag 2"); // 预期结果 TC_CANTest SOA CheckReq SetSecRowRtSeatHeatingStruct.SecRowRtSeatHeatingReq 1&ServiceExecuteFeedbackFlag 2
  g_EM_SOAClient_Swc_SOA_CHECK_Prepare("Veh_SetSecRowRtSeatHeatingRespStruct.Veh_SetSecRowRtSeatHeatingNRC 0"); // 预期结果 TC_CANTest SOA check Veh_SetSecRowRtSeatHeatingRespStruct.Veh_SetSecRowRtSeatHeatingNRC 0
  g_CAN_Bus_Swc_Set("C_LDCU_SysSt.C_LDCU_EVSysReadySt 2"); // 测试步骤 TC_CANTest SET C_LDCU_SysSt.C_LDCU_EVSysReadySt 2//Not ready
  g_EM_SOAClient_Swc_SOA_CHECK("Veh_SetSecRowRtSeatHeatingRespStruct.Veh_SetSecRowRtSeatHeatingNRC 0"); // 预期结果 TC_CANTest SOA check Veh_SetSecRowRtSeatHeatingRespStruct.Veh_SetSecRowRtSeatHeatingNRC 0
  g_EM_SOAClient_Swc_SOA_CHECK("Veh_SeatCtrlService_ErrStruct.OpeNRC 0 traceback7"); // 预期结果 TC_CANTest SOA check Veh_SeatCtrlService_ErrStruct.OpeNRC 0 traceback7
  g_EM_Equipment_Swc_TC_IG("ON"); // 测试步骤 TC_IG ON
  g_EM_Equipment_Swc_TC_4G_Time_Delay_Second("2"); // 测试步骤 TC_Sleep 2
}

testcase SYS_CDCU_erpaiyoucezuoyijiare_0101()
{
  TestDescription("二排右侧座椅加热-12");
  teststep("warning","原始用例id为SYS-CDCU-二排右侧座椅加热-0101");
  g_EM_Equipment_Swc_TC_IG("OFF"); // 测试步骤 TC_IG OFF
  g_CAN_Bus_Swc_Set("I_LDCU_BodySysSt1.I_LDCU_PowerMode 1"); // 测试步骤 TC_CANTest SET I_LDCU_BodySysSt1.I_LDCU_PowerMode 1
  g_EM_Equipment_Swc_TC_4G_Time_Delay_Second("1"); // 测试步骤 TC_Sleep 1
  g_CAN_Bus_Swc_Set("I_LDCU_BodySysSt1.I_LDCU_PowerMode 2"); // 测试步骤 TC_CANTest SET I_LDCU_BodySysSt1.I_LDCU_PowerMode 2
  g_CAN_Bus_Swc_Set("I_LDCU_NM.I_LDCU_NMRepeatMsgReqBit 1"); // 测试步骤 TC_CANTest SET I_LDCU_NM.I_LDCU_NMRepeatMsgReqBit 1 //网络唤醒维持帧
  g_CAN_Bus_Swc_Set("C_LDCU_SysSt.C_LDCU_EVSysReadySt 2"); // 测试步骤 TC_CANTest SET C_LDCU_SysSt.C_LDCU_EVSysReadySt 2//HV ON
  gTC_CANTest_SOA_CheckReq_Prepare("SetSecRowRtSeatHeatingStruct.SecRowRtSeatHeatingReq 1&ServiceExecuteFeedbackFlag 2"); // 预期结果 TC_CANTest SOA CheckReq SetSecRowRtSeatHeatingStruct.SecRowRtSeatHeatingReq 1&ServiceExecuteFeedbackFlag 2
  g_EM_SOAClient_Swc_SOA_CHECK_Prepare("Veh_SetSecRowRtSeatHeatingRespStruct.Veh_SetSecRowRtSeatHeatingNRC 0"); // 预期结果 TC_CANTest SOA check Veh_SetSecRowRtSeatHeatingRespStruct.Veh_SetSecRowRtSeatHeatingNRC 0
  g_EM_SOAClient_Swc_SOA_CHECK_Prepare("Veh_SeatCtrlService_ErrStruct.OpeNRC 0 traceback7"); // 预期结果 TC_CANTest SOA check Veh_SeatCtrlService_ErrStruct.OpeNRC 0 traceback7
  g_EM_SOAClient_Swc_SOA_REQ("Veh_SetSecRowRtSeatHeatingStruct.Veh_SecRowRtSeatHeatingReq:1&UserID:0x01010001&ServiceExecuteFeedbackFlag:2"); // 测试步骤 TC_CANTest SOA REQ Veh_SetSecRowRtSeatHeatingStruct.Veh_SecRowRtSeatHeatingReq:1&UserID:0x01010001&ServiceExecuteFeedbackFlag:2
  gTC_CANTest_SOA_CheckReq("SetSecRowRtSeatHeatingStruct.SecRowRtSeatHeatingReq 1&ServiceExecuteFeedbackFlag 2"); // 预期结果 TC_CANTest SOA CheckReq SetSecRowRtSeatHeatingStruct.SecRowRtSeatHeatingReq 1&ServiceExecuteFeedbackFlag 2
  g_EM_SOAClient_Swc_SOA_CHECK("Veh_SetSecRowRtSeatHeatingRespStruct.Veh_SetSecRowRtSeatHeatingNRC 0"); // 预期结果 TC_CANTest SOA check Veh_SetSecRowRtSeatHeatingRespStruct.Veh_SetSecRowRtSeatHeatingNRC 0
  g_EM_SOAClient_Swc_SOA_CHECK("Veh_SeatCtrlService_ErrStruct.OpeNRC 0 traceback7"); // 预期结果 TC_CANTest SOA check Veh_SeatCtrlService_ErrStruct.OpeNRC 0 traceback7
  g_EM_Equipment_Swc_TC_IG("ON"); // 测试步骤 TC_IG ON
  g_EM_Equipment_Swc_TC_4G_Time_Delay_Second("2"); // 测试步骤 TC_Sleep 2
}

testcase SYS_CDCU_erpaiyoucezuoyijiare_0102()
{
  TestDescription("二排右侧座椅加热-13");
  teststep("warning","原始用例id为SYS-CDCU-二排右侧座椅加热-0102");
  gTC_CANTest_SOA_CheckReq_Prepare("SetSecRowRtSeatHeatingStruct.SecRowRtSeatHeatingReq 2&ServiceExecuteFeedbackFlag 2"); // 预期结果 TC_CANTest SOA CheckReq SetSecRowRtSeatHeatingStruct.SecRowRtSeatHeatingReq 2&ServiceExecuteFeedbackFlag 2
  g_EM_SOAClient_Swc_SOA_CHECK_Prepare("Veh_SeatCtrlService_ErrStruct.OpeNRC 0 traceback7"); // 预期结果 TC_CANTest SOA check Veh_SeatCtrlService_ErrStruct.OpeNRC 0 traceback7
  g_EM_SOAClient_Swc_SOA_REQ("Veh_SetSecRowRtSeatHeatingStruct.Veh_SecRowRtSeatHeatingReq:2&ServiceExecuteFeedbackFlag:2"); // 测试步骤 TC_CANTest SOA REQ Veh_SetSecRowRtSeatHeatingStruct.Veh_SecRowRtSeatHeatingReq:2&ServiceExecuteFeedbackFlag:2
  gTC_CANTest_SOA_CheckReq("SetSecRowRtSeatHeatingStruct.SecRowRtSeatHeatingReq 2&ServiceExecuteFeedbackFlag 2"); // 预期结果 TC_CANTest SOA CheckReq SetSecRowRtSeatHeatingStruct.SecRowRtSeatHeatingReq 2&ServiceExecuteFeedbackFlag 2
  g_EM_SOAClient_Swc_SOA_CHECK("Veh_SeatCtrlService_ErrStruct.OpeNRC 0 traceback7"); // 预期结果 TC_CANTest SOA check Veh_SeatCtrlService_ErrStruct.OpeNRC 0 traceback7
  g_EM_Equipment_Swc_TC_4G_Time_Delay_Second("5"); // 测试步骤 TC_Sleep 5
}

testcase SYS_CDCU_erpaiyoucezuoyijiare_0103()
{
  TestDescription("二排右侧座椅加热-14");
  teststep("warning","原始用例id为SYS-CDCU-二排右侧座椅加热-0103");
  gTC_CANTest_SOA_CheckReq_Prepare("SetSecRowRtSeatHeatingStruct.SecRowRtSeatHeatingReq 3&ServiceExecuteFeedbackFlag 2"); // 预期结果 TC_CANTest SOA CheckReq SetSecRowRtSeatHeatingStruct.SecRowRtSeatHeatingReq 3&ServiceExecuteFeedbackFlag 2
  g_EM_SOAClient_Swc_SOA_CHECK_Prepare("Veh_SeatCtrlService_ErrStruct.OpeNRC 0 traceback7"); // 预期结果 TC_CANTest SOA check Veh_SeatCtrlService_ErrStruct.OpeNRC 0 traceback7
  g_EM_SOAClient_Swc_SOA_REQ("Veh_SetSecRowRtSeatHeatingStruct.Veh_SecRowRtSeatHeatingReq:3&ServiceExecuteFeedbackFlag:2"); // 测试步骤 TC_CANTest SOA REQ Veh_SetSecRowRtSeatHeatingStruct.Veh_SecRowRtSeatHeatingReq:3&ServiceExecuteFeedbackFlag:2
  gTC_CANTest_SOA_CheckReq("SetSecRowRtSeatHeatingStruct.SecRowRtSeatHeatingReq 3&ServiceExecuteFeedbackFlag 2"); // 预期结果 TC_CANTest SOA CheckReq SetSecRowRtSeatHeatingStruct.SecRowRtSeatHeatingReq 3&ServiceExecuteFeedbackFlag 2
  g_EM_SOAClient_Swc_SOA_CHECK("Veh_SeatCtrlService_ErrStruct.OpeNRC 0 traceback7"); // 预期结果 TC_CANTest SOA check Veh_SeatCtrlService_ErrStruct.OpeNRC 0 traceback7
  g_EM_Equipment_Swc_TC_4G_Time_Delay_Second("5"); // 测试步骤 TC_Sleep 5
}

testcase SYS_CDCU_erpaiyoucezuoyijiare_0104()
{
  TestDescription("二排右侧座椅加热-15");
  teststep("warning","原始用例id为SYS-CDCU-二排右侧座椅加热-0104");
  g_CAN_Bus_Swc_Set("C_LDCU_SysSt.C_LDCU_EVSysReadySt 0"); // 测试步骤 TC_CANTest SET C_LDCU_SysSt.C_LDCU_EVSysReadySt 0
  gTC_CANTest_SOA_CheckReq_Prepare("SetSecRowRtSeatHeatingStruct.SecRowRtSeatHeatingReq 4&ServiceExecuteFeedbackFlag 2"); // 预期结果 TC_CANTest SOA CheckReq SetSecRowRtSeatHeatingStruct.SecRowRtSeatHeatingReq 4&ServiceExecuteFeedbackFlag 2
  g_EM_SOAClient_Swc_SOA_CHECK_Prepare("Veh_SeatCtrlService_ErrStruct.OpeNRC 0 traceback7"); // 预期结果 TC_CANTest SOA check Veh_SeatCtrlService_ErrStruct.OpeNRC 0 traceback7
  g_EM_SOAClient_Swc_SOA_REQ("Veh_SetSecRowRtSeatHeatingStruct.Veh_SecRowRtSeatHeatingReq:4&ServiceExecuteFeedbackFlag:2"); // 测试步骤 TC_CANTest SOA REQ Veh_SetSecRowRtSeatHeatingStruct.Veh_SecRowRtSeatHeatingReq:4&ServiceExecuteFeedbackFlag:2
  gTC_CANTest_SOA_CheckReq("SetSecRowRtSeatHeatingStruct.SecRowRtSeatHeatingReq 4&ServiceExecuteFeedbackFlag 2"); // 预期结果 TC_CANTest SOA CheckReq SetSecRowRtSeatHeatingStruct.SecRowRtSeatHeatingReq 4&ServiceExecuteFeedbackFlag 2
  g_EM_SOAClient_Swc_SOA_CHECK("Veh_SeatCtrlService_ErrStruct.OpeNRC 0 traceback7"); // 预期结果 TC_CANTest SOA check Veh_SeatCtrlService_ErrStruct.OpeNRC 0 traceback7
}

testcase SYS_CDCU_guanbizhujiazuoyitongfeng_0105()
{
  TestDescription("主驾座椅通风-1");
  teststep("warning","原始用例id为SYS-CDCU-关闭主驾座椅通风-0105");
  g_EM_Equipment_Swc_TC_PW("OFF"); // 测试步骤 TC_PW OFF
  g_EM_Equipment_Swc_TC_IG("OFF"); // 测试步骤 TC_IG OFF
  g_EM_Equipment_Swc_TC_4G_Time_Delay_Second("1"); // 测试步骤 TC_Sleep 1
  g_EM_Equipment_Swc_TC_PW("ON"); // 测试步骤 TC_PW ON
  g_EM_Equipment_Swc_TC_IG("ON"); // 测试步骤 TC_IG ON
  g_EM_Equipment_Swc_TC_4G_Time_Delay_Second("5"); // 测试步骤 TC_Sleep 5
}

testcase SYS_CDCU_guanbizhujiazuoyitongfeng_0106()
{
  TestDescription("主驾座椅通风-2");
  teststep("warning","原始用例id为SYS-CDCU-关闭主驾座椅通风-0106");
  g_EM_Equipment_Swc_TC_IG("OFF"); // 测试步骤 TC_IG OFF
  g_CAN_Bus_Swc_Set("I_LDCU_BodySysSt1.I_LDCU_PowerMode 1"); // 测试步骤 TC_CANTest SET I_LDCU_BodySysSt1.I_LDCU_PowerMode 1
  g_EM_Equipment_Swc_TC_4G_Time_Delay_Second("1"); // 测试步骤 TC_Sleep 1
  g_CAN_Bus_Swc_Set("I_LDCU_BodySysSt1.I_LDCU_PowerMode 0"); // 测试步骤 TC_CANTest SET I_LDCU_BodySysSt1.I_LDCU_PowerMode 0
  g_CAN_Bus_Swc_Set("I_LDCU_NM.I_LDCU_NMRepeatMsgReqBit 1"); // 测试步骤 TC_CANTest SET I_LDCU_NM.I_LDCU_NMRepeatMsgReqBit 1 //网络唤醒维持帧
  g_CAN_Bus_Swc_Set("C_LDCU_SysSt.C_LDCU_EVSysReadySt 0"); // 测试步骤 TC_CANTest SET C_LDCU_SysSt.C_LDCU_EVSysReadySt 0//Not ready
  g_EM_SOAClient_Swc_SOA_CHECK_Prepare("Veh_SeatCtrlService_ErrStruct.OpeNRC 0 traceback7"); // 预期结果 TC_CANTest SOA check Veh_SeatCtrlService_ErrStruct.OpeNRC 0 traceback7
  g_EM_SOAClient_Swc_SOA_REQ("Veh_SetDrvSeatVentilationStruct.Veh_DrvSeatVentilationReq:1&ServiceExecuteFeedbackFlag:2&UserID:0x01010001"); // 测试步骤 TC_CANTest SOA REQ Veh_SetDrvSeatVentilationStruct.Veh_DrvSeatVentilationReq:1&ServiceExecuteFeedbackFlag:2&UserID:0x01010001
  gTC_CANTest_SOA_CheckReq_Prepare("HighVoltageCtrlStruct.HighVoltageCtrl 2"); // 预期结果 TC_CANTest SOA CheckReq HighVoltageCtrlStruct.HighVoltageCtrl 2
  g_EM_SOAClient_Swc_SOA_CHECK_Prepare("SOAEngineInterSignalStruct.SeatVentilationHVReq 1"); // 预期结果 TC_CANTest SOA check SOAEngineInterSignalStruct.SeatVentilationHVReq 1
  gTC_CANTest_SOA_CheckReq_Prepare("SetDrvSeatVentilationStruct.DrvSeatVentilationReq 1&ServiceExecuteFeedbackFlag 2"); // 预期结果 TC_CANTest SOA CheckReq SetDrvSeatVentilationStruct.DrvSeatVentilationReq 1&ServiceExecuteFeedbackFlag 2
  g_EM_SOAClient_Swc_SOA_CHECK_Prepare("Veh_SetDrvSeatVentilationRespStruct.Veh_SetDrvSeatVentilationNRC 0"); // 预期结果 TC_CANTest SOA check Veh_SetDrvSeatVentilationRespStruct.Veh_SetDrvSeatVentilationNRC 0
  g_CAN_Bus_Swc_Set("C_LDCU_SysSt.C_LDCU_EVSysReadySt 2"); // 测试步骤 TC_CANTest SET C_LDCU_SysSt.C_LDCU_EVSysReadySt 2//Not ready
  gTC_CANTest_SOA_CheckReq("HighVoltageCtrlStruct.HighVoltageCtrl 2"); // 预期结果 TC_CANTest SOA CheckReq HighVoltageCtrlStruct.HighVoltageCtrl 2
  g_EM_SOAClient_Swc_SOA_CHECK("SOAEngineInterSignalStruct.SeatVentilationHVReq 1"); // 预期结果 TC_CANTest SOA check SOAEngineInterSignalStruct.SeatVentilationHVReq 1
  gTC_CANTest_SOA_CheckReq("SetDrvSeatVentilationStruct.DrvSeatVentilationReq 1&ServiceExecuteFeedbackFlag 2"); // 预期结果 TC_CANTest SOA CheckReq SetDrvSeatVentilationStruct.DrvSeatVentilationReq 1&ServiceExecuteFeedbackFlag 2
  g_EM_SOAClient_Swc_SOA_CHECK("Veh_SetDrvSeatVentilationRespStruct.Veh_SetDrvSeatVentilationNRC 0"); // 预期结果 TC_CANTest SOA check Veh_SetDrvSeatVentilationRespStruct.Veh_SetDrvSeatVentilationNRC 0
  g_EM_Equipment_Swc_TC_IG("ON"); // 测试步骤 TC_IG ON
  g_EM_SOAClient_Swc_SOA_CHECK("Veh_SeatCtrlService_ErrStruct.OpeNRC 0 traceback7"); // 预期结果 TC_CANTest SOA check Veh_SeatCtrlService_ErrStruct.OpeNRC 0 traceback7
  g_EM_SOAClient_Swc_SOA_CHECK_Prepare("SOAEngineInterSignalStruct.SeatVentilationHVReq 0"); // 预期结果 TC_CANTest SOA check SOAEngineInterSignalStruct.SeatVentilationHVReq 0
  g_CAN_Bus_Swc_Set("I_LDCU_BodySysSt1.I_LDCU_PowerMode 1"); // 测试步骤 TC_CANTest SET I_LDCU_BodySysSt1.I_LDCU_PowerMode 1
  g_EM_SOAClient_Swc_SOA_CHECK("SOAEngineInterSignalStruct.SeatVentilationHVReq 0"); // 预期结果 TC_CANTest SOA check SOAEngineInterSignalStruct.SeatVentilationHVReq 0
  g_EM_Equipment_Swc_TC_4G_Time_Delay_Second("1"); // 测试步骤 TC_Sleep 1
}

testcase SYS_CDCU_guanbizhujiazuoyitongfeng_0107()
{
  TestDescription("主驾座椅通风-3");
  teststep("warning","原始用例id为SYS-CDCU-关闭主驾座椅通风-0107");
  g_EM_Equipment_Swc_TC_IG("OFF"); // 测试步骤 TC_IG OFF
  g_EM_Equipment_Swc_TC_4G_Time_Delay_Second("1"); // 测试步骤 TC_Sleep 1
  g_CAN_Bus_Swc_Set("I_LDCU_BodySysSt1.I_LDCU_PowerMode 1"); // 测试步骤 TC_CANTest SET I_LDCU_BodySysSt1.I_LDCU_PowerMode 1
  g_EM_Equipment_Swc_TC_4G_Time_Delay_Second("1"); // 测试步骤 TC_Sleep 1
  g_CAN_Bus_Swc_Set("I_LDCU_BodySysSt1.I_LDCU_PowerMode 0"); // 测试步骤 TC_CANTest SET I_LDCU_BodySysSt1.I_LDCU_PowerMode 0
  g_CAN_Bus_Swc_Set("I_LDCU_NM.I_LDCU_NMRepeatMsgReqBit 1"); // 测试步骤 TC_CANTest SET I_LDCU_NM.I_LDCU_NMRepeatMsgReqBit 1 //网络唤醒维持帧
  g_CAN_Bus_Swc_Set("C_LDCU_SysSt.C_LDCU_EVSysReadySt 1"); // 测试步骤 TC_CANTest SET C_LDCU_SysSt.C_LDCU_EVSysReadySt 1//HV ON
  gTC_CANTest_SOA_CheckReq_Prepare("SetDrvSeatVentilationStruct.DrvSeatVentilationReq 1&ServiceExecuteFeedbackFlag 2"); // 预期结果 TC_CANTest SOA CheckReq SetDrvSeatVentilationStruct.DrvSeatVentilationReq 1&ServiceExecuteFeedbackFlag 2
  g_EM_SOAClient_Swc_SOA_CHECK_Prepare("Veh_SeatCtrlService_ErrStruct.OpeNRC 0 traceback7"); // 预期结果 TC_CANTest SOA check Veh_SeatCtrlService_ErrStruct.OpeNRC 0 traceback7
  g_EM_SOAClient_Swc_SOA_REQ("Veh_SetDrvSeatVentilationStruct.Veh_DrvSeatVentilationReq:1&ServiceExecuteFeedbackFlag:2&UserID:0x01010001"); // 测试步骤 TC_CANTest SOA REQ Veh_SetDrvSeatVentilationStruct.Veh_DrvSeatVentilationReq:1&ServiceExecuteFeedbackFlag:2&UserID:0x01010001
  gTC_CANTest_SOA_CheckReq("SetDrvSeatVentilationStruct.DrvSeatVentilationReq 1&ServiceExecuteFeedbackFlag 2"); // 预期结果 TC_CANTest SOA CheckReq SetDrvSeatVentilationStruct.DrvSeatVentilationReq 1&ServiceExecuteFeedbackFlag 2
  g_EM_SOAClient_Swc_SOA_CHECK_Prepare("Veh_SetDrvSeatVentilationRespStruct.Veh_SetDrvSeatVentilationNRC 0"); // 预期结果 TC_CANTest SOA check Veh_SetDrvSeatVentilationRespStruct.Veh_SetDrvSeatVentilationNRC 0
  g_CAN_Bus_Swc_Set("C_LDCU_SysSt.C_LDCU_EVSysReadySt 2"); // 测试步骤 TC_CANTest SET C_LDCU_SysSt.C_LDCU_EVSysReadySt 2//Not ready
  g_EM_SOAClient_Swc_SOA_CHECK("Veh_SetDrvSeatVentilationRespStruct.Veh_SetDrvSeatVentilationNRC 0"); // 预期结果 TC_CANTest SOA check Veh_SetDrvSeatVentilationRespStruct.Veh_SetDrvSeatVentilationNRC 0
  g_EM_SOAClient_Swc_SOA_CHECK("Veh_SeatCtrlService_ErrStruct.OpeNRC 0 traceback7"); // 预期结果 TC_CANTest SOA check Veh_SeatCtrlService_ErrStruct.OpeNRC 0 traceback7
  g_EM_Equipment_Swc_TC_IG("ON"); // 测试步骤 TC_IG ON
  g_EM_Equipment_Swc_TC_4G_Time_Delay_Second("1"); // 测试步骤 TC_Sleep 1
}

testcase SYS_CDCU_guanbizhujiazuoyitongfeng_0108()
{
  TestDescription("主驾座椅通风-4");
  teststep("warning","原始用例id为SYS-CDCU-关闭主驾座椅通风-0108");
  g_EM_Equipment_Swc_TC_IG("OFF"); // 测试步骤 TC_IG OFF
  g_CAN_Bus_Swc_Set("I_LDCU_BodySysSt1.I_LDCU_PowerMode 1"); // 测试步骤 TC_CANTest SET I_LDCU_BodySysSt1.I_LDCU_PowerMode 1
  g_EM_Equipment_Swc_TC_4G_Time_Delay_Second("1"); // 测试步骤 TC_Sleep 1
  g_CAN_Bus_Swc_Set("I_LDCU_BodySysSt1.I_LDCU_PowerMode 0"); // 测试步骤 TC_CANTest SET I_LDCU_BodySysSt1.I_LDCU_PowerMode 0
  g_CAN_Bus_Swc_Set("I_LDCU_NM.I_LDCU_NMRepeatMsgReqBit 1"); // 测试步骤 TC_CANTest SET I_LDCU_NM.I_LDCU_NMRepeatMsgReqBit 1 //网络唤醒维持帧
  g_CAN_Bus_Swc_Set("C_LDCU_SysSt.C_LDCU_EVSysReadySt 2"); // 测试步骤 TC_CANTest SET C_LDCU_SysSt.C_LDCU_EVSysReadySt 2//HV ON
  gTC_CANTest_SOA_CheckReq_Prepare("SetDrvSeatVentilationStruct.DrvSeatVentilationReq 1&ServiceExecuteFeedbackFlag 2"); // 预期结果 TC_CANTest SOA CheckReq SetDrvSeatVentilationStruct.DrvSeatVentilationReq 1&ServiceExecuteFeedbackFlag 2
  g_EM_SOAClient_Swc_SOA_CHECK_Prepare("Veh_SeatCtrlService_ErrStruct.OpeNRC 0 traceback7"); // 预期结果 TC_CANTest SOA check Veh_SeatCtrlService_ErrStruct.OpeNRC 0 traceback7
  g_EM_SOAClient_Swc_SOA_REQ("Veh_SetDrvSeatVentilationStruct.Veh_DrvSeatVentilationReq:1&ServiceExecuteFeedbackFlag:2&UserID:0x01010001"); // 测试步骤 TC_CANTest SOA REQ Veh_SetDrvSeatVentilationStruct.Veh_DrvSeatVentilationReq:1&ServiceExecuteFeedbackFlag:2&UserID:0x01010001
  gTC_CANTest_SOA_CheckReq("SetDrvSeatVentilationStruct.DrvSeatVentilationReq 1&ServiceExecuteFeedbackFlag 2"); // 预期结果 TC_CANTest SOA CheckReq SetDrvSeatVentilationStruct.DrvSeatVentilationReq 1&ServiceExecuteFeedbackFlag 2
  g_EM_SOAClient_Swc_SOA_CHECK_Prepare("Veh_SetDrvSeatVentilationRespStruct.Veh_SetDrvSeatVentilationNRC 0"); // 预期结果 TC_CANTest SOA check Veh_SetDrvSeatVentilationRespStruct.Veh_SetDrvSeatVentilationNRC 0
  g_CAN_Bus_Swc_Set("C_LDCU_SysSt.C_LDCU_EVSysReadySt 2"); // 测试步骤 TC_CANTest SET C_LDCU_SysSt.C_LDCU_EVSysReadySt 2//Not ready
  g_EM_SOAClient_Swc_SOA_CHECK("Veh_SetDrvSeatVentilationRespStruct.Veh_SetDrvSeatVentilationNRC 0"); // 预期结果 TC_CANTest SOA check Veh_SetDrvSeatVentilationRespStruct.Veh_SetDrvSeatVentilationNRC 0
  g_EM_SOAClient_Swc_SOA_CHECK("Veh_SeatCtrlService_ErrStruct.OpeNRC 0 traceback7"); // 预期结果 TC_CANTest SOA check Veh_SeatCtrlService_ErrStruct.OpeNRC 0 traceback7
  g_EM_Equipment_Swc_TC_IG("ON"); // 测试步骤 TC_IG ON
}

testcase SYS_CDCU_guanbizhujiazuoyitongfeng_0109()
{
  TestDescription("主驾座椅通风-5");
  teststep("warning","原始用例id为SYS-CDCU-关闭主驾座椅通风-0109");
  g_CAN_Bus_Swc_Set("I_LDCU_BodySysSt1.I_LDCU_PowerMode 1"); // 测试步骤 TC_CANTest SET I_LDCU_BodySysSt1.I_LDCU_PowerMode 1
  g_CAN_Bus_Swc_Set("I_LDCU_NM.I_LDCU_NMRepeatMsgReqBit 1"); // 测试步骤 TC_CANTest SET I_LDCU_NM.I_LDCU_NMRepeatMsgReqBit 1 //网络唤醒维持帧
  g_CAN_Bus_Swc_Set("C_LDCU_SysSt.C_LDCU_EVSysReadySt 2"); // 测试步骤 TC_CANTest SET C_LDCU_SysSt.C_LDCU_EVSysReadySt 2//ready
  gTC_CANTest_SOA_CheckReq_Prepare("SetDrvSeatVentilationStruct.DrvSeatVentilationReq 1&ServiceExecuteFeedbackFlag 2"); // 预期结果 TC_CANTest SOA CheckReq SetDrvSeatVentilationStruct.DrvSeatVentilationReq 1&ServiceExecuteFeedbackFlag 2
  g_EM_SOAClient_Swc_SOA_CHECK_Prepare("Veh_SeatCtrlService_ErrStruct.OpeNRC 0 traceback7"); // 预期结果 TC_CANTest SOA check Veh_SeatCtrlService_ErrStruct.OpeNRC 0 traceback7
  g_EM_SOAClient_Swc_SOA_REQ("Veh_SetDrvSeatVentilationStruct.Veh_DrvSeatVentilationReq:1&ServiceExecuteFeedbackFlag:2"); // 测试步骤 TC_CANTest SOA REQ Veh_SetDrvSeatVentilationStruct.Veh_DrvSeatVentilationReq:1&ServiceExecuteFeedbackFlag:2
  gTC_CANTest_SOA_CheckReq("SetDrvSeatVentilationStruct.DrvSeatVentilationReq 1&ServiceExecuteFeedbackFlag 2"); // 预期结果 TC_CANTest SOA CheckReq SetDrvSeatVentilationStruct.DrvSeatVentilationReq 1&ServiceExecuteFeedbackFlag 2
  g_CAN_Bus_Swc_Set("C_LDCU_SysSt.C_LDCU_EVSysReadySt 2"); // 测试步骤 TC_CANTest SET C_LDCU_SysSt.C_LDCU_EVSysReadySt 2//Not ready
  g_EM_SOAClient_Swc_SOA_CHECK("Veh_SeatCtrlService_ErrStruct.OpeNRC 0 traceback7"); // 预期结果 TC_CANTest SOA check Veh_SeatCtrlService_ErrStruct.OpeNRC 0 traceback7
}

testcase SYS_CDCU_guanbizhujiazuoyitongfeng_0110()
{
  TestDescription("主驾座椅通风-6");
  teststep("warning","原始用例id为SYS-CDCU-关闭主驾座椅通风-0110");
  g_CAN_Bus_Swc_Set("I_LDCU_BodySysSt1.I_LDCU_PowerMode 1"); // 测试步骤 TC_CANTest SET I_LDCU_BodySysSt1.I_LDCU_PowerMode 1
  g_CAN_Bus_Swc_Set("I_LDCU_NM.I_LDCU_NMRepeatMsgReqBit 1"); // 测试步骤 TC_CANTest SET I_LDCU_NM.I_LDCU_NMRepeatMsgReqBit 1 //网络唤醒维持帧
  g_CAN_Bus_Swc_Set("C_LDCU_SysSt.C_LDCU_EVSysReadySt 1"); // 测试步骤 TC_CANTest SET C_LDCU_SysSt.C_LDCU_EVSysReadySt 1//Not ready
  gTC_CANTest_SOA_CheckReq_Prepare("SetDrvSeatVentilationStruct.DrvSeatVentilationReq 1&ServiceExecuteFeedbackFlag 2"); // 预期结果 TC_CANTest SOA CheckReq SetDrvSeatVentilationStruct.DrvSeatVentilationReq 1&ServiceExecuteFeedbackFlag 2
  g_EM_SOAClient_Swc_SOA_CHECK_Prepare("Veh_SeatCtrlService_ErrStruct.OpeNRC 0 traceback7"); // 预期结果 TC_CANTest SOA check Veh_SeatCtrlService_ErrStruct.OpeNRC 0 traceback7
  g_EM_SOAClient_Swc_SOA_REQ("Veh_SetDrvSeatVentilationStruct.Veh_DrvSeatVentilationReq:1&ServiceExecuteFeedbackFlag:2"); // 测试步骤 TC_CANTest SOA REQ Veh_SetDrvSeatVentilationStruct.Veh_DrvSeatVentilationReq:1&ServiceExecuteFeedbackFlag:2
  gTC_CANTest_SOA_CheckReq("SetDrvSeatVentilationStruct.DrvSeatVentilationReq 1&ServiceExecuteFeedbackFlag 2"); // 预期结果 TC_CANTest SOA CheckReq SetDrvSeatVentilationStruct.DrvSeatVentilationReq 1&ServiceExecuteFeedbackFlag 2
  g_CAN_Bus_Swc_Set("C_LDCU_SysSt.C_LDCU_EVSysReadySt 2"); // 测试步骤 TC_CANTest SET C_LDCU_SysSt.C_LDCU_EVSysReadySt 2//Not ready
  g_EM_SOAClient_Swc_SOA_CHECK("Veh_SeatCtrlService_ErrStruct.OpeNRC 0 traceback7"); // 预期结果 TC_CANTest SOA check Veh_SeatCtrlService_ErrStruct.OpeNRC 0 traceback7
}

testcase SYS_CDCU_guanbizhujiazuoyitongfeng_0111()
{
  TestDescription("主驾座椅通风-7");
  teststep("warning","原始用例id为SYS-CDCU-关闭主驾座椅通风-0111");
  g_CAN_Bus_Swc_Set("I_LDCU_BodySysSt1.I_LDCU_PowerMode 1"); // 测试步骤 TC_CANTest SET I_LDCU_BodySysSt1.I_LDCU_PowerMode 1
  g_CAN_Bus_Swc_Set("I_LDCU_NM.I_LDCU_NMRepeatMsgReqBit 1"); // 测试步骤 TC_CANTest SET I_LDCU_NM.I_LDCU_NMRepeatMsgReqBit 1 //网络唤醒维持帧
  g_CAN_Bus_Swc_Set("C_LDCU_SysSt.C_LDCU_EVSysReadySt 2"); // 测试步骤 TC_CANTest SET C_LDCU_SysSt.C_LDCU_EVSysReadySt 2//Not ready
  gTC_CANTest_SOA_CheckReq_Prepare("SetDrvSeatVentilationStruct.DrvSeatVentilationReq 1&ServiceExecuteFeedbackFlag 2"); // 预期结果 TC_CANTest SOA CheckReq SetDrvSeatVentilationStruct.DrvSeatVentilationReq 1&ServiceExecuteFeedbackFlag 2
  g_EM_SOAClient_Swc_SOA_CHECK_Prepare("Veh_SeatCtrlService_ErrStruct.OpeNRC 0 traceback7"); // 预期结果 TC_CANTest SOA check Veh_SeatCtrlService_ErrStruct.OpeNRC 0 traceback7
  g_EM_SOAClient_Swc_SOA_REQ("Veh_SetDrvSeatVentilationStruct.Veh_DrvSeatVentilationReq:1&ServiceExecuteFeedbackFlag:2"); // 测试步骤 TC_CANTest SOA REQ Veh_SetDrvSeatVentilationStruct.Veh_DrvSeatVentilationReq:1&ServiceExecuteFeedbackFlag:2
  gTC_CANTest_SOA_CheckReq("SetDrvSeatVentilationStruct.DrvSeatVentilationReq 1&ServiceExecuteFeedbackFlag 2"); // 预期结果 TC_CANTest SOA CheckReq SetDrvSeatVentilationStruct.DrvSeatVentilationReq 1&ServiceExecuteFeedbackFlag 2
  g_CAN_Bus_Swc_Set("C_LDCU_SysSt.C_LDCU_EVSysReadySt 2"); // 测试步骤 TC_CANTest SET C_LDCU_SysSt.C_LDCU_EVSysReadySt 2//Not ready
  g_EM_SOAClient_Swc_SOA_CHECK("Veh_SeatCtrlService_ErrStruct.OpeNRC 0 traceback7"); // 预期结果 TC_CANTest SOA check Veh_SeatCtrlService_ErrStruct.OpeNRC 0 traceback7
}

testcase SYS_CDCU_guanbizhujiazuoyitongfeng_0112()
{
  TestDescription("主驾座椅通风-8");
  teststep("warning","原始用例id为SYS-CDCU-关闭主驾座椅通风-0112");
  gTC_CANTest_SOA_CheckReq_Prepare("SetDrvSeatVentilationStruct.DrvSeatVentilationReq 2&ServiceExecuteFeedbackFlag 2"); // 预期结果 TC_CANTest SOA CheckReq SetDrvSeatVentilationStruct.DrvSeatVentilationReq 2&ServiceExecuteFeedbackFlag 2
  g_EM_SOAClient_Swc_SOA_CHECK_Prepare("Veh_SeatCtrlService_ErrStruct.OpeNRC 0 traceback7"); // 预期结果 TC_CANTest SOA check Veh_SeatCtrlService_ErrStruct.OpeNRC 0 traceback7
  g_EM_SOAClient_Swc_SOA_REQ("Veh_SetDrvSeatVentilationStruct.Veh_DrvSeatVentilationReq:2&ServiceExecuteFeedbackFlag:2"); // 测试步骤 TC_CANTest SOA REQ Veh_SetDrvSeatVentilationStruct.Veh_DrvSeatVentilationReq:2&ServiceExecuteFeedbackFlag:2
  gTC_CANTest_SOA_CheckReq("SetDrvSeatVentilationStruct.DrvSeatVentilationReq 2&ServiceExecuteFeedbackFlag 2"); // 预期结果 TC_CANTest SOA CheckReq SetDrvSeatVentilationStruct.DrvSeatVentilationReq 2&ServiceExecuteFeedbackFlag 2
  g_EM_SOAClient_Swc_SOA_CHECK("Veh_SeatCtrlService_ErrStruct.OpeNRC 0 traceback7"); // 预期结果 TC_CANTest SOA check Veh_SeatCtrlService_ErrStruct.OpeNRC 0 traceback7
  g_EM_Equipment_Swc_TC_4G_Time_Delay_Second("5"); // 测试步骤 TC_Sleep 5
}

testcase SYS_CDCU_guanbizhujiazuoyitongfeng_0113()
{
  TestDescription("主驾座椅通风-9");
  teststep("warning","原始用例id为SYS-CDCU-关闭主驾座椅通风-0113");
  gTC_CANTest_SOA_CheckReq_Prepare("SetDrvSeatVentilationStruct.DrvSeatVentilationReq 3&ServiceExecuteFeedbackFlag 2"); // 预期结果 TC_CANTest SOA CheckReq SetDrvSeatVentilationStruct.DrvSeatVentilationReq 3&ServiceExecuteFeedbackFlag 2
  g_EM_SOAClient_Swc_SOA_CHECK_Prepare("Veh_SeatCtrlService_ErrStruct.OpeNRC 0 traceback7"); // 预期结果 TC_CANTest SOA check Veh_SeatCtrlService_ErrStruct.OpeNRC 0 traceback7
  g_EM_SOAClient_Swc_SOA_REQ("Veh_SetDrvSeatVentilationStruct.Veh_DrvSeatVentilationReq:3&ServiceExecuteFeedbackFlag:2"); // 测试步骤 TC_CANTest SOA REQ Veh_SetDrvSeatVentilationStruct.Veh_DrvSeatVentilationReq:3&ServiceExecuteFeedbackFlag:2
  gTC_CANTest_SOA_CheckReq("SetDrvSeatVentilationStruct.DrvSeatVentilationReq 3&ServiceExecuteFeedbackFlag 2"); // 预期结果 TC_CANTest SOA CheckReq SetDrvSeatVentilationStruct.DrvSeatVentilationReq 3&ServiceExecuteFeedbackFlag 2
  g_EM_SOAClient_Swc_SOA_CHECK("Veh_SeatCtrlService_ErrStruct.OpeNRC 0 traceback7"); // 预期结果 TC_CANTest SOA check Veh_SeatCtrlService_ErrStruct.OpeNRC 0 traceback7
  g_EM_Equipment_Swc_TC_4G_Time_Delay_Second("5"); // 测试步骤 TC_Sleep 5
}

testcase SYS_CDCU_guanbizhujiazuoyitongfeng_0114()
{
  TestDescription("主驾座椅通风-10");
  teststep("warning","原始用例id为SYS-CDCU-关闭主驾座椅通风-0114");
  g_CAN_Bus_Swc_Set("C_LDCU_SysSt.C_LDCU_EVSysReadySt 0"); // 测试步骤 TC_CANTest SET C_LDCU_SysSt.C_LDCU_EVSysReadySt 0
  gTC_CANTest_SOA_CheckReq_Prepare("SetDrvSeatVentilationStruct.DrvSeatVentilationReq 4&ServiceExecuteFeedbackFlag 2"); // 预期结果 TC_CANTest SOA CheckReq SetDrvSeatVentilationStruct.DrvSeatVentilationReq 4&ServiceExecuteFeedbackFlag 2
  g_EM_SOAClient_Swc_SOA_CHECK_Prepare("Veh_SeatCtrlService_ErrStruct.OpeNRC 0 traceback7"); // 预期结果 TC_CANTest SOA check Veh_SeatCtrlService_ErrStruct.OpeNRC 0 traceback7
  g_EM_SOAClient_Swc_SOA_REQ("Veh_SetDrvSeatVentilationStruct.Veh_DrvSeatVentilationReq:4&ServiceExecuteFeedbackFlag:2"); // 测试步骤 TC_CANTest SOA REQ Veh_SetDrvSeatVentilationStruct.Veh_DrvSeatVentilationReq:4&ServiceExecuteFeedbackFlag:2
  gTC_CANTest_SOA_CheckReq("SetDrvSeatVentilationStruct.DrvSeatVentilationReq 4&ServiceExecuteFeedbackFlag 2"); // 预期结果 TC_CANTest SOA CheckReq SetDrvSeatVentilationStruct.DrvSeatVentilationReq 4&ServiceExecuteFeedbackFlag 2
  g_EM_SOAClient_Swc_SOA_CHECK("Veh_SeatCtrlService_ErrStruct.OpeNRC 0 traceback7"); // 预期结果 TC_CANTest SOA check Veh_SeatCtrlService_ErrStruct.OpeNRC 0 traceback7
}

testcase SYS_CDCU_guanbizhujiazuoyitongfeng_0115()
{
  TestDescription("主驾座椅通风-11");
  teststep("warning","原始用例id为SYS-CDCU-关闭主驾座椅通风-0115");
  g_EM_Equipment_Swc_TC_PW("ON"); // 测试步骤 TC_PW ON
  g_EM_Equipment_Swc_TC_IG("OFF"); // 测试步骤 TC_IG OFF
  g_CAN_Bus_Swc_Set("I_LDCU_BodySysSt1.I_LDCU_PowerMode 1"); // 测试步骤 TC_CANTest SET I_LDCU_BodySysSt1.I_LDCU_PowerMode 1
  g_EM_Equipment_Swc_TC_4G_Time_Delay_Second("5"); // 测试步骤 TC_Sleep 5
  g_CAN_Bus_Swc_Set("I_LDCU_BodySysSt1.I_LDCU_PowerMode 2"); // 测试步骤 TC_CANTest SET I_LDCU_BodySysSt1.I_LDCU_PowerMode 2
  g_CAN_Bus_Swc_Set("I_LDCU_NM.I_LDCU_NMRepeatMsgReqBit 1"); // 测试步骤 TC_CANTest SET I_LDCU_NM.I_LDCU_NMRepeatMsgReqBit 1 //网络唤醒维持帧
  g_CAN_Bus_Swc_Set("C_LDCU_SysSt.C_LDCU_EVSysReadySt 0"); // 测试步骤 TC_CANTest SET C_LDCU_SysSt.C_LDCU_EVSysReadySt 0//Not ready
  gTC_CANTest_SOA_CheckReq_Prepare("HighVoltageCtrlStruct.HighVoltageCtrl 2"); // 预期结果 TC_CANTest SOA CheckReq HighVoltageCtrlStruct.HighVoltageCtrl 2
  g_EM_SOAClient_Swc_SOA_CHECK_Prepare("Veh_SeatCtrlService_ErrStruct.OpeNRC 0 traceback7"); // 预期结果 TC_CANTest SOA check Veh_SeatCtrlService_ErrStruct.OpeNRC 0 traceback7
  g_EM_SOAClient_Swc_SOA_REQ("Veh_SetDrvSeatVentilationStruct.Veh_DrvSeatVentilationReq:1&ServiceExecuteFeedbackFlag:2"); // 测试步骤 TC_CANTest SOA REQ Veh_SetDrvSeatVentilationStruct.Veh_DrvSeatVentilationReq:1&ServiceExecuteFeedbackFlag:2
  gTC_CANTest_SOA_CheckReq("HighVoltageCtrlStruct.HighVoltageCtrl 2"); // 预期结果 TC_CANTest SOA CheckReq HighVoltageCtrlStruct.HighVoltageCtrl 2
  gTC_CANTest_SOA_CheckReq_Prepare("SetDrvSeatVentilationStruct.DrvSeatVentilationReq 1&ServiceExecuteFeedbackFlag 2"); // 预期结果 TC_CANTest SOA CheckReq SetDrvSeatVentilationStruct.DrvSeatVentilationReq 1&ServiceExecuteFeedbackFlag 2
  g_EM_SOAClient_Swc_SOA_CHECK_Prepare("Veh_SetDrvSeatVentilationRespStruct.Veh_SetDrvSeatVentilationNRC 0"); // 预期结果 TC_CANTest SOA check Veh_SetDrvSeatVentilationRespStruct.Veh_SetDrvSeatVentilationNRC 0
  g_CAN_Bus_Swc_Set("C_LDCU_SysSt.C_LDCU_EVSysReadySt 2"); // 测试步骤 TC_CANTest SET C_LDCU_SysSt.C_LDCU_EVSysReadySt 2//Not ready
  gTC_CANTest_SOA_CheckReq("SetDrvSeatVentilationStruct.DrvSeatVentilationReq 1&ServiceExecuteFeedbackFlag 2"); // 预期结果 TC_CANTest SOA CheckReq SetDrvSeatVentilationStruct.DrvSeatVentilationReq 1&ServiceExecuteFeedbackFlag 2
  g_EM_SOAClient_Swc_SOA_CHECK("Veh_SetDrvSeatVentilationRespStruct.Veh_SetDrvSeatVentilationNRC 0"); // 预期结果 TC_CANTest SOA check Veh_SetDrvSeatVentilationRespStruct.Veh_SetDrvSeatVentilationNRC 0
  g_EM_SOAClient_Swc_SOA_CHECK("Veh_SeatCtrlService_ErrStruct.OpeNRC 0 traceback7"); // 预期结果 TC_CANTest SOA check Veh_SeatCtrlService_ErrStruct.OpeNRC 0 traceback7
  g_EM_Equipment_Swc_TC_IG("ON"); // 测试步骤 TC_IG ON
  g_EM_Equipment_Swc_TC_4G_Time_Delay_Second("2"); // 测试步骤 TC_Sleep 2
}

testcase SYS_CDCU_guanbizhujiazuoyitongfeng_0116()
{
  TestDescription("主驾座椅通风-12");
  teststep("warning","原始用例id为SYS-CDCU-关闭主驾座椅通风-0116");
  g_EM_Equipment_Swc_TC_IG("OFF"); // 测试步骤 TC_IG OFF
  g_CAN_Bus_Swc_Set("I_LDCU_BodySysSt1.I_LDCU_PowerMode 1"); // 测试步骤 TC_CANTest SET I_LDCU_BodySysSt1.I_LDCU_PowerMode 1
  g_EM_Equipment_Swc_TC_4G_Time_Delay_Second("1"); // 测试步骤 TC_Sleep 1
  g_CAN_Bus_Swc_Set("I_LDCU_BodySysSt1.I_LDCU_PowerMode 2"); // 测试步骤 TC_CANTest SET I_LDCU_BodySysSt1.I_LDCU_PowerMode 2
  g_CAN_Bus_Swc_Set("I_LDCU_NM.I_LDCU_NMRepeatMsgReqBit 1"); // 测试步骤 TC_CANTest SET I_LDCU_NM.I_LDCU_NMRepeatMsgReqBit 1 //网络唤醒维持帧
  g_CAN_Bus_Swc_Set("C_LDCU_SysSt.C_LDCU_EVSysReadySt 1"); // 测试步骤 TC_CANTest SET C_LDCU_SysSt.C_LDCU_EVSysReadySt 1//HV ON
  gTC_CANTest_SOA_CheckReq_Prepare("SetDrvSeatVentilationStruct.DrvSeatVentilationReq 1&ServiceExecuteFeedbackFlag 2"); // 预期结果 TC_CANTest SOA CheckReq SetDrvSeatVentilationStruct.DrvSeatVentilationReq 1&ServiceExecuteFeedbackFlag 2
  g_EM_SOAClient_Swc_SOA_CHECK_Prepare("Veh_SeatCtrlService_ErrStruct.OpeNRC 0 traceback7"); // 预期结果 TC_CANTest SOA check Veh_SeatCtrlService_ErrStruct.OpeNRC 0 traceback7
  g_EM_SOAClient_Swc_SOA_REQ("Veh_SetDrvSeatVentilationStruct.Veh_DrvSeatVentilationReq:1&ServiceExecuteFeedbackFlag:2"); // 测试步骤 TC_CANTest SOA REQ Veh_SetDrvSeatVentilationStruct.Veh_DrvSeatVentilationReq:1&ServiceExecuteFeedbackFlag:2
  gTC_CANTest_SOA_CheckReq("SetDrvSeatVentilationStruct.DrvSeatVentilationReq 1&ServiceExecuteFeedbackFlag 2"); // 预期结果 TC_CANTest SOA CheckReq SetDrvSeatVentilationStruct.DrvSeatVentilationReq 1&ServiceExecuteFeedbackFlag 2
  g_EM_SOAClient_Swc_SOA_CHECK_Prepare("Veh_SetDrvSeatVentilationRespStruct.Veh_SetDrvSeatVentilationNRC 0"); // 预期结果 TC_CANTest SOA check Veh_SetDrvSeatVentilationRespStruct.Veh_SetDrvSeatVentilationNRC 0
  g_CAN_Bus_Swc_Set("C_LDCU_SysSt.C_LDCU_EVSysReadySt 2"); // 测试步骤 TC_CANTest SET C_LDCU_SysSt.C_LDCU_EVSysReadySt 2//Not ready
  g_EM_SOAClient_Swc_SOA_CHECK("Veh_SetDrvSeatVentilationRespStruct.Veh_SetDrvSeatVentilationNRC 0"); // 预期结果 TC_CANTest SOA check Veh_SetDrvSeatVentilationRespStruct.Veh_SetDrvSeatVentilationNRC 0
  g_EM_SOAClient_Swc_SOA_CHECK("Veh_SeatCtrlService_ErrStruct.OpeNRC 0 traceback7"); // 预期结果 TC_CANTest SOA check Veh_SeatCtrlService_ErrStruct.OpeNRC 0 traceback7
  g_EM_Equipment_Swc_TC_IG("ON"); // 测试步骤 TC_IG ON
  g_EM_Equipment_Swc_TC_4G_Time_Delay_Second("2"); // 测试步骤 TC_Sleep 2
}

testcase SYS_CDCU_guanbizhujiazuoyitongfeng_0117()
{
  TestDescription("主驾座椅通风-13");
  teststep("warning","原始用例id为SYS-CDCU-关闭主驾座椅通风-0117");
  g_EM_Equipment_Swc_TC_IG("OFF"); // 测试步骤 TC_IG OFF
  g_CAN_Bus_Swc_Set("I_LDCU_BodySysSt1.I_LDCU_PowerMode 1"); // 测试步骤 TC_CANTest SET I_LDCU_BodySysSt1.I_LDCU_PowerMode 1
  g_EM_Equipment_Swc_TC_4G_Time_Delay_Second("1"); // 测试步骤 TC_Sleep 1
  g_CAN_Bus_Swc_Set("I_LDCU_BodySysSt1.I_LDCU_PowerMode 2"); // 测试步骤 TC_CANTest SET I_LDCU_BodySysSt1.I_LDCU_PowerMode 2
  g_CAN_Bus_Swc_Set("I_LDCU_NM.I_LDCU_NMRepeatMsgReqBit 1"); // 测试步骤 TC_CANTest SET I_LDCU_NM.I_LDCU_NMRepeatMsgReqBit 1 //网络唤醒维持帧
  g_CAN_Bus_Swc_Set("C_LDCU_SysSt.C_LDCU_EVSysReadySt 2"); // 测试步骤 TC_CANTest SET C_LDCU_SysSt.C_LDCU_EVSysReadySt 2//HV ON
  gTC_CANTest_SOA_CheckReq_Prepare("SetDrvSeatVentilationStruct.DrvSeatVentilationReq 1&ServiceExecuteFeedbackFlag 2"); // 预期结果 TC_CANTest SOA CheckReq SetDrvSeatVentilationStruct.DrvSeatVentilationReq 1&ServiceExecuteFeedbackFlag 2
  g_EM_SOAClient_Swc_SOA_CHECK_Prepare("Veh_SetDrvSeatVentilationRespStruct.Veh_SetDrvSeatVentilationNRC 0"); // 预期结果 TC_CANTest SOA check Veh_SetDrvSeatVentilationRespStruct.Veh_SetDrvSeatVentilationNRC 0
  g_EM_SOAClient_Swc_SOA_CHECK_Prepare("Veh_SeatCtrlService_ErrStruct.OpeNRC 0 traceback7"); // 预期结果 TC_CANTest SOA check Veh_SeatCtrlService_ErrStruct.OpeNRC 0 traceback7
  g_EM_SOAClient_Swc_SOA_REQ("Veh_SetDrvSeatVentilationStruct.Veh_DrvSeatVentilationReq:1&ServiceExecuteFeedbackFlag:2"); // 测试步骤 TC_CANTest SOA REQ Veh_SetDrvSeatVentilationStruct.Veh_DrvSeatVentilationReq:1&ServiceExecuteFeedbackFlag:2
  gTC_CANTest_SOA_CheckReq("SetDrvSeatVentilationStruct.DrvSeatVentilationReq 1&ServiceExecuteFeedbackFlag 2"); // 预期结果 TC_CANTest SOA CheckReq SetDrvSeatVentilationStruct.DrvSeatVentilationReq 1&ServiceExecuteFeedbackFlag 2
  g_EM_SOAClient_Swc_SOA_CHECK("Veh_SetDrvSeatVentilationRespStruct.Veh_SetDrvSeatVentilationNRC 0"); // 预期结果 TC_CANTest SOA check Veh_SetDrvSeatVentilationRespStruct.Veh_SetDrvSeatVentilationNRC 0
  g_EM_SOAClient_Swc_SOA_CHECK("Veh_SeatCtrlService_ErrStruct.OpeNRC 0 traceback7"); // 预期结果 TC_CANTest SOA check Veh_SeatCtrlService_ErrStruct.OpeNRC 0 traceback7
  g_EM_Equipment_Swc_TC_IG("ON"); // 测试步骤 TC_IG ON
  g_EM_Equipment_Swc_TC_4G_Time_Delay_Second("2"); // 测试步骤 TC_Sleep 2
}

testcase SYS_CDCU_guanbizhujiazuoyitongfeng_0118()
{
  TestDescription("主驾座椅通风-14");
  teststep("warning","原始用例id为SYS-CDCU-关闭主驾座椅通风-0118");
  gTC_CANTest_SOA_CheckReq_Prepare("SetDrvSeatVentilationStruct.DrvSeatVentilationReq 2&ServiceExecuteFeedbackFlag 2"); // 预期结果 TC_CANTest SOA CheckReq SetDrvSeatVentilationStruct.DrvSeatVentilationReq 2&ServiceExecuteFeedbackFlag 2
  g_EM_SOAClient_Swc_SOA_CHECK_Prepare("Veh_SeatCtrlService_ErrStruct.OpeNRC 0 traceback7"); // 预期结果 TC_CANTest SOA check Veh_SeatCtrlService_ErrStruct.OpeNRC 0 traceback7
  g_EM_SOAClient_Swc_SOA_REQ("Veh_SetDrvSeatVentilationStruct.Veh_DrvSeatVentilationReq:2&ServiceExecuteFeedbackFlag:2"); // 测试步骤 TC_CANTest SOA REQ Veh_SetDrvSeatVentilationStruct.Veh_DrvSeatVentilationReq:2&ServiceExecuteFeedbackFlag:2
  gTC_CANTest_SOA_CheckReq("SetDrvSeatVentilationStruct.DrvSeatVentilationReq 2&ServiceExecuteFeedbackFlag 2"); // 预期结果 TC_CANTest SOA CheckReq SetDrvSeatVentilationStruct.DrvSeatVentilationReq 2&ServiceExecuteFeedbackFlag 2
  g_EM_SOAClient_Swc_SOA_CHECK("Veh_SeatCtrlService_ErrStruct.OpeNRC 0 traceback7"); // 预期结果 TC_CANTest SOA check Veh_SeatCtrlService_ErrStruct.OpeNRC 0 traceback7
}

testcase SYS_CDCU_guanbizhujiazuoyitongfeng_0119()
{
  TestDescription("主驾座椅通风-15");
  teststep("warning","原始用例id为SYS-CDCU-关闭主驾座椅通风-0119");
  gTC_CANTest_SOA_CheckReq_Prepare("SetDrvSeatVentilationStruct.DrvSeatVentilationReq 3&ServiceExecuteFeedbackFlag 2"); // 预期结果 TC_CANTest SOA CheckReq SetDrvSeatVentilationStruct.DrvSeatVentilationReq 3&ServiceExecuteFeedbackFlag 2
  g_EM_SOAClient_Swc_SOA_CHECK_Prepare("Veh_SeatCtrlService_ErrStruct.OpeNRC 0 traceback7"); // 预期结果 TC_CANTest SOA check Veh_SeatCtrlService_ErrStruct.OpeNRC 0 traceback7
  g_EM_SOAClient_Swc_SOA_REQ("Veh_SetDrvSeatVentilationStruct.Veh_DrvSeatVentilationReq:3&ServiceExecuteFeedbackFlag:2"); // 测试步骤 TC_CANTest SOA REQ Veh_SetDrvSeatVentilationStruct.Veh_DrvSeatVentilationReq:3&ServiceExecuteFeedbackFlag:2
  gTC_CANTest_SOA_CheckReq("SetDrvSeatVentilationStruct.DrvSeatVentilationReq 3&ServiceExecuteFeedbackFlag 2"); // 预期结果 TC_CANTest SOA CheckReq SetDrvSeatVentilationStruct.DrvSeatVentilationReq 3&ServiceExecuteFeedbackFlag 2
  g_EM_SOAClient_Swc_SOA_CHECK("Veh_SeatCtrlService_ErrStruct.OpeNRC 0 traceback7"); // 预期结果 TC_CANTest SOA check Veh_SeatCtrlService_ErrStruct.OpeNRC 0 traceback7
  g_EM_Equipment_Swc_TC_4G_Time_Delay_Second("5"); // 测试步骤 TC_Sleep 5
}

testcase SYS_CDCU_guanbizhujiazuoyitongfeng_0120()
{
  TestDescription("主驾座椅通风-16");
  teststep("warning","原始用例id为SYS-CDCU-关闭主驾座椅通风-0120");
  g_CAN_Bus_Swc_Set("C_LDCU_SysSt.C_LDCU_EVSysReadySt 0"); // 测试步骤 TC_CANTest SET C_LDCU_SysSt.C_LDCU_EVSysReadySt 0
  gTC_CANTest_SOA_CheckReq_Prepare("SetDrvSeatVentilationStruct.DrvSeatVentilationReq 4&ServiceExecuteFeedbackFlag 2"); // 预期结果 TC_CANTest SOA CheckReq SetDrvSeatVentilationStruct.DrvSeatVentilationReq 4&ServiceExecuteFeedbackFlag 2
  g_EM_SOAClient_Swc_SOA_CHECK_Prepare("Veh_SeatCtrlService_ErrStruct.OpeNRC 0 traceback7"); // 预期结果 TC_CANTest SOA check Veh_SeatCtrlService_ErrStruct.OpeNRC 0 traceback7
  g_EM_SOAClient_Swc_SOA_REQ("Veh_SetDrvSeatVentilationStruct.Veh_DrvSeatVentilationReq:4&ServiceExecuteFeedbackFlag:2"); // 测试步骤 TC_CANTest SOA REQ Veh_SetDrvSeatVentilationStruct.Veh_DrvSeatVentilationReq:4&ServiceExecuteFeedbackFlag:2
  gTC_CANTest_SOA_CheckReq("SetDrvSeatVentilationStruct.DrvSeatVentilationReq 4&ServiceExecuteFeedbackFlag 2"); // 预期结果 TC_CANTest SOA CheckReq SetDrvSeatVentilationStruct.DrvSeatVentilationReq 4&ServiceExecuteFeedbackFlag 2
  g_EM_SOAClient_Swc_SOA_CHECK("Veh_SeatCtrlService_ErrStruct.OpeNRC 0 traceback7"); // 预期结果 TC_CANTest SOA check Veh_SeatCtrlService_ErrStruct.OpeNRC 0 traceback7
}

testcase SYS_CDCU_guanbifujiazuoyitongfeng_0121()
{
  TestDescription("副驾座椅通风-1");
  teststep("warning","原始用例id为SYS-CDCU-关闭副驾座椅通风-0121");
  g_EM_Equipment_Swc_TC_PW("ON"); // 测试步骤 TC_PW ON
  g_EM_Equipment_Swc_TC_IG("OFF"); // 测试步骤 TC_IG OFF
  g_CAN_Bus_Swc_Set("I_LDCU_BodySysSt1.I_LDCU_PowerMode 1"); // 测试步骤 TC_CANTest SET I_LDCU_BodySysSt1.I_LDCU_PowerMode 1
  g_EM_Equipment_Swc_TC_4G_Time_Delay_Second("1"); // 测试步骤 TC_Sleep 1
  g_CAN_Bus_Swc_Set("I_LDCU_BodySysSt1.I_LDCU_PowerMode 0"); // 测试步骤 TC_CANTest SET I_LDCU_BodySysSt1.I_LDCU_PowerMode 0
  g_CAN_Bus_Swc_Set("I_LDCU_NM.I_LDCU_NMRepeatMsgReqBit 1"); // 测试步骤 TC_CANTest SET I_LDCU_NM.I_LDCU_NMRepeatMsgReqBit 1 //网络唤醒维持帧
  g_CAN_Bus_Swc_Set("C_LDCU_SysSt.C_LDCU_EVSysReadySt 0"); // 测试步骤 TC_CANTest SET C_LDCU_SysSt.C_LDCU_EVSysReadySt 0//Not ready
  gTC_CANTest_SOA_CheckReq_Prepare("HighVoltageCtrlStruct.HighVoltageCtrl 2"); // 预期结果 TC_CANTest SOA CheckReq HighVoltageCtrlStruct.HighVoltageCtrl 2
  g_EM_SOAClient_Swc_SOA_CHECK_Prepare("Veh_SeatCtrlService_ErrStruct.OpeNRC 0 traceback7"); // 预期结果 TC_CANTest SOA check Veh_SeatCtrlService_ErrStruct.OpeNRC 0 traceback7
  g_EM_SOAClient_Swc_SOA_REQ("Veh_SetPsngrSeatVentilationStruct.Veh_PsngrSeatVentilationReq:1&ServiceExecuteFeedbackFlag:2&UserID:0x01010001"); // 测试步骤 TC_CANTest SOA REQ Veh_SetPsngrSeatVentilationStruct.Veh_PsngrSeatVentilationReq:1&ServiceExecuteFeedbackFlag:2&UserID:0x01010001
  gTC_CANTest_SOA_CheckReq("HighVoltageCtrlStruct.HighVoltageCtrl 2"); // 预期结果 TC_CANTest SOA CheckReq HighVoltageCtrlStruct.HighVoltageCtrl 2
  gTC_CANTest_SOA_CheckReq_Prepare("SetPsngrSeatVentilationStruct.PsngrSeatVentilationReq 1&ServiceExecuteFeedbackFlag 2"); // 预期结果 TC_CANTest SOA CheckReq SetPsngrSeatVentilationStruct.PsngrSeatVentilationReq 1&ServiceExecuteFeedbackFlag 2
  g_EM_SOAClient_Swc_SOA_CHECK_Prepare("SOAEngineInterSignalStruct.SeatVentilationHVReq 1"); // 预期结果 TC_CANTest SOA Check SOAEngineInterSignalStruct.SeatVentilationHVReq 1
  g_EM_SOAClient_Swc_SOA_CHECK_Prepare("Veh_SetPsngrSeatVentilationRespStruct.Veh_SetPsngrSeatVentilationNRC 0"); // 预期结果 TC_CANTest SOA check Veh_SetPsngrSeatVentilationRespStruct.Veh_SetPsngrSeatVentilationNRC 0
  g_CAN_Bus_Swc_Set("C_LDCU_SysSt.C_LDCU_EVSysReadySt 2"); // 测试步骤 TC_CANTest SET C_LDCU_SysSt.C_LDCU_EVSysReadySt 2//Not ready
  gTC_CANTest_SOA_CheckReq("SetPsngrSeatVentilationStruct.PsngrSeatVentilationReq 1&ServiceExecuteFeedbackFlag 2"); // 预期结果 TC_CANTest SOA CheckReq SetPsngrSeatVentilationStruct.PsngrSeatVentilationReq 1&ServiceExecuteFeedbackFlag 2
  g_EM_SOAClient_Swc_SOA_CHECK("SOAEngineInterSignalStruct.SeatVentilationHVReq 1"); // 预期结果 TC_CANTest SOA Check SOAEngineInterSignalStruct.SeatVentilationHVReq 1
  g_EM_SOAClient_Swc_SOA_CHECK("Veh_SetPsngrSeatVentilationRespStruct.Veh_SetPsngrSeatVentilationNRC 0"); // 预期结果 TC_CANTest SOA check Veh_SetPsngrSeatVentilationRespStruct.Veh_SetPsngrSeatVentilationNRC 0
  g_EM_SOAClient_Swc_SOA_CHECK("Veh_SeatCtrlService_ErrStruct.OpeNRC 0 traceback7"); // 预期结果 TC_CANTest SOA check Veh_SeatCtrlService_ErrStruct.OpeNRC 0 traceback7
  g_EM_Equipment_Swc_TC_IG("ON"); // 测试步骤 TC_IG ON
  g_EM_SOAClient_Swc_SOA_CHECK_Prepare("SOAEngineInterSignalStruct.SeatVentilationHVReq 0"); // 预期结果 TC_CANTest SOA Check SOAEngineInterSignalStruct.SeatVentilationHVReq 0
  g_CAN_Bus_Swc_Set("I_LDCU_BodySysSt1.I_LDCU_PowerMode 1"); // 测试步骤 TC_CANTest SET I_LDCU_BodySysSt1.I_LDCU_PowerMode 1
  g_EM_SOAClient_Swc_SOA_CHECK("SOAEngineInterSignalStruct.SeatVentilationHVReq 0"); // 预期结果 TC_CANTest SOA Check SOAEngineInterSignalStruct.SeatVentilationHVReq 0
  g_EM_Equipment_Swc_TC_4G_Time_Delay_Second("2"); // 测试步骤 TC_Sleep 2
}

testcase SYS_CDCU_guanbifujiazuoyitongfeng_0122()
{
  TestDescription("副驾座椅通风-2");
  teststep("warning","原始用例id为SYS-CDCU-关闭副驾座椅通风-0122");
  g_EM_Equipment_Swc_TC_IG("OFF"); // 测试步骤 TC_IG OFF
  g_CAN_Bus_Swc_Set("I_LDCU_BodySysSt1.I_LDCU_PowerMode 1"); // 测试步骤 TC_CANTest SET I_LDCU_BodySysSt1.I_LDCU_PowerMode 1
  g_EM_Equipment_Swc_TC_4G_Time_Delay_Second("1"); // 测试步骤 TC_Sleep 1
  g_CAN_Bus_Swc_Set("I_LDCU_BodySysSt1.I_LDCU_PowerMode 0"); // 测试步骤 TC_CANTest SET I_LDCU_BodySysSt1.I_LDCU_PowerMode 0
  g_CAN_Bus_Swc_Set("I_LDCU_NM.I_LDCU_NMRepeatMsgReqBit 1"); // 测试步骤 TC_CANTest SET I_LDCU_NM.I_LDCU_NMRepeatMsgReqBit 1 //网络唤醒维持帧
  g_CAN_Bus_Swc_Set("C_LDCU_SysSt.C_LDCU_EVSysReadySt 1"); // 测试步骤 TC_CANTest SET C_LDCU_SysSt.C_LDCU_EVSysReadySt 1//HV ON
  g_EM_SOAClient_Swc_SOA_CHECK_Prepare("Veh_SeatCtrlService_ErrStruct.OpeNRC 0 traceback7"); // 预期结果 TC_CANTest SOA check Veh_SeatCtrlService_ErrStruct.OpeNRC 0 traceback7
  g_EM_SOAClient_Swc_SOA_REQ("Veh_SetPsngrSeatVentilationStruct.Veh_PsngrSeatVentilationReq:1&ServiceExecuteFeedbackFlag:2&UserID:0x01010001"); // 测试步骤 TC_CANTest SOA REQ Veh_SetPsngrSeatVentilationStruct.Veh_PsngrSeatVentilationReq:1&ServiceExecuteFeedbackFlag:2&UserID:0x01010001
  gTC_CANTest_SOA_CheckReq_Prepare("SetPsngrSeatVentilationStruct.PsngrSeatVentilationReq 1&ServiceExecuteFeedbackFlag 2"); // 预期结果 TC_CANTest SOA CheckReq SetPsngrSeatVentilationStruct.PsngrSeatVentilationReq 1&ServiceExecuteFeedbackFlag 2
  g_EM_SOAClient_Swc_SOA_CHECK_Prepare("Veh_SetPsngrSeatVentilationRespStruct.Veh_SetPsngrSeatVentilationNRC 0"); // 预期结果 TC_CANTest SOA check Veh_SetPsngrSeatVentilationRespStruct.Veh_SetPsngrSeatVentilationNRC 0
  g_CAN_Bus_Swc_Set("C_LDCU_SysSt.C_LDCU_EVSysReadySt 2"); // 测试步骤 TC_CANTest SET C_LDCU_SysSt.C_LDCU_EVSysReadySt 2//Not ready
  gTC_CANTest_SOA_CheckReq("SetPsngrSeatVentilationStruct.PsngrSeatVentilationReq 1&ServiceExecuteFeedbackFlag 2"); // 预期结果 TC_CANTest SOA CheckReq SetPsngrSeatVentilationStruct.PsngrSeatVentilationReq 1&ServiceExecuteFeedbackFlag 2
  g_EM_SOAClient_Swc_SOA_CHECK("Veh_SetPsngrSeatVentilationRespStruct.Veh_SetPsngrSeatVentilationNRC 0"); // 预期结果 TC_CANTest SOA check Veh_SetPsngrSeatVentilationRespStruct.Veh_SetPsngrSeatVentilationNRC 0
  g_EM_Equipment_Swc_TC_IG("ON"); // 测试步骤 TC_IG ON
  g_EM_SOAClient_Swc_SOA_CHECK("Veh_SeatCtrlService_ErrStruct.OpeNRC 0 traceback7"); // 预期结果 TC_CANTest SOA check Veh_SeatCtrlService_ErrStruct.OpeNRC 0 traceback7
  g_EM_Equipment_Swc_TC_4G_Time_Delay_Second("2"); // 测试步骤 TC_Sleep 2
}

testcase SYS_CDCU_guanbifujiazuoyitongfeng_0123()
{
  TestDescription("副驾座椅通风-3");
  teststep("warning","原始用例id为SYS-CDCU-关闭副驾座椅通风-0123");
  g_EM_Equipment_Swc_TC_IG("OFF"); // 测试步骤 TC_IG OFF
  g_CAN_Bus_Swc_Set("I_LDCU_BodySysSt1.I_LDCU_PowerMode 1"); // 测试步骤 TC_CANTest SET I_LDCU_BodySysSt1.I_LDCU_PowerMode 1
  g_EM_Equipment_Swc_TC_4G_Time_Delay_Second("1"); // 测试步骤 TC_Sleep 1
  g_CAN_Bus_Swc_Set("I_LDCU_BodySysSt1.I_LDCU_PowerMode 0"); // 测试步骤 TC_CANTest SET I_LDCU_BodySysSt1.I_LDCU_PowerMode 0
  g_CAN_Bus_Swc_Set("I_LDCU_NM.I_LDCU_NMRepeatMsgReqBit 1"); // 测试步骤 TC_CANTest SET I_LDCU_NM.I_LDCU_NMRepeatMsgReqBit 1 //网络唤醒维持帧
  g_CAN_Bus_Swc_Set("C_LDCU_SysSt.C_LDCU_EVSysReadySt 2"); // 测试步骤 TC_CANTest SET C_LDCU_SysSt.C_LDCU_EVSysReadySt 2//HV ON
  g_EM_SOAClient_Swc_SOA_CHECK_Prepare("Veh_SeatCtrlService_ErrStruct.OpeNRC 0 traceback7"); // 预期结果 TC_CANTest SOA check Veh_SeatCtrlService_ErrStruct.OpeNRC 0 traceback7
  g_EM_SOAClient_Swc_SOA_REQ("Veh_SetPsngrSeatVentilationStruct.Veh_PsngrSeatVentilationReq:1&ServiceExecuteFeedbackFlag:2&UserID:0x01010001"); // 测试步骤 TC_CANTest SOA REQ Veh_SetPsngrSeatVentilationStruct.Veh_PsngrSeatVentilationReq:1&ServiceExecuteFeedbackFlag:2&UserID:0x01010001
  gTC_CANTest_SOA_CheckReq_Prepare("SetPsngrSeatVentilationStruct.PsngrSeatVentilationReq 1&ServiceExecuteFeedbackFlag 2"); // 预期结果 TC_CANTest SOA CheckReq SetPsngrSeatVentilationStruct.PsngrSeatVentilationReq 1&ServiceExecuteFeedbackFlag 2
  g_EM_SOAClient_Swc_SOA_CHECK_Prepare("Veh_SetPsngrSeatVentilationRespStruct.Veh_SetPsngrSeatVentilationNRC 0"); // 预期结果 TC_CANTest SOA check Veh_SetPsngrSeatVentilationRespStruct.Veh_SetPsngrSeatVentilationNRC 0
  g_CAN_Bus_Swc_Set("C_LDCU_SysSt.C_LDCU_EVSysReadySt 2"); // 测试步骤 TC_CANTest SET C_LDCU_SysSt.C_LDCU_EVSysReadySt 2//Not ready
  gTC_CANTest_SOA_CheckReq("SetPsngrSeatVentilationStruct.PsngrSeatVentilationReq 1&ServiceExecuteFeedbackFlag 2"); // 预期结果 TC_CANTest SOA CheckReq SetPsngrSeatVentilationStruct.PsngrSeatVentilationReq 1&ServiceExecuteFeedbackFlag 2
  g_EM_SOAClient_Swc_SOA_CHECK("Veh_SetPsngrSeatVentilationRespStruct.Veh_SetPsngrSeatVentilationNRC 0"); // 预期结果 TC_CANTest SOA check Veh_SetPsngrSeatVentilationRespStruct.Veh_SetPsngrSeatVentilationNRC 0
  g_EM_Equipment_Swc_TC_IG("ON"); // 测试步骤 TC_IG ON
  g_EM_SOAClient_Swc_SOA_CHECK("Veh_SeatCtrlService_ErrStruct.OpeNRC 0 traceback7"); // 预期结果 TC_CANTest SOA check Veh_SeatCtrlService_ErrStruct.OpeNRC 0 traceback7
  g_EM_Equipment_Swc_TC_4G_Time_Delay_Second("2"); // 测试步骤 TC_Sleep 2
}

testcase SYS_CDCU_guanbifujiazuoyitongfeng_0124()
{
  TestDescription("副驾座椅通风-5");
  teststep("warning","原始用例id为SYS-CDCU-关闭副驾座椅通风-0124");
  g_CAN_Bus_Swc_Set("I_LDCU_BodySysSt1.I_LDCU_PowerMode 1"); // 测试步骤 TC_CANTest SET I_LDCU_BodySysSt1.I_LDCU_PowerMode 1
  g_CAN_Bus_Swc_Set("I_LDCU_NM.I_LDCU_NMRepeatMsgReqBit 1"); // 测试步骤 TC_CANTest SET I_LDCU_NM.I_LDCU_NMRepeatMsgReqBit 1 //网络唤醒维持帧
  g_CAN_Bus_Swc_Set("C_LDCU_SysSt.C_LDCU_EVSysReadySt 1"); // 测试步骤 TC_CANTest SET C_LDCU_SysSt.C_LDCU_EVSysReadySt 1//Not ready
  gTC_CANTest_SOA_CheckReq_Prepare("SetPsngrSeatVentilationStruct.PsngrSeatVentilationReq 1&ServiceExecuteFeedbackFlag 2"); // 预期结果 TC_CANTest SOA CheckReq SetPsngrSeatVentilationStruct.PsngrSeatVentilationReq 1&ServiceExecuteFeedbackFlag 2
  g_EM_SOAClient_Swc_SOA_CHECK_Prepare("Veh_SeatCtrlService_ErrStruct.OpeNRC 0 traceback7"); // 预期结果 TC_CANTest SOA check Veh_SeatCtrlService_ErrStruct.OpeNRC 0 traceback7
  g_EM_SOAClient_Swc_SOA_REQ("Veh_SetPsngrSeatVentilationStruct.Veh_PsngrSeatVentilationReq:1&ServiceExecuteFeedbackFlag:2"); // 测试步骤 TC_CANTest SOA REQ Veh_SetPsngrSeatVentilationStruct.Veh_PsngrSeatVentilationReq:1&ServiceExecuteFeedbackFlag:2
  gTC_CANTest_SOA_CheckReq("SetPsngrSeatVentilationStruct.PsngrSeatVentilationReq 1&ServiceExecuteFeedbackFlag 2"); // 预期结果 TC_CANTest SOA CheckReq SetPsngrSeatVentilationStruct.PsngrSeatVentilationReq 1&ServiceExecuteFeedbackFlag 2
  g_EM_SOAClient_Swc_SOA_CHECK_Prepare("Veh_SetPsngrSeatVentilationRespStruct.Veh_SetPsngrSeatVentilationNRC 0"); // 预期结果 TC_CANTest SOA check Veh_SetPsngrSeatVentilationRespStruct.Veh_SetPsngrSeatVentilationNRC 0
  g_CAN_Bus_Swc_Set("C_LDCU_SysSt.C_LDCU_EVSysReadySt 2"); // 测试步骤 TC_CANTest SET C_LDCU_SysSt.C_LDCU_EVSysReadySt 2//Not ready
  g_EM_SOAClient_Swc_SOA_CHECK("Veh_SetPsngrSeatVentilationRespStruct.Veh_SetPsngrSeatVentilationNRC 0"); // 预期结果 TC_CANTest SOA check Veh_SetPsngrSeatVentilationRespStruct.Veh_SetPsngrSeatVentilationNRC 0
  g_EM_SOAClient_Swc_SOA_CHECK("Veh_SeatCtrlService_ErrStruct.OpeNRC 0 traceback7"); // 预期结果 TC_CANTest SOA check Veh_SeatCtrlService_ErrStruct.OpeNRC 0 traceback7
}

testcase SYS_CDCU_guanbifujiazuoyitongfeng_0125()
{
  TestDescription("副驾座椅通风-6");
  teststep("warning","原始用例id为SYS-CDCU-关闭副驾座椅通风-0125");
  g_CAN_Bus_Swc_Set("I_LDCU_BodySysSt1.I_LDCU_PowerMode 1"); // 测试步骤 TC_CANTest SET I_LDCU_BodySysSt1.I_LDCU_PowerMode 1
  g_CAN_Bus_Swc_Set("I_LDCU_NM.I_LDCU_NMRepeatMsgReqBit 1"); // 测试步骤 TC_CANTest SET I_LDCU_NM.I_LDCU_NMRepeatMsgReqBit 1 //网络唤醒维持帧
  g_CAN_Bus_Swc_Set("C_LDCU_SysSt.C_LDCU_EVSysReadySt 2"); // 测试步骤 TC_CANTest SET C_LDCU_SysSt.C_LDCU_EVSysReadySt 2//Not ready
  gTC_CANTest_SOA_CheckReq_Prepare("SetPsngrSeatVentilationStruct.PsngrSeatVentilationReq 1&ServiceExecuteFeedbackFlag 2"); // 预期结果 TC_CANTest SOA CheckReq SetPsngrSeatVentilationStruct.PsngrSeatVentilationReq 1&ServiceExecuteFeedbackFlag 2
  g_EM_SOAClient_Swc_SOA_CHECK_Prepare("Veh_SeatCtrlService_ErrStruct.OpeNRC 0 traceback7"); // 预期结果 TC_CANTest SOA check Veh_SeatCtrlService_ErrStruct.OpeNRC 0 traceback7
  g_EM_SOAClient_Swc_SOA_REQ("Veh_SetPsngrSeatVentilationStruct.Veh_PsngrSeatVentilationReq:1&ServiceExecuteFeedbackFlag:2"); // 测试步骤 TC_CANTest SOA REQ Veh_SetPsngrSeatVentilationStruct.Veh_PsngrSeatVentilationReq:1&ServiceExecuteFeedbackFlag:2
  gTC_CANTest_SOA_CheckReq("SetPsngrSeatVentilationStruct.PsngrSeatVentilationReq 1&ServiceExecuteFeedbackFlag 2"); // 预期结果 TC_CANTest SOA CheckReq SetPsngrSeatVentilationStruct.PsngrSeatVentilationReq 1&ServiceExecuteFeedbackFlag 2
  g_EM_SOAClient_Swc_SOA_CHECK_Prepare("Veh_SetPsngrSeatVentilationRespStruct.Veh_SetPsngrSeatVentilationNRC 0"); // 预期结果 TC_CANTest SOA check Veh_SetPsngrSeatVentilationRespStruct.Veh_SetPsngrSeatVentilationNRC 0
  g_CAN_Bus_Swc_Set("C_LDCU_SysSt.C_LDCU_EVSysReadySt 2"); // 测试步骤 TC_CANTest SET C_LDCU_SysSt.C_LDCU_EVSysReadySt 2//Not ready
  g_EM_SOAClient_Swc_SOA_CHECK("Veh_SetPsngrSeatVentilationRespStruct.Veh_SetPsngrSeatVentilationNRC 0"); // 预期结果 TC_CANTest SOA check Veh_SetPsngrSeatVentilationRespStruct.Veh_SetPsngrSeatVentilationNRC 0
  g_EM_SOAClient_Swc_SOA_CHECK("Veh_SeatCtrlService_ErrStruct.OpeNRC 0 traceback7"); // 预期结果 TC_CANTest SOA check Veh_SeatCtrlService_ErrStruct.OpeNRC 0 traceback7
}

testcase SYS_CDCU_guanbifujiazuoyitongfeng_0126()
{
  TestDescription("副驾座椅通风-7");
  teststep("warning","原始用例id为SYS-CDCU-关闭副驾座椅通风-0126");
  gTC_CANTest_SOA_CheckReq_Prepare("SetPsngrSeatVentilationStruct.PsngrSeatVentilationReq 2&ServiceExecuteFeedbackFlag 2"); // 预期结果 TC_CANTest SOA CheckReq SetPsngrSeatVentilationStruct.PsngrSeatVentilationReq 2&ServiceExecuteFeedbackFlag 2
  g_EM_SOAClient_Swc_SOA_CHECK_Prepare("Veh_SetPsngrSeatVentilationRespStruct.Veh_SetPsngrSeatVentilationNRC 0"); // 预期结果 TC_CANTest SOA check Veh_SetPsngrSeatVentilationRespStruct.Veh_SetPsngrSeatVentilationNRC 0
  g_EM_SOAClient_Swc_SOA_CHECK_Prepare("Veh_SeatCtrlService_ErrStruct.OpeNRC 0 traceback7"); // 预期结果 TC_CANTest SOA check Veh_SeatCtrlService_ErrStruct.OpeNRC 0 traceback7
  g_EM_SOAClient_Swc_SOA_REQ("Veh_SetPsngrSeatVentilationStruct.Veh_PsngrSeatVentilationReq:2&ServiceExecuteFeedbackFlag:2"); // 测试步骤 TC_CANTest SOA REQ Veh_SetPsngrSeatVentilationStruct.Veh_PsngrSeatVentilationReq:2&ServiceExecuteFeedbackFlag:2
  gTC_CANTest_SOA_CheckReq("SetPsngrSeatVentilationStruct.PsngrSeatVentilationReq 2&ServiceExecuteFeedbackFlag 2"); // 预期结果 TC_CANTest SOA CheckReq SetPsngrSeatVentilationStruct.PsngrSeatVentilationReq 2&ServiceExecuteFeedbackFlag 2
  g_EM_SOAClient_Swc_SOA_CHECK("Veh_SetPsngrSeatVentilationRespStruct.Veh_SetPsngrSeatVentilationNRC 0"); // 预期结果 TC_CANTest SOA check Veh_SetPsngrSeatVentilationRespStruct.Veh_SetPsngrSeatVentilationNRC 0
  g_EM_SOAClient_Swc_SOA_CHECK("Veh_SeatCtrlService_ErrStruct.OpeNRC 0 traceback7"); // 预期结果 TC_CANTest SOA check Veh_SeatCtrlService_ErrStruct.OpeNRC 0 traceback7
  g_EM_Equipment_Swc_TC_4G_Time_Delay_Second("5"); // 测试步骤 TC_Sleep 5
}

testcase SYS_CDCU_guanbifujiazuoyitongfeng_0127()
{
  TestDescription("副驾座椅通风-8");
  teststep("warning","原始用例id为SYS-CDCU-关闭副驾座椅通风-0127");
  gTC_CANTest_SOA_CheckReq_Prepare("SetPsngrSeatVentilationStruct.PsngrSeatVentilationReq 3&ServiceExecuteFeedbackFlag 2"); // 预期结果 TC_CANTest SOA CheckReq SetPsngrSeatVentilationStruct.PsngrSeatVentilationReq 3&ServiceExecuteFeedbackFlag 2
  g_EM_SOAClient_Swc_SOA_CHECK_Prepare("Veh_SetPsngrSeatVentilationRespStruct.Veh_SetPsngrSeatVentilationNRC 0"); // 预期结果 TC_CANTest SOA check Veh_SetPsngrSeatVentilationRespStruct.Veh_SetPsngrSeatVentilationNRC 0
  g_EM_SOAClient_Swc_SOA_CHECK_Prepare("Veh_SeatCtrlService_ErrStruct.OpeNRC 0 traceback7"); // 预期结果 TC_CANTest SOA check Veh_SeatCtrlService_ErrStruct.OpeNRC 0 traceback7
  g_EM_SOAClient_Swc_SOA_REQ("Veh_SetPsngrSeatVentilationStruct.Veh_PsngrSeatVentilationReq:3&ServiceExecuteFeedbackFlag:2"); // 测试步骤 TC_CANTest SOA REQ Veh_SetPsngrSeatVentilationStruct.Veh_PsngrSeatVentilationReq:3&ServiceExecuteFeedbackFlag:2
  gTC_CANTest_SOA_CheckReq("SetPsngrSeatVentilationStruct.PsngrSeatVentilationReq 3&ServiceExecuteFeedbackFlag 2"); // 预期结果 TC_CANTest SOA CheckReq SetPsngrSeatVentilationStruct.PsngrSeatVentilationReq 3&ServiceExecuteFeedbackFlag 2
  g_EM_SOAClient_Swc_SOA_CHECK("Veh_SetPsngrSeatVentilationRespStruct.Veh_SetPsngrSeatVentilationNRC 0"); // 预期结果 TC_CANTest SOA check Veh_SetPsngrSeatVentilationRespStruct.Veh_SetPsngrSeatVentilationNRC 0
  g_EM_SOAClient_Swc_SOA_CHECK("Veh_SeatCtrlService_ErrStruct.OpeNRC 0 traceback7"); // 预期结果 TC_CANTest SOA check Veh_SeatCtrlService_ErrStruct.OpeNRC 0 traceback7
  g_EM_Equipment_Swc_TC_4G_Time_Delay_Second("5"); // 测试步骤 TC_Sleep 5
}

testcase SYS_CDCU_guanbifujiazuoyitongfeng_0128()
{
  TestDescription("副驾座椅通风-9");
  teststep("warning","原始用例id为SYS-CDCU-关闭副驾座椅通风-0128");
  g_CAN_Bus_Swc_Set("C_LDCU_SysSt.C_LDCU_EVSysReadySt 0"); // 测试步骤 TC_CANTest SET C_LDCU_SysSt.C_LDCU_EVSysReadySt 0
  gTC_CANTest_SOA_CheckReq_Prepare("SetPsngrSeatVentilationStruct.PsngrSeatVentilationReq 4&ServiceExecuteFeedbackFlag 2"); // 预期结果 TC_CANTest SOA CheckReq SetPsngrSeatVentilationStruct.PsngrSeatVentilationReq 4&ServiceExecuteFeedbackFlag 2
  g_EM_SOAClient_Swc_SOA_CHECK_Prepare("Veh_SetPsngrSeatVentilationRespStruct.Veh_SetPsngrSeatVentilationNRC 0"); // 预期结果 TC_CANTest SOA check Veh_SetPsngrSeatVentilationRespStruct.Veh_SetPsngrSeatVentilationNRC 0
  g_EM_SOAClient_Swc_SOA_CHECK_Prepare("Veh_SeatCtrlService_ErrStruct.OpeNRC 0 traceback7"); // 预期结果 TC_CANTest SOA check Veh_SeatCtrlService_ErrStruct.OpeNRC 0 traceback7
  g_EM_SOAClient_Swc_SOA_REQ("Veh_SetPsngrSeatVentilationStruct.Veh_PsngrSeatVentilationReq:4&ServiceExecuteFeedbackFlag:2"); // 测试步骤 TC_CANTest SOA REQ Veh_SetPsngrSeatVentilationStruct.Veh_PsngrSeatVentilationReq:4&ServiceExecuteFeedbackFlag:2
  gTC_CANTest_SOA_CheckReq("SetPsngrSeatVentilationStruct.PsngrSeatVentilationReq 4&ServiceExecuteFeedbackFlag 2"); // 预期结果 TC_CANTest SOA CheckReq SetPsngrSeatVentilationStruct.PsngrSeatVentilationReq 4&ServiceExecuteFeedbackFlag 2
  g_EM_SOAClient_Swc_SOA_CHECK("Veh_SetPsngrSeatVentilationRespStruct.Veh_SetPsngrSeatVentilationNRC 0"); // 预期结果 TC_CANTest SOA check Veh_SetPsngrSeatVentilationRespStruct.Veh_SetPsngrSeatVentilationNRC 0
  g_EM_SOAClient_Swc_SOA_CHECK("Veh_SeatCtrlService_ErrStruct.OpeNRC 0 traceback7"); // 预期结果 TC_CANTest SOA check Veh_SeatCtrlService_ErrStruct.OpeNRC 0 traceback7
}

testcase SYS_CDCU_guanbifujiazuoyitongfeng_0129()
{
  TestDescription("副驾座椅通风-10");
  teststep("warning","原始用例id为SYS-CDCU-关闭副驾座椅通风-0129");
  g_CAN_Bus_Swc_Set("I_LDCU_BodySysSt1.I_LDCU_PowerMode 1"); // 测试步骤 TC_CANTest SET I_LDCU_BodySysSt1.I_LDCU_PowerMode 1
  g_EM_Equipment_Swc_TC_4G_Time_Delay_Second("1"); // 测试步骤 TC_Sleep 1
  g_CAN_Bus_Swc_Set("I_LDCU_BodySysSt1.I_LDCU_PowerMode 2"); // 测试步骤 TC_CANTest SET I_LDCU_BodySysSt1.I_LDCU_PowerMode 2
  g_CAN_Bus_Swc_Set("I_LDCU_NM.I_LDCU_NMRepeatMsgReqBit 1"); // 测试步骤 TC_CANTest SET I_LDCU_NM.I_LDCU_NMRepeatMsgReqBit 1 //网络唤醒维持帧
  g_CAN_Bus_Swc_Set("C_LDCU_SysSt.C_LDCU_EVSysReadySt 0"); // 测试步骤 TC_CANTest SET C_LDCU_SysSt.C_LDCU_EVSysReadySt 0//Not ready
  gTC_CANTest_SOA_CheckReq_Prepare("HighVoltageCtrlStruct.HighVoltageCtrl 2"); // 预期结果 TC_CANTest SOA CheckReq HighVoltageCtrlStruct.HighVoltageCtrl 2
  g_EM_SOAClient_Swc_SOA_CHECK_Prepare("Veh_SeatCtrlService_ErrStruct.OpeNRC 0 traceback7"); // 预期结果 TC_CANTest SOA check Veh_SeatCtrlService_ErrStruct.OpeNRC 0 traceback7
  g_EM_SOAClient_Swc_SOA_REQ("Veh_SetPsngrSeatVentilationStruct.Veh_PsngrSeatVentilationReq:1&ServiceExecuteFeedbackFlag:2&UserID:0x01010001"); // 测试步骤 TC_CANTest SOA REQ Veh_SetPsngrSeatVentilationStruct.Veh_PsngrSeatVentilationReq:1&ServiceExecuteFeedbackFlag:2&UserID:0x01010001
  gTC_CANTest_SOA_CheckReq("HighVoltageCtrlStruct.HighVoltageCtrl 2"); // 预期结果 TC_CANTest SOA CheckReq HighVoltageCtrlStruct.HighVoltageCtrl 2
  gTC_CANTest_SOA_CheckReq_Prepare("SetPsngrSeatVentilationStruct.PsngrSeatVentilationReq 1&ServiceExecuteFeedbackFlag 2"); // 预期结果 TC_CANTest SOA CheckReq SetPsngrSeatVentilationStruct.PsngrSeatVentilationReq 1&ServiceExecuteFeedbackFlag 2
  g_EM_SOAClient_Swc_SOA_CHECK_Prepare("Veh_SetPsngrSeatVentilationRespStruct.Veh_SetPsngrSeatVentilationNRC 0"); // 预期结果 TC_CANTest SOA check Veh_SetPsngrSeatVentilationRespStruct.Veh_SetPsngrSeatVentilationNRC 0
  g_CAN_Bus_Swc_Set("C_LDCU_SysSt.C_LDCU_EVSysReadySt 2"); // 测试步骤 TC_CANTest SET C_LDCU_SysSt.C_LDCU_EVSysReadySt 2//Not ready
  gTC_CANTest_SOA_CheckReq("SetPsngrSeatVentilationStruct.PsngrSeatVentilationReq 1&ServiceExecuteFeedbackFlag 2"); // 预期结果 TC_CANTest SOA CheckReq SetPsngrSeatVentilationStruct.PsngrSeatVentilationReq 1&ServiceExecuteFeedbackFlag 2
  g_EM_SOAClient_Swc_SOA_CHECK("Veh_SetPsngrSeatVentilationRespStruct.Veh_SetPsngrSeatVentilationNRC 0"); // 预期结果 TC_CANTest SOA check Veh_SetPsngrSeatVentilationRespStruct.Veh_SetPsngrSeatVentilationNRC 0
  g_EM_Equipment_Swc_TC_IG("ON"); // 测试步骤 TC_IG ON
  g_EM_SOAClient_Swc_SOA_CHECK("Veh_SeatCtrlService_ErrStruct.OpeNRC 0 traceback7"); // 预期结果 TC_CANTest SOA check Veh_SeatCtrlService_ErrStruct.OpeNRC 0 traceback7
}

testcase SYS_CDCU_guanbifujiazuoyitongfeng_0130()
{
  TestDescription("副驾座椅通风-11");
  teststep("warning","原始用例id为SYS-CDCU-关闭副驾座椅通风-0130");
  g_CAN_Bus_Swc_Set("I_LDCU_BodySysSt1.I_LDCU_PowerMode 1"); // 测试步骤 TC_CANTest SET I_LDCU_BodySysSt1.I_LDCU_PowerMode 1
  g_EM_Equipment_Swc_TC_4G_Time_Delay_Second("1"); // 测试步骤 TC_Sleep 1
  g_CAN_Bus_Swc_Set("I_LDCU_BodySysSt1.I_LDCU_PowerMode 2"); // 测试步骤 TC_CANTest SET I_LDCU_BodySysSt1.I_LDCU_PowerMode 2
  g_CAN_Bus_Swc_Set("I_LDCU_NM.I_LDCU_NMRepeatMsgReqBit 1"); // 测试步骤 TC_CANTest SET I_LDCU_NM.I_LDCU_NMRepeatMsgReqBit 1 //网络唤醒维持帧
  g_CAN_Bus_Swc_Set("C_LDCU_SysSt.C_LDCU_EVSysReadySt 1"); // 测试步骤 TC_CANTest SET C_LDCU_SysSt.C_LDCU_EVSysReadySt 1//HV ON
  gTC_CANTest_SOA_CheckReq_Prepare("SetPsngrSeatVentilationStruct.PsngrSeatVentilationReq 1&ServiceExecuteFeedbackFlag 2"); // 预期结果 TC_CANTest SOA CheckReq SetPsngrSeatVentilationStruct.PsngrSeatVentilationReq 1&ServiceExecuteFeedbackFlag 2
  g_EM_SOAClient_Swc_SOA_CHECK_Prepare("Veh_SeatCtrlService_ErrStruct.OpeNRC 0 traceback7"); // 预期结果 TC_CANTest SOA check Veh_SeatCtrlService_ErrStruct.OpeNRC 0 traceback7
  g_EM_SOAClient_Swc_SOA_REQ("Veh_SetPsngrSeatVentilationStruct.Veh_PsngrSeatVentilationReq:1&ServiceExecuteFeedbackFlag:2&UserID:0x01010001"); // 测试步骤 TC_CANTest SOA REQ Veh_SetPsngrSeatVentilationStruct.Veh_PsngrSeatVentilationReq:1&ServiceExecuteFeedbackFlag:2&UserID:0x01010001
  gTC_CANTest_SOA_CheckReq("SetPsngrSeatVentilationStruct.PsngrSeatVentilationReq 1&ServiceExecuteFeedbackFlag 2"); // 预期结果 TC_CANTest SOA CheckReq SetPsngrSeatVentilationStruct.PsngrSeatVentilationReq 1&ServiceExecuteFeedbackFlag 2
  g_EM_SOAClient_Swc_SOA_CHECK_Prepare("Veh_SetPsngrSeatVentilationRespStruct.Veh_SetPsngrSeatVentilationNRC 0"); // 预期结果 TC_CANTest SOA check Veh_SetPsngrSeatVentilationRespStruct.Veh_SetPsngrSeatVentilationNRC 0
  g_CAN_Bus_Swc_Set("C_LDCU_SysSt.C_LDCU_EVSysReadySt 2"); // 测试步骤 TC_CANTest SET C_LDCU_SysSt.C_LDCU_EVSysReadySt 2//Not ready
  g_EM_SOAClient_Swc_SOA_CHECK("Veh_SetPsngrSeatVentilationRespStruct.Veh_SetPsngrSeatVentilationNRC 0"); // 预期结果 TC_CANTest SOA check Veh_SetPsngrSeatVentilationRespStruct.Veh_SetPsngrSeatVentilationNRC 0
  g_EM_SOAClient_Swc_SOA_CHECK("Veh_SeatCtrlService_ErrStruct.OpeNRC 0 traceback7"); // 预期结果 TC_CANTest SOA check Veh_SeatCtrlService_ErrStruct.OpeNRC 0 traceback7
  g_EM_Equipment_Swc_TC_IG("ON"); // 测试步骤 TC_IG ON
}

testcase SYS_CDCU_guanbifujiazuoyitongfeng_0131()
{
  TestDescription("副驾座椅通风-12");
  teststep("warning","原始用例id为SYS-CDCU-关闭副驾座椅通风-0131");
  g_CAN_Bus_Swc_Set("I_LDCU_BodySysSt1.I_LDCU_PowerMode 1"); // 测试步骤 TC_CANTest SET I_LDCU_BodySysSt1.I_LDCU_PowerMode 1
  g_EM_Equipment_Swc_TC_4G_Time_Delay_Second("1"); // 测试步骤 TC_Sleep 1
  g_CAN_Bus_Swc_Set("I_LDCU_BodySysSt1.I_LDCU_PowerMode 2"); // 测试步骤 TC_CANTest SET I_LDCU_BodySysSt1.I_LDCU_PowerMode 2
  g_CAN_Bus_Swc_Set("I_LDCU_NM.I_LDCU_NMRepeatMsgReqBit 1"); // 测试步骤 TC_CANTest SET I_LDCU_NM.I_LDCU_NMRepeatMsgReqBit 1 //网络唤醒维持帧
  g_CAN_Bus_Swc_Set("C_LDCU_SysSt.C_LDCU_EVSysReadySt 2"); // 测试步骤 TC_CANTest SET C_LDCU_SysSt.C_LDCU_EVSysReadySt 2//HV ON
  gTC_CANTest_SOA_CheckReq_Prepare("SetPsngrSeatVentilationStruct.PsngrSeatVentilationReq 1&ServiceExecuteFeedbackFlag 2"); // 预期结果 TC_CANTest SOA CheckReq SetPsngrSeatVentilationStruct.PsngrSeatVentilationReq 1&ServiceExecuteFeedbackFlag 2
  g_EM_SOAClient_Swc_SOA_CHECK_Prepare("Veh_SetPsngrSeatVentilationRespStruct.Veh_SetPsngrSeatVentilationNRC 0"); // 预期结果 TC_CANTest SOA check Veh_SetPsngrSeatVentilationRespStruct.Veh_SetPsngrSeatVentilationNRC 0
  g_EM_SOAClient_Swc_SOA_CHECK_Prepare("Veh_SeatCtrlService_ErrStruct.OpeNRC 0 traceback7"); // 预期结果 TC_CANTest SOA check Veh_SeatCtrlService_ErrStruct.OpeNRC 0 traceback7
  g_EM_SOAClient_Swc_SOA_REQ("Veh_SetPsngrSeatVentilationStruct.Veh_PsngrSeatVentilationReq:1&ServiceExecuteFeedbackFlag:2&UserID:0x01010001"); // 测试步骤 TC_CANTest SOA REQ Veh_SetPsngrSeatVentilationStruct.Veh_PsngrSeatVentilationReq:1&ServiceExecuteFeedbackFlag:2&UserID:0x01010001
  gTC_CANTest_SOA_CheckReq("SetPsngrSeatVentilationStruct.PsngrSeatVentilationReq 1&ServiceExecuteFeedbackFlag 2"); // 预期结果 TC_CANTest SOA CheckReq SetPsngrSeatVentilationStruct.PsngrSeatVentilationReq 1&ServiceExecuteFeedbackFlag 2
  g_EM_SOAClient_Swc_SOA_CHECK("Veh_SetPsngrSeatVentilationRespStruct.Veh_SetPsngrSeatVentilationNRC 0"); // 预期结果 TC_CANTest SOA check Veh_SetPsngrSeatVentilationRespStruct.Veh_SetPsngrSeatVentilationNRC 0
  g_EM_Equipment_Swc_TC_IG("ON"); // 测试步骤 TC_IG ON
  g_EM_SOAClient_Swc_SOA_CHECK("Veh_SeatCtrlService_ErrStruct.OpeNRC 0 traceback7"); // 预期结果 TC_CANTest SOA check Veh_SeatCtrlService_ErrStruct.OpeNRC 0 traceback7
}

testcase SYS_CDCU_guanbifujiazuoyitongfeng_0132()
{
  TestDescription("副驾座椅通风-13");
  teststep("warning","原始用例id为SYS-CDCU-关闭副驾座椅通风-0132");
  gTC_CANTest_SOA_CheckReq_Prepare("SetPsngrSeatVentilationStruct.PsngrSeatVentilationReq 2&ServiceExecuteFeedbackFlag 2"); // 预期结果 TC_CANTest SOA CheckReq SetPsngrSeatVentilationStruct.PsngrSeatVentilationReq 2&ServiceExecuteFeedbackFlag 2
  g_EM_SOAClient_Swc_SOA_CHECK_Prepare("Veh_SetPsngrSeatVentilationRespStruct.Veh_SetPsngrSeatVentilationNRC 0"); // 预期结果 TC_CANTest SOA check Veh_SetPsngrSeatVentilationRespStruct.Veh_SetPsngrSeatVentilationNRC 0
  g_EM_SOAClient_Swc_SOA_CHECK_Prepare("Veh_SeatCtrlService_ErrStruct.OpeNRC 0 traceback7"); // 预期结果 TC_CANTest SOA check Veh_SeatCtrlService_ErrStruct.OpeNRC 0 traceback7
  g_EM_SOAClient_Swc_SOA_REQ("Veh_SetPsngrSeatVentilationStruct.Veh_PsngrSeatVentilationReq:2&ServiceExecuteFeedbackFlag:2"); // 测试步骤 TC_CANTest SOA REQ Veh_SetPsngrSeatVentilationStruct.Veh_PsngrSeatVentilationReq:2&ServiceExecuteFeedbackFlag:2
  gTC_CANTest_SOA_CheckReq("SetPsngrSeatVentilationStruct.PsngrSeatVentilationReq 2&ServiceExecuteFeedbackFlag 2"); // 预期结果 TC_CANTest SOA CheckReq SetPsngrSeatVentilationStruct.PsngrSeatVentilationReq 2&ServiceExecuteFeedbackFlag 2
  g_EM_SOAClient_Swc_SOA_CHECK("Veh_SetPsngrSeatVentilationRespStruct.Veh_SetPsngrSeatVentilationNRC 0"); // 预期结果 TC_CANTest SOA check Veh_SetPsngrSeatVentilationRespStruct.Veh_SetPsngrSeatVentilationNRC 0
  g_EM_SOAClient_Swc_SOA_CHECK("Veh_SeatCtrlService_ErrStruct.OpeNRC 0 traceback7"); // 预期结果 TC_CANTest SOA check Veh_SeatCtrlService_ErrStruct.OpeNRC 0 traceback7
  g_EM_Equipment_Swc_TC_4G_Time_Delay_Second("5"); // 测试步骤 TC_Sleep 5
}

testcase SYS_CDCU_guanbifujiazuoyitongfeng_0133()
{
  TestDescription("副驾座椅通风-14");
  teststep("warning","原始用例id为SYS-CDCU-关闭副驾座椅通风-0133");
  gTC_CANTest_SOA_CheckReq_Prepare("SetPsngrSeatVentilationStruct.PsngrSeatVentilationReq 3&ServiceExecuteFeedbackFlag 2"); // 预期结果 TC_CANTest SOA CheckReq SetPsngrSeatVentilationStruct.PsngrSeatVentilationReq 3&ServiceExecuteFeedbackFlag 2
  g_EM_SOAClient_Swc_SOA_CHECK_Prepare("Veh_SetPsngrSeatVentilationRespStruct.Veh_SetPsngrSeatVentilationNRC 0"); // 预期结果 TC_CANTest SOA check Veh_SetPsngrSeatVentilationRespStruct.Veh_SetPsngrSeatVentilationNRC 0
  g_EM_SOAClient_Swc_SOA_CHECK_Prepare("Veh_SeatCtrlService_ErrStruct.OpeNRC 0 traceback7"); // 预期结果 TC_CANTest SOA check Veh_SeatCtrlService_ErrStruct.OpeNRC 0 traceback7
  g_EM_SOAClient_Swc_SOA_REQ("Veh_SetPsngrSeatVentilationStruct.Veh_PsngrSeatVentilationReq:3&ServiceExecuteFeedbackFlag:2"); // 测试步骤 TC_CANTest SOA REQ Veh_SetPsngrSeatVentilationStruct.Veh_PsngrSeatVentilationReq:3&ServiceExecuteFeedbackFlag:2
  gTC_CANTest_SOA_CheckReq("SetPsngrSeatVentilationStruct.PsngrSeatVentilationReq 3&ServiceExecuteFeedbackFlag 2"); // 预期结果 TC_CANTest SOA CheckReq SetPsngrSeatVentilationStruct.PsngrSeatVentilationReq 3&ServiceExecuteFeedbackFlag 2
  g_EM_SOAClient_Swc_SOA_CHECK("Veh_SetPsngrSeatVentilationRespStruct.Veh_SetPsngrSeatVentilationNRC 0"); // 预期结果 TC_CANTest SOA check Veh_SetPsngrSeatVentilationRespStruct.Veh_SetPsngrSeatVentilationNRC 0
  g_EM_SOAClient_Swc_SOA_CHECK("Veh_SeatCtrlService_ErrStruct.OpeNRC 0 traceback7"); // 预期结果 TC_CANTest SOA check Veh_SeatCtrlService_ErrStruct.OpeNRC 0 traceback7
  g_EM_Equipment_Swc_TC_4G_Time_Delay_Second("5"); // 测试步骤 TC_Sleep 5
}

testcase SYS_CDCU_guanbifujiazuoyitongfeng_0134()
{
  TestDescription("副驾座椅通风-15");
  teststep("warning","原始用例id为SYS-CDCU-关闭副驾座椅通风-0134");
  g_CAN_Bus_Swc_Set("C_LDCU_SysSt.C_LDCU_EVSysReadySt 0"); // 测试步骤 TC_CANTest SET C_LDCU_SysSt.C_LDCU_EVSysReadySt 0
  gTC_CANTest_SOA_CheckReq_Prepare("SetPsngrSeatVentilationStruct.PsngrSeatVentilationReq 4&ServiceExecuteFeedbackFlag 2"); // 预期结果 TC_CANTest SOA CheckReq SetPsngrSeatVentilationStruct.PsngrSeatVentilationReq 4&ServiceExecuteFeedbackFlag 2
  g_EM_SOAClient_Swc_SOA_CHECK_Prepare("Veh_SetPsngrSeatVentilationRespStruct.Veh_SetPsngrSeatVentilationNRC 0"); // 预期结果 TC_CANTest SOA check Veh_SetPsngrSeatVentilationRespStruct.Veh_SetPsngrSeatVentilationNRC 0
  g_EM_SOAClient_Swc_SOA_CHECK_Prepare("Veh_SeatCtrlService_ErrStruct.OpeNRC 0 traceback7"); // 预期结果 TC_CANTest SOA check Veh_SeatCtrlService_ErrStruct.OpeNRC 0 traceback7
  g_EM_SOAClient_Swc_SOA_REQ("Veh_SetPsngrSeatVentilationStruct.Veh_PsngrSeatVentilationReq:4&ServiceExecuteFeedbackFlag:2"); // 测试步骤 TC_CANTest SOA REQ Veh_SetPsngrSeatVentilationStruct.Veh_PsngrSeatVentilationReq:4&ServiceExecuteFeedbackFlag:2
  gTC_CANTest_SOA_CheckReq("SetPsngrSeatVentilationStruct.PsngrSeatVentilationReq 4&ServiceExecuteFeedbackFlag 2"); // 预期结果 TC_CANTest SOA CheckReq SetPsngrSeatVentilationStruct.PsngrSeatVentilationReq 4&ServiceExecuteFeedbackFlag 2
  g_EM_SOAClient_Swc_SOA_CHECK("Veh_SetPsngrSeatVentilationRespStruct.Veh_SetPsngrSeatVentilationNRC 0"); // 预期结果 TC_CANTest SOA check Veh_SetPsngrSeatVentilationRespStruct.Veh_SetPsngrSeatVentilationNRC 0
  g_EM_SOAClient_Swc_SOA_CHECK("Veh_SeatCtrlService_ErrStruct.OpeNRC 0 traceback7"); // 预期结果 TC_CANTest SOA check Veh_SeatCtrlService_ErrStruct.OpeNRC 0 traceback7
}

testcase SYS_CDCU_erpaizuocezuoyitongfeng_0135()
{
  TestDescription("前提条件初始化");
  teststep("warning","原始用例id为SYS-CDCU-二排左侧座椅通风-0135");
  g_EM_Equipment_Swc_TC_PW("OFF"); // 测试步骤 TC_PW OFF
  g_EM_Equipment_Swc_TC_IG("OFF"); // 测试步骤 TC_IG OFF
  g_EM_Equipment_Swc_TC_4G_Time_Delay_Second("1"); // 测试步骤 TC_Sleep 1
  g_EM_Equipment_Swc_TC_PW("ON"); // 测试步骤 TC_PW ON
  g_EM_Equipment_Swc_TC_IG("ON"); // 测试步骤 TC_IG ON
  g_EM_Equipment_Swc_TC_4G_Time_Delay_Second("5"); // 测试步骤 TC_Sleep 5
}

testcase SYS_CDCU_erpaizuocezuoyitongfeng_0136()
{
  TestDescription("二排左侧座椅通风-1");
  teststep("warning","原始用例id为SYS-CDCU-二排左侧座椅通风-0136");
  g_EM_Equipment_Swc_TC_IG("OFF"); // 测试步骤 TC_IG OFF
  g_CAN_Bus_Swc_Set("I_LDCU_BodySysSt1.I_LDCU_PowerMode 1"); // 测试步骤 TC_CANTest SET I_LDCU_BodySysSt1.I_LDCU_PowerMode 1
  g_EM_Equipment_Swc_TC_4G_Time_Delay_Second("1"); // 测试步骤 TC_Sleep 1
  g_CAN_Bus_Swc_Set("I_LDCU_BodySysSt1.I_LDCU_PowerMode 0"); // 测试步骤 TC_CANTest SET I_LDCU_BodySysSt1.I_LDCU_PowerMode 0
  g_CAN_Bus_Swc_Set("I_LDCU_NM.I_LDCU_NMRepeatMsgReqBit 1"); // 测试步骤 TC_CANTest SET I_LDCU_NM.I_LDCU_NMRepeatMsgReqBit 1 //网络唤醒维持帧
  g_CAN_Bus_Swc_Set("C_LDCU_SysSt.C_LDCU_EVSysReadySt 0"); // 测试步骤 TC_CANTest SET C_LDCU_SysSt.C_LDCU_EVSysReadySt 0//Not ready
  gTC_CANTest_SOA_CheckReq_Prepare("HighVoltageCtrlStruct.HighVoltageCtrl 2"); // 预期结果 TC_CANTest SOA CheckReq HighVoltageCtrlStruct.HighVoltageCtrl 2
  g_EM_SOAClient_Swc_SOA_CHECK_Prepare("Veh_SeatCtrlService_ErrStruct.OpeNRC 0 traceback7"); // 预期结果 TC_CANTest SOA check Veh_SeatCtrlService_ErrStruct.OpeNRC 0 traceback7
  g_EM_SOAClient_Swc_SOA_REQ("Veh_SetSecRowLtSeatVentilationStruct.Veh_SecRowLtSeatVentilationReq:1&ServiceExecuteFeedbackFlag:2&UserID:0x01010001"); // 测试步骤 TC_CANTest SOA REQ Veh_SetSecRowLtSeatVentilationStruct.Veh_SecRowLtSeatVentilationReq:1&ServiceExecuteFeedbackFlag:2&UserID:0x01010001
  gTC_CANTest_SOA_CheckReq("HighVoltageCtrlStruct.HighVoltageCtrl 2"); // 预期结果 TC_CANTest SOA CheckReq HighVoltageCtrlStruct.HighVoltageCtrl 2
  gTC_CANTest_SOA_CheckReq_Prepare("SetSecRowLtSeatVentilationStruct.SecRowLtSeatVentilationReq 1&ServiceExecuteFeedbackFlag 2"); // 预期结果 TC_CANTest SOA CheckReq SetSecRowLtSeatVentilationStruct.SecRowLtSeatVentilationReq 1&ServiceExecuteFeedbackFlag 2
  g_CAN_Bus_Swc_Set("C_LDCU_SysSt.C_LDCU_EVSysReadySt 2"); // 测试步骤 TC_CANTest SET C_LDCU_SysSt.C_LDCU_EVSysReadySt 2//Not ready
  gTC_CANTest_SOA_CheckReq("SetSecRowLtSeatVentilationStruct.SecRowLtSeatVentilationReq 1&ServiceExecuteFeedbackFlag 2"); // 预期结果 TC_CANTest SOA CheckReq SetSecRowLtSeatVentilationStruct.SecRowLtSeatVentilationReq 1&ServiceExecuteFeedbackFlag 2
  g_EM_SOAClient_Swc_SOA_CHECK("Veh_SeatCtrlService_ErrStruct.OpeNRC 0 traceback7"); // 预期结果 TC_CANTest SOA check Veh_SeatCtrlService_ErrStruct.OpeNRC 0 traceback7
  g_EM_Equipment_Swc_TC_IG("ON"); // 测试步骤 TC_IG ON
  g_EM_Equipment_Swc_TC_4G_Time_Delay_Second("2"); // 测试步骤 TC_Sleep 2
}

testcase SYS_CDCU_erpaizuocezuoyitongfeng_0137()
{
  TestDescription("二排左侧座椅通风-2");
  teststep("warning","原始用例id为SYS-CDCU-二排左侧座椅通风-0137");
  g_EM_Equipment_Swc_TC_IG("OFF"); // 测试步骤 TC_IG OFF
  g_CAN_Bus_Swc_Set("I_LDCU_BodySysSt1.I_LDCU_PowerMode 1"); // 测试步骤 TC_CANTest SET I_LDCU_BodySysSt1.I_LDCU_PowerMode 1
  g_EM_Equipment_Swc_TC_4G_Time_Delay_Second("1"); // 测试步骤 TC_Sleep 1
  g_CAN_Bus_Swc_Set("I_LDCU_BodySysSt1.I_LDCU_PowerMode 0"); // 测试步骤 TC_CANTest SET I_LDCU_BodySysSt1.I_LDCU_PowerMode 0
  g_CAN_Bus_Swc_Set("I_LDCU_NM.I_LDCU_NMRepeatMsgReqBit 1"); // 测试步骤 TC_CANTest SET I_LDCU_NM.I_LDCU_NMRepeatMsgReqBit 1 //网络唤醒维持帧
  g_CAN_Bus_Swc_Set("C_LDCU_SysSt.C_LDCU_EVSysReadySt 1"); // 测试步骤 TC_CANTest SET C_LDCU_SysSt.C_LDCU_EVSysReadySt 1//HV ON
  g_EM_SOAClient_Swc_SOA_CHECK_Prepare("Veh_SeatCtrlService_ErrStruct.OpeNRC 0 traceback7"); // 预期结果 TC_CANTest SOA check Veh_SeatCtrlService_ErrStruct.OpeNRC 0 traceback7
  g_EM_SOAClient_Swc_SOA_REQ("Veh_SetSecRowLtSeatVentilationStruct.Veh_SecRowLtSeatVentilationReq:1&ServiceExecuteFeedbackFlag:2&UserID:0x01010001"); // 测试步骤 TC_CANTest SOA REQ Veh_SetSecRowLtSeatVentilationStruct.Veh_SecRowLtSeatVentilationReq:1&ServiceExecuteFeedbackFlag:2&UserID:0x01010001
  gTC_CANTest_SOA_CheckReq_Prepare("SetSecRowLtSeatVentilationStruct.SecRowLtSeatVentilationReq 1&ServiceExecuteFeedbackFlag 2"); // 预期结果 TC_CANTest SOA CheckReq SetSecRowLtSeatVentilationStruct.SecRowLtSeatVentilationReq 1&ServiceExecuteFeedbackFlag 2
  g_CAN_Bus_Swc_Set("C_LDCU_SysSt.C_LDCU_EVSysReadySt 2"); // 测试步骤 TC_CANTest SET C_LDCU_SysSt.C_LDCU_EVSysReadySt 2//Not ready
  gTC_CANTest_SOA_CheckReq("SetSecRowLtSeatVentilationStruct.SecRowLtSeatVentilationReq 1&ServiceExecuteFeedbackFlag 2"); // 预期结果 TC_CANTest SOA CheckReq SetSecRowLtSeatVentilationStruct.SecRowLtSeatVentilationReq 1&ServiceExecuteFeedbackFlag 2
  g_EM_SOAClient_Swc_SOA_CHECK("Veh_SeatCtrlService_ErrStruct.OpeNRC 0 traceback7"); // 预期结果 TC_CANTest SOA check Veh_SeatCtrlService_ErrStruct.OpeNRC 0 traceback7
  g_EM_Equipment_Swc_TC_IG("ON"); // 测试步骤 TC_IG ON
  g_EM_Equipment_Swc_TC_4G_Time_Delay_Second("2"); // 测试步骤 TC_Sleep 2
}

testcase SYS_CDCU_erpaizuocezuoyitongfeng_0138()
{
  TestDescription("二排左侧座椅通风-3");
  teststep("warning","原始用例id为SYS-CDCU-二排左侧座椅通风-0138");
  g_EM_Equipment_Swc_TC_IG("OFF"); // 测试步骤 TC_IG OFF
  g_CAN_Bus_Swc_Set("I_LDCU_BodySysSt1.I_LDCU_PowerMode 1"); // 测试步骤 TC_CANTest SET I_LDCU_BodySysSt1.I_LDCU_PowerMode 1
  g_EM_Equipment_Swc_TC_4G_Time_Delay_Second("1"); // 测试步骤 TC_Sleep 1
  g_CAN_Bus_Swc_Set("I_LDCU_BodySysSt1.I_LDCU_PowerMode 0"); // 测试步骤 TC_CANTest SET I_LDCU_BodySysSt1.I_LDCU_PowerMode 0
  g_CAN_Bus_Swc_Set("I_LDCU_NM.I_LDCU_NMRepeatMsgReqBit 1"); // 测试步骤 TC_CANTest SET I_LDCU_NM.I_LDCU_NMRepeatMsgReqBit 1 //网络唤醒维持帧
  g_CAN_Bus_Swc_Set("C_LDCU_SysSt.C_LDCU_EVSysReadySt 2"); // 测试步骤 TC_CANTest SET C_LDCU_SysSt.C_LDCU_EVSysReadySt 2//HV ON
  g_EM_SOAClient_Swc_SOA_CHECK_Prepare("Veh_SeatCtrlService_ErrStruct.OpeNRC 0 traceback7"); // 预期结果 TC_CANTest SOA check Veh_SeatCtrlService_ErrStruct.OpeNRC 0 traceback7
  g_EM_SOAClient_Swc_SOA_REQ("Veh_SetSecRowLtSeatVentilationStruct.Veh_SecRowLtSeatVentilationReq:1&ServiceExecuteFeedbackFlag:2&UserID:0x01010001"); // 测试步骤 TC_CANTest SOA REQ Veh_SetSecRowLtSeatVentilationStruct.Veh_SecRowLtSeatVentilationReq:1&ServiceExecuteFeedbackFlag:2&UserID:0x01010001
  gTC_CANTest_SOA_CheckReq_Prepare("SetSecRowLtSeatVentilationStruct.SecRowLtSeatVentilationReq 1&ServiceExecuteFeedbackFlag 2"); // 预期结果 TC_CANTest SOA CheckReq SetSecRowLtSeatVentilationStruct.SecRowLtSeatVentilationReq 1&ServiceExecuteFeedbackFlag 2
  g_CAN_Bus_Swc_Set("C_LDCU_SysSt.C_LDCU_EVSysReadySt 2"); // 测试步骤 TC_CANTest SET C_LDCU_SysSt.C_LDCU_EVSysReadySt 2//Not ready
  gTC_CANTest_SOA_CheckReq("SetSecRowLtSeatVentilationStruct.SecRowLtSeatVentilationReq 1&ServiceExecuteFeedbackFlag 2"); // 预期结果 TC_CANTest SOA CheckReq SetSecRowLtSeatVentilationStruct.SecRowLtSeatVentilationReq 1&ServiceExecuteFeedbackFlag 2
  g_EM_SOAClient_Swc_SOA_CHECK("Veh_SeatCtrlService_ErrStruct.OpeNRC 0 traceback7"); // 预期结果 TC_CANTest SOA check Veh_SeatCtrlService_ErrStruct.OpeNRC 0 traceback7
  g_EM_Equipment_Swc_TC_IG("ON"); // 测试步骤 TC_IG ON
  g_EM_Equipment_Swc_TC_4G_Time_Delay_Second("2"); // 测试步骤 TC_Sleep 2
}

testcase SYS_CDCU_erpaizuocezuoyitongfeng_0139()
{
  TestDescription("二排左侧座椅通风-5");
  teststep("warning","原始用例id为SYS-CDCU-二排左侧座椅通风-0139");
  g_CAN_Bus_Swc_Set("I_LDCU_BodySysSt1.I_LDCU_PowerMode 1"); // 测试步骤 TC_CANTest SET I_LDCU_BodySysSt1.I_LDCU_PowerMode 1
  g_CAN_Bus_Swc_Set("I_LDCU_NM.I_LDCU_NMRepeatMsgReqBit 1"); // 测试步骤 TC_CANTest SET I_LDCU_NM.I_LDCU_NMRepeatMsgReqBit 1 //网络唤醒维持帧
  g_CAN_Bus_Swc_Set("C_LDCU_SysSt.C_LDCU_EVSysReadySt 1"); // 测试步骤 TC_CANTest SET C_LDCU_SysSt.C_LDCU_EVSysReadySt 1//Not ready
  gTC_CANTest_SOA_CheckReq_Prepare("SetSecRowLtSeatVentilationStruct.SecRowLtSeatVentilationReq 1&ServiceExecuteFeedbackFlag 2"); // 预期结果 TC_CANTest SOA CheckReq SetSecRowLtSeatVentilationStruct.SecRowLtSeatVentilationReq 1&ServiceExecuteFeedbackFlag 2
  g_EM_SOAClient_Swc_SOA_CHECK_Prepare("Veh_SeatCtrlService_ErrStruct.OpeNRC 0 traceback7"); // 预期结果 TC_CANTest SOA check Veh_SeatCtrlService_ErrStruct.OpeNRC 0 traceback7
  g_EM_SOAClient_Swc_SOA_REQ("Veh_SetSecRowLtSeatVentilationStruct.Veh_SecRowLtSeatVentilationReq:1&ServiceExecuteFeedbackFlag:2"); // 测试步骤 TC_CANTest SOA REQ Veh_SetSecRowLtSeatVentilationStruct.Veh_SecRowLtSeatVentilationReq:1&ServiceExecuteFeedbackFlag:2
  gTC_CANTest_SOA_CheckReq("SetSecRowLtSeatVentilationStruct.SecRowLtSeatVentilationReq 1&ServiceExecuteFeedbackFlag 2"); // 预期结果 TC_CANTest SOA CheckReq SetSecRowLtSeatVentilationStruct.SecRowLtSeatVentilationReq 1&ServiceExecuteFeedbackFlag 2
  g_CAN_Bus_Swc_Set("C_LDCU_SysSt.C_LDCU_EVSysReadySt 2"); // 测试步骤 TC_CANTest SET C_LDCU_SysSt.C_LDCU_EVSysReadySt 2//Not ready
  g_EM_SOAClient_Swc_SOA_CHECK("Veh_SeatCtrlService_ErrStruct.OpeNRC 0 traceback7"); // 预期结果 TC_CANTest SOA check Veh_SeatCtrlService_ErrStruct.OpeNRC 0 traceback7
}

testcase SYS_CDCU_erpaizuocezuoyitongfeng_0140()
{
  TestDescription("二排左侧座椅通风-6");
  teststep("warning","原始用例id为SYS-CDCU-二排左侧座椅通风-0140");
  g_CAN_Bus_Swc_Set("I_LDCU_BodySysSt1.I_LDCU_PowerMode 1"); // 测试步骤 TC_CANTest SET I_LDCU_BodySysSt1.I_LDCU_PowerMode 1
  g_CAN_Bus_Swc_Set("I_LDCU_NM.I_LDCU_NMRepeatMsgReqBit 1"); // 测试步骤 TC_CANTest SET I_LDCU_NM.I_LDCU_NMRepeatMsgReqBit 1 //网络唤醒维持帧
  g_CAN_Bus_Swc_Set("C_LDCU_SysSt.C_LDCU_EVSysReadySt 2"); // 测试步骤 TC_CANTest SET C_LDCU_SysSt.C_LDCU_EVSysReadySt 2//Not ready
  gTC_CANTest_SOA_CheckReq_Prepare("SetSecRowLtSeatVentilationStruct.SecRowLtSeatVentilationReq 1&ServiceExecuteFeedbackFlag 2"); // 预期结果 TC_CANTest SOA CheckReq SetSecRowLtSeatVentilationStruct.SecRowLtSeatVentilationReq 1&ServiceExecuteFeedbackFlag 2
  g_EM_SOAClient_Swc_SOA_CHECK_Prepare("Veh_SeatCtrlService_ErrStruct.OpeNRC 0 traceback7"); // 预期结果 TC_CANTest SOA check Veh_SeatCtrlService_ErrStruct.OpeNRC 0 traceback7
  g_EM_SOAClient_Swc_SOA_REQ("Veh_SetSecRowLtSeatVentilationStruct.Veh_SecRowLtSeatVentilationReq:1&ServiceExecuteFeedbackFlag:2"); // 测试步骤 TC_CANTest SOA REQ Veh_SetSecRowLtSeatVentilationStruct.Veh_SecRowLtSeatVentilationReq:1&ServiceExecuteFeedbackFlag:2
  gTC_CANTest_SOA_CheckReq("SetSecRowLtSeatVentilationStruct.SecRowLtSeatVentilationReq 1&ServiceExecuteFeedbackFlag 2"); // 预期结果 TC_CANTest SOA CheckReq SetSecRowLtSeatVentilationStruct.SecRowLtSeatVentilationReq 1&ServiceExecuteFeedbackFlag 2
  g_CAN_Bus_Swc_Set("C_LDCU_SysSt.C_LDCU_EVSysReadySt 2"); // 测试步骤 TC_CANTest SET C_LDCU_SysSt.C_LDCU_EVSysReadySt 2//Not ready
  g_EM_SOAClient_Swc_SOA_CHECK("Veh_SeatCtrlService_ErrStruct.OpeNRC 0 traceback7"); // 预期结果 TC_CANTest SOA check Veh_SeatCtrlService_ErrStruct.OpeNRC 0 traceback7
}

testcase SYS_CDCU_erpaizuocezuoyitongfeng_0141()
{
  TestDescription("二排左侧座椅通风-7");
  teststep("warning","原始用例id为SYS-CDCU-二排左侧座椅通风-0141");
  gTC_CANTest_SOA_CheckReq_Prepare("SetSecRowLtSeatVentilationStruct.SecRowLtSeatVentilationReq 2&ServiceExecuteFeedbackFlag 2"); // 预期结果 TC_CANTest SOA CheckReq SetSecRowLtSeatVentilationStruct.SecRowLtSeatVentilationReq 2&ServiceExecuteFeedbackFlag 2
  g_EM_SOAClient_Swc_SOA_CHECK_Prepare("Veh_SeatCtrlService_ErrStruct.OpeNRC 0 traceback7"); // 预期结果 TC_CANTest SOA check Veh_SeatCtrlService_ErrStruct.OpeNRC 0 traceback7
  g_EM_SOAClient_Swc_SOA_REQ("Veh_SetSecRowLtSeatVentilationStruct.Veh_SecRowLtSeatVentilationReq:2&ServiceExecuteFeedbackFlag:2"); // 测试步骤 TC_CANTest SOA REQ Veh_SetSecRowLtSeatVentilationStruct.Veh_SecRowLtSeatVentilationReq:2&ServiceExecuteFeedbackFlag:2
  gTC_CANTest_SOA_CheckReq("SetSecRowLtSeatVentilationStruct.SecRowLtSeatVentilationReq 2&ServiceExecuteFeedbackFlag 2"); // 预期结果 TC_CANTest SOA CheckReq SetSecRowLtSeatVentilationStruct.SecRowLtSeatVentilationReq 2&ServiceExecuteFeedbackFlag 2
  g_EM_SOAClient_Swc_SOA_CHECK("Veh_SeatCtrlService_ErrStruct.OpeNRC 0 traceback7"); // 预期结果 TC_CANTest SOA check Veh_SeatCtrlService_ErrStruct.OpeNRC 0 traceback7
  g_EM_Equipment_Swc_TC_4G_Time_Delay_Second("5"); // 测试步骤 TC_Sleep 5
}

testcase SYS_CDCU_erpaizuocezuoyitongfeng_0142()
{
  TestDescription("二排左侧座椅通风-8");
  teststep("warning","原始用例id为SYS-CDCU-二排左侧座椅通风-0142");
  gTC_CANTest_SOA_CheckReq_Prepare("SetSecRowLtSeatVentilationStruct.SecRowLtSeatVentilationReq 3&ServiceExecuteFeedbackFlag 2"); // 预期结果 TC_CANTest SOA CheckReq SetSecRowLtSeatVentilationStruct.SecRowLtSeatVentilationReq 3&ServiceExecuteFeedbackFlag 2
  g_EM_SOAClient_Swc_SOA_CHECK_Prepare("Veh_SeatCtrlService_ErrStruct.OpeNRC 0 traceback7"); // 预期结果 TC_CANTest SOA check Veh_SeatCtrlService_ErrStruct.OpeNRC 0 traceback7
  g_EM_SOAClient_Swc_SOA_REQ("Veh_SetSecRowLtSeatVentilationStruct.Veh_SecRowLtSeatVentilationReq:3&ServiceExecuteFeedbackFlag:2"); // 测试步骤 TC_CANTest SOA REQ Veh_SetSecRowLtSeatVentilationStruct.Veh_SecRowLtSeatVentilationReq:3&ServiceExecuteFeedbackFlag:2
  gTC_CANTest_SOA_CheckReq("SetSecRowLtSeatVentilationStruct.SecRowLtSeatVentilationReq 3&ServiceExecuteFeedbackFlag 2"); // 预期结果 TC_CANTest SOA CheckReq SetSecRowLtSeatVentilationStruct.SecRowLtSeatVentilationReq 3&ServiceExecuteFeedbackFlag 2
  g_EM_SOAClient_Swc_SOA_CHECK("Veh_SeatCtrlService_ErrStruct.OpeNRC 0 traceback7"); // 预期结果 TC_CANTest SOA check Veh_SeatCtrlService_ErrStruct.OpeNRC 0 traceback7
  g_EM_Equipment_Swc_TC_4G_Time_Delay_Second("5"); // 测试步骤 TC_Sleep 5
}

testcase SYS_CDCU_erpaizuocezuoyitongfeng_0143()
{
  TestDescription("二排左侧座椅通风-9");
  teststep("warning","原始用例id为SYS-CDCU-二排左侧座椅通风-0143");
  g_CAN_Bus_Swc_Set("C_LDCU_SysSt.C_LDCU_EVSysReadySt 0"); // 测试步骤 TC_CANTest SET C_LDCU_SysSt.C_LDCU_EVSysReadySt 0
  gTC_CANTest_SOA_CheckReq_Prepare("SetSecRowLtSeatVentilationStruct.SecRowLtSeatVentilationReq 4&ServiceExecuteFeedbackFlag 2"); // 预期结果 TC_CANTest SOA CheckReq SetSecRowLtSeatVentilationStruct.SecRowLtSeatVentilationReq 4&ServiceExecuteFeedbackFlag 2
  g_EM_SOAClient_Swc_SOA_CHECK_Prepare("Veh_SeatCtrlService_ErrStruct.OpeNRC 0 traceback7"); // 预期结果 TC_CANTest SOA check Veh_SeatCtrlService_ErrStruct.OpeNRC 0 traceback7
  g_EM_SOAClient_Swc_SOA_REQ("Veh_SetSecRowLtSeatVentilationStruct.Veh_SecRowLtSeatVentilationReq:4&ServiceExecuteFeedbackFlag:2"); // 测试步骤 TC_CANTest SOA REQ Veh_SetSecRowLtSeatVentilationStruct.Veh_SecRowLtSeatVentilationReq:4&ServiceExecuteFeedbackFlag:2
  gTC_CANTest_SOA_CheckReq("SetSecRowLtSeatVentilationStruct.SecRowLtSeatVentilationReq 4&ServiceExecuteFeedbackFlag 2"); // 预期结果 TC_CANTest SOA CheckReq SetSecRowLtSeatVentilationStruct.SecRowLtSeatVentilationReq 4&ServiceExecuteFeedbackFlag 2
  g_EM_SOAClient_Swc_SOA_CHECK("Veh_SeatCtrlService_ErrStruct.OpeNRC 0 traceback7"); // 预期结果 TC_CANTest SOA check Veh_SeatCtrlService_ErrStruct.OpeNRC 0 traceback7
}

testcase SYS_CDCU_erpaiyoucezuoyitongfeng_0144()
{
  TestDescription("前提条件初始化");
  teststep("warning","原始用例id为SYS-CDCU-二排右侧座椅通风-0144");
  g_EM_Equipment_Swc_TC_PW("OFF"); // 测试步骤 TC_PW OFF
  g_EM_Equipment_Swc_TC_IG("OFF"); // 测试步骤 TC_IG OFF
  g_EM_Equipment_Swc_TC_4G_Time_Delay_Second("1"); // 测试步骤 TC_Sleep 1
  g_EM_Equipment_Swc_TC_PW("ON"); // 测试步骤 TC_PW ON
  g_EM_Equipment_Swc_TC_IG("ON"); // 测试步骤 TC_IG ON
  g_EM_Equipment_Swc_TC_4G_Time_Delay_Second("5"); // 测试步骤 TC_Sleep 5
}

testcase SYS_CDCU_erpaiyoucezuoyitongfeng_0145()
{
  TestDescription("二排右侧座椅通风-1");
  teststep("warning","原始用例id为SYS-CDCU-二排右侧座椅通风-0145");
  g_EM_Equipment_Swc_TC_IG("OFF"); // 测试步骤 TC_IG OFF
  g_CAN_Bus_Swc_Set("I_LDCU_BodySysSt1.I_LDCU_PowerMode 1"); // 测试步骤 TC_CANTest SET I_LDCU_BodySysSt1.I_LDCU_PowerMode 1
  g_EM_Equipment_Swc_TC_4G_Time_Delay_Second("1"); // 测试步骤 TC_Sleep 1
  g_CAN_Bus_Swc_Set("I_LDCU_BodySysSt1.I_LDCU_PowerMode 0"); // 测试步骤 TC_CANTest SET I_LDCU_BodySysSt1.I_LDCU_PowerMode 0
  g_CAN_Bus_Swc_Set("I_LDCU_NM.I_LDCU_NMRepeatMsgReqBit 1"); // 测试步骤 TC_CANTest SET I_LDCU_NM.I_LDCU_NMRepeatMsgReqBit 1 //网络唤醒维持帧
  g_CAN_Bus_Swc_Set("C_LDCU_SysSt.C_LDCU_EVSysReadySt 0"); // 测试步骤 TC_CANTest SET C_LDCU_SysSt.C_LDCU_EVSysReadySt 0//Not ready
  gTC_CANTest_SOA_CheckReq_Prepare("HighVoltageCtrlStruct.HighVoltageCtrl 2"); // 预期结果 TC_CANTest SOA CheckReq HighVoltageCtrlStruct.HighVoltageCtrl 2
  g_EM_SOAClient_Swc_SOA_CHECK_Prepare("Veh_SeatCtrlService_ErrStruct.OpeNRC 0 traceback7"); // 预期结果 TC_CANTest SOA check Veh_SeatCtrlService_ErrStruct.OpeNRC 0 traceback7
  g_EM_SOAClient_Swc_SOA_REQ("Veh_SetSecRowRtSeatVentilationStruct.Veh_SecRowRtSeatVentilationReq:1&ServiceExecuteFeedbackFlag:2&UserID:0x01010001"); // 测试步骤 TC_CANTest SOA REQ Veh_SetSecRowRtSeatVentilationStruct.Veh_SecRowRtSeatVentilationReq:1&ServiceExecuteFeedbackFlag:2&UserID:0x01010001
  gTC_CANTest_SOA_CheckReq("HighVoltageCtrlStruct.HighVoltageCtrl 2"); // 预期结果 TC_CANTest SOA CheckReq HighVoltageCtrlStruct.HighVoltageCtrl 2
  gTC_CANTest_SOA_CheckReq_Prepare("SetSecRowRtSeatVentilationStruct.SecRowRtSeatVentilationReq 1&ServiceExecuteFeedbackFlag 2"); // 预期结果 TC_CANTest SOA CheckReq SetSecRowRtSeatVentilationStruct.SecRowRtSeatVentilationReq 1&ServiceExecuteFeedbackFlag 2
  g_EM_SOAClient_Swc_SOA_CHECK_Prepare("Veh_SetSecRowRtSeatVentilationRespStruct.Veh_SetSecRowRtSeatVentilationNRC 0"); // 预期结果 TC_CANTest SOA check Veh_SetSecRowRtSeatVentilationRespStruct.Veh_SetSecRowRtSeatVentilationNRC 0
  g_CAN_Bus_Swc_Set("C_LDCU_SysSt.C_LDCU_EVSysReadySt 2"); // 测试步骤 TC_CANTest SET C_LDCU_SysSt.C_LDCU_EVSysReadySt 2//Not ready
  gTC_CANTest_SOA_CheckReq("SetSecRowRtSeatVentilationStruct.SecRowRtSeatVentilationReq 1&ServiceExecuteFeedbackFlag 2"); // 预期结果 TC_CANTest SOA CheckReq SetSecRowRtSeatVentilationStruct.SecRowRtSeatVentilationReq 1&ServiceExecuteFeedbackFlag 2
  g_EM_SOAClient_Swc_SOA_CHECK("Veh_SetSecRowRtSeatVentilationRespStruct.Veh_SetSecRowRtSeatVentilationNRC 0"); // 预期结果 TC_CANTest SOA check Veh_SetSecRowRtSeatVentilationRespStruct.Veh_SetSecRowRtSeatVentilationNRC 0
  g_EM_SOAClient_Swc_SOA_CHECK("Veh_SeatCtrlService_ErrStruct.OpeNRC 0 traceback7"); // 预期结果 TC_CANTest SOA check Veh_SeatCtrlService_ErrStruct.OpeNRC 0 traceback7
  g_EM_Equipment_Swc_TC_IG("ON"); // 测试步骤 TC_IG ON
  g_EM_Equipment_Swc_TC_4G_Time_Delay_Second("2"); // 测试步骤 TC_Sleep 2
}

testcase SYS_CDCU_erpaiyoucezuoyitongfeng_0146()
{
  TestDescription("二排右侧座椅通风-2");
  teststep("warning","原始用例id为SYS-CDCU-二排右侧座椅通风-0146");
  g_EM_Equipment_Swc_TC_IG("OFF"); // 测试步骤 TC_IG OFF
  g_CAN_Bus_Swc_Set("I_LDCU_BodySysSt1.I_LDCU_PowerMode 1"); // 测试步骤 TC_CANTest SET I_LDCU_BodySysSt1.I_LDCU_PowerMode 1
  g_EM_Equipment_Swc_TC_4G_Time_Delay_Second("1"); // 测试步骤 TC_Sleep 1
  g_CAN_Bus_Swc_Set("I_LDCU_BodySysSt1.I_LDCU_PowerMode 0"); // 测试步骤 TC_CANTest SET I_LDCU_BodySysSt1.I_LDCU_PowerMode 0
  g_CAN_Bus_Swc_Set("I_LDCU_NM.I_LDCU_NMRepeatMsgReqBit 1"); // 测试步骤 TC_CANTest SET I_LDCU_NM.I_LDCU_NMRepeatMsgReqBit 1 //网络唤醒维持帧
  g_CAN_Bus_Swc_Set("C_LDCU_SysSt.C_LDCU_EVSysReadySt 1"); // 测试步骤 TC_CANTest SET C_LDCU_SysSt.C_LDCU_EVSysReadySt 1//HV ON
  g_EM_SOAClient_Swc_SOA_CHECK_Prepare("Veh_SeatCtrlService_ErrStruct.OpeNRC 0 traceback7"); // 预期结果 TC_CANTest SOA check Veh_SeatCtrlService_ErrStruct.OpeNRC 0 traceback7
  g_EM_SOAClient_Swc_SOA_REQ("Veh_SetSecRowRtSeatVentilationStruct.Veh_SecRowRtSeatVentilationReq:1&ServiceExecuteFeedbackFlag:2&UserID:0x01010001"); // 测试步骤 TC_CANTest SOA REQ Veh_SetSecRowRtSeatVentilationStruct.Veh_SecRowRtSeatVentilationReq:1&ServiceExecuteFeedbackFlag:2&UserID:0x01010001
  gTC_CANTest_SOA_CheckReq_Prepare("SetSecRowRtSeatVentilationStruct.SecRowRtSeatVentilationReq 1&ServiceExecuteFeedbackFlag 2"); // 预期结果 TC_CANTest SOA CheckReq SetSecRowRtSeatVentilationStruct.SecRowRtSeatVentilationReq 1&ServiceExecuteFeedbackFlag 2
  g_EM_SOAClient_Swc_SOA_CHECK_Prepare("Veh_SetSecRowRtSeatVentilationRespStruct.Veh_SetSecRowRtSeatVentilationNRC 0"); // 预期结果 TC_CANTest SOA check Veh_SetSecRowRtSeatVentilationRespStruct.Veh_SetSecRowRtSeatVentilationNRC 0
  g_CAN_Bus_Swc_Set("C_LDCU_SysSt.C_LDCU_EVSysReadySt 2"); // 测试步骤 TC_CANTest SET C_LDCU_SysSt.C_LDCU_EVSysReadySt 2//Not ready
  gTC_CANTest_SOA_CheckReq("SetSecRowRtSeatVentilationStruct.SecRowRtSeatVentilationReq 1&ServiceExecuteFeedbackFlag 2"); // 预期结果 TC_CANTest SOA CheckReq SetSecRowRtSeatVentilationStruct.SecRowRtSeatVentilationReq 1&ServiceExecuteFeedbackFlag 2
  g_EM_SOAClient_Swc_SOA_CHECK("Veh_SetSecRowRtSeatVentilationRespStruct.Veh_SetSecRowRtSeatVentilationNRC 0"); // 预期结果 TC_CANTest SOA check Veh_SetSecRowRtSeatVentilationRespStruct.Veh_SetSecRowRtSeatVentilationNRC 0
  g_EM_SOAClient_Swc_SOA_CHECK("Veh_SeatCtrlService_ErrStruct.OpeNRC 0 traceback7"); // 预期结果 TC_CANTest SOA check Veh_SeatCtrlService_ErrStruct.OpeNRC 0 traceback7
  g_EM_Equipment_Swc_TC_IG("ON"); // 测试步骤 TC_IG ON
  g_EM_Equipment_Swc_TC_4G_Time_Delay_Second("2"); // 测试步骤 TC_Sleep 2
}

testcase SYS_CDCU_erpaiyoucezuoyitongfeng_0147()
{
  TestDescription("二排右侧座椅通风-3");
  teststep("warning","原始用例id为SYS-CDCU-二排右侧座椅通风-0147");
  g_EM_Equipment_Swc_TC_IG("OFF"); // 测试步骤 TC_IG OFF
  g_CAN_Bus_Swc_Set("I_LDCU_BodySysSt1.I_LDCU_PowerMode 1"); // 测试步骤 TC_CANTest SET I_LDCU_BodySysSt1.I_LDCU_PowerMode 1
  g_EM_Equipment_Swc_TC_4G_Time_Delay_Second("1"); // 测试步骤 TC_Sleep 1
  g_CAN_Bus_Swc_Set("I_LDCU_BodySysSt1.I_LDCU_PowerMode 0"); // 测试步骤 TC_CANTest SET I_LDCU_BodySysSt1.I_LDCU_PowerMode 0
  g_CAN_Bus_Swc_Set("I_LDCU_NM.I_LDCU_NMRepeatMsgReqBit 1"); // 测试步骤 TC_CANTest SET I_LDCU_NM.I_LDCU_NMRepeatMsgReqBit 1 //网络唤醒维持帧
  g_CAN_Bus_Swc_Set("C_LDCU_SysSt.C_LDCU_EVSysReadySt 2"); // 测试步骤 TC_CANTest SET C_LDCU_SysSt.C_LDCU_EVSysReadySt 2//HV ON
  gTC_CANTest_SOA_CheckReq_Prepare("SetSecRowRtSeatVentilationStruct.SecRowRtSeatVentilationReq 1&ServiceExecuteFeedbackFlag 2"); // 预期结果 TC_CANTest SOA CheckReq SetSecRowRtSeatVentilationStruct.SecRowRtSeatVentilationReq 1&ServiceExecuteFeedbackFlag 2
  g_EM_SOAClient_Swc_SOA_CHECK_Prepare("Veh_SeatCtrlService_ErrStruct.OpeNRC 0 traceback7"); // 预期结果 TC_CANTest SOA check Veh_SeatCtrlService_ErrStruct.OpeNRC 0 traceback7
  g_EM_SOAClient_Swc_SOA_REQ("Veh_SetSecRowRtSeatVentilationStruct.Veh_SecRowRtSeatVentilationReq:1&ServiceExecuteFeedbackFlag:2&UserID:0x01010001"); // 测试步骤 TC_CANTest SOA REQ Veh_SetSecRowRtSeatVentilationStruct.Veh_SecRowRtSeatVentilationReq:1&ServiceExecuteFeedbackFlag:2&UserID:0x01010001
  gTC_CANTest_SOA_CheckReq("SetSecRowRtSeatVentilationStruct.SecRowRtSeatVentilationReq 1&ServiceExecuteFeedbackFlag 2"); // 预期结果 TC_CANTest SOA CheckReq SetSecRowRtSeatVentilationStruct.SecRowRtSeatVentilationReq 1&ServiceExecuteFeedbackFlag 2
  g_EM_SOAClient_Swc_SOA_CHECK_Prepare("Veh_SetSecRowRtSeatVentilationRespStruct.Veh_SetSecRowRtSeatVentilationNRC 0"); // 预期结果 TC_CANTest SOA check Veh_SetSecRowRtSeatVentilationRespStruct.Veh_SetSecRowRtSeatVentilationNRC 0
  g_CAN_Bus_Swc_Set("C_LDCU_SysSt.C_LDCU_EVSysReadySt 2"); // 测试步骤 TC_CANTest SET C_LDCU_SysSt.C_LDCU_EVSysReadySt 2//Not ready
  g_EM_SOAClient_Swc_SOA_CHECK("Veh_SetSecRowRtSeatVentilationRespStruct.Veh_SetSecRowRtSeatVentilationNRC 0"); // 预期结果 TC_CANTest SOA check Veh_SetSecRowRtSeatVentilationRespStruct.Veh_SetSecRowRtSeatVentilationNRC 0
  g_EM_SOAClient_Swc_SOA_CHECK("Veh_SeatCtrlService_ErrStruct.OpeNRC 0 traceback7"); // 预期结果 TC_CANTest SOA check Veh_SeatCtrlService_ErrStruct.OpeNRC 0 traceback7
  g_EM_Equipment_Swc_TC_IG("ON"); // 测试步骤 TC_IG ON
  g_EM_Equipment_Swc_TC_4G_Time_Delay_Second("2"); // 测试步骤 TC_Sleep 2
}

testcase SYS_CDCU_erpaiyoucezuoyitongfeng_0148()
{
  TestDescription("二排右侧座椅通风-5");
  teststep("warning","原始用例id为SYS-CDCU-二排右侧座椅通风-0148");
  g_CAN_Bus_Swc_Set("I_LDCU_BodySysSt1.I_LDCU_PowerMode 1"); // 测试步骤 TC_CANTest SET I_LDCU_BodySysSt1.I_LDCU_PowerMode 1
  g_CAN_Bus_Swc_Set("I_LDCU_NM.I_LDCU_NMRepeatMsgReqBit 1"); // 测试步骤 TC_CANTest SET I_LDCU_NM.I_LDCU_NMRepeatMsgReqBit 1 //网络唤醒维持帧
  g_CAN_Bus_Swc_Set("C_LDCU_SysSt.C_LDCU_EVSysReadySt 1"); // 测试步骤 TC_CANTest SET C_LDCU_SysSt.C_LDCU_EVSysReadySt 1//Not ready
  gTC_CANTest_SOA_CheckReq_Prepare("SetSecRowRtSeatVentilationStruct.SecRowRtSeatVentilationReq 1&ServiceExecuteFeedbackFlag 2"); // 预期结果 TC_CANTest SOA CheckReq SetSecRowRtSeatVentilationStruct.SecRowRtSeatVentilationReq 1&ServiceExecuteFeedbackFlag 2
  g_EM_SOAClient_Swc_SOA_CHECK_Prepare("Veh_SeatCtrlService_ErrStruct.OpeNRC 0 traceback7"); // 预期结果 TC_CANTest SOA check Veh_SeatCtrlService_ErrStruct.OpeNRC 0 traceback7
  g_EM_SOAClient_Swc_SOA_REQ("Veh_SetSecRowRtSeatVentilationStruct.Veh_SecRowRtSeatVentilationReq:1&ServiceExecuteFeedbackFlag:2"); // 测试步骤 TC_CANTest SOA REQ Veh_SetSecRowRtSeatVentilationStruct.Veh_SecRowRtSeatVentilationReq:1&ServiceExecuteFeedbackFlag:2
  gTC_CANTest_SOA_CheckReq("SetSecRowRtSeatVentilationStruct.SecRowRtSeatVentilationReq 1&ServiceExecuteFeedbackFlag 2"); // 预期结果 TC_CANTest SOA CheckReq SetSecRowRtSeatVentilationStruct.SecRowRtSeatVentilationReq 1&ServiceExecuteFeedbackFlag 2
  g_CAN_Bus_Swc_Set("C_LDCU_SysSt.C_LDCU_EVSysReadySt 2"); // 测试步骤 TC_CANTest SET C_LDCU_SysSt.C_LDCU_EVSysReadySt 2//Not ready
  g_EM_SOAClient_Swc_SOA_CHECK("Veh_SeatCtrlService_ErrStruct.OpeNRC 0 traceback7"); // 预期结果 TC_CANTest SOA check Veh_SeatCtrlService_ErrStruct.OpeNRC 0 traceback7
}

testcase SYS_CDCU_erpaiyoucezuoyitongfeng_0149()
{
  TestDescription("二排右侧座椅通风-6");
  teststep("warning","原始用例id为SYS-CDCU-二排右侧座椅通风-0149");
  g_CAN_Bus_Swc_Set("I_LDCU_BodySysSt1.I_LDCU_PowerMode 1"); // 测试步骤 TC_CANTest SET I_LDCU_BodySysSt1.I_LDCU_PowerMode 1
  g_CAN_Bus_Swc_Set("I_LDCU_NM.I_LDCU_NMRepeatMsgReqBit 1"); // 测试步骤 TC_CANTest SET I_LDCU_NM.I_LDCU_NMRepeatMsgReqBit 1 //网络唤醒维持帧
  g_CAN_Bus_Swc_Set("C_LDCU_SysSt.C_LDCU_EVSysReadySt 2"); // 测试步骤 TC_CANTest SET C_LDCU_SysSt.C_LDCU_EVSysReadySt 2//Not ready
  gTC_CANTest_SOA_CheckReq_Prepare("SetSecRowRtSeatVentilationStruct.SecRowRtSeatVentilationReq 1&ServiceExecuteFeedbackFlag 2"); // 预期结果 TC_CANTest SOA CheckReq SetSecRowRtSeatVentilationStruct.SecRowRtSeatVentilationReq 1&ServiceExecuteFeedbackFlag 2
  g_EM_SOAClient_Swc_SOA_CHECK_Prepare("Veh_SeatCtrlService_ErrStruct.OpeNRC 0 traceback7"); // 预期结果 TC_CANTest SOA check Veh_SeatCtrlService_ErrStruct.OpeNRC 0 traceback7
  g_EM_SOAClient_Swc_SOA_REQ("Veh_SetSecRowRtSeatVentilationStruct.Veh_SecRowRtSeatVentilationReq:1&ServiceExecuteFeedbackFlag:2"); // 测试步骤 TC_CANTest SOA REQ Veh_SetSecRowRtSeatVentilationStruct.Veh_SecRowRtSeatVentilationReq:1&ServiceExecuteFeedbackFlag:2
  gTC_CANTest_SOA_CheckReq("SetSecRowRtSeatVentilationStruct.SecRowRtSeatVentilationReq 1&ServiceExecuteFeedbackFlag 2"); // 预期结果 TC_CANTest SOA CheckReq SetSecRowRtSeatVentilationStruct.SecRowRtSeatVentilationReq 1&ServiceExecuteFeedbackFlag 2
  g_CAN_Bus_Swc_Set("C_LDCU_SysSt.C_LDCU_EVSysReadySt 2"); // 测试步骤 TC_CANTest SET C_LDCU_SysSt.C_LDCU_EVSysReadySt 2//Not ready
  g_EM_SOAClient_Swc_SOA_CHECK("Veh_SeatCtrlService_ErrStruct.OpeNRC 0 traceback7"); // 预期结果 TC_CANTest SOA check Veh_SeatCtrlService_ErrStruct.OpeNRC 0 traceback7
}

testcase SYS_CDCU_erpaiyoucezuoyitongfeng_0150()
{
  TestDescription("二排右侧座椅通风-7");
  teststep("warning","原始用例id为SYS-CDCU-二排右侧座椅通风-0150");
  gTC_CANTest_SOA_CheckReq_Prepare("SetSecRowRtSeatVentilationStruct.SecRowRtSeatVentilationReq 2&ServiceExecuteFeedbackFlag 2"); // 预期结果 TC_CANTest SOA CheckReq SetSecRowRtSeatVentilationStruct.SecRowRtSeatVentilationReq 2&ServiceExecuteFeedbackFlag 2
  g_EM_SOAClient_Swc_SOA_CHECK_Prepare("Veh_SetSecRowRtSeatVentilationRespStruct.Veh_SetSecRowRtSeatVentilationNRC 0"); // 预期结果 TC_CANTest SOA check Veh_SetSecRowRtSeatVentilationRespStruct.Veh_SetSecRowRtSeatVentilationNRC 0
  g_EM_SOAClient_Swc_SOA_CHECK_Prepare("Veh_SeatCtrlService_ErrStruct.OpeNRC 0 traceback7"); // 预期结果 TC_CANTest SOA check Veh_SeatCtrlService_ErrStruct.OpeNRC 0 traceback7
  g_EM_SOAClient_Swc_SOA_REQ("Veh_SetSecRowRtSeatVentilationStruct.Veh_SecRowRtSeatVentilationReq:2&ServiceExecuteFeedbackFlag:2"); // 测试步骤 TC_CANTest SOA REQ Veh_SetSecRowRtSeatVentilationStruct.Veh_SecRowRtSeatVentilationReq:2&ServiceExecuteFeedbackFlag:2
  gTC_CANTest_SOA_CheckReq("SetSecRowRtSeatVentilationStruct.SecRowRtSeatVentilationReq 2&ServiceExecuteFeedbackFlag 2"); // 预期结果 TC_CANTest SOA CheckReq SetSecRowRtSeatVentilationStruct.SecRowRtSeatVentilationReq 2&ServiceExecuteFeedbackFlag 2
  g_EM_SOAClient_Swc_SOA_CHECK("Veh_SetSecRowRtSeatVentilationRespStruct.Veh_SetSecRowRtSeatVentilationNRC 0"); // 预期结果 TC_CANTest SOA check Veh_SetSecRowRtSeatVentilationRespStruct.Veh_SetSecRowRtSeatVentilationNRC 0
  g_EM_SOAClient_Swc_SOA_CHECK("Veh_SeatCtrlService_ErrStruct.OpeNRC 0 traceback7"); // 预期结果 TC_CANTest SOA check Veh_SeatCtrlService_ErrStruct.OpeNRC 0 traceback7
}

testcase SYS_CDCU_erpaiyoucezuoyitongfeng_0151()
{
  TestDescription("二排右侧座椅通风-8");
  teststep("warning","原始用例id为SYS-CDCU-二排右侧座椅通风-0151");
  gTC_CANTest_SOA_CheckReq_Prepare("SetSecRowRtSeatVentilationStruct.SecRowRtSeatVentilationReq 3&ServiceExecuteFeedbackFlag 2"); // 预期结果 TC_CANTest SOA CheckReq SetSecRowRtSeatVentilationStruct.SecRowRtSeatVentilationReq 3&ServiceExecuteFeedbackFlag 2
  g_EM_SOAClient_Swc_SOA_CHECK_Prepare("Veh_SetSecRowRtSeatVentilationRespStruct.Veh_SetSecRowRtSeatVentilationNRC 0"); // 预期结果 TC_CANTest SOA check Veh_SetSecRowRtSeatVentilationRespStruct.Veh_SetSecRowRtSeatVentilationNRC 0
  g_EM_SOAClient_Swc_SOA_CHECK_Prepare("Veh_SeatCtrlService_ErrStruct.OpeNRC 0 traceback7"); // 预期结果 TC_CANTest SOA check Veh_SeatCtrlService_ErrStruct.OpeNRC 0 traceback7
  g_EM_SOAClient_Swc_SOA_REQ("Veh_SetSecRowRtSeatVentilationStruct.Veh_SecRowRtSeatVentilationReq:3&ServiceExecuteFeedbackFlag:2"); // 测试步骤 TC_CANTest SOA REQ Veh_SetSecRowRtSeatVentilationStruct.Veh_SecRowRtSeatVentilationReq:3&ServiceExecuteFeedbackFlag:2
  gTC_CANTest_SOA_CheckReq("SetSecRowRtSeatVentilationStruct.SecRowRtSeatVentilationReq 3&ServiceExecuteFeedbackFlag 2"); // 预期结果 TC_CANTest SOA CheckReq SetSecRowRtSeatVentilationStruct.SecRowRtSeatVentilationReq 3&ServiceExecuteFeedbackFlag 2
  g_EM_SOAClient_Swc_SOA_CHECK("Veh_SetSecRowRtSeatVentilationRespStruct.Veh_SetSecRowRtSeatVentilationNRC 0"); // 预期结果 TC_CANTest SOA check Veh_SetSecRowRtSeatVentilationRespStruct.Veh_SetSecRowRtSeatVentilationNRC 0
  g_EM_SOAClient_Swc_SOA_CHECK("Veh_SeatCtrlService_ErrStruct.OpeNRC 0 traceback7"); // 预期结果 TC_CANTest SOA check Veh_SeatCtrlService_ErrStruct.OpeNRC 0 traceback7
}

testcase SYS_CDCU_erpaiyoucezuoyitongfeng_0152()
{
  TestDescription("二排右侧座椅通风-9");
  teststep("warning","原始用例id为SYS-CDCU-二排右侧座椅通风-0152");
  gTC_CANTest_SOA_CheckReq_Prepare("SetSecRowRtSeatVentilationStruct.SecRowRtSeatVentilationReq 4&ServiceExecuteFeedbackFlag 2"); // 预期结果 TC_CANTest SOA CheckReq SetSecRowRtSeatVentilationStruct.SecRowRtSeatVentilationReq 4&ServiceExecuteFeedbackFlag 2
  g_EM_SOAClient_Swc_SOA_CHECK_Prepare("Veh_SetSecRowRtSeatVentilationRespStruct.Veh_SetSecRowRtSeatVentilationNRC 0"); // 预期结果 TC_CANTest SOA check Veh_SetSecRowRtSeatVentilationRespStruct.Veh_SetSecRowRtSeatVentilationNRC 0
  g_EM_SOAClient_Swc_SOA_CHECK_Prepare("Veh_SeatCtrlService_ErrStruct.OpeNRC 0 traceback7"); // 预期结果 TC_CANTest SOA check Veh_SeatCtrlService_ErrStruct.OpeNRC 0 traceback7
  g_EM_SOAClient_Swc_SOA_REQ("Veh_SetSecRowRtSeatVentilationStruct.Veh_SecRowRtSeatVentilationReq:4&ServiceExecuteFeedbackFlag:2"); // 测试步骤 TC_CANTest SOA REQ Veh_SetSecRowRtSeatVentilationStruct.Veh_SecRowRtSeatVentilationReq:4&ServiceExecuteFeedbackFlag:2
  gTC_CANTest_SOA_CheckReq("SetSecRowRtSeatVentilationStruct.SecRowRtSeatVentilationReq 4&ServiceExecuteFeedbackFlag 2"); // 预期结果 TC_CANTest SOA CheckReq SetSecRowRtSeatVentilationStruct.SecRowRtSeatVentilationReq 4&ServiceExecuteFeedbackFlag 2
  g_EM_SOAClient_Swc_SOA_CHECK("Veh_SetSecRowRtSeatVentilationRespStruct.Veh_SetSecRowRtSeatVentilationNRC 0"); // 预期结果 TC_CANTest SOA check Veh_SetSecRowRtSeatVentilationRespStruct.Veh_SetSecRowRtSeatVentilationNRC 0
  g_EM_SOAClient_Swc_SOA_CHECK("Veh_SeatCtrlService_ErrStruct.OpeNRC 0 traceback7"); // 预期结果 TC_CANTest SOA check Veh_SeatCtrlService_ErrStruct.OpeNRC 0 traceback7
}

testcase SYS_CDCU_erpaiyoucezuoyitongfeng_0153()
{
  TestDescription("二排右侧座椅通风-10");
  teststep("warning","原始用例id为SYS-CDCU-二排右侧座椅通风-0153");
  g_CAN_Bus_Swc_Set("I_LDCU_BodySysSt1.I_LDCU_PowerMode 1"); // 测试步骤 TC_CANTest SET I_LDCU_BodySysSt1.I_LDCU_PowerMode 1
  g_EM_Equipment_Swc_TC_4G_Time_Delay_Second("2"); // 测试步骤 TC_Sleep 2
  g_CAN_Bus_Swc_Set("I_LDCU_BodySysSt1.I_LDCU_PowerMode 2"); // 测试步骤 TC_CANTest SET I_LDCU_BodySysSt1.I_LDCU_PowerMode 2
  g_CAN_Bus_Swc_Set("I_LDCU_NM.I_LDCU_NMRepeatMsgReqBit 1"); // 测试步骤 TC_CANTest SET I_LDCU_NM.I_LDCU_NMRepeatMsgReqBit 1 //网络唤醒维持帧
  g_CAN_Bus_Swc_Set("C_LDCU_SysSt.C_LDCU_EVSysReadySt 0"); // 测试步骤 TC_CANTest SET C_LDCU_SysSt.C_LDCU_EVSysReadySt 0//Not ready
  gTC_CANTest_SOA_CheckReq_Prepare("HighVoltageCtrlStruct.HighVoltageCtrl 2"); // 预期结果 TC_CANTest SOA CheckReq HighVoltageCtrlStruct.HighVoltageCtrl 2
  g_EM_SOAClient_Swc_SOA_CHECK_Prepare("Veh_SeatCtrlService_ErrStruct.OpeNRC 0 traceback7"); // 预期结果 TC_CANTest SOA check Veh_SeatCtrlService_ErrStruct.OpeNRC 0 traceback7
  g_EM_SOAClient_Swc_SOA_REQ("Veh_SetSecRowRtSeatVentilationStruct.Veh_SecRowRtSeatVentilationReq:1&ServiceExecuteFeedbackFlag:2&UserID:0x01010001"); // 测试步骤 TC_CANTest SOA REQ Veh_SetSecRowRtSeatVentilationStruct.Veh_SecRowRtSeatVentilationReq:1&ServiceExecuteFeedbackFlag:2&UserID:0x01010001
  gTC_CANTest_SOA_CheckReq("HighVoltageCtrlStruct.HighVoltageCtrl 2"); // 预期结果 TC_CANTest SOA CheckReq HighVoltageCtrlStruct.HighVoltageCtrl 2
  gTC_CANTest_SOA_CheckReq_Prepare("SetSecRowRtSeatVentilationStruct.SecRowRtSeatVentilationReq 1&ServiceExecuteFeedbackFlag 2"); // 预期结果 TC_CANTest SOA CheckReq SetSecRowRtSeatVentilationStruct.SecRowRtSeatVentilationReq 1&ServiceExecuteFeedbackFlag 2
  g_EM_SOAClient_Swc_SOA_CHECK_Prepare("Veh_SetSecRowRtSeatVentilationRespStruct.Veh_SetSecRowRtSeatVentilationNRC 0"); // 预期结果 TC_CANTest SOA check Veh_SetSecRowRtSeatVentilationRespStruct.Veh_SetSecRowRtSeatVentilationNRC 0
  g_CAN_Bus_Swc_Set("C_LDCU_SysSt.C_LDCU_EVSysReadySt 2"); // 测试步骤 TC_CANTest SET C_LDCU_SysSt.C_LDCU_EVSysReadySt 2//Not ready
  gTC_CANTest_SOA_CheckReq("SetSecRowRtSeatVentilationStruct.SecRowRtSeatVentilationReq 1&ServiceExecuteFeedbackFlag 2"); // 预期结果 TC_CANTest SOA CheckReq SetSecRowRtSeatVentilationStruct.SecRowRtSeatVentilationReq 1&ServiceExecuteFeedbackFlag 2
  g_EM_SOAClient_Swc_SOA_CHECK("Veh_SetSecRowRtSeatVentilationRespStruct.Veh_SetSecRowRtSeatVentilationNRC 0"); // 预期结果 TC_CANTest SOA check Veh_SetSecRowRtSeatVentilationRespStruct.Veh_SetSecRowRtSeatVentilationNRC 0
  g_EM_SOAClient_Swc_SOA_CHECK("Veh_SeatCtrlService_ErrStruct.OpeNRC 0 traceback7"); // 预期结果 TC_CANTest SOA check Veh_SeatCtrlService_ErrStruct.OpeNRC 0 traceback7
  g_EM_Equipment_Swc_TC_IG("ON"); // 测试步骤 TC_IG ON
  g_EM_Equipment_Swc_TC_4G_Time_Delay_Second("2"); // 测试步骤 TC_Sleep 2
}

testcase SYS_CDCU_erpaiyoucezuoyitongfeng_0154()
{
  TestDescription("二排右侧座椅通风-11");
  teststep("warning","原始用例id为SYS-CDCU-二排右侧座椅通风-0154");
  g_CAN_Bus_Swc_Set("I_LDCU_BodySysSt1.I_LDCU_PowerMode 1"); // 测试步骤 TC_CANTest SET I_LDCU_BodySysSt1.I_LDCU_PowerMode 1
  g_EM_Equipment_Swc_TC_4G_Time_Delay_Second("2"); // 测试步骤 TC_Sleep 2
  g_CAN_Bus_Swc_Set("I_LDCU_BodySysSt1.I_LDCU_PowerMode 2"); // 测试步骤 TC_CANTest SET I_LDCU_BodySysSt1.I_LDCU_PowerMode 2
  g_CAN_Bus_Swc_Set("I_LDCU_NM.I_LDCU_NMRepeatMsgReqBit 1"); // 测试步骤 TC_CANTest SET I_LDCU_NM.I_LDCU_NMRepeatMsgReqBit 1 //网络唤醒维持帧
  g_CAN_Bus_Swc_Set("C_LDCU_SysSt.C_LDCU_EVSysReadySt 1"); // 测试步骤 TC_CANTest SET C_LDCU_SysSt.C_LDCU_EVSysReadySt 1//HV ON
  gTC_CANTest_SOA_CheckReq_Prepare("SetSecRowRtSeatVentilationStruct.SecRowRtSeatVentilationReq 1&ServiceExecuteFeedbackFlag 2"); // 预期结果 TC_CANTest SOA CheckReq SetSecRowRtSeatVentilationStruct.SecRowRtSeatVentilationReq 1&ServiceExecuteFeedbackFlag 2
  g_EM_SOAClient_Swc_SOA_CHECK_Prepare("Veh_SeatCtrlService_ErrStruct.OpeNRC 0 traceback7"); // 预期结果 TC_CANTest SOA check Veh_SeatCtrlService_ErrStruct.OpeNRC 0 traceback7
  g_EM_SOAClient_Swc_SOA_REQ("Veh_SetSecRowRtSeatVentilationStruct.Veh_SecRowRtSeatVentilationReq:1&ServiceExecuteFeedbackFlag:2&UserID:0x01010001"); // 测试步骤 TC_CANTest SOA REQ Veh_SetSecRowRtSeatVentilationStruct.Veh_SecRowRtSeatVentilationReq:1&ServiceExecuteFeedbackFlag:2&UserID:0x01010001
  gTC_CANTest_SOA_CheckReq("SetSecRowRtSeatVentilationStruct.SecRowRtSeatVentilationReq 1&ServiceExecuteFeedbackFlag 2"); // 预期结果 TC_CANTest SOA CheckReq SetSecRowRtSeatVentilationStruct.SecRowRtSeatVentilationReq 1&ServiceExecuteFeedbackFlag 2
  g_EM_SOAClient_Swc_SOA_CHECK_Prepare("Veh_SetSecRowRtSeatVentilationRespStruct.Veh_SetSecRowRtSeatVentilationNRC 0"); // 预期结果 TC_CANTest SOA check Veh_SetSecRowRtSeatVentilationRespStruct.Veh_SetSecRowRtSeatVentilationNRC 0
  g_CAN_Bus_Swc_Set("C_LDCU_SysSt.C_LDCU_EVSysReadySt 2"); // 测试步骤 TC_CANTest SET C_LDCU_SysSt.C_LDCU_EVSysReadySt 2//Not ready
  g_EM_SOAClient_Swc_SOA_CHECK("Veh_SetSecRowRtSeatVentilationRespStruct.Veh_SetSecRowRtSeatVentilationNRC 0"); // 预期结果 TC_CANTest SOA check Veh_SetSecRowRtSeatVentilationRespStruct.Veh_SetSecRowRtSeatVentilationNRC 0
  g_EM_SOAClient_Swc_SOA_CHECK("Veh_SeatCtrlService_ErrStruct.OpeNRC 0 traceback7"); // 预期结果 TC_CANTest SOA check Veh_SeatCtrlService_ErrStruct.OpeNRC 0 traceback7
  g_EM_Equipment_Swc_TC_IG("ON"); // 测试步骤 TC_IG ON
  g_EM_Equipment_Swc_TC_4G_Time_Delay_Second("2"); // 测试步骤 TC_Sleep 2
}

testcase SYS_CDCU_erpaiyoucezuoyitongfeng_0155()
{
  TestDescription("二排右侧座椅通风-12");
  teststep("warning","原始用例id为SYS-CDCU-二排右侧座椅通风-0155");
  g_CAN_Bus_Swc_Set("I_LDCU_BodySysSt1.I_LDCU_PowerMode 1"); // 测试步骤 TC_CANTest SET I_LDCU_BodySysSt1.I_LDCU_PowerMode 1
  g_EM_Equipment_Swc_TC_4G_Time_Delay_Second("1"); // 测试步骤 TC_Sleep 1
  g_CAN_Bus_Swc_Set("I_LDCU_BodySysSt1.I_LDCU_PowerMode 2"); // 测试步骤 TC_CANTest SET I_LDCU_BodySysSt1.I_LDCU_PowerMode 2
  g_CAN_Bus_Swc_Set("I_LDCU_NM.I_LDCU_NMRepeatMsgReqBit 1"); // 测试步骤 TC_CANTest SET I_LDCU_NM.I_LDCU_NMRepeatMsgReqBit 1 //网络唤醒维持帧
  g_CAN_Bus_Swc_Set("C_LDCU_SysSt.C_LDCU_EVSysReadySt 2"); // 测试步骤 TC_CANTest SET C_LDCU_SysSt.C_LDCU_EVSysReadySt 2//HV ON
  gTC_CANTest_SOA_CheckReq_Prepare("SetSecRowRtSeatVentilationStruct.SecRowRtSeatVentilationReq 1&ServiceExecuteFeedbackFlag 2"); // 预期结果 TC_CANTest SOA CheckReq SetSecRowRtSeatVentilationStruct.SecRowRtSeatVentilationReq 1&ServiceExecuteFeedbackFlag 2
  g_EM_SOAClient_Swc_SOA_CHECK_Prepare("Veh_SetSecRowRtSeatVentilationRespStruct.Veh_SetSecRowRtSeatVentilationNRC 0"); // 预期结果 TC_CANTest SOA check Veh_SetSecRowRtSeatVentilationRespStruct.Veh_SetSecRowRtSeatVentilationNRC 0
  g_EM_SOAClient_Swc_SOA_CHECK_Prepare("Veh_SeatCtrlService_ErrStruct.OpeNRC 0 traceback7"); // 预期结果 TC_CANTest SOA check Veh_SeatCtrlService_ErrStruct.OpeNRC 0 traceback7
  g_EM_SOAClient_Swc_SOA_REQ("Veh_SetSecRowRtSeatVentilationStruct.Veh_SecRowRtSeatVentilationReq:1&ServiceExecuteFeedbackFlag:2&UserID:0x01010001"); // 测试步骤 TC_CANTest SOA REQ Veh_SetSecRowRtSeatVentilationStruct.Veh_SecRowRtSeatVentilationReq:1&ServiceExecuteFeedbackFlag:2&UserID:0x01010001
  gTC_CANTest_SOA_CheckReq("SetSecRowRtSeatVentilationStruct.SecRowRtSeatVentilationReq 1&ServiceExecuteFeedbackFlag 2"); // 预期结果 TC_CANTest SOA CheckReq SetSecRowRtSeatVentilationStruct.SecRowRtSeatVentilationReq 1&ServiceExecuteFeedbackFlag 2
  g_EM_SOAClient_Swc_SOA_CHECK("Veh_SetSecRowRtSeatVentilationRespStruct.Veh_SetSecRowRtSeatVentilationNRC 0"); // 预期结果 TC_CANTest SOA check Veh_SetSecRowRtSeatVentilationRespStruct.Veh_SetSecRowRtSeatVentilationNRC 0
  g_EM_SOAClient_Swc_SOA_CHECK("Veh_SeatCtrlService_ErrStruct.OpeNRC 0 traceback7"); // 预期结果 TC_CANTest SOA check Veh_SeatCtrlService_ErrStruct.OpeNRC 0 traceback7
  g_EM_Equipment_Swc_TC_IG("ON"); // 测试步骤 TC_IG ON
  g_EM_Equipment_Swc_TC_4G_Time_Delay_Second("2"); // 测试步骤 TC_Sleep 2
}

testcase SYS_CDCU_erpaiyoucezuoyitongfeng_0156()
{
  TestDescription("二排右侧座椅通风-13");
  teststep("warning","原始用例id为SYS-CDCU-二排右侧座椅通风-0156");
  gTC_CANTest_SOA_CheckReq_Prepare("SetSecRowRtSeatVentilationStruct.SecRowRtSeatVentilationReq 2&ServiceExecuteFeedbackFlag 2"); // 预期结果 TC_CANTest SOA CheckReq SetSecRowRtSeatVentilationStruct.SecRowRtSeatVentilationReq 2&ServiceExecuteFeedbackFlag 2
  g_EM_SOAClient_Swc_SOA_CHECK_Prepare("Veh_SetSecRowRtSeatVentilationRespStruct.Veh_SetSecRowRtSeatVentilationNRC 0"); // 预期结果 TC_CANTest SOA check Veh_SetSecRowRtSeatVentilationRespStruct.Veh_SetSecRowRtSeatVentilationNRC 0
  g_EM_SOAClient_Swc_SOA_CHECK_Prepare("Veh_SeatCtrlService_ErrStruct.OpeNRC 0 traceback7"); // 预期结果 TC_CANTest SOA check Veh_SeatCtrlService_ErrStruct.OpeNRC 0 traceback7
  g_EM_SOAClient_Swc_SOA_REQ("Veh_SetSecRowRtSeatVentilationStruct.Veh_SecRowRtSeatVentilationReq:2&ServiceExecuteFeedbackFlag:2&UserID:0x01010001"); // 测试步骤 TC_CANTest SOA REQ Veh_SetSecRowRtSeatVentilationStruct.Veh_SecRowRtSeatVentilationReq:2&ServiceExecuteFeedbackFlag:2&UserID:0x01010001
  gTC_CANTest_SOA_CheckReq("SetSecRowRtSeatVentilationStruct.SecRowRtSeatVentilationReq 2&ServiceExecuteFeedbackFlag 2"); // 预期结果 TC_CANTest SOA CheckReq SetSecRowRtSeatVentilationStruct.SecRowRtSeatVentilationReq 2&ServiceExecuteFeedbackFlag 2
  g_EM_SOAClient_Swc_SOA_CHECK("Veh_SetSecRowRtSeatVentilationRespStruct.Veh_SetSecRowRtSeatVentilationNRC 0"); // 预期结果 TC_CANTest SOA check Veh_SetSecRowRtSeatVentilationRespStruct.Veh_SetSecRowRtSeatVentilationNRC 0
  g_EM_SOAClient_Swc_SOA_CHECK("Veh_SeatCtrlService_ErrStruct.OpeNRC 0 traceback7"); // 预期结果 TC_CANTest SOA check Veh_SeatCtrlService_ErrStruct.OpeNRC 0 traceback7
}

testcase SYS_CDCU_erpaiyoucezuoyitongfeng_0157()
{
  TestDescription("二排右侧座椅通风-14");
  teststep("warning","原始用例id为SYS-CDCU-二排右侧座椅通风-0157");
  gTC_CANTest_SOA_CheckReq_Prepare("SetSecRowRtSeatVentilationStruct.SecRowRtSeatVentilationReq 3&ServiceExecuteFeedbackFlag 2"); // 预期结果 TC_CANTest SOA CheckReq SetSecRowRtSeatVentilationStruct.SecRowRtSeatVentilationReq 3&ServiceExecuteFeedbackFlag 2
  g_EM_SOAClient_Swc_SOA_CHECK_Prepare("Veh_SetSecRowRtSeatVentilationRespStruct.Veh_SetSecRowRtSeatVentilationNRC 0"); // 预期结果 TC_CANTest SOA check Veh_SetSecRowRtSeatVentilationRespStruct.Veh_SetSecRowRtSeatVentilationNRC 0
  g_EM_SOAClient_Swc_SOA_CHECK_Prepare("Veh_SeatCtrlService_ErrStruct.OpeNRC 0 traceback7"); // 预期结果 TC_CANTest SOA check Veh_SeatCtrlService_ErrStruct.OpeNRC 0 traceback7
  g_EM_SOAClient_Swc_SOA_REQ("Veh_SetSecRowRtSeatVentilationStruct.Veh_SecRowRtSeatVentilationReq:3&ServiceExecuteFeedbackFlag:2&UserID:0x01010001"); // 测试步骤 TC_CANTest SOA REQ Veh_SetSecRowRtSeatVentilationStruct.Veh_SecRowRtSeatVentilationReq:3&ServiceExecuteFeedbackFlag:2&UserID:0x01010001
  gTC_CANTest_SOA_CheckReq("SetSecRowRtSeatVentilationStruct.SecRowRtSeatVentilationReq 3&ServiceExecuteFeedbackFlag 2"); // 预期结果 TC_CANTest SOA CheckReq SetSecRowRtSeatVentilationStruct.SecRowRtSeatVentilationReq 3&ServiceExecuteFeedbackFlag 2
  g_EM_SOAClient_Swc_SOA_CHECK("Veh_SetSecRowRtSeatVentilationRespStruct.Veh_SetSecRowRtSeatVentilationNRC 0"); // 预期结果 TC_CANTest SOA check Veh_SetSecRowRtSeatVentilationRespStruct.Veh_SetSecRowRtSeatVentilationNRC 0
  g_EM_SOAClient_Swc_SOA_CHECK("Veh_SeatCtrlService_ErrStruct.OpeNRC 0 traceback7"); // 预期结果 TC_CANTest SOA check Veh_SeatCtrlService_ErrStruct.OpeNRC 0 traceback7
}

testcase SYS_CDCU_erpaiyoucezuoyitongfeng_0158()
{
  TestDescription("二排右侧座椅通风-15");
  teststep("warning","原始用例id为SYS-CDCU-二排右侧座椅通风-0158");
  g_CAN_Bus_Swc_Set("C_LDCU_SysSt.C_LDCU_EVSysReadySt 0"); // 测试步骤 TC_CANTest SET C_LDCU_SysSt.C_LDCU_EVSysReadySt 0
  gTC_CANTest_SOA_CheckReq_Prepare("SetSecRowRtSeatVentilationStruct.SecRowRtSeatVentilationReq 4&ServiceExecuteFeedbackFlag 2"); // 预期结果 TC_CANTest SOA CheckReq SetSecRowRtSeatVentilationStruct.SecRowRtSeatVentilationReq 4&ServiceExecuteFeedbackFlag 2
  g_EM_SOAClient_Swc_SOA_CHECK_Prepare("Veh_SetSecRowRtSeatVentilationRespStruct.Veh_SetSecRowRtSeatVentilationNRC 0"); // 预期结果 TC_CANTest SOA check Veh_SetSecRowRtSeatVentilationRespStruct.Veh_SetSecRowRtSeatVentilationNRC 0
  g_EM_SOAClient_Swc_SOA_CHECK_Prepare("Veh_SeatCtrlService_ErrStruct.OpeNRC 0 traceback7"); // 预期结果 TC_CANTest SOA check Veh_SeatCtrlService_ErrStruct.OpeNRC 0 traceback7
  g_EM_SOAClient_Swc_SOA_REQ("Veh_SetSecRowRtSeatVentilationStruct.Veh_SecRowRtSeatVentilationReq:4&ServiceExecuteFeedbackFlag:2&UserID:0x01010001"); // 测试步骤 TC_CANTest SOA REQ Veh_SetSecRowRtSeatVentilationStruct.Veh_SecRowRtSeatVentilationReq:4&ServiceExecuteFeedbackFlag:2&UserID:0x01010001
  gTC_CANTest_SOA_CheckReq("SetSecRowRtSeatVentilationStruct.SecRowRtSeatVentilationReq 4&ServiceExecuteFeedbackFlag 2"); // 预期结果 TC_CANTest SOA CheckReq SetSecRowRtSeatVentilationStruct.SecRowRtSeatVentilationReq 4&ServiceExecuteFeedbackFlag 2
  g_EM_SOAClient_Swc_SOA_CHECK("Veh_SetSecRowRtSeatVentilationRespStruct.Veh_SetSecRowRtSeatVentilationNRC 0"); // 预期结果 TC_CANTest SOA check Veh_SetSecRowRtSeatVentilationRespStruct.Veh_SetSecRowRtSeatVentilationNRC 0
  g_EM_SOAClient_Swc_SOA_CHECK("Veh_SeatCtrlService_ErrStruct.OpeNRC 0 traceback7"); // 预期结果 TC_CANTest SOA check Veh_SeatCtrlService_ErrStruct.OpeNRC 0 traceback7
}

testcase SYS_CDCU_yichangchangjing_0001()
{
  TestDescription("异常场景");
  teststep("warning","原始用例id为SYS-CDCU-异常场景-0001");
  g_CAN_Bus_Swc_Set("I_LDCU_BodySysSt1.I_LDCU_PowerMode 1"); // 测试步骤 TC_CANTest SET I_LDCU_BodySysSt1.I_LDCU_PowerMode 1
  g_CAN_Bus_Swc_Set("C_LDCU_SysSt.C_LDCU_EVSysReadySt 2"); // 测试步骤 TC_CANTest SET C_LDCU_SysSt.C_LDCU_EVSysReadySt 2//Ready
}

testcase SYS_CDCU_yichangchangjing_0002()
{
  TestDescription("异常场景");
  teststep("warning","原始用例id为SYS-CDCU-异常场景-0002");
  g_EM_SOAClient_Swc_SOA_CHECK_Prepare("Veh_SeatCtrlService_ErrStruct.OpeErrInfo[0-1]:0x9 traceback5"); // 预期结果 TC_CANTest SOA check Veh_SeatCtrlService_ErrStruct.OpeErrInfo[0-1]:0x9 traceback5
  g_EM_SOAClient_Swc_SOA_CHECK_Prepare("Veh_SeatCtrlService_ErrStruct.OpeNRC 0x1 traceback9"); // 预期结果 TC_CANTest SOA check Veh_SeatCtrlService_ErrStruct.OpeNRC 0x1 traceback9
  g_EM_SOAClient_Swc_SOA_REQ("Veh_TurnOnDrvSeatMassageStruct.Veh_DrvSeatMassgIntenReq:1&Veh_DrvSeatMassgProgReq:1&ServiceExecuteFeedbackFlag:2&UserID:0x01010001"); // 测试步骤 TC_CANTest SOA REQ Veh_TurnOnDrvSeatMassageStruct.Veh_DrvSeatMassgIntenReq:1&Veh_DrvSeatMassgProgReq:1&ServiceExecuteFeedbackFlag:2&UserID:0x01010001
  g_EM_SOAClient_Swc_SOA_CHECK("Veh_SeatCtrlService_ErrStruct.OpeErrInfo[0-1]:0x9 traceback5"); // 预期结果 TC_CANTest SOA check Veh_SeatCtrlService_ErrStruct.OpeErrInfo[0-1]:0x9 traceback5
  g_EM_SOAClient_Swc_SOA_CHECK("Veh_SeatCtrlService_ErrStruct.OpeNRC 0x1 traceback9"); // 预期结果 TC_CANTest SOA check Veh_SeatCtrlService_ErrStruct.OpeNRC 0x1 traceback9
}

testcase SYS_CDCU_yichangchangjing_0003()
{
  TestDescription("异常场景");
  teststep("warning","原始用例id为SYS-CDCU-异常场景-0003");
  g_EM_SOAClient_Swc_SOA_CHECK_Prepare("Veh_SeatCtrlService_ErrStruct.OpeErrInfo[0-1]:0x9 traceback5"); // 预期结果 TC_CANTest SOA check Veh_SeatCtrlService_ErrStruct.OpeErrInfo[0-1]:0x9 traceback5
  g_EM_SOAClient_Swc_SOA_CHECK_Prepare("Veh_SeatCtrlService_ErrStruct.OpeNRC 0x1 traceback9"); // 预期结果 TC_CANTest SOA check Veh_SeatCtrlService_ErrStruct.OpeNRC 0x1 traceback9
  g_EM_SOAClient_Swc_SOA_REQ("Veh_SetDrvSeatHeatingStruct.Veh_DrvSeatHeatingReq:1&UserID:0x01010001&ServiceExecuteFeedbackFlag:2"); // 测试步骤 TC_CANTest SOA REQ Veh_SetDrvSeatHeatingStruct.Veh_DrvSeatHeatingReq:1&UserID:0x01010001&ServiceExecuteFeedbackFlag:2
  g_EM_SOAClient_Swc_SOA_CHECK("Veh_SeatCtrlService_ErrStruct.OpeErrInfo[0-1]:0x9 traceback5"); // 预期结果 TC_CANTest SOA check Veh_SeatCtrlService_ErrStruct.OpeErrInfo[0-1]:0x9 traceback5
  g_EM_SOAClient_Swc_SOA_CHECK("Veh_SeatCtrlService_ErrStruct.OpeNRC 0x1 traceback9"); // 预期结果 TC_CANTest SOA check Veh_SeatCtrlService_ErrStruct.OpeNRC 0x1 traceback9
}

testcase SYS_CDCU_yichangchangjing_0004()
{
  TestDescription("异常场景");
  teststep("warning","原始用例id为SYS-CDCU-异常场景-0004");
  g_EM_SOAClient_Swc_SOA_CHECK_Prepare("Veh_SeatCtrlService_ErrStruct.OpeErrInfo[0-1]:0x9 traceback5"); // 预期结果 TC_CANTest SOA check Veh_SeatCtrlService_ErrStruct.OpeErrInfo[0-1]:0x9 traceback5
  g_EM_SOAClient_Swc_SOA_CHECK_Prepare("Veh_SeatCtrlService_ErrStruct.OpeNRC 0x1 traceback9"); // 预期结果 TC_CANTest SOA check Veh_SeatCtrlService_ErrStruct.OpeNRC 0x1 traceback9
  g_EM_SOAClient_Swc_SOA_REQ("Veh_SetDrvSeatVentilationStruct.Veh_DrvSeatVentilationReq:1&UserID:0x01010001&ServiceExecuteFeedbackFlag:2"); // 测试步骤 TC_CANTest SOA REQ Veh_SetDrvSeatVentilationStruct.Veh_DrvSeatVentilationReq:1&UserID:0x01010001&ServiceExecuteFeedbackFlag:2
  g_EM_SOAClient_Swc_SOA_CHECK("Veh_SeatCtrlService_ErrStruct.OpeErrInfo[0-1]:0x9 traceback5"); // 预期结果 TC_CANTest SOA check Veh_SeatCtrlService_ErrStruct.OpeErrInfo[0-1]:0x9 traceback5
  g_EM_SOAClient_Swc_SOA_CHECK("Veh_SeatCtrlService_ErrStruct.OpeNRC 0x1 traceback9"); // 预期结果 TC_CANTest SOA check Veh_SeatCtrlService_ErrStruct.OpeNRC 0x1 traceback9
}

testcase SYS_CDCU_yichangchangjing_0005()
{
  TestDescription("异常场景");
  teststep("warning","原始用例id为SYS-CDCU-异常场景-0005");
  g_EM_SOAClient_Swc_SOA_CHECK_Prepare("Veh_SeatCtrlService_ErrStruct.OpeErrInfo[0-1]:0x9 traceback5"); // 预期结果 TC_CANTest SOA check Veh_SeatCtrlService_ErrStruct.OpeErrInfo[0-1]:0x9 traceback5
  g_EM_SOAClient_Swc_SOA_CHECK_Prepare("Veh_SeatCtrlService_ErrStruct.OpeNRC 0x1 traceback9"); // 预期结果 TC_CANTest SOA check Veh_SeatCtrlService_ErrStruct.OpeNRC 0x1 traceback9
  g_EM_SOAClient_Swc_SOA_REQ("Veh_TurnOnDrvSeatMassageStruct.Veh_DrvSeatMassgIntenReq:1&Veh_DrvSeatMassgProgReq:1&ServiceExecuteFeedbackFlag:2&UserID:0x01010001"); // 测试步骤 TC_CANTest SOA REQ Veh_TurnOnDrvSeatMassageStruct.Veh_DrvSeatMassgIntenReq:1&Veh_DrvSeatMassgProgReq:1&ServiceExecuteFeedbackFlag:2&UserID:0x01010001
  g_EM_SOAClient_Swc_SOA_CHECK("Veh_SeatCtrlService_ErrStruct.OpeErrInfo[0-1]:0x9 traceback5"); // 预期结果 TC_CANTest SOA check Veh_SeatCtrlService_ErrStruct.OpeErrInfo[0-1]:0x9 traceback5
  g_EM_SOAClient_Swc_SOA_CHECK("Veh_SeatCtrlService_ErrStruct.OpeNRC 0x1 traceback9"); // 预期结果 TC_CANTest SOA check Veh_SeatCtrlService_ErrStruct.OpeNRC 0x1 traceback9
}

testcase SYS_CDCU_yichangchangjing_0006()
{
  TestDescription("异常场景");
  teststep("warning","原始用例id为SYS-CDCU-异常场景-0006");
  g_EM_SOAClient_Swc_SOA_CHECK_Prepare("Veh_SeatCtrlService_ErrStruct.OpeErrInfo[0-1]:0x9 traceback5"); // 预期结果 TC_CANTest SOA check Veh_SeatCtrlService_ErrStruct.OpeErrInfo[0-1]:0x9 traceback5
  g_EM_SOAClient_Swc_SOA_CHECK_Prepare("Veh_SeatCtrlService_ErrStruct.OpeNRC 0x1 traceback9"); // 预期结果 TC_CANTest SOA check Veh_SeatCtrlService_ErrStruct.OpeNRC 0x1 traceback9
  g_EM_SOAClient_Swc_SOA_REQ("Veh_SetDrvSeatHeatingStruct.Veh_DrvSeatHeatingReq:1&UserID:0x01010001&ServiceExecuteFeedbackFlag:2"); // 测试步骤 TC_CANTest SOA REQ Veh_SetDrvSeatHeatingStruct.Veh_DrvSeatHeatingReq:1&UserID:0x01010001&ServiceExecuteFeedbackFlag:2
  g_EM_SOAClient_Swc_SOA_CHECK("Veh_SeatCtrlService_ErrStruct.OpeErrInfo[0-1]:0x9 traceback5"); // 预期结果 TC_CANTest SOA check Veh_SeatCtrlService_ErrStruct.OpeErrInfo[0-1]:0x9 traceback5
  g_EM_SOAClient_Swc_SOA_CHECK("Veh_SeatCtrlService_ErrStruct.OpeNRC 0x1 traceback9"); // 预期结果 TC_CANTest SOA check Veh_SeatCtrlService_ErrStruct.OpeNRC 0x1 traceback9
}

testcase SYS_CDCU_yichangchangjing_0007()
{
  TestDescription("异常场景");
  teststep("warning","原始用例id为SYS-CDCU-异常场景-0007");
  g_EM_SOAClient_Swc_SOA_CHECK_Prepare("Veh_SeatCtrlService_ErrStruct.OpeErrInfo[0-1]:0x9 traceback5"); // 预期结果 TC_CANTest SOA check Veh_SeatCtrlService_ErrStruct.OpeErrInfo[0-1]:0x9 traceback5
  g_EM_SOAClient_Swc_SOA_CHECK_Prepare("Veh_SeatCtrlService_ErrStruct.OpeNRC 0x1 traceback9"); // 预期结果 TC_CANTest SOA check Veh_SeatCtrlService_ErrStruct.OpeNRC 0x1 traceback9
  g_EM_SOAClient_Swc_SOA_REQ("Veh_SetPsngrSeatVentilationStruct.Veh_PsngrSeatVentilationReq:1&UserID:0x01010001&ServiceExecuteFeedbackFlag:2"); // 测试步骤 TC_CANTest SOA REQ Veh_SetPsngrSeatVentilationStruct.Veh_PsngrSeatVentilationReq:1&UserID:0x01010001&ServiceExecuteFeedbackFlag:2
  g_EM_SOAClient_Swc_SOA_CHECK("Veh_SeatCtrlService_ErrStruct.OpeErrInfo[0-1]:0x9 traceback5"); // 预期结果 TC_CANTest SOA check Veh_SeatCtrlService_ErrStruct.OpeErrInfo[0-1]:0x9 traceback5
  g_EM_SOAClient_Swc_SOA_CHECK("Veh_SeatCtrlService_ErrStruct.OpeNRC 0x1 traceback9"); // 预期结果 TC_CANTest SOA check Veh_SeatCtrlService_ErrStruct.OpeNRC 0x1 traceback9
}

testcase SYS_CDCU_dianyuanmoshiqiehuan_0164()
{
  TestDescription("电源模式切换");
  teststep("warning","原始用例id为SYS-CDCU-电源模式切换-0164");
  g_EM_Equipment_Swc_TC_PW("OFF"); // 测试步骤 TC_PW OFF
  g_EM_Equipment_Swc_TC_IG("OFF"); // 测试步骤 TC_IG OFF
  g_EM_Equipment_Swc_TC_4G_Time_Delay_Second("1"); // 测试步骤 TC_Sleep 1
  g_EM_Equipment_Swc_TC_PW("ON"); // 测试步骤 TC_PW ON
  g_EM_Equipment_Swc_TC_IG("ON"); // 测试步骤 TC_IG ON
  g_EM_Equipment_Swc_TC_4G_Time_Delay_Second("2"); // 测试步骤 TC_Sleep 2
  gTC_CANTest_SOA_Set8001Delay("0"); // 测试步骤 TC_CANTest SOA Set8001Delay 0
  g_EM_SOAClient_Swc_SOA_SubPeriod("Veh_SeatCtrlService_ErrGrp 1"); // 测试步骤 TC_CANTest SOA SubPeriod Veh_SeatCtrlService_ErrGrp 1
  g_CAN_Bus_Swc_Set("I_LDCU_BodySysSt1.I_LDCU_PowerMode 1"); // 测试步骤 TC_CANTest SET I_LDCU_BodySysSt1.I_LDCU_PowerMode 1
  g_CAN_Bus_Swc_Set("C_LDCU_SysSt.C_LDCU_EVSysReadySt 2"); // 测试步骤 TC_CANTest SET C_LDCU_SysSt.C_LDCU_EVSysReadySt 2
}

testcase SYS_CDCU_dianyuanmoshiqiehuan_0165()
{
  TestDescription("电源模式切换");
  teststep("warning","原始用例id为SYS-CDCU-电源模式切换-0165");
  g_EM_Equipment_Swc_TC_PW("ON"); // 测试步骤 TC_PW ON
  g_CAN_Bus_Swc_Set("I_LDCU_BodySysSt1.I_LDCU_PowerMode 1"); // 测试步骤 TC_CANTest SET I_LDCU_BodySysSt1.I_LDCU_PowerMode 1
  g_CAN_Bus_Swc_Set("I_LDCU_NM.I_LDCU_NMRepeatMsgReqBit 1"); // 测试步骤 TC_CANTest SET I_LDCU_NM.I_LDCU_NMRepeatMsgReqBit 1 //网络唤醒维持帧
  g_CAN_Bus_Swc_Set("C_LDCU_SysSt.C_LDCU_EVSysReadySt 0"); // 测试步骤 TC_CANTest SET C_LDCU_SysSt.C_LDCU_EVSysReadySt 0//Not ready
  g_CAN_Bus_Swc_Set("I_LDCU_BodySysSt1.I_LDCU_PowerMode 0"); // 测试步骤 TC_CANTest SET I_LDCU_BodySysSt1.I_LDCU_PowerMode 0
  g_CAN_Bus_Swc_CheckEventStart("I_CDCU_SeatCtrl.I_CDCU_DrvSeatMassgProgCmd 1,I_CDCU_PsngrSeatMassgProgCmd 1,I_CDCU_SecRowRtSeatMassgProgCmd 1,I_CDCU_SecRowLtSeatMassgProgCmd 1"); // 测试步骤 TC_CANTest CheckEventStart I_CDCU_SeatCtrl.I_CDCU_DrvSeatMassgProgCmd 1,I_CDCU_PsngrSeatMassgProgCmd 1,I_CDCU_SecRowRtSeatMassgProgCmd 1,I_CDCU_SecRowLtSeatMassgProgCmd 1
  g_EM_Equipment_Swc_TC_IG("OFF"); // 测试步骤 TC_IG OFF
  g_CAN_Bus_Swc_CheckPeriod_FilterStarted("I_CDCU_SeatCtrl.I_CDCU_DrvSeatMassgProgCmd,I_CDCU_PsngrSeatMassgProgCmd,I_CDCU_SecRowRtSeatMassgProgCmd,I_CDCU_SecRowLtSeatMassgProgCmd 1:0,1:0,1:0,1:0 3;50;50"); // 预期结果 TC_CANTest CheckPeriod_FilterStarted I_CDCU_SeatCtrl.I_CDCU_DrvSeatMassgProgCmd,I_CDCU_PsngrSeatMassgProgCmd,I_CDCU_SecRowRtSeatMassgProgCmd,I_CDCU_SecRowLtSeatMassgProgCmd 1:0,1:0,1:0,1:0 3;50;50
  g_EM_Equipment_Swc_TC_4G_Time_Delay_Second("1"); // 测试步骤 TC_Sleep 1
  g_EM_Equipment_Swc_TC_IG("ON"); // 测试步骤 TC_IG ON
}

testcase SYS_CDCU_dianyuanmoshiqiehuan_0166()
{
  TestDescription("电源模式切换");
  teststep("warning","原始用例id为SYS-CDCU-电源模式切换-0166");
  g_EM_Equipment_Swc_TC_PW("OFF"); // 测试步骤 TC_PW OFF
  g_EM_Equipment_Swc_TC_IG("OFF"); // 测试步骤 TC_IG OFF
  g_EM_Equipment_Swc_TC_4G_Time_Delay_Second("1"); // 测试步骤 TC_Sleep 1
  g_EM_Equipment_Swc_TC_PW("ON"); // 测试步骤 TC_PW ON
  g_EM_Equipment_Swc_TC_IG("ON"); // 测试步骤 TC_IG ON
  g_EM_Equipment_Swc_TC_4G_Time_Delay_Second("2"); // 测试步骤 TC_Sleep 2
  g_CAN_Bus_Swc_Set("I_LDCU_BodySysSt1.I_LDCU_PowerMode 1"); // 测试步骤 TC_CANTest SET I_LDCU_BodySysSt1.I_LDCU_PowerMode 1
  g_CAN_Bus_Swc_Set("C_LDCU_SysSt.C_LDCU_EVSysReadySt 2"); // 测试步骤 TC_CANTest SET C_LDCU_SysSt.C_LDCU_EVSysReadySt 2
}

testcase SYS_CDCU_dianyuanmoshiqiehuan_0167()
{
  TestDescription("电源模式切换");
  teststep("warning","原始用例id为SYS-CDCU-电源模式切换-0167");
  g_EM_Equipment_Swc_TC_PW("ON"); // 测试步骤 TC_PW ON
  g_CAN_Bus_Swc_Set("I_LDCU_BodySysSt1.I_LDCU_PowerMode 1"); // 测试步骤 TC_CANTest SET I_LDCU_BodySysSt1.I_LDCU_PowerMode 1
  g_CAN_Bus_Swc_Set("I_LDCU_NM.I_LDCU_NMRepeatMsgReqBit 1"); // 测试步骤 TC_CANTest SET I_LDCU_NM.I_LDCU_NMRepeatMsgReqBit 1 //网络唤醒维持帧
  g_CAN_Bus_Swc_Set("C_LDCU_SysSt.C_LDCU_EVSysReadySt 0"); // 测试步骤 TC_CANTest SET C_LDCU_SysSt.C_LDCU_EVSysReadySt 0//Not ready
  g_CAN_Bus_Swc_Set("I_LDCU_BodySysSt1.I_LDCU_PowerMode 0"); // 测试步骤 TC_CANTest SET I_LDCU_BodySysSt1.I_LDCU_PowerMode 0
  g_EM_Equipment_Swc_TC_IG("OFF"); // 测试步骤 TC_IG OFF
  g_CAN_Bus_Swc_Check("I_CDCU_CycleEventCtrl1.I_CDCU_DrvSeatLumbRelaxCmd 0,I_CDCU_PsngrSeatLumbRelaxCmd 0"); // 预期结果 TC_CANTest Check I_CDCU_CycleEventCtrl1.I_CDCU_DrvSeatLumbRelaxCmd 0,I_CDCU_PsngrSeatLumbRelaxCmd 0
  g_EM_Equipment_Swc_TC_4G_Time_Delay_Second("1"); // 测试步骤 TC_Sleep 1
  g_EM_Equipment_Swc_TC_IG("ON"); // 测试步骤 TC_IG ON
}

testcase SYS_CDCU_zhujiazuoyiyaobushuhuan_0168()
{
  TestDescription("主驾座椅腰部舒缓非ready条件");
  teststep("warning","原始用例id为SYS-CDCU-主驾座椅腰部舒缓-0168");
  g_CAN_Bus_Swc_Set("I_LDCU_BodySysSt1.I_LDCU_PowerMode 1"); // 测试步骤 TC_CANTest SET I_LDCU_BodySysSt1.I_LDCU_PowerMode 1
  g_CAN_Bus_Swc_Set("C_LDCU_SysSt.C_LDCU_EVSysReadySt 0"); // 测试步骤 TC_CANTest SET C_LDCU_SysSt.C_LDCU_EVSysReadySt 0
}

testcase SYS_CDCU_zhujiazuoyiyaobushuhuan_0169()
{
  TestDescription("调节主驾座椅腰部舒缓模式-1");
  teststep("warning","原始用例id为SYS-CDCU-主驾座椅腰部舒缓-0169");
  g_CAN_Bus_Swc_CheckEventStart("I_CDCU_CycleEventCtrl1.I_CDCU_DrvSeatLumbRelaxCmd 3"); // 测试步骤 TC_CANTest CheckEventStart I_CDCU_CycleEventCtrl1.I_CDCU_DrvSeatLumbRelaxCmd 3
  g_EM_SOAClient_Swc_SOA_CHECK_Prepare("Veh_SetDrvSeatLumbRelaxRespStruct.Veh_SetDrvSeatLumbRelaxNRC 0 traceback5"); // 预期结果 TC_CANTest SOA check Veh_SetDrvSeatLumbRelaxRespStruct.Veh_SetDrvSeatLumbRelaxNRC 0 traceback5
  g_EM_SOAClient_Swc_SOA_CHECK_Prepare("Veh_SeatCtrlService_ErrStruct.OpeNRC 0 traceback7"); // 预期结果 TC_CANTest SOA check Veh_SeatCtrlService_ErrStruct.OpeNRC 0 traceback7
  g_EM_SOAClient_Swc_SOA_REQ("Veh_SetDrvSeatLumbRelaxStruct.Veh_DrvSeatLumbRelaxReq:1&ServiceExecuteFeedbackFlag:2"); // 测试步骤 TC_CANTest SOA REQ Veh_SetDrvSeatLumbRelaxStruct.Veh_DrvSeatLumbRelaxReq:1&ServiceExecuteFeedbackFlag:2
  g_CAN_Bus_Swc_CheckPeriod_FilterStarted("I_CDCU_CycleEventCtrl1.I_CDCU_DrvSeatLumbRelaxCmd 3:0 3;100;100"); // 预期结果 TC_CANTest CheckPeriod_FilterStarted I_CDCU_CycleEventCtrl1.I_CDCU_DrvSeatLumbRelaxCmd 3:0 3;100;100
  g_EM_SOAClient_Swc_SOA_CHECK("Veh_SetDrvSeatLumbRelaxRespStruct.Veh_SetDrvSeatLumbRelaxNRC 0 traceback5"); // 预期结果 TC_CANTest SOA check Veh_SetDrvSeatLumbRelaxRespStruct.Veh_SetDrvSeatLumbRelaxNRC 0 traceback5
  g_CAN_Bus_Swc_Set("I_LDCU_SeatSysSts.I_LDCU_DrvSeatLumbRelaxSts 1"); // 测试步骤 TC_CANTest SET I_LDCU_SeatSysSts.I_LDCU_DrvSeatLumbRelaxSts 1
  g_EM_SOAClient_Swc_SOA_CHECK("Veh_SeatCtrlService_ErrStruct.OpeNRC 0 traceback7"); // 预期结果 TC_CANTest SOA check Veh_SeatCtrlService_ErrStruct.OpeNRC 0 traceback7
  g_EM_Equipment_Swc_TC_4G_Time_Delay_Second("1785"); // 测试步骤 TC_Sleep 1785
  g_CAN_Bus_Swc_CheckEventStart("I_CDCU_CycleEventCtrl1.I_CDCU_DrvSeatLumbRelaxCmd 2"); // 测试步骤 TC_CANTest CheckEventStart I_CDCU_CycleEventCtrl1.I_CDCU_DrvSeatLumbRelaxCmd 2
  g_EM_Equipment_Swc_TC_4G_Time_Delay_Second("15"); // 测试步骤 TC_Sleep 15
  g_CAN_Bus_Swc_CheckPeriod_FilterStarted("I_CDCU_CycleEventCtrl1.I_CDCU_DrvSeatLumbRelaxCmd 2:0 3;100;50"); // 预期结果 TC_CANTest CheckPeriod_FilterStarted I_CDCU_CycleEventCtrl1.I_CDCU_DrvSeatLumbRelaxCmd 2:0 3;100;50
}

testcase SYS_CDCU_zhujiazuoyiyaobushuhuan_0170()
{
  TestDescription("调节主驾座椅腰部舒缓模式-2");
  teststep("warning","原始用例id为SYS-CDCU-主驾座椅腰部舒缓-0170");
  g_CAN_Bus_Swc_CheckEventStart("I_CDCU_CycleEventCtrl1.I_CDCU_DrvSeatLumbRelaxCmd 4"); // 测试步骤 TC_CANTest CheckEventStart I_CDCU_CycleEventCtrl1.I_CDCU_DrvSeatLumbRelaxCmd 4
  g_EM_SOAClient_Swc_SOA_CHECK_Prepare("Veh_SetDrvSeatLumbRelaxRespStruct.Veh_SetDrvSeatLumbRelaxNRC 0 traceback5"); // 预期结果 TC_CANTest SOA check Veh_SetDrvSeatLumbRelaxRespStruct.Veh_SetDrvSeatLumbRelaxNRC 0 traceback5
  g_EM_SOAClient_Swc_SOA_CHECK_Prepare("Veh_SeatCtrlService_ErrStruct.OpeNRC 0 traceback7"); // 预期结果 TC_CANTest SOA check Veh_SeatCtrlService_ErrStruct.OpeNRC 0 traceback7
  g_EM_SOAClient_Swc_SOA_REQ("Veh_SetDrvSeatLumbRelaxStruct.Veh_DrvSeatLumbRelaxReq:2&ServiceExecuteFeedbackFlag:2"); // 测试步骤 TC_CANTest SOA REQ Veh_SetDrvSeatLumbRelaxStruct.Veh_DrvSeatLumbRelaxReq:2&ServiceExecuteFeedbackFlag:2
  g_CAN_Bus_Swc_CheckPeriod_FilterStarted("I_CDCU_CycleEventCtrl1.I_CDCU_DrvSeatLumbRelaxCmd 4:0 3;100;100"); // 预期结果 TC_CANTest CheckPeriod_FilterStarted I_CDCU_CycleEventCtrl1.I_CDCU_DrvSeatLumbRelaxCmd 4:0 3;100;100
  g_EM_SOAClient_Swc_SOA_CHECK("Veh_SetDrvSeatLumbRelaxRespStruct.Veh_SetDrvSeatLumbRelaxNRC 0 traceback5"); // 预期结果 TC_CANTest SOA check Veh_SetDrvSeatLumbRelaxRespStruct.Veh_SetDrvSeatLumbRelaxNRC 0 traceback5
  g_CAN_Bus_Swc_Set("I_LDCU_SeatSysSts.I_LDCU_DrvSeatLumbRelaxSts 2"); // 测试步骤 TC_CANTest SET I_LDCU_SeatSysSts.I_LDCU_DrvSeatLumbRelaxSts 2
  g_EM_SOAClient_Swc_SOA_CHECK("Veh_SeatCtrlService_ErrStruct.OpeNRC 0 traceback7"); // 预期结果 TC_CANTest SOA check Veh_SeatCtrlService_ErrStruct.OpeNRC 0 traceback7
}

testcase SYS_CDCU_zhujiazuoyiyaobushuhuan_0171()
{
  TestDescription("调节主驾座椅腰部舒缓模式-3");
  teststep("warning","原始用例id为SYS-CDCU-主驾座椅腰部舒缓-0171");
  g_CAN_Bus_Swc_CheckEventStart("I_CDCU_CycleEventCtrl1.I_CDCU_DrvSeatLumbRelaxCmd 5"); // 测试步骤 TC_CANTest CheckEventStart I_CDCU_CycleEventCtrl1.I_CDCU_DrvSeatLumbRelaxCmd 5
  g_EM_SOAClient_Swc_SOA_CHECK_Prepare("Veh_SetDrvSeatLumbRelaxRespStruct.Veh_SetDrvSeatLumbRelaxNRC 0 traceback5"); // 预期结果 TC_CANTest SOA check Veh_SetDrvSeatLumbRelaxRespStruct.Veh_SetDrvSeatLumbRelaxNRC 0 traceback5
  g_EM_SOAClient_Swc_SOA_CHECK_Prepare("Veh_SeatCtrlService_ErrStruct.OpeNRC 0 traceback7"); // 预期结果 TC_CANTest SOA check Veh_SeatCtrlService_ErrStruct.OpeNRC 0 traceback7
  g_EM_SOAClient_Swc_SOA_REQ("Veh_SetDrvSeatLumbRelaxStruct.Veh_DrvSeatLumbRelaxReq:3&ServiceExecuteFeedbackFlag:2"); // 测试步骤 TC_CANTest SOA REQ Veh_SetDrvSeatLumbRelaxStruct.Veh_DrvSeatLumbRelaxReq:3&ServiceExecuteFeedbackFlag:2
  g_CAN_Bus_Swc_CheckPeriod_FilterStarted("I_CDCU_CycleEventCtrl1.I_CDCU_DrvSeatLumbRelaxCmd 5:0 3;100;100"); // 预期结果 TC_CANTest CheckPeriod_FilterStarted I_CDCU_CycleEventCtrl1.I_CDCU_DrvSeatLumbRelaxCmd 5:0 3;100;100
  g_EM_SOAClient_Swc_SOA_CHECK("Veh_SetDrvSeatLumbRelaxRespStruct.Veh_SetDrvSeatLumbRelaxNRC 0 traceback5"); // 预期结果 TC_CANTest SOA check Veh_SetDrvSeatLumbRelaxRespStruct.Veh_SetDrvSeatLumbRelaxNRC 0 traceback5
  g_CAN_Bus_Swc_Set("I_LDCU_SeatSysSts.I_LDCU_DrvSeatLumbRelaxSts 3"); // 测试步骤 TC_CANTest SET I_LDCU_SeatSysSts.I_LDCU_DrvSeatLumbRelaxSts 3
  g_EM_SOAClient_Swc_SOA_CHECK("Veh_SeatCtrlService_ErrStruct.OpeNRC 0 traceback7"); // 预期结果 TC_CANTest SOA check Veh_SeatCtrlService_ErrStruct.OpeNRC 0 traceback7
}

testcase SYS_CDCU_zhujiazuoyiyaobushuhuan_0172()
{
  TestDescription("关闭主驾座椅腰部舒缓模式-1");
  teststep("warning","原始用例id为SYS-CDCU-主驾座椅腰部舒缓-0172");
  g_CAN_Bus_Swc_CheckEventStart("I_CDCU_CycleEventCtrl1.I_CDCU_DrvSeatLumbRelaxCmd 2"); // 测试步骤 TC_CANTest CheckEventStart I_CDCU_CycleEventCtrl1.I_CDCU_DrvSeatLumbRelaxCmd 2
  g_EM_SOAClient_Swc_SOA_CHECK_Prepare("Veh_SetDrvSeatLumbRelaxRespStruct.Veh_SetDrvSeatLumbRelaxNRC 0 traceback5"); // 预期结果 TC_CANTest SOA check Veh_SetDrvSeatLumbRelaxRespStruct.Veh_SetDrvSeatLumbRelaxNRC 0 traceback5
  g_EM_SOAClient_Swc_SOA_CHECK_Prepare("Veh_SeatCtrlService_ErrStruct.OpeNRC 0 traceback7"); // 预期结果 TC_CANTest SOA check Veh_SeatCtrlService_ErrStruct.OpeNRC 0 traceback7
  g_EM_SOAClient_Swc_SOA_REQ("Veh_SetDrvSeatLumbRelaxStruct.Veh_DrvSeatLumbRelaxReq:0&ServiceExecuteFeedbackFlag:2"); // 测试步骤 TC_CANTest SOA REQ Veh_SetDrvSeatLumbRelaxStruct.Veh_DrvSeatLumbRelaxReq:0&ServiceExecuteFeedbackFlag:2
  g_CAN_Bus_Swc_CheckPeriod_FilterStarted("I_CDCU_CycleEventCtrl1.I_CDCU_DrvSeatLumbRelaxCmd 2:0 3;100;100"); // 预期结果 TC_CANTest CheckPeriod_FilterStarted I_CDCU_CycleEventCtrl1.I_CDCU_DrvSeatLumbRelaxCmd 2:0 3;100;100
  g_EM_SOAClient_Swc_SOA_CHECK("Veh_SetDrvSeatLumbRelaxRespStruct.Veh_SetDrvSeatLumbRelaxNRC 0 traceback5"); // 预期结果 TC_CANTest SOA check Veh_SetDrvSeatLumbRelaxRespStruct.Veh_SetDrvSeatLumbRelaxNRC 0 traceback5
  g_CAN_Bus_Swc_Set("I_LDCU_SeatSysSts.I_LDCU_DrvSeatLumbRelaxSts 0"); // 测试步骤 TC_CANTest SET I_LDCU_SeatSysSts.I_LDCU_DrvSeatLumbRelaxSts 0
  g_EM_SOAClient_Swc_SOA_CHECK("Veh_SeatCtrlService_ErrStruct.OpeNRC 0 traceback7"); // 预期结果 TC_CANTest SOA check Veh_SeatCtrlService_ErrStruct.OpeNRC 0 traceback7
}

testcase SYS_CDCU_fujiazuoyiyaobushuhuan_0173()
{
  TestDescription("调节副驾座椅腰部舒缓模式-1");
  teststep("warning","原始用例id为SYS-CDCU-副驾座椅腰部舒缓-0173");
  g_CAN_Bus_Swc_CheckEventStart("I_CDCU_CycleEventCtrl1.I_CDCU_PsngrSeatLumbRelaxCmd 2"); // 测试步骤 TC_CANTest CheckEventStart I_CDCU_CycleEventCtrl1.I_CDCU_PsngrSeatLumbRelaxCmd 2
  g_EM_SOAClient_Swc_SOA_CHECK_Prepare("Veh_SetPsngrSeatLumbRelaxRespStruct.Veh_SetPsngrSeatLumbRelaxNRC 0 traceback5"); // 预期结果 TC_CANTest SOA check Veh_SetPsngrSeatLumbRelaxRespStruct.Veh_SetPsngrSeatLumbRelaxNRC 0 traceback5
  g_EM_SOAClient_Swc_SOA_CHECK_Prepare("Veh_SeatCtrlService_ErrStruct.OpeNRC 0 traceback7"); // 预期结果 TC_CANTest SOA check Veh_SeatCtrlService_ErrStruct.OpeNRC 0 traceback7
  g_EM_SOAClient_Swc_SOA_REQ("Veh_SetPsngrSeatLumbRelaxStruct.Veh_PsngrSeatLumbRelaxReq:0&ServiceExecuteFeedbackFlag:2"); // 测试步骤 TC_CANTest SOA REQ Veh_SetPsngrSeatLumbRelaxStruct.Veh_PsngrSeatLumbRelaxReq:0&ServiceExecuteFeedbackFlag:2
  g_CAN_Bus_Swc_CheckPeriod_FilterStarted("I_CDCU_CycleEventCtrl1.I_CDCU_PsngrSeatLumbRelaxCmd 2:0 3;100;100"); // 预期结果 TC_CANTest CheckPeriod_FilterStarted I_CDCU_CycleEventCtrl1.I_CDCU_PsngrSeatLumbRelaxCmd 2:0 3;100;100
  g_EM_SOAClient_Swc_SOA_CHECK("Veh_SetPsngrSeatLumbRelaxRespStruct.Veh_SetPsngrSeatLumbRelaxNRC 0 traceback5"); // 预期结果 TC_CANTest SOA check Veh_SetPsngrSeatLumbRelaxRespStruct.Veh_SetPsngrSeatLumbRelaxNRC 0 traceback5
  g_CAN_Bus_Swc_Set("I_RDCU_SeatInfo2.I_RDCU_PsngrSeatLumbRelaxSts 0"); // 测试步骤 TC_CANTest SET I_RDCU_SeatInfo2.I_RDCU_PsngrSeatLumbRelaxSts 0
  g_EM_SOAClient_Swc_SOA_CHECK("Veh_SeatCtrlService_ErrStruct.OpeNRC 0 traceback7"); // 预期结果 TC_CANTest SOA check Veh_SeatCtrlService_ErrStruct.OpeNRC 0 traceback7
}

testcase SYS_CDCU_fujiazuoyiyaobushuhuan_0174()
{
  TestDescription("调节副驾座椅腰部舒缓模式-2");
  teststep("warning","原始用例id为SYS-CDCU-副驾座椅腰部舒缓-0174");
  g_CAN_Bus_Swc_CheckEventStart("I_CDCU_CycleEventCtrl1.I_CDCU_PsngrSeatLumbRelaxCmd 3"); // 测试步骤 TC_CANTest CheckEventStart I_CDCU_CycleEventCtrl1.I_CDCU_PsngrSeatLumbRelaxCmd 3
  g_EM_SOAClient_Swc_SOA_CHECK_Prepare("Veh_SetPsngrSeatLumbRelaxRespStruct.Veh_SetPsngrSeatLumbRelaxNRC 0 traceback5"); // 预期结果 TC_CANTest SOA check Veh_SetPsngrSeatLumbRelaxRespStruct.Veh_SetPsngrSeatLumbRelaxNRC 0 traceback5
  g_EM_SOAClient_Swc_SOA_CHECK_Prepare("Veh_SeatCtrlService_ErrStruct.OpeNRC 0 traceback7"); // 预期结果 TC_CANTest SOA check Veh_SeatCtrlService_ErrStruct.OpeNRC 0 traceback7
  g_EM_SOAClient_Swc_SOA_REQ("Veh_SetPsngrSeatLumbRelaxStruct.Veh_PsngrSeatLumbRelaxReq:1&ServiceExecuteFeedbackFlag:2"); // 测试步骤 TC_CANTest SOA REQ Veh_SetPsngrSeatLumbRelaxStruct.Veh_PsngrSeatLumbRelaxReq:1&ServiceExecuteFeedbackFlag:2
  g_CAN_Bus_Swc_CheckPeriod_FilterStarted("I_CDCU_CycleEventCtrl1.I_CDCU_PsngrSeatLumbRelaxCmd 3:0 3;100;100"); // 预期结果 TC_CANTest CheckPeriod_FilterStarted I_CDCU_CycleEventCtrl1.I_CDCU_PsngrSeatLumbRelaxCmd 3:0 3;100;100
  g_EM_SOAClient_Swc_SOA_CHECK("Veh_SetPsngrSeatLumbRelaxRespStruct.Veh_SetPsngrSeatLumbRelaxNRC 0 traceback5"); // 预期结果 TC_CANTest SOA check Veh_SetPsngrSeatLumbRelaxRespStruct.Veh_SetPsngrSeatLumbRelaxNRC 0 traceback5
  g_CAN_Bus_Swc_Set("I_RDCU_SeatInfo2.I_RDCU_PsngrSeatLumbRelaxSts 1"); // 测试步骤 TC_CANTest SET I_RDCU_SeatInfo2.I_RDCU_PsngrSeatLumbRelaxSts 1
  g_EM_SOAClient_Swc_SOA_CHECK("Veh_SeatCtrlService_ErrStruct.OpeNRC 0 traceback7"); // 预期结果 TC_CANTest SOA check Veh_SeatCtrlService_ErrStruct.OpeNRC 0 traceback7
}

testcase SYS_CDCU_fujiazuoyiyaobushuhuan_0175()
{
  TestDescription("调节副驾座椅腰部舒缓模式-3");
  teststep("warning","原始用例id为SYS-CDCU-副驾座椅腰部舒缓-0175");
  g_CAN_Bus_Swc_CheckEventStart("I_CDCU_CycleEventCtrl1.I_CDCU_PsngrSeatLumbRelaxCmd 4"); // 测试步骤 TC_CANTest CheckEventStart I_CDCU_CycleEventCtrl1.I_CDCU_PsngrSeatLumbRelaxCmd 4
  g_EM_SOAClient_Swc_SOA_CHECK_Prepare("Veh_SetPsngrSeatLumbRelaxRespStruct.Veh_SetPsngrSeatLumbRelaxNRC 0 traceback5"); // 预期结果 TC_CANTest SOA check Veh_SetPsngrSeatLumbRelaxRespStruct.Veh_SetPsngrSeatLumbRelaxNRC 0 traceback5
  g_EM_SOAClient_Swc_SOA_CHECK_Prepare("Veh_SeatCtrlService_ErrStruct.OpeNRC 0 traceback7"); // 预期结果 TC_CANTest SOA check Veh_SeatCtrlService_ErrStruct.OpeNRC 0 traceback7
  g_EM_SOAClient_Swc_SOA_REQ("Veh_SetPsngrSeatLumbRelaxStruct.Veh_PsngrSeatLumbRelaxReq:2&ServiceExecuteFeedbackFlag:2"); // 测试步骤 TC_CANTest SOA REQ Veh_SetPsngrSeatLumbRelaxStruct.Veh_PsngrSeatLumbRelaxReq:2&ServiceExecuteFeedbackFlag:2
  g_CAN_Bus_Swc_CheckPeriod_FilterStarted("I_CDCU_CycleEventCtrl1.I_CDCU_PsngrSeatLumbRelaxCmd 4:0 3;100;100"); // 预期结果 TC_CANTest CheckPeriod_FilterStarted I_CDCU_CycleEventCtrl1.I_CDCU_PsngrSeatLumbRelaxCmd 4:0 3;100;100
  g_EM_SOAClient_Swc_SOA_CHECK("Veh_SetPsngrSeatLumbRelaxRespStruct.Veh_SetPsngrSeatLumbRelaxNRC 0 traceback5"); // 预期结果 TC_CANTest SOA check Veh_SetPsngrSeatLumbRelaxRespStruct.Veh_SetPsngrSeatLumbRelaxNRC 0 traceback5
  g_CAN_Bus_Swc_Set("I_RDCU_SeatInfo2.I_RDCU_PsngrSeatLumbRelaxSts 2"); // 测试步骤 TC_CANTest SET I_RDCU_SeatInfo2.I_RDCU_PsngrSeatLumbRelaxSts 2
  g_EM_SOAClient_Swc_SOA_CHECK("Veh_SeatCtrlService_ErrStruct.OpeNRC 0 traceback7"); // 预期结果 TC_CANTest SOA check Veh_SeatCtrlService_ErrStruct.OpeNRC 0 traceback7
}

testcase SYS_CDCU_fujiazuoyiyaobushuhuan_0176()
{
  TestDescription("关闭副驾座椅腰部舒缓模式-1");
  teststep("warning","原始用例id为SYS-CDCU-副驾座椅腰部舒缓-0176");
  g_CAN_Bus_Swc_CheckEventStart("I_CDCU_CycleEventCtrl1.I_CDCU_PsngrSeatLumbRelaxCmd 5"); // 测试步骤 TC_CANTest CheckEventStart I_CDCU_CycleEventCtrl1.I_CDCU_PsngrSeatLumbRelaxCmd 5
  g_EM_SOAClient_Swc_SOA_CHECK_Prepare("Veh_SetPsngrSeatLumbRelaxRespStruct.Veh_SetPsngrSeatLumbRelaxNRC 0 traceback5"); // 预期结果 TC_CANTest SOA check Veh_SetPsngrSeatLumbRelaxRespStruct.Veh_SetPsngrSeatLumbRelaxNRC 0 traceback5
  g_EM_SOAClient_Swc_SOA_CHECK_Prepare("Veh_SeatCtrlService_ErrStruct.OpeNRC 0 traceback7"); // 预期结果 TC_CANTest SOA check Veh_SeatCtrlService_ErrStruct.OpeNRC 0 traceback7
  g_EM_SOAClient_Swc_SOA_REQ("Veh_SetPsngrSeatLumbRelaxStruct.Veh_PsngrSeatLumbRelaxReq:3&ServiceExecuteFeedbackFlag:2"); // 测试步骤 TC_CANTest SOA REQ Veh_SetPsngrSeatLumbRelaxStruct.Veh_PsngrSeatLumbRelaxReq:3&ServiceExecuteFeedbackFlag:2
  g_CAN_Bus_Swc_CheckPeriod_FilterStarted("I_CDCU_CycleEventCtrl1.I_CDCU_PsngrSeatLumbRelaxCmd 5:0 3;100;100"); // 预期结果 TC_CANTest CheckPeriod_FilterStarted I_CDCU_CycleEventCtrl1.I_CDCU_PsngrSeatLumbRelaxCmd 5:0 3;100;100
  g_EM_SOAClient_Swc_SOA_CHECK("Veh_SetPsngrSeatLumbRelaxRespStruct.Veh_SetPsngrSeatLumbRelaxNRC 0 traceback5"); // 预期结果 TC_CANTest SOA check Veh_SetPsngrSeatLumbRelaxRespStruct.Veh_SetPsngrSeatLumbRelaxNRC 0 traceback5
  g_CAN_Bus_Swc_Set("I_RDCU_SeatInfo2.I_RDCU_PsngrSeatLumbRelaxSts 3"); // 测试步骤 TC_CANTest SET I_RDCU_SeatInfo2.I_RDCU_PsngrSeatLumbRelaxSts 3
  g_EM_SOAClient_Swc_SOA_CHECK("Veh_SeatCtrlService_ErrStruct.OpeNRC 0 traceback7"); // 预期结果 TC_CANTest SOA check Veh_SeatCtrlService_ErrStruct.OpeNRC 0 traceback7
  g_EM_Equipment_Swc_TC_4G_Time_Delay_Second("10"); // 测试步骤 TC_Sleep 10
}

testcase SYS_CDCU_zhujiazuoyiyaobushuhuan_0177()
{
  TestDescription("主驾座椅腰部舒缓ready条件");
  teststep("warning","原始用例id为SYS-CDCU-主驾座椅腰部舒缓-0177");
  g_CAN_Bus_Swc_Set("I_LDCU_BodySysSt1.I_LDCU_PowerMode 1"); // 测试步骤 TC_CANTest SET I_LDCU_BodySysSt1.I_LDCU_PowerMode 1
  g_CAN_Bus_Swc_Set("C_LDCU_SysSt.C_LDCU_EVSysReadySt 2"); // 测试步骤 TC_CANTest SET C_LDCU_SysSt.C_LDCU_EVSysReadySt 2
  g_EM_Equipment_Swc_TC_4G_Time_Delay_Second("2"); // 测试步骤 TC_Sleep 2
}

testcase SYS_CDCU_zhujiazuoyiyaobushuhuan_0178()
{
  TestDescription("调节主驾座椅腰部舒缓模式-1");
  teststep("warning","原始用例id为SYS-CDCU-主驾座椅腰部舒缓-0178");
  g_CAN_Bus_Swc_CheckEventStart("I_CDCU_CycleEventCtrl1.I_CDCU_DrvSeatLumbRelaxCmd 3"); // 测试步骤 TC_CANTest CheckEventStart I_CDCU_CycleEventCtrl1.I_CDCU_DrvSeatLumbRelaxCmd 3
  g_EM_SOAClient_Swc_SOA_CHECK_Prepare("Veh_SetDrvSeatLumbRelaxRespStruct.Veh_SetDrvSeatLumbRelaxNRC 0 traceback5"); // 预期结果 TC_CANTest SOA check Veh_SetDrvSeatLumbRelaxRespStruct.Veh_SetDrvSeatLumbRelaxNRC 0 traceback5
  g_EM_SOAClient_Swc_SOA_CHECK_Prepare("Veh_SeatCtrlService_ErrStruct.OpeNRC 0 traceback7"); // 预期结果 TC_CANTest SOA check Veh_SeatCtrlService_ErrStruct.OpeNRC 0 traceback7
  g_EM_SOAClient_Swc_SOA_REQ("Veh_SetDrvSeatLumbRelaxStruct.Veh_DrvSeatLumbRelaxReq:1&ServiceExecuteFeedbackFlag:2"); // 测试步骤 TC_CANTest SOA REQ Veh_SetDrvSeatLumbRelaxStruct.Veh_DrvSeatLumbRelaxReq:1&ServiceExecuteFeedbackFlag:2
  g_CAN_Bus_Swc_CheckPeriod_FilterStarted("I_CDCU_CycleEventCtrl1.I_CDCU_DrvSeatLumbRelaxCmd 3:0 3;100;100"); // 预期结果 TC_CANTest CheckPeriod_FilterStarted I_CDCU_CycleEventCtrl1.I_CDCU_DrvSeatLumbRelaxCmd 3:0 3;100;100
  g_EM_SOAClient_Swc_SOA_CHECK("Veh_SetDrvSeatLumbRelaxRespStruct.Veh_SetDrvSeatLumbRelaxNRC 0 traceback5"); // 预期结果 TC_CANTest SOA check Veh_SetDrvSeatLumbRelaxRespStruct.Veh_SetDrvSeatLumbRelaxNRC 0 traceback5
  g_CAN_Bus_Swc_Set("I_LDCU_SeatSysSts.I_LDCU_DrvSeatLumbRelaxSts 1"); // 测试步骤 TC_CANTest SET I_LDCU_SeatSysSts.I_LDCU_DrvSeatLumbRelaxSts 1
  g_EM_SOAClient_Swc_SOA_CHECK("Veh_SeatCtrlService_ErrStruct.OpeNRC 0 traceback7"); // 预期结果 TC_CANTest SOA check Veh_SeatCtrlService_ErrStruct.OpeNRC 0 traceback7
  g_EM_Equipment_Swc_TC_4G_Time_Delay_Second("1785"); // 测试步骤 TC_Sleep 1785
  g_CAN_Bus_Swc_CheckEventStart("I_CDCU_CycleEventCtrl1.I_CDCU_DrvSeatLumbRelaxCmd 2"); // 测试步骤 TC_CANTest CheckEventStart I_CDCU_CycleEventCtrl1.I_CDCU_DrvSeatLumbRelaxCmd 2
  g_EM_Equipment_Swc_TC_4G_Time_Delay_Second("15"); // 测试步骤 TC_Sleep 15
  g_CAN_Bus_Swc_CheckPeriod_FilterStarted("I_CDCU_CycleEventCtrl1.I_CDCU_DrvSeatLumbRelaxCmd 2:0 3;100;50"); // 预期结果 TC_CANTest CheckPeriod_FilterStarted I_CDCU_CycleEventCtrl1.I_CDCU_DrvSeatLumbRelaxCmd 2:0 3;100;50
}

testcase SYS_CDCU_zhujiazuoyiyaobushuhuan_0179()
{
  TestDescription("调节主驾座椅腰部舒缓模式-2");
  teststep("warning","原始用例id为SYS-CDCU-主驾座椅腰部舒缓-0179");
  g_CAN_Bus_Swc_CheckEventStart("I_CDCU_CycleEventCtrl1.I_CDCU_DrvSeatLumbRelaxCmd 4"); // 测试步骤 TC_CANTest CheckEventStart I_CDCU_CycleEventCtrl1.I_CDCU_DrvSeatLumbRelaxCmd 4
  g_EM_SOAClient_Swc_SOA_CHECK_Prepare("Veh_SetDrvSeatLumbRelaxRespStruct.Veh_SetDrvSeatLumbRelaxNRC 0 traceback5"); // 预期结果 TC_CANTest SOA check Veh_SetDrvSeatLumbRelaxRespStruct.Veh_SetDrvSeatLumbRelaxNRC 0 traceback5
  g_EM_SOAClient_Swc_SOA_CHECK_Prepare("Veh_SeatCtrlService_ErrStruct.OpeNRC 0 traceback7"); // 预期结果 TC_CANTest SOA check Veh_SeatCtrlService_ErrStruct.OpeNRC 0 traceback7
  g_EM_SOAClient_Swc_SOA_REQ("Veh_SetDrvSeatLumbRelaxStruct.Veh_DrvSeatLumbRelaxReq:2&ServiceExecuteFeedbackFlag:2"); // 测试步骤 TC_CANTest SOA REQ Veh_SetDrvSeatLumbRelaxStruct.Veh_DrvSeatLumbRelaxReq:2&ServiceExecuteFeedbackFlag:2
  g_CAN_Bus_Swc_CheckPeriod_FilterStarted("I_CDCU_CycleEventCtrl1.I_CDCU_DrvSeatLumbRelaxCmd 4:0 3;100;100"); // 预期结果 TC_CANTest CheckPeriod_FilterStarted I_CDCU_CycleEventCtrl1.I_CDCU_DrvSeatLumbRelaxCmd 4:0 3;100;100
  g_EM_SOAClient_Swc_SOA_CHECK("Veh_SetDrvSeatLumbRelaxRespStruct.Veh_SetDrvSeatLumbRelaxNRC 0 traceback5"); // 预期结果 TC_CANTest SOA check Veh_SetDrvSeatLumbRelaxRespStruct.Veh_SetDrvSeatLumbRelaxNRC 0 traceback5
  g_CAN_Bus_Swc_Set("I_LDCU_SeatSysSts.I_LDCU_DrvSeatLumbRelaxSts 2"); // 测试步骤 TC_CANTest SET I_LDCU_SeatSysSts.I_LDCU_DrvSeatLumbRelaxSts 2
  g_EM_SOAClient_Swc_SOA_CHECK("Veh_SeatCtrlService_ErrStruct.OpeNRC 0 traceback7"); // 预期结果 TC_CANTest SOA check Veh_SeatCtrlService_ErrStruct.OpeNRC 0 traceback7
}

testcase SYS_CDCU_zhujiazuoyiyaobushuhuan_0180()
{
  TestDescription("调节主驾座椅腰部舒缓模式-3");
  teststep("warning","原始用例id为SYS-CDCU-主驾座椅腰部舒缓-0180");
  g_CAN_Bus_Swc_CheckEventStart("I_CDCU_CycleEventCtrl1.I_CDCU_DrvSeatLumbRelaxCmd 5"); // 测试步骤 TC_CANTest CheckEventStart I_CDCU_CycleEventCtrl1.I_CDCU_DrvSeatLumbRelaxCmd 5
  g_EM_SOAClient_Swc_SOA_CHECK_Prepare("Veh_SetDrvSeatLumbRelaxRespStruct.Veh_SetDrvSeatLumbRelaxNRC 0 traceback5"); // 预期结果 TC_CANTest SOA check Veh_SetDrvSeatLumbRelaxRespStruct.Veh_SetDrvSeatLumbRelaxNRC 0 traceback5
  g_EM_SOAClient_Swc_SOA_CHECK_Prepare("Veh_SeatCtrlService_ErrStruct.OpeNRC 0 traceback7"); // 预期结果 TC_CANTest SOA check Veh_SeatCtrlService_ErrStruct.OpeNRC 0 traceback7
  g_EM_SOAClient_Swc_SOA_REQ("Veh_SetDrvSeatLumbRelaxStruct.Veh_DrvSeatLumbRelaxReq:3&ServiceExecuteFeedbackFlag:2"); // 测试步骤 TC_CANTest SOA REQ Veh_SetDrvSeatLumbRelaxStruct.Veh_DrvSeatLumbRelaxReq:3&ServiceExecuteFeedbackFlag:2
  g_CAN_Bus_Swc_CheckPeriod_FilterStarted("I_CDCU_CycleEventCtrl1.I_CDCU_DrvSeatLumbRelaxCmd 5:0 3;100;100"); // 预期结果 TC_CANTest CheckPeriod_FilterStarted I_CDCU_CycleEventCtrl1.I_CDCU_DrvSeatLumbRelaxCmd 5:0 3;100;100
  g_EM_SOAClient_Swc_SOA_CHECK("Veh_SetDrvSeatLumbRelaxRespStruct.Veh_SetDrvSeatLumbRelaxNRC 0 traceback5"); // 预期结果 TC_CANTest SOA check Veh_SetDrvSeatLumbRelaxRespStruct.Veh_SetDrvSeatLumbRelaxNRC 0 traceback5
  g_CAN_Bus_Swc_Set("I_LDCU_SeatSysSts.I_LDCU_DrvSeatLumbRelaxSts 3"); // 测试步骤 TC_CANTest SET I_LDCU_SeatSysSts.I_LDCU_DrvSeatLumbRelaxSts 3
  g_EM_SOAClient_Swc_SOA_CHECK("Veh_SeatCtrlService_ErrStruct.OpeNRC 0 traceback7"); // 预期结果 TC_CANTest SOA check Veh_SeatCtrlService_ErrStruct.OpeNRC 0 traceback7
}

testcase SYS_CDCU_zhujiazuoyiyaobushuhuan_0181()
{
  TestDescription("关闭主驾座椅腰部舒缓模式-1");
  teststep("warning","原始用例id为SYS-CDCU-主驾座椅腰部舒缓-0181");
  g_CAN_Bus_Swc_CheckEventStart("I_CDCU_CycleEventCtrl1.I_CDCU_DrvSeatLumbRelaxCmd 2"); // 测试步骤 TC_CANTest CheckEventStart I_CDCU_CycleEventCtrl1.I_CDCU_DrvSeatLumbRelaxCmd 2
  g_EM_SOAClient_Swc_SOA_CHECK_Prepare("Veh_SetDrvSeatLumbRelaxRespStruct.Veh_SetDrvSeatLumbRelaxNRC 0 traceback5"); // 预期结果 TC_CANTest SOA check Veh_SetDrvSeatLumbRelaxRespStruct.Veh_SetDrvSeatLumbRelaxNRC 0 traceback5
  g_EM_SOAClient_Swc_SOA_CHECK_Prepare("Veh_SeatCtrlService_ErrStruct.OpeNRC 0 traceback7"); // 预期结果 TC_CANTest SOA check Veh_SeatCtrlService_ErrStruct.OpeNRC 0 traceback7
  g_EM_SOAClient_Swc_SOA_REQ("Veh_SetDrvSeatLumbRelaxStruct.Veh_DrvSeatLumbRelaxReq:0&ServiceExecuteFeedbackFlag:2"); // 测试步骤 TC_CANTest SOA REQ Veh_SetDrvSeatLumbRelaxStruct.Veh_DrvSeatLumbRelaxReq:0&ServiceExecuteFeedbackFlag:2
  g_CAN_Bus_Swc_CheckPeriod_FilterStarted("I_CDCU_CycleEventCtrl1.I_CDCU_DrvSeatLumbRelaxCmd 2:0 3;100;100"); // 预期结果 TC_CANTest CheckPeriod_FilterStarted I_CDCU_CycleEventCtrl1.I_CDCU_DrvSeatLumbRelaxCmd 2:0 3;100;100
  g_EM_SOAClient_Swc_SOA_CHECK("Veh_SetDrvSeatLumbRelaxRespStruct.Veh_SetDrvSeatLumbRelaxNRC 0 traceback5"); // 预期结果 TC_CANTest SOA check Veh_SetDrvSeatLumbRelaxRespStruct.Veh_SetDrvSeatLumbRelaxNRC 0 traceback5
  g_CAN_Bus_Swc_Set("I_LDCU_SeatSysSts.I_LDCU_DrvSeatLumbRelaxSts 0"); // 测试步骤 TC_CANTest SET I_LDCU_SeatSysSts.I_LDCU_DrvSeatLumbRelaxSts 0
  g_EM_SOAClient_Swc_SOA_CHECK("Veh_SeatCtrlService_ErrStruct.OpeNRC 0 traceback7"); // 预期结果 TC_CANTest SOA check Veh_SeatCtrlService_ErrStruct.OpeNRC 0 traceback7
}

testcase SYS_CDCU_fujiazuoyiyaobushuhuan_0182()
{
  TestDescription("调节副驾座椅腰部舒缓模式-1");
  teststep("warning","原始用例id为SYS-CDCU-副驾座椅腰部舒缓-0182");
  g_CAN_Bus_Swc_CheckEventStart("I_CDCU_CycleEventCtrl1.I_CDCU_PsngrSeatLumbRelaxCmd 2"); // 测试步骤 TC_CANTest CheckEventStart I_CDCU_CycleEventCtrl1.I_CDCU_PsngrSeatLumbRelaxCmd 2
  g_EM_SOAClient_Swc_SOA_CHECK_Prepare("Veh_SetPsngrSeatLumbRelaxRespStruct.Veh_SetPsngrSeatLumbRelaxNRC 0 traceback5"); // 预期结果 TC_CANTest SOA check Veh_SetPsngrSeatLumbRelaxRespStruct.Veh_SetPsngrSeatLumbRelaxNRC 0 traceback5
  g_EM_SOAClient_Swc_SOA_CHECK_Prepare("Veh_SeatCtrlService_ErrStruct.OpeNRC 0 traceback7"); // 预期结果 TC_CANTest SOA check Veh_SeatCtrlService_ErrStruct.OpeNRC 0 traceback7
  g_EM_SOAClient_Swc_SOA_REQ("Veh_SetPsngrSeatLumbRelaxStruct.Veh_PsngrSeatLumbRelaxReq:0&ServiceExecuteFeedbackFlag:2"); // 测试步骤 TC_CANTest SOA REQ Veh_SetPsngrSeatLumbRelaxStruct.Veh_PsngrSeatLumbRelaxReq:0&ServiceExecuteFeedbackFlag:2
  g_CAN_Bus_Swc_CheckPeriod_FilterStarted("I_CDCU_CycleEventCtrl1.I_CDCU_PsngrSeatLumbRelaxCmd 2:0 3;100;100"); // 预期结果 TC_CANTest CheckPeriod_FilterStarted I_CDCU_CycleEventCtrl1.I_CDCU_PsngrSeatLumbRelaxCmd 2:0 3;100;100
  g_EM_SOAClient_Swc_SOA_CHECK("Veh_SetPsngrSeatLumbRelaxRespStruct.Veh_SetPsngrSeatLumbRelaxNRC 0 traceback5"); // 预期结果 TC_CANTest SOA check Veh_SetPsngrSeatLumbRelaxRespStruct.Veh_SetPsngrSeatLumbRelaxNRC 0 traceback5
  g_CAN_Bus_Swc_Set("I_RDCU_SeatInfo2.I_RDCU_PsngrSeatLumbRelaxSts 0"); // 测试步骤 TC_CANTest SET I_RDCU_SeatInfo2.I_RDCU_PsngrSeatLumbRelaxSts 0
  g_EM_SOAClient_Swc_SOA_CHECK("Veh_SeatCtrlService_ErrStruct.OpeNRC 0 traceback7"); // 预期结果 TC_CANTest SOA check Veh_SeatCtrlService_ErrStruct.OpeNRC 0 traceback7
}

testcase SYS_CDCU_fujiazuoyiyaobushuhuan_0183()
{
  TestDescription("调节副驾座椅腰部舒缓模式-2");
  teststep("warning","原始用例id为SYS-CDCU-副驾座椅腰部舒缓-0183");
  g_CAN_Bus_Swc_CheckEventStart("I_CDCU_CycleEventCtrl1.I_CDCU_PsngrSeatLumbRelaxCmd 3"); // 测试步骤 TC_CANTest CheckEventStart I_CDCU_CycleEventCtrl1.I_CDCU_PsngrSeatLumbRelaxCmd 3
  g_EM_SOAClient_Swc_SOA_CHECK_Prepare("Veh_SetPsngrSeatLumbRelaxRespStruct.Veh_SetPsngrSeatLumbRelaxNRC 0 traceback5"); // 预期结果 TC_CANTest SOA check Veh_SetPsngrSeatLumbRelaxRespStruct.Veh_SetPsngrSeatLumbRelaxNRC 0 traceback5
  g_EM_SOAClient_Swc_SOA_CHECK_Prepare("Veh_SeatCtrlService_ErrStruct.OpeNRC 0 traceback7"); // 预期结果 TC_CANTest SOA check Veh_SeatCtrlService_ErrStruct.OpeNRC 0 traceback7
  g_EM_SOAClient_Swc_SOA_REQ("Veh_SetPsngrSeatLumbRelaxStruct.Veh_PsngrSeatLumbRelaxReq:1&ServiceExecuteFeedbackFlag:2"); // 测试步骤 TC_CANTest SOA REQ Veh_SetPsngrSeatLumbRelaxStruct.Veh_PsngrSeatLumbRelaxReq:1&ServiceExecuteFeedbackFlag:2
  g_CAN_Bus_Swc_CheckPeriod_FilterStarted("I_CDCU_CycleEventCtrl1.I_CDCU_PsngrSeatLumbRelaxCmd 3:0 3;100;100"); // 预期结果 TC_CANTest CheckPeriod_FilterStarted I_CDCU_CycleEventCtrl1.I_CDCU_PsngrSeatLumbRelaxCmd 3:0 3;100;100
  g_EM_SOAClient_Swc_SOA_CHECK("Veh_SetPsngrSeatLumbRelaxRespStruct.Veh_SetPsngrSeatLumbRelaxNRC 0 traceback5"); // 预期结果 TC_CANTest SOA check Veh_SetPsngrSeatLumbRelaxRespStruct.Veh_SetPsngrSeatLumbRelaxNRC 0 traceback5
  g_CAN_Bus_Swc_Set("I_RDCU_SeatInfo2.I_RDCU_PsngrSeatLumbRelaxSts 1"); // 测试步骤 TC_CANTest SET I_RDCU_SeatInfo2.I_RDCU_PsngrSeatLumbRelaxSts 1
  g_EM_SOAClient_Swc_SOA_CHECK("Veh_SeatCtrlService_ErrStruct.OpeNRC 0 traceback7"); // 预期结果 TC_CANTest SOA check Veh_SeatCtrlService_ErrStruct.OpeNRC 0 traceback7
}

testcase SYS_CDCU_fujiazuoyiyaobushuhuan_0184()
{
  TestDescription("调节副驾座椅腰部舒缓模式-3");
  teststep("warning","原始用例id为SYS-CDCU-副驾座椅腰部舒缓-0184");
  g_CAN_Bus_Swc_CheckEventStart("I_CDCU_CycleEventCtrl1.I_CDCU_PsngrSeatLumbRelaxCmd 4"); // 测试步骤 TC_CANTest CheckEventStart I_CDCU_CycleEventCtrl1.I_CDCU_PsngrSeatLumbRelaxCmd 4
  g_EM_SOAClient_Swc_SOA_CHECK_Prepare("Veh_SetPsngrSeatLumbRelaxRespStruct.Veh_SetPsngrSeatLumbRelaxNRC 0 traceback5"); // 预期结果 TC_CANTest SOA check Veh_SetPsngrSeatLumbRelaxRespStruct.Veh_SetPsngrSeatLumbRelaxNRC 0 traceback5
  g_EM_SOAClient_Swc_SOA_CHECK_Prepare("Veh_SeatCtrlService_ErrStruct.OpeNRC 0 traceback7"); // 预期结果 TC_CANTest SOA check Veh_SeatCtrlService_ErrStruct.OpeNRC 0 traceback7
  g_EM_SOAClient_Swc_SOA_REQ("Veh_SetPsngrSeatLumbRelaxStruct.Veh_PsngrSeatLumbRelaxReq:2&ServiceExecuteFeedbackFlag:2"); // 测试步骤 TC_CANTest SOA REQ Veh_SetPsngrSeatLumbRelaxStruct.Veh_PsngrSeatLumbRelaxReq:2&ServiceExecuteFeedbackFlag:2
  g_CAN_Bus_Swc_CheckPeriod_FilterStarted("I_CDCU_CycleEventCtrl1.I_CDCU_PsngrSeatLumbRelaxCmd 4:0 3;100;100"); // 预期结果 TC_CANTest CheckPeriod_FilterStarted I_CDCU_CycleEventCtrl1.I_CDCU_PsngrSeatLumbRelaxCmd 4:0 3;100;100
  g_EM_SOAClient_Swc_SOA_CHECK("Veh_SetPsngrSeatLumbRelaxRespStruct.Veh_SetPsngrSeatLumbRelaxNRC 0 traceback5"); // 预期结果 TC_CANTest SOA check Veh_SetPsngrSeatLumbRelaxRespStruct.Veh_SetPsngrSeatLumbRelaxNRC 0 traceback5
  g_CAN_Bus_Swc_Set("I_RDCU_SeatInfo2.I_RDCU_PsngrSeatLumbRelaxSts 2"); // 测试步骤 TC_CANTest SET I_RDCU_SeatInfo2.I_RDCU_PsngrSeatLumbRelaxSts 2
  g_EM_SOAClient_Swc_SOA_CHECK("Veh_SeatCtrlService_ErrStruct.OpeNRC 0 traceback7"); // 预期结果 TC_CANTest SOA check Veh_SeatCtrlService_ErrStruct.OpeNRC 0 traceback7
}

testcase SYS_CDCU_fujiazuoyiyaobushuhuan_0185()
{
  TestDescription("关闭副驾座椅腰部舒缓模式-1");
  teststep("warning","原始用例id为SYS-CDCU-副驾座椅腰部舒缓-0185");
  g_CAN_Bus_Swc_CheckEventStart("I_CDCU_CycleEventCtrl1.I_CDCU_PsngrSeatLumbRelaxCmd 5"); // 测试步骤 TC_CANTest CheckEventStart I_CDCU_CycleEventCtrl1.I_CDCU_PsngrSeatLumbRelaxCmd 5
  g_EM_SOAClient_Swc_SOA_CHECK_Prepare("Veh_SetPsngrSeatLumbRelaxRespStruct.Veh_SetPsngrSeatLumbRelaxNRC 0 traceback5"); // 预期结果 TC_CANTest SOA check Veh_SetPsngrSeatLumbRelaxRespStruct.Veh_SetPsngrSeatLumbRelaxNRC 0 traceback5
  g_EM_SOAClient_Swc_SOA_CHECK_Prepare("Veh_SeatCtrlService_ErrStruct.OpeNRC 0 traceback7"); // 预期结果 TC_CANTest SOA check Veh_SeatCtrlService_ErrStruct.OpeNRC 0 traceback7
  g_EM_SOAClient_Swc_SOA_REQ("Veh_SetPsngrSeatLumbRelaxStruct.Veh_PsngrSeatLumbRelaxReq:3&ServiceExecuteFeedbackFlag:2"); // 测试步骤 TC_CANTest SOA REQ Veh_SetPsngrSeatLumbRelaxStruct.Veh_PsngrSeatLumbRelaxReq:3&ServiceExecuteFeedbackFlag:2
  g_CAN_Bus_Swc_CheckPeriod_FilterStarted("I_CDCU_CycleEventCtrl1.I_CDCU_PsngrSeatLumbRelaxCmd 5:0 3;100;100"); // 预期结果 TC_CANTest CheckPeriod_FilterStarted I_CDCU_CycleEventCtrl1.I_CDCU_PsngrSeatLumbRelaxCmd 5:0 3;100;100
  g_EM_SOAClient_Swc_SOA_CHECK("Veh_SetPsngrSeatLumbRelaxRespStruct.Veh_SetPsngrSeatLumbRelaxNRC 0 traceback5"); // 预期结果 TC_CANTest SOA check Veh_SetPsngrSeatLumbRelaxRespStruct.Veh_SetPsngrSeatLumbRelaxNRC 0 traceback5
  g_CAN_Bus_Swc_Set("I_RDCU_SeatInfo2.I_RDCU_PsngrSeatLumbRelaxSts 3"); // 测试步骤 TC_CANTest SET I_RDCU_SeatInfo2.I_RDCU_PsngrSeatLumbRelaxSts 3
  g_EM_SOAClient_Swc_SOA_CHECK("Veh_SeatCtrlService_ErrStruct.OpeNRC 0 traceback7"); // 预期结果 TC_CANTest SOA check Veh_SeatCtrlService_ErrStruct.OpeNRC 0 traceback7
}

testcase SYS_CDCU_zhujiazuoyiyaobushuhuan_0186()
{
  TestDescription("主驾座椅腰部舒缓模式-1强度1");
  teststep("warning","原始用例id为SYS-CDCU-主驾座椅腰部舒缓-0186");
  g_CAN_Bus_Swc_Set("I_RDCU_SeatInfo2.I_RDCU_PsngrSeatLumbRelaxSts 0"); // 测试步骤 TC_CANTest SET I_RDCU_SeatInfo2.I_RDCU_PsngrSeatLumbRelaxSts 0
  g_CAN_Bus_Swc_Set("I_LDCU_SeatSysSts.I_LDCU_DrvSeatLumbRelaxSts 3"); // 测试步骤 TC_CANTest SET I_LDCU_SeatSysSts.I_LDCU_DrvSeatLumbRelaxSts 3
  g_CAN_Bus_Swc_CheckEventStart("I_CDCU_CycleEventCtrl1.I_CDCU_DrvSeatLumbRelaxIntensityCmd 1"); // 测试步骤 TC_CANTest CheckEventStart I_CDCU_CycleEventCtrl1.I_CDCU_DrvSeatLumbRelaxIntensityCmd 1
  g_EM_SOAClient_Swc_SOA_CHECK_Prepare("Veh_SetDrvSeatLumbRelaxIntenRespStruct.Veh_SetDrvSeatLumbRelaxIntenNRC 0 traceback5"); // 预期结果 TC_CANTest SOA check Veh_SetDrvSeatLumbRelaxIntenRespStruct.Veh_SetDrvSeatLumbRelaxIntenNRC 0 traceback5
  g_EM_SOAClient_Swc_SOA_CHECK_Prepare("Veh_SeatCtrlService_ErrStruct.OpeNRC 0 traceback7"); // 预期结果 TC_CANTest SOA check Veh_SeatCtrlService_ErrStruct.OpeNRC 0 traceback7
  g_EM_SOAClient_Swc_SOA_CHECK_Prepare("Veh_SeatLumbRelaxIntenStsStruct.Veh_DrvSeatLumbRelaxIntenSts 1 traceback5"); // 预期结果 TC_CANTest SOA check Veh_SeatLumbRelaxIntenStsStruct.Veh_DrvSeatLumbRelaxIntenSts 1 traceback5
  g_EM_SOAClient_Swc_SOA_REQ("Veh_SetDrvSeatLumbRelaxIntenReqStruct.Veh_DrvSeatLumbRelaxIntenReq:1&ServiceExecuteFeedbackFlag:2"); // 测试步骤 TC_CANTest SOA REQ Veh_SetDrvSeatLumbRelaxIntenReqStruct.Veh_DrvSeatLumbRelaxIntenReq:1&ServiceExecuteFeedbackFlag:2
  g_CAN_Bus_Swc_CheckPeriod_FilterStarted("I_CDCU_CycleEventCtrl1.I_CDCU_DrvSeatLumbRelaxIntensityCmd 1:0 3;100;100"); // 预期结果 TC_CANTest CheckPeriod_FilterStarted I_CDCU_CycleEventCtrl1.I_CDCU_DrvSeatLumbRelaxIntensityCmd 1:0 3;100;100
  g_EM_SOAClient_Swc_SOA_CHECK("Veh_SetDrvSeatLumbRelaxIntenRespStruct.Veh_SetDrvSeatLumbRelaxIntenNRC 0 traceback5"); // 预期结果 TC_CANTest SOA check Veh_SetDrvSeatLumbRelaxIntenRespStruct.Veh_SetDrvSeatLumbRelaxIntenNRC 0 traceback5
  g_CAN_Bus_Swc_Set("I_LDCU_SeatSysSts.I_LDCU_DrvSeatLumbRelaxIntenSts 1"); // 测试步骤 TC_CANTest SET I_LDCU_SeatSysSts.I_LDCU_DrvSeatLumbRelaxIntenSts 1
  g_EM_SOAClient_Swc_SOA_CHECK("Veh_SeatCtrlService_ErrStruct.OpeNRC 0 traceback7"); // 预期结果 TC_CANTest SOA check Veh_SeatCtrlService_ErrStruct.OpeNRC 0 traceback7
  g_EM_SOAClient_Swc_SOA_CHECK("Veh_SeatLumbRelaxIntenStsStruct.Veh_DrvSeatLumbRelaxIntenSts 1 traceback5"); // 预期结果 TC_CANTest SOA check Veh_SeatLumbRelaxIntenStsStruct.Veh_DrvSeatLumbRelaxIntenSts 1 traceback5
}

testcase SYS_CDCU_zhujiazuoyiyaobushuhuan_0187()
{
  TestDescription("主驾座椅腰部舒缓模式-1强度2");
  teststep("warning","原始用例id为SYS-CDCU-主驾座椅腰部舒缓-0187");
  g_CAN_Bus_Swc_Set("I_RDCU_SeatInfo2.I_RDCU_PsngrSeatLumbRelaxSts 0"); // 测试步骤 TC_CANTest SET I_RDCU_SeatInfo2.I_RDCU_PsngrSeatLumbRelaxSts 0
  g_CAN_Bus_Swc_Set("I_LDCU_SeatSysSts.I_LDCU_DrvSeatLumbRelaxSts 3"); // 测试步骤 TC_CANTest SET I_LDCU_SeatSysSts.I_LDCU_DrvSeatLumbRelaxSts 3
  g_CAN_Bus_Swc_CheckEventStart("I_CDCU_CycleEventCtrl1.I_CDCU_DrvSeatLumbRelaxIntensityCmd 2"); // 测试步骤 TC_CANTest CheckEventStart I_CDCU_CycleEventCtrl1.I_CDCU_DrvSeatLumbRelaxIntensityCmd 2
  g_EM_SOAClient_Swc_SOA_CHECK_Prepare("Veh_SetDrvSeatLumbRelaxIntenRespStruct.Veh_SetDrvSeatLumbRelaxIntenNRC 0 traceback5"); // 预期结果 TC_CANTest SOA check Veh_SetDrvSeatLumbRelaxIntenRespStruct.Veh_SetDrvSeatLumbRelaxIntenNRC 0 traceback5
  g_EM_SOAClient_Swc_SOA_CHECK_Prepare("Veh_SeatCtrlService_ErrStruct.OpeNRC 0 traceback7"); // 预期结果 TC_CANTest SOA check Veh_SeatCtrlService_ErrStruct.OpeNRC 0 traceback7
  g_EM_SOAClient_Swc_SOA_CHECK_Prepare("Veh_SeatLumbRelaxIntenStsStruct.Veh_DrvSeatLumbRelaxIntenSts 2 traceback5"); // 预期结果 TC_CANTest SOA check Veh_SeatLumbRelaxIntenStsStruct.Veh_DrvSeatLumbRelaxIntenSts 2 traceback5
  g_EM_SOAClient_Swc_SOA_REQ("Veh_SetDrvSeatLumbRelaxIntenReqStruct.Veh_DrvSeatLumbRelaxIntenReq:2&ServiceExecuteFeedbackFlag:2"); // 测试步骤 TC_CANTest SOA REQ Veh_SetDrvSeatLumbRelaxIntenReqStruct.Veh_DrvSeatLumbRelaxIntenReq:2&ServiceExecuteFeedbackFlag:2
  g_CAN_Bus_Swc_CheckPeriod_FilterStarted("I_CDCU_CycleEventCtrl1.I_CDCU_DrvSeatLumbRelaxIntensityCmd 2:0 3;100;100"); // 预期结果 TC_CANTest CheckPeriod_FilterStarted I_CDCU_CycleEventCtrl1.I_CDCU_DrvSeatLumbRelaxIntensityCmd 2:0 3;100;100
  g_EM_SOAClient_Swc_SOA_CHECK("Veh_SetDrvSeatLumbRelaxIntenRespStruct.Veh_SetDrvSeatLumbRelaxIntenNRC 0 traceback5"); // 预期结果 TC_CANTest SOA check Veh_SetDrvSeatLumbRelaxIntenRespStruct.Veh_SetDrvSeatLumbRelaxIntenNRC 0 traceback5
  g_CAN_Bus_Swc_Set("I_LDCU_SeatSysSts.I_LDCU_DrvSeatLumbRelaxIntenSts 2"); // 测试步骤 TC_CANTest SET I_LDCU_SeatSysSts.I_LDCU_DrvSeatLumbRelaxIntenSts 2
  g_EM_SOAClient_Swc_SOA_CHECK("Veh_SeatCtrlService_ErrStruct.OpeNRC 0 traceback7"); // 预期结果 TC_CANTest SOA check Veh_SeatCtrlService_ErrStruct.OpeNRC 0 traceback7
  g_EM_SOAClient_Swc_SOA_CHECK("Veh_SeatLumbRelaxIntenStsStruct.Veh_DrvSeatLumbRelaxIntenSts 2 traceback5"); // 预期结果 TC_CANTest SOA check Veh_SeatLumbRelaxIntenStsStruct.Veh_DrvSeatLumbRelaxIntenSts 2 traceback5
}

testcase SYS_CDCU_zhujiazuoyiyaobushuhuan_0188()
{
  TestDescription("主驾座椅腰部舒缓模式-1强度3");
  teststep("warning","原始用例id为SYS-CDCU-主驾座椅腰部舒缓-0188");
  g_CAN_Bus_Swc_Set("I_RDCU_SeatInfo2.I_RDCU_PsngrSeatLumbRelaxSts 0"); // 测试步骤 TC_CANTest SET I_RDCU_SeatInfo2.I_RDCU_PsngrSeatLumbRelaxSts 0
  g_CAN_Bus_Swc_Set("I_LDCU_SeatSysSts.I_LDCU_DrvSeatLumbRelaxSts 3"); // 测试步骤 TC_CANTest SET I_LDCU_SeatSysSts.I_LDCU_DrvSeatLumbRelaxSts 3
  g_CAN_Bus_Swc_CheckEventStart("I_CDCU_CycleEventCtrl1.I_CDCU_DrvSeatLumbRelaxIntensityCmd 3"); // 测试步骤 TC_CANTest CheckEventStart I_CDCU_CycleEventCtrl1.I_CDCU_DrvSeatLumbRelaxIntensityCmd 3
  g_EM_SOAClient_Swc_SOA_CHECK_Prepare("Veh_SetDrvSeatLumbRelaxIntenRespStruct.Veh_SetDrvSeatLumbRelaxIntenNRC 0 traceback5"); // 预期结果 TC_CANTest SOA check Veh_SetDrvSeatLumbRelaxIntenRespStruct.Veh_SetDrvSeatLumbRelaxIntenNRC 0 traceback5
  g_EM_SOAClient_Swc_SOA_CHECK_Prepare("Veh_SeatCtrlService_ErrStruct.OpeNRC 0 traceback7"); // 预期结果 TC_CANTest SOA check Veh_SeatCtrlService_ErrStruct.OpeNRC 0 traceback7
  g_EM_SOAClient_Swc_SOA_CHECK_Prepare("Veh_SeatLumbRelaxIntenStsStruct.Veh_DrvSeatLumbRelaxIntenSts 3 traceback5"); // 预期结果 TC_CANTest SOA check Veh_SeatLumbRelaxIntenStsStruct.Veh_DrvSeatLumbRelaxIntenSts 3 traceback5
  g_EM_SOAClient_Swc_SOA_REQ("Veh_SetDrvSeatLumbRelaxIntenReqStruct.Veh_DrvSeatLumbRelaxIntenReq:3&ServiceExecuteFeedbackFlag:2"); // 测试步骤 TC_CANTest SOA REQ Veh_SetDrvSeatLumbRelaxIntenReqStruct.Veh_DrvSeatLumbRelaxIntenReq:3&ServiceExecuteFeedbackFlag:2
  g_CAN_Bus_Swc_CheckPeriod_FilterStarted("I_CDCU_CycleEventCtrl1.I_CDCU_DrvSeatLumbRelaxIntensityCmd 3:0 3;100;100"); // 预期结果 TC_CANTest CheckPeriod_FilterStarted I_CDCU_CycleEventCtrl1.I_CDCU_DrvSeatLumbRelaxIntensityCmd 3:0 3;100;100
  g_EM_SOAClient_Swc_SOA_CHECK("Veh_SetDrvSeatLumbRelaxIntenRespStruct.Veh_SetDrvSeatLumbRelaxIntenNRC 0 traceback5"); // 预期结果 TC_CANTest SOA check Veh_SetDrvSeatLumbRelaxIntenRespStruct.Veh_SetDrvSeatLumbRelaxIntenNRC 0 traceback5
  g_CAN_Bus_Swc_Set("I_LDCU_SeatSysSts.I_LDCU_DrvSeatLumbRelaxIntenSts 3"); // 测试步骤 TC_CANTest SET I_LDCU_SeatSysSts.I_LDCU_DrvSeatLumbRelaxIntenSts 3
  g_EM_SOAClient_Swc_SOA_CHECK("Veh_SeatCtrlService_ErrStruct.OpeNRC 0 traceback7"); // 预期结果 TC_CANTest SOA check Veh_SeatCtrlService_ErrStruct.OpeNRC 0 traceback7
  g_EM_SOAClient_Swc_SOA_CHECK("Veh_SeatLumbRelaxIntenStsStruct.Veh_DrvSeatLumbRelaxIntenSts 3 traceback5"); // 预期结果 TC_CANTest SOA check Veh_SeatLumbRelaxIntenStsStruct.Veh_DrvSeatLumbRelaxIntenSts 3 traceback5
}

testcase SYS_CDCU_zhujiazuoyiyaobushuhuan_0189()
{
  TestDescription("主驾座椅腰部舒缓模式-1强度3-无效sts失败");
  teststep("warning","原始用例id为SYS-CDCU-主驾座椅腰部舒缓-0189");
  g_CAN_Bus_Swc_Set("I_RDCU_SeatInfo2.I_RDCU_PsngrSeatLumbRelaxSts 0"); // 测试步骤 TC_CANTest SET I_RDCU_SeatInfo2.I_RDCU_PsngrSeatLumbRelaxSts 0
  g_CAN_Bus_Swc_Set("I_LDCU_SeatSysSts.I_LDCU_DrvSeatLumbRelaxSts 0"); // 测试步骤 TC_CANTest SET I_LDCU_SeatSysSts.I_LDCU_DrvSeatLumbRelaxSts 0
  g_EM_SOAClient_Swc_SOA_CHECK_Prepare("Veh_SetDrvSeatLumbRelaxIntenRespStruct.Veh_SetDrvSeatLumbRelaxIntenNRC 0 traceback5"); // 预期结果 TC_CANTest SOA check Veh_SetDrvSeatLumbRelaxIntenRespStruct.Veh_SetDrvSeatLumbRelaxIntenNRC 0 traceback5
  g_EM_SOAClient_Swc_SOA_CHECK_Prepare("Veh_SeatCtrlService_ErrStruct.OpeNRC 255 traceback7"); // 预期结果 TC_CANTest SOA check Veh_SeatCtrlService_ErrStruct.OpeNRC 255 traceback7
  g_EM_SOAClient_Swc_SOA_REQ("Veh_SetDrvSeatLumbRelaxIntenReqStruct.Veh_DrvSeatLumbRelaxIntenReq:3&ServiceExecuteFeedbackFlag:2"); // 测试步骤 TC_CANTest SOA REQ Veh_SetDrvSeatLumbRelaxIntenReqStruct.Veh_DrvSeatLumbRelaxIntenReq:3&ServiceExecuteFeedbackFlag:2
  g_EM_SOAClient_Swc_SOA_CHECK("Veh_SetDrvSeatLumbRelaxIntenRespStruct.Veh_SetDrvSeatLumbRelaxIntenNRC 0 traceback5"); // 预期结果 TC_CANTest SOA check Veh_SetDrvSeatLumbRelaxIntenRespStruct.Veh_SetDrvSeatLumbRelaxIntenNRC 0 traceback5
  g_EM_SOAClient_Swc_SOA_CHECK("Veh_SeatCtrlService_ErrStruct.OpeNRC 255 traceback7"); // 预期结果 TC_CANTest SOA check Veh_SeatCtrlService_ErrStruct.OpeNRC 255 traceback7
}

testcase SYS_CDCU_zhujiazuoyiyaobushuhuan_0190()
{
  TestDescription("主驾座椅腰部舒缓模式-2强度1");
  teststep("warning","原始用例id为SYS-CDCU-主驾座椅腰部舒缓-0190");
  g_CAN_Bus_Swc_Set("I_RDCU_SeatInfo2.I_RDCU_PsngrSeatLumbRelaxSts 0"); // 测试步骤 TC_CANTest SET I_RDCU_SeatInfo2.I_RDCU_PsngrSeatLumbRelaxSts 0
  g_CAN_Bus_Swc_Set("I_LDCU_SeatSysSts.I_LDCU_DrvSeatLumbRelaxSts 4"); // 测试步骤 TC_CANTest SET I_LDCU_SeatSysSts.I_LDCU_DrvSeatLumbRelaxSts 4
  g_CAN_Bus_Swc_CheckEventStart("I_CDCU_CycleEventCtrl1.I_CDCU_DrvSeatLumbRelaxIntensityCmd 1"); // 测试步骤 TC_CANTest CheckEventStart I_CDCU_CycleEventCtrl1.I_CDCU_DrvSeatLumbRelaxIntensityCmd 1
  g_EM_SOAClient_Swc_SOA_CHECK_Prepare("Veh_SetDrvSeatLumbRelaxIntenRespStruct.Veh_SetDrvSeatLumbRelaxIntenNRC 0 traceback5"); // 预期结果 TC_CANTest SOA check Veh_SetDrvSeatLumbRelaxIntenRespStruct.Veh_SetDrvSeatLumbRelaxIntenNRC 0 traceback5
  g_EM_SOAClient_Swc_SOA_CHECK_Prepare("Veh_SeatCtrlService_ErrStruct.OpeNRC 0 traceback7"); // 预期结果 TC_CANTest SOA check Veh_SeatCtrlService_ErrStruct.OpeNRC 0 traceback7
  g_EM_SOAClient_Swc_SOA_CHECK_Prepare("Veh_SeatLumbRelaxIntenStsStruct.Veh_DrvSeatLumbRelaxIntenSts 1 traceback5"); // 预期结果 TC_CANTest SOA check Veh_SeatLumbRelaxIntenStsStruct.Veh_DrvSeatLumbRelaxIntenSts 1 traceback5
  g_EM_SOAClient_Swc_SOA_REQ("Veh_SetDrvSeatLumbRelaxIntenReqStruct.Veh_DrvSeatLumbRelaxIntenReq:1&ServiceExecuteFeedbackFlag:2"); // 测试步骤 TC_CANTest SOA REQ Veh_SetDrvSeatLumbRelaxIntenReqStruct.Veh_DrvSeatLumbRelaxIntenReq:1&ServiceExecuteFeedbackFlag:2
  g_CAN_Bus_Swc_CheckPeriod_FilterStarted("I_CDCU_CycleEventCtrl1.I_CDCU_DrvSeatLumbRelaxIntensityCmd 1:0 3;100;100"); // 预期结果 TC_CANTest CheckPeriod_FilterStarted I_CDCU_CycleEventCtrl1.I_CDCU_DrvSeatLumbRelaxIntensityCmd 1:0 3;100;100
  g_EM_SOAClient_Swc_SOA_CHECK("Veh_SetDrvSeatLumbRelaxIntenRespStruct.Veh_SetDrvSeatLumbRelaxIntenNRC 0 traceback5"); // 预期结果 TC_CANTest SOA check Veh_SetDrvSeatLumbRelaxIntenRespStruct.Veh_SetDrvSeatLumbRelaxIntenNRC 0 traceback5
  g_CAN_Bus_Swc_Set("I_LDCU_SeatSysSts.I_LDCU_DrvSeatLumbRelaxIntenSts 1"); // 测试步骤 TC_CANTest SET I_LDCU_SeatSysSts.I_LDCU_DrvSeatLumbRelaxIntenSts 1
  g_EM_SOAClient_Swc_SOA_CHECK("Veh_SeatCtrlService_ErrStruct.OpeNRC 0 traceback7"); // 预期结果 TC_CANTest SOA check Veh_SeatCtrlService_ErrStruct.OpeNRC 0 traceback7
  g_EM_SOAClient_Swc_SOA_CHECK("Veh_SeatLumbRelaxIntenStsStruct.Veh_DrvSeatLumbRelaxIntenSts 1 traceback5"); // 预期结果 TC_CANTest SOA check Veh_SeatLumbRelaxIntenStsStruct.Veh_DrvSeatLumbRelaxIntenSts 1 traceback5
}

testcase SYS_CDCU_zhujiazuoyiyaobushuhuan_0191()
{
  TestDescription("主驾座椅腰部舒缓模式-2强度2");
  teststep("warning","原始用例id为SYS-CDCU-主驾座椅腰部舒缓-0191");
  g_CAN_Bus_Swc_Set("I_RDCU_SeatInfo2.I_RDCU_PsngrSeatLumbRelaxSts 0"); // 测试步骤 TC_CANTest SET I_RDCU_SeatInfo2.I_RDCU_PsngrSeatLumbRelaxSts 0
  g_CAN_Bus_Swc_Set("I_LDCU_SeatSysSts.I_LDCU_DrvSeatLumbRelaxSts 4"); // 测试步骤 TC_CANTest SET I_LDCU_SeatSysSts.I_LDCU_DrvSeatLumbRelaxSts 4
  g_CAN_Bus_Swc_CheckEventStart("I_CDCU_CycleEventCtrl1.I_CDCU_DrvSeatLumbRelaxIntensityCmd 2"); // 测试步骤 TC_CANTest CheckEventStart I_CDCU_CycleEventCtrl1.I_CDCU_DrvSeatLumbRelaxIntensityCmd 2
  g_EM_SOAClient_Swc_SOA_CHECK_Prepare("Veh_SetDrvSeatLumbRelaxIntenRespStruct.Veh_SetDrvSeatLumbRelaxIntenNRC 0 traceback5"); // 预期结果 TC_CANTest SOA check Veh_SetDrvSeatLumbRelaxIntenRespStruct.Veh_SetDrvSeatLumbRelaxIntenNRC 0 traceback5
  g_EM_SOAClient_Swc_SOA_CHECK_Prepare("Veh_SeatCtrlService_ErrStruct.OpeNRC 0 traceback7"); // 预期结果 TC_CANTest SOA check Veh_SeatCtrlService_ErrStruct.OpeNRC 0 traceback7
  g_EM_SOAClient_Swc_SOA_CHECK_Prepare("Veh_SeatLumbRelaxIntenStsStruct.Veh_DrvSeatLumbRelaxIntenSts 2 traceback5"); // 预期结果 TC_CANTest SOA check Veh_SeatLumbRelaxIntenStsStruct.Veh_DrvSeatLumbRelaxIntenSts 2 traceback5
  g_EM_SOAClient_Swc_SOA_REQ("Veh_SetDrvSeatLumbRelaxIntenReqStruct.Veh_DrvSeatLumbRelaxIntenReq:2&ServiceExecuteFeedbackFlag:2"); // 测试步骤 TC_CANTest SOA REQ Veh_SetDrvSeatLumbRelaxIntenReqStruct.Veh_DrvSeatLumbRelaxIntenReq:2&ServiceExecuteFeedbackFlag:2
  g_CAN_Bus_Swc_CheckPeriod_FilterStarted("I_CDCU_CycleEventCtrl1.I_CDCU_DrvSeatLumbRelaxIntensityCmd 2:0 3;100;100"); // 预期结果 TC_CANTest CheckPeriod_FilterStarted I_CDCU_CycleEventCtrl1.I_CDCU_DrvSeatLumbRelaxIntensityCmd 2:0 3;100;100
  g_EM_SOAClient_Swc_SOA_CHECK("Veh_SetDrvSeatLumbRelaxIntenRespStruct.Veh_SetDrvSeatLumbRelaxIntenNRC 0 traceback5"); // 预期结果 TC_CANTest SOA check Veh_SetDrvSeatLumbRelaxIntenRespStruct.Veh_SetDrvSeatLumbRelaxIntenNRC 0 traceback5
  g_CAN_Bus_Swc_Set("I_LDCU_SeatSysSts.I_LDCU_DrvSeatLumbRelaxIntenSts 2"); // 测试步骤 TC_CANTest SET I_LDCU_SeatSysSts.I_LDCU_DrvSeatLumbRelaxIntenSts 2
  g_EM_SOAClient_Swc_SOA_CHECK("Veh_SeatCtrlService_ErrStruct.OpeNRC 0 traceback7"); // 预期结果 TC_CANTest SOA check Veh_SeatCtrlService_ErrStruct.OpeNRC 0 traceback7
  g_EM_SOAClient_Swc_SOA_CHECK("Veh_SeatLumbRelaxIntenStsStruct.Veh_DrvSeatLumbRelaxIntenSts 2 traceback5"); // 预期结果 TC_CANTest SOA check Veh_SeatLumbRelaxIntenStsStruct.Veh_DrvSeatLumbRelaxIntenSts 2 traceback5
}

testcase SYS_CDCU_zhujiazuoyiyaobushuhuan_0192()
{
  TestDescription("主驾座椅腰部舒缓模式-2强度3");
  teststep("warning","原始用例id为SYS-CDCU-主驾座椅腰部舒缓-0192");
  g_CAN_Bus_Swc_Set("I_RDCU_SeatInfo2.I_RDCU_PsngrSeatLumbRelaxSts 0"); // 测试步骤 TC_CANTest SET I_RDCU_SeatInfo2.I_RDCU_PsngrSeatLumbRelaxSts 0
  g_CAN_Bus_Swc_Set("I_LDCU_SeatSysSts.I_LDCU_DrvSeatLumbRelaxSts 4"); // 测试步骤 TC_CANTest SET I_LDCU_SeatSysSts.I_LDCU_DrvSeatLumbRelaxSts 4
  g_CAN_Bus_Swc_CheckEventStart("I_CDCU_CycleEventCtrl1.I_CDCU_DrvSeatLumbRelaxIntensityCmd 3"); // 测试步骤 TC_CANTest CheckEventStart I_CDCU_CycleEventCtrl1.I_CDCU_DrvSeatLumbRelaxIntensityCmd 3
  g_EM_SOAClient_Swc_SOA_CHECK_Prepare("Veh_SetDrvSeatLumbRelaxIntenRespStruct.Veh_SetDrvSeatLumbRelaxIntenNRC 0 traceback5"); // 预期结果 TC_CANTest SOA check Veh_SetDrvSeatLumbRelaxIntenRespStruct.Veh_SetDrvSeatLumbRelaxIntenNRC 0 traceback5
  g_EM_SOAClient_Swc_SOA_CHECK_Prepare("Veh_SeatCtrlService_ErrStruct.OpeNRC 0 traceback7"); // 预期结果 TC_CANTest SOA check Veh_SeatCtrlService_ErrStruct.OpeNRC 0 traceback7
  g_EM_SOAClient_Swc_SOA_CHECK_Prepare("Veh_SeatLumbRelaxIntenStsStruct.Veh_DrvSeatLumbRelaxIntenSts 3 traceback5"); // 预期结果 TC_CANTest SOA check Veh_SeatLumbRelaxIntenStsStruct.Veh_DrvSeatLumbRelaxIntenSts 3 traceback5
  g_EM_SOAClient_Swc_SOA_REQ("Veh_SetDrvSeatLumbRelaxIntenReqStruct.Veh_DrvSeatLumbRelaxIntenReq:3&ServiceExecuteFeedbackFlag:2"); // 测试步骤 TC_CANTest SOA REQ Veh_SetDrvSeatLumbRelaxIntenReqStruct.Veh_DrvSeatLumbRelaxIntenReq:3&ServiceExecuteFeedbackFlag:2
  g_CAN_Bus_Swc_CheckPeriod_FilterStarted("I_CDCU_CycleEventCtrl1.I_CDCU_DrvSeatLumbRelaxIntensityCmd 3:0 3;100;100"); // 预期结果 TC_CANTest CheckPeriod_FilterStarted I_CDCU_CycleEventCtrl1.I_CDCU_DrvSeatLumbRelaxIntensityCmd 3:0 3;100;100
  g_EM_SOAClient_Swc_SOA_CHECK("Veh_SetDrvSeatLumbRelaxIntenRespStruct.Veh_SetDrvSeatLumbRelaxIntenNRC 0 traceback5"); // 预期结果 TC_CANTest SOA check Veh_SetDrvSeatLumbRelaxIntenRespStruct.Veh_SetDrvSeatLumbRelaxIntenNRC 0 traceback5
  g_CAN_Bus_Swc_Set("I_LDCU_SeatSysSts.I_LDCU_DrvSeatLumbRelaxIntenSts 3"); // 测试步骤 TC_CANTest SET I_LDCU_SeatSysSts.I_LDCU_DrvSeatLumbRelaxIntenSts 3
  g_EM_SOAClient_Swc_SOA_CHECK("Veh_SeatCtrlService_ErrStruct.OpeNRC 0 traceback7"); // 预期结果 TC_CANTest SOA check Veh_SeatCtrlService_ErrStruct.OpeNRC 0 traceback7
  g_EM_SOAClient_Swc_SOA_CHECK("Veh_SeatLumbRelaxIntenStsStruct.Veh_DrvSeatLumbRelaxIntenSts 3 traceback5"); // 预期结果 TC_CANTest SOA check Veh_SeatLumbRelaxIntenStsStruct.Veh_DrvSeatLumbRelaxIntenSts 3 traceback5
}

testcase SYS_CDCU_zhujiazuoyiyaobushuhuan_0193()
{
  TestDescription("主驾座椅腰部舒缓模式-3强度1");
  teststep("warning","原始用例id为SYS-CDCU-主驾座椅腰部舒缓-0193");
  g_CAN_Bus_Swc_Set("I_RDCU_SeatInfo2.I_RDCU_PsngrSeatLumbRelaxSts 0"); // 测试步骤 TC_CANTest SET I_RDCU_SeatInfo2.I_RDCU_PsngrSeatLumbRelaxSts 0
  g_CAN_Bus_Swc_Set("I_LDCU_SeatSysSts.I_LDCU_DrvSeatLumbRelaxSts 5"); // 测试步骤 TC_CANTest SET I_LDCU_SeatSysSts.I_LDCU_DrvSeatLumbRelaxSts 5
  g_CAN_Bus_Swc_CheckEventStart("I_CDCU_CycleEventCtrl1.I_CDCU_DrvSeatLumbRelaxIntensityCmd 1"); // 测试步骤 TC_CANTest CheckEventStart I_CDCU_CycleEventCtrl1.I_CDCU_DrvSeatLumbRelaxIntensityCmd 1
  g_EM_SOAClient_Swc_SOA_CHECK_Prepare("Veh_SetDrvSeatLumbRelaxIntenRespStruct.Veh_SetDrvSeatLumbRelaxIntenNRC 0 traceback5"); // 预期结果 TC_CANTest SOA check Veh_SetDrvSeatLumbRelaxIntenRespStruct.Veh_SetDrvSeatLumbRelaxIntenNRC 0 traceback5
  g_EM_SOAClient_Swc_SOA_CHECK_Prepare("Veh_SeatCtrlService_ErrStruct.OpeNRC 0 traceback7"); // 预期结果 TC_CANTest SOA check Veh_SeatCtrlService_ErrStruct.OpeNRC 0 traceback7
  g_EM_SOAClient_Swc_SOA_CHECK_Prepare("Veh_SeatLumbRelaxIntenStsStruct.Veh_DrvSeatLumbRelaxIntenSts 1 traceback5"); // 预期结果 TC_CANTest SOA check Veh_SeatLumbRelaxIntenStsStruct.Veh_DrvSeatLumbRelaxIntenSts 1 traceback5
  g_EM_SOAClient_Swc_SOA_REQ("Veh_SetDrvSeatLumbRelaxIntenReqStruct.Veh_DrvSeatLumbRelaxIntenReq:1&ServiceExecuteFeedbackFlag:2"); // 测试步骤 TC_CANTest SOA REQ Veh_SetDrvSeatLumbRelaxIntenReqStruct.Veh_DrvSeatLumbRelaxIntenReq:1&ServiceExecuteFeedbackFlag:2
  g_CAN_Bus_Swc_CheckPeriod_FilterStarted("I_CDCU_CycleEventCtrl1.I_CDCU_DrvSeatLumbRelaxIntensityCmd 1:0 3;100;100"); // 预期结果 TC_CANTest CheckPeriod_FilterStarted I_CDCU_CycleEventCtrl1.I_CDCU_DrvSeatLumbRelaxIntensityCmd 1:0 3;100;100
  g_EM_SOAClient_Swc_SOA_CHECK("Veh_SetDrvSeatLumbRelaxIntenRespStruct.Veh_SetDrvSeatLumbRelaxIntenNRC 0 traceback5"); // 预期结果 TC_CANTest SOA check Veh_SetDrvSeatLumbRelaxIntenRespStruct.Veh_SetDrvSeatLumbRelaxIntenNRC 0 traceback5
  g_CAN_Bus_Swc_Set("I_LDCU_SeatSysSts.I_LDCU_DrvSeatLumbRelaxIntenSts 1"); // 测试步骤 TC_CANTest SET I_LDCU_SeatSysSts.I_LDCU_DrvSeatLumbRelaxIntenSts 1
  g_EM_SOAClient_Swc_SOA_CHECK("Veh_SeatCtrlService_ErrStruct.OpeNRC 0 traceback7"); // 预期结果 TC_CANTest SOA check Veh_SeatCtrlService_ErrStruct.OpeNRC 0 traceback7
  g_EM_SOAClient_Swc_SOA_CHECK("Veh_SeatLumbRelaxIntenStsStruct.Veh_DrvSeatLumbRelaxIntenSts 1 traceback5"); // 预期结果 TC_CANTest SOA check Veh_SeatLumbRelaxIntenStsStruct.Veh_DrvSeatLumbRelaxIntenSts 1 traceback5
}

testcase SYS_CDCU_zhujiazuoyiyaobushuhuan_0194()
{
  TestDescription("主驾座椅腰部舒缓模式-3强度2");
  teststep("warning","原始用例id为SYS-CDCU-主驾座椅腰部舒缓-0194");
  g_CAN_Bus_Swc_Set("I_RDCU_SeatInfo2.I_RDCU_PsngrSeatLumbRelaxSts 0"); // 测试步骤 TC_CANTest SET I_RDCU_SeatInfo2.I_RDCU_PsngrSeatLumbRelaxSts 0
  g_CAN_Bus_Swc_Set("I_LDCU_SeatSysSts.I_LDCU_DrvSeatLumbRelaxSts 5"); // 测试步骤 TC_CANTest SET I_LDCU_SeatSysSts.I_LDCU_DrvSeatLumbRelaxSts 5
  g_CAN_Bus_Swc_CheckEventStart("I_CDCU_CycleEventCtrl1.I_CDCU_DrvSeatLumbRelaxIntensityCmd 2"); // 测试步骤 TC_CANTest CheckEventStart I_CDCU_CycleEventCtrl1.I_CDCU_DrvSeatLumbRelaxIntensityCmd 2
  g_EM_SOAClient_Swc_SOA_CHECK_Prepare("Veh_SetDrvSeatLumbRelaxIntenRespStruct.Veh_SetDrvSeatLumbRelaxIntenNRC 0 traceback5"); // 预期结果 TC_CANTest SOA check Veh_SetDrvSeatLumbRelaxIntenRespStruct.Veh_SetDrvSeatLumbRelaxIntenNRC 0 traceback5
  g_EM_SOAClient_Swc_SOA_CHECK_Prepare("Veh_SeatCtrlService_ErrStruct.OpeNRC 0 traceback7"); // 预期结果 TC_CANTest SOA check Veh_SeatCtrlService_ErrStruct.OpeNRC 0 traceback7
  g_EM_SOAClient_Swc_SOA_CHECK_Prepare("Veh_SeatLumbRelaxIntenStsStruct.Veh_DrvSeatLumbRelaxIntenSts 2 traceback5"); // 预期结果 TC_CANTest SOA check Veh_SeatLumbRelaxIntenStsStruct.Veh_DrvSeatLumbRelaxIntenSts 2 traceback5
  g_EM_SOAClient_Swc_SOA_REQ("Veh_SetDrvSeatLumbRelaxIntenReqStruct.Veh_DrvSeatLumbRelaxIntenReq:2&ServiceExecuteFeedbackFlag:2"); // 测试步骤 TC_CANTest SOA REQ Veh_SetDrvSeatLumbRelaxIntenReqStruct.Veh_DrvSeatLumbRelaxIntenReq:2&ServiceExecuteFeedbackFlag:2
  g_CAN_Bus_Swc_CheckPeriod_FilterStarted("I_CDCU_CycleEventCtrl1.I_CDCU_DrvSeatLumbRelaxIntensityCmd 2:0 3;100;100"); // 预期结果 TC_CANTest CheckPeriod_FilterStarted I_CDCU_CycleEventCtrl1.I_CDCU_DrvSeatLumbRelaxIntensityCmd 2:0 3;100;100
  g_EM_SOAClient_Swc_SOA_CHECK("Veh_SetDrvSeatLumbRelaxIntenRespStruct.Veh_SetDrvSeatLumbRelaxIntenNRC 0 traceback5"); // 预期结果 TC_CANTest SOA check Veh_SetDrvSeatLumbRelaxIntenRespStruct.Veh_SetDrvSeatLumbRelaxIntenNRC 0 traceback5
  g_CAN_Bus_Swc_Set("I_LDCU_SeatSysSts.I_LDCU_DrvSeatLumbRelaxIntenSts 2"); // 测试步骤 TC_CANTest SET I_LDCU_SeatSysSts.I_LDCU_DrvSeatLumbRelaxIntenSts 2
  g_EM_SOAClient_Swc_SOA_CHECK("Veh_SeatCtrlService_ErrStruct.OpeNRC 0 traceback7"); // 预期结果 TC_CANTest SOA check Veh_SeatCtrlService_ErrStruct.OpeNRC 0 traceback7
  g_EM_SOAClient_Swc_SOA_CHECK("Veh_SeatLumbRelaxIntenStsStruct.Veh_DrvSeatLumbRelaxIntenSts 2 traceback5"); // 预期结果 TC_CANTest SOA check Veh_SeatLumbRelaxIntenStsStruct.Veh_DrvSeatLumbRelaxIntenSts 2 traceback5
}

testcase SYS_CDCU_zhujiazuoyiyaobushuhuan_0195()
{
  TestDescription("主驾座椅腰部舒缓模式-3强度3");
  teststep("warning","原始用例id为SYS-CDCU-主驾座椅腰部舒缓-0195");
  g_CAN_Bus_Swc_Set("I_RDCU_SeatInfo2.I_RDCU_PsngrSeatLumbRelaxSts 0"); // 测试步骤 TC_CANTest SET I_RDCU_SeatInfo2.I_RDCU_PsngrSeatLumbRelaxSts 0
  g_CAN_Bus_Swc_Set("I_LDCU_SeatSysSts.I_LDCU_DrvSeatLumbRelaxSts 5"); // 测试步骤 TC_CANTest SET I_LDCU_SeatSysSts.I_LDCU_DrvSeatLumbRelaxSts 5
  g_CAN_Bus_Swc_CheckEventStart("I_CDCU_CycleEventCtrl1.I_CDCU_DrvSeatLumbRelaxIntensityCmd 3"); // 测试步骤 TC_CANTest CheckEventStart I_CDCU_CycleEventCtrl1.I_CDCU_DrvSeatLumbRelaxIntensityCmd 3
  g_EM_SOAClient_Swc_SOA_CHECK_Prepare("Veh_SetDrvSeatLumbRelaxIntenRespStruct.Veh_SetDrvSeatLumbRelaxIntenNRC 0 traceback5"); // 预期结果 TC_CANTest SOA check Veh_SetDrvSeatLumbRelaxIntenRespStruct.Veh_SetDrvSeatLumbRelaxIntenNRC 0 traceback5
  g_EM_SOAClient_Swc_SOA_CHECK_Prepare("Veh_SeatCtrlService_ErrStruct.OpeNRC 0 traceback7"); // 预期结果 TC_CANTest SOA check Veh_SeatCtrlService_ErrStruct.OpeNRC 0 traceback7
  g_EM_SOAClient_Swc_SOA_CHECK_Prepare("Veh_SeatLumbRelaxIntenStsStruct.Veh_DrvSeatLumbRelaxIntenSts 3 traceback5"); // 预期结果 TC_CANTest SOA check Veh_SeatLumbRelaxIntenStsStruct.Veh_DrvSeatLumbRelaxIntenSts 3 traceback5
  g_EM_SOAClient_Swc_SOA_REQ("Veh_SetDrvSeatLumbRelaxIntenReqStruct.Veh_DrvSeatLumbRelaxIntenReq:3&ServiceExecuteFeedbackFlag:2"); // 测试步骤 TC_CANTest SOA REQ Veh_SetDrvSeatLumbRelaxIntenReqStruct.Veh_DrvSeatLumbRelaxIntenReq:3&ServiceExecuteFeedbackFlag:2
  g_CAN_Bus_Swc_CheckPeriod_FilterStarted("I_CDCU_CycleEventCtrl1.I_CDCU_DrvSeatLumbRelaxIntensityCmd 3:0 3;100;100"); // 预期结果 TC_CANTest CheckPeriod_FilterStarted I_CDCU_CycleEventCtrl1.I_CDCU_DrvSeatLumbRelaxIntensityCmd 3:0 3;100;100
  g_EM_SOAClient_Swc_SOA_CHECK("Veh_SetDrvSeatLumbRelaxIntenRespStruct.Veh_SetDrvSeatLumbRelaxIntenNRC 0 traceback5"); // 预期结果 TC_CANTest SOA check Veh_SetDrvSeatLumbRelaxIntenRespStruct.Veh_SetDrvSeatLumbRelaxIntenNRC 0 traceback5
  g_CAN_Bus_Swc_Set("I_LDCU_SeatSysSts.I_LDCU_DrvSeatLumbRelaxIntenSts 3"); // 测试步骤 TC_CANTest SET I_LDCU_SeatSysSts.I_LDCU_DrvSeatLumbRelaxIntenSts 3
  g_EM_SOAClient_Swc_SOA_CHECK("Veh_SeatCtrlService_ErrStruct.OpeNRC 0 traceback7"); // 预期结果 TC_CANTest SOA check Veh_SeatCtrlService_ErrStruct.OpeNRC 0 traceback7
  g_EM_SOAClient_Swc_SOA_CHECK("Veh_SeatLumbRelaxIntenStsStruct.Veh_DrvSeatLumbRelaxIntenSts 3 traceback5"); // 预期结果 TC_CANTest SOA check Veh_SeatLumbRelaxIntenStsStruct.Veh_DrvSeatLumbRelaxIntenSts 3 traceback5
}

testcase SYS_CDCU_fujiazuoyiyaobushuhuan_0196()
{
  TestDescription("副驾座椅腰部舒缓模式-1强度1");
  teststep("warning","原始用例id为SYS-CDCU-副驾座椅腰部舒缓-0196");
  g_CAN_Bus_Swc_Set("I_RDCU_SeatInfo2.I_RDCU_PsngrSeatLumbRelaxSts 3"); // 测试步骤 TC_CANTest SET I_RDCU_SeatInfo2.I_RDCU_PsngrSeatLumbRelaxSts 3
  g_CAN_Bus_Swc_Set("I_LDCU_SeatSysSts.I_LDCU_DrvSeatLumbRelaxSts 0"); // 测试步骤 TC_CANTest SET I_LDCU_SeatSysSts.I_LDCU_DrvSeatLumbRelaxSts 0
  g_CAN_Bus_Swc_CheckEventStart("I_CDCU_CycleEventCtrl1.I_CDCU_PsSeatLumbRelaxIntenCmd 1"); // 测试步骤 TC_CANTest CheckEventStart I_CDCU_CycleEventCtrl1.I_CDCU_PsSeatLumbRelaxIntenCmd 1
  g_EM_SOAClient_Swc_SOA_CHECK_Prepare("Veh_SetPsSeatLumbRelaxIntenRespStruct.Veh_SetPsSeatLumbRelaxIntenNRC 0 traceback5"); // 预期结果 TC_CANTest SOA check Veh_SetPsSeatLumbRelaxIntenRespStruct.Veh_SetPsSeatLumbRelaxIntenNRC 0 traceback5
  g_EM_SOAClient_Swc_SOA_CHECK_Prepare("Veh_SeatCtrlService_ErrStruct.OpeNRC 0 traceback7"); // 预期结果 TC_CANTest SOA check Veh_SeatCtrlService_ErrStruct.OpeNRC 0 traceback7
  g_EM_SOAClient_Swc_SOA_CHECK_Prepare("Veh_SeatLumbRelaxIntenStsStruct.Veh_PsSeatLumbRelaxIntenSts 1 traceback5"); // 预期结果 TC_CANTest SOA check Veh_SeatLumbRelaxIntenStsStruct.Veh_PsSeatLumbRelaxIntenSts 1 traceback5
  g_EM_SOAClient_Swc_SOA_REQ("Veh_SetPsSeatLumbRelaxIntenReqStruct.Veh_PsSeatLumbRelaxIntenReq:1&ServiceExecuteFeedbackFlag:2"); // 测试步骤 TC_CANTest SOA REQ Veh_SetPsSeatLumbRelaxIntenReqStruct.Veh_PsSeatLumbRelaxIntenReq:1&ServiceExecuteFeedbackFlag:2
  g_CAN_Bus_Swc_CheckPeriod_FilterStarted("I_CDCU_CycleEventCtrl1.I_CDCU_PsSeatLumbRelaxIntenCmd 1:0 3;100;100"); // 预期结果 TC_CANTest CheckPeriod_FilterStarted I_CDCU_CycleEventCtrl1.I_CDCU_PsSeatLumbRelaxIntenCmd 1:0 3;100;100
  g_EM_SOAClient_Swc_SOA_CHECK("Veh_SetPsSeatLumbRelaxIntenRespStruct.Veh_SetPsSeatLumbRelaxIntenNRC 0 traceback5"); // 预期结果 TC_CANTest SOA check Veh_SetPsSeatLumbRelaxIntenRespStruct.Veh_SetPsSeatLumbRelaxIntenNRC 0 traceback5
  g_CAN_Bus_Swc_Set("I_RDCU_SeatInfo2.I_RDCU_PsSeatLumbRelaxIntenSts 1"); // 测试步骤 TC_CANTest SET I_RDCU_SeatInfo2.I_RDCU_PsSeatLumbRelaxIntenSts 1
  g_EM_SOAClient_Swc_SOA_CHECK("Veh_SeatCtrlService_ErrStruct.OpeNRC 0 traceback7"); // 预期结果 TC_CANTest SOA check Veh_SeatCtrlService_ErrStruct.OpeNRC 0 traceback7
  g_EM_SOAClient_Swc_SOA_CHECK("Veh_SeatLumbRelaxIntenStsStruct.Veh_PsSeatLumbRelaxIntenSts 1 traceback5"); // 预期结果 TC_CANTest SOA check Veh_SeatLumbRelaxIntenStsStruct.Veh_PsSeatLumbRelaxIntenSts 1 traceback5
}

testcase SYS_CDCU_fujiazuoyiyaobushuhuan_0197()
{
  TestDescription("副驾座椅腰部舒缓模式-2强度2");
  teststep("warning","原始用例id为SYS-CDCU-副驾座椅腰部舒缓-0197");
  g_CAN_Bus_Swc_Set("I_RDCU_SeatInfo2.I_RDCU_PsngrSeatLumbRelaxSts 4"); // 测试步骤 TC_CANTest SET I_RDCU_SeatInfo2.I_RDCU_PsngrSeatLumbRelaxSts 4
  g_CAN_Bus_Swc_Set("I_LDCU_SeatSysSts.I_LDCU_DrvSeatLumbRelaxSts 0"); // 测试步骤 TC_CANTest SET I_LDCU_SeatSysSts.I_LDCU_DrvSeatLumbRelaxSts 0
  g_CAN_Bus_Swc_CheckEventStart("I_CDCU_CycleEventCtrl1.I_CDCU_PsSeatLumbRelaxIntenCmd 2"); // 测试步骤 TC_CANTest CheckEventStart I_CDCU_CycleEventCtrl1.I_CDCU_PsSeatLumbRelaxIntenCmd 2
  g_EM_SOAClient_Swc_SOA_CHECK_Prepare("Veh_SetPsSeatLumbRelaxIntenRespStruct.Veh_SetPsSeatLumbRelaxIntenNRC 0 traceback5"); // 预期结果 TC_CANTest SOA check Veh_SetPsSeatLumbRelaxIntenRespStruct.Veh_SetPsSeatLumbRelaxIntenNRC 0 traceback5
  g_EM_SOAClient_Swc_SOA_CHECK_Prepare("Veh_SeatCtrlService_ErrStruct.OpeNRC 0 traceback7"); // 预期结果 TC_CANTest SOA check Veh_SeatCtrlService_ErrStruct.OpeNRC 0 traceback7
  g_EM_SOAClient_Swc_SOA_CHECK_Prepare("Veh_SeatLumbRelaxIntenStsStruct.Veh_PsSeatLumbRelaxIntenSts 2 traceback5"); // 预期结果 TC_CANTest SOA check Veh_SeatLumbRelaxIntenStsStruct.Veh_PsSeatLumbRelaxIntenSts 2 traceback5
  g_EM_SOAClient_Swc_SOA_REQ("Veh_SetPsSeatLumbRelaxIntenReqStruct.Veh_PsSeatLumbRelaxIntenReq:2&ServiceExecuteFeedbackFlag:2"); // 测试步骤 TC_CANTest SOA REQ Veh_SetPsSeatLumbRelaxIntenReqStruct.Veh_PsSeatLumbRelaxIntenReq:2&ServiceExecuteFeedbackFlag:2
  g_CAN_Bus_Swc_CheckPeriod_FilterStarted("I_CDCU_CycleEventCtrl1.I_CDCU_PsSeatLumbRelaxIntenCmd 2:0 3;100;100"); // 预期结果 TC_CANTest CheckPeriod_FilterStarted I_CDCU_CycleEventCtrl1.I_CDCU_PsSeatLumbRelaxIntenCmd 2:0 3;100;100
  g_EM_SOAClient_Swc_SOA_CHECK("Veh_SetPsSeatLumbRelaxIntenRespStruct.Veh_SetPsSeatLumbRelaxIntenNRC 0 traceback5"); // 预期结果 TC_CANTest SOA check Veh_SetPsSeatLumbRelaxIntenRespStruct.Veh_SetPsSeatLumbRelaxIntenNRC 0 traceback5
  g_CAN_Bus_Swc_Set("I_RDCU_SeatInfo2.I_RDCU_PsSeatLumbRelaxIntenSts 2"); // 测试步骤 TC_CANTest SET I_RDCU_SeatInfo2.I_RDCU_PsSeatLumbRelaxIntenSts 2
  g_EM_SOAClient_Swc_SOA_CHECK("Veh_SeatCtrlService_ErrStruct.OpeNRC 0 traceback7"); // 预期结果 TC_CANTest SOA check Veh_SeatCtrlService_ErrStruct.OpeNRC 0 traceback7
  g_EM_SOAClient_Swc_SOA_CHECK("Veh_SeatLumbRelaxIntenStsStruct.Veh_PsSeatLumbRelaxIntenSts 2 traceback5"); // 预期结果 TC_CANTest SOA check Veh_SeatLumbRelaxIntenStsStruct.Veh_PsSeatLumbRelaxIntenSts 2 traceback5
}

testcase SYS_CDCU_fujiazuoyiyaobushuhuan_0198()
{
  TestDescription("副驾座椅腰部舒缓模式-3强度3");
  teststep("warning","原始用例id为SYS-CDCU-副驾座椅腰部舒缓-0198");
  g_CAN_Bus_Swc_Set("I_RDCU_SeatInfo2.I_RDCU_PsngrSeatLumbRelaxSts 5"); // 测试步骤 TC_CANTest SET I_RDCU_SeatInfo2.I_RDCU_PsngrSeatLumbRelaxSts 5
  g_CAN_Bus_Swc_Set("I_LDCU_SeatSysSts.I_LDCU_DrvSeatLumbRelaxSts 0"); // 测试步骤 TC_CANTest SET I_LDCU_SeatSysSts.I_LDCU_DrvSeatLumbRelaxSts 0
  g_CAN_Bus_Swc_CheckEventStart("I_CDCU_CycleEventCtrl1.I_CDCU_PsSeatLumbRelaxIntenCmd 3"); // 测试步骤 TC_CANTest CheckEventStart I_CDCU_CycleEventCtrl1.I_CDCU_PsSeatLumbRelaxIntenCmd 3
  g_EM_SOAClient_Swc_SOA_CHECK_Prepare("Veh_SetPsSeatLumbRelaxIntenRespStruct.Veh_SetPsSeatLumbRelaxIntenNRC 0 traceback5"); // 预期结果 TC_CANTest SOA check Veh_SetPsSeatLumbRelaxIntenRespStruct.Veh_SetPsSeatLumbRelaxIntenNRC 0 traceback5
  g_EM_SOAClient_Swc_SOA_CHECK_Prepare("Veh_SeatCtrlService_ErrStruct.OpeNRC 0 traceback7"); // 预期结果 TC_CANTest SOA check Veh_SeatCtrlService_ErrStruct.OpeNRC 0 traceback7
  g_EM_SOAClient_Swc_SOA_CHECK_Prepare("Veh_SeatLumbRelaxIntenStsStruct.Veh_PsSeatLumbRelaxIntenSts 3 traceback5"); // 预期结果 TC_CANTest SOA check Veh_SeatLumbRelaxIntenStsStruct.Veh_PsSeatLumbRelaxIntenSts 3 traceback5
  g_EM_SOAClient_Swc_SOA_REQ("Veh_SetPsSeatLumbRelaxIntenReqStruct.Veh_PsSeatLumbRelaxIntenReq:3&ServiceExecuteFeedbackFlag:2"); // 测试步骤 TC_CANTest SOA REQ Veh_SetPsSeatLumbRelaxIntenReqStruct.Veh_PsSeatLumbRelaxIntenReq:3&ServiceExecuteFeedbackFlag:2
  g_CAN_Bus_Swc_CheckPeriod_FilterStarted("I_CDCU_CycleEventCtrl1.I_CDCU_PsSeatLumbRelaxIntenCmd 3:0 3;100;100"); // 预期结果 TC_CANTest CheckPeriod_FilterStarted I_CDCU_CycleEventCtrl1.I_CDCU_PsSeatLumbRelaxIntenCmd 3:0 3;100;100
  g_EM_SOAClient_Swc_SOA_CHECK("Veh_SetPsSeatLumbRelaxIntenRespStruct.Veh_SetPsSeatLumbRelaxIntenNRC 0 traceback5"); // 预期结果 TC_CANTest SOA check Veh_SetPsSeatLumbRelaxIntenRespStruct.Veh_SetPsSeatLumbRelaxIntenNRC 0 traceback5
  g_CAN_Bus_Swc_Set("I_RDCU_SeatInfo2.I_RDCU_PsSeatLumbRelaxIntenSts 3"); // 测试步骤 TC_CANTest SET I_RDCU_SeatInfo2.I_RDCU_PsSeatLumbRelaxIntenSts 3
  g_EM_SOAClient_Swc_SOA_CHECK("Veh_SeatCtrlService_ErrStruct.OpeNRC 0 traceback7"); // 预期结果 TC_CANTest SOA check Veh_SeatCtrlService_ErrStruct.OpeNRC 0 traceback7
  g_EM_SOAClient_Swc_SOA_CHECK("Veh_SeatLumbRelaxIntenStsStruct.Veh_PsSeatLumbRelaxIntenSts 3 traceback5"); // 预期结果 TC_CANTest SOA check Veh_SeatLumbRelaxIntenStsStruct.Veh_PsSeatLumbRelaxIntenSts 3 traceback5
}

testcase SYS_CDCU_zhujiazuoyitongfengjiarejiyi_0199()
{
  TestDescription("主驾座椅通风加热记忆-1");
  teststep("warning","原始用例id为SYS-CDCU-主驾座椅通风加热记忆-0199");
  g_EM_Equipment_Swc_TC_IG("ON"); // 测试步骤 TC_IG ON
  g_CAN_Bus_Swc_Set("I_LDCU_BodySysSt1.I_LDCU_PowerMode 1"); // 测试步骤 TC_CANTest SET I_LDCU_BodySysSt1.I_LDCU_PowerMode 1
  gTC_CANTest_SOA_SetSever("DrvSeatFuncStStruct.DrvSeatVentilationSt:1"); // 测试步骤 TC_CANTest SOA SetServer DrvSeatFuncStStruct.DrvSeatVentilationSt:1
  gTC_CANTest_SOA_SetSever("DrvSeatFuncStStruct.DrvSeatHeatSt:1"); // 测试步骤 TC_CANTest SOA SetServer DrvSeatFuncStStruct.DrvSeatHeatSt:1
  g_EM_Equipment_Swc_TC_4G_Time_Delay_Second("1"); // 测试步骤 TC_Sleep 1
  g_EM_Equipment_Swc_TC_IG("OFF"); // 测试步骤 TC_IG OFF
  gTC_CANTest_SOA_CheckReq_Prepare("SetDrvSeatVentilationStruct.DrvSeatVentilationReq 4 traceback2"); // 预期结果 TC_CANTest SOA CheckReq SetDrvSeatVentilationStruct.DrvSeatVentilationReq 4 traceback2
  gTC_CANTest_SOA_CheckReq_Prepare("SetDrvSeatHeatingStruct.DrvSeatHeatingReq 4 traceback2"); // 预期结果 TC_CANTest SOA CheckReq SetDrvSeatHeatingStruct.DrvSeatHeatingReq 4 traceback2
  g_CAN_Bus_Swc_Set("I_LDCU_BodySysSt1.I_LDCU_PowerMode 0"); // 测试步骤 TC_CANTest SET I_LDCU_BodySysSt1.I_LDCU_PowerMode 0
  gTC_CANTest_SOA_CheckReq("SetDrvSeatVentilationStruct.DrvSeatVentilationReq 4 traceback2"); // 预期结果 TC_CANTest SOA CheckReq SetDrvSeatVentilationStruct.DrvSeatVentilationReq 4 traceback2
  gTC_CANTest_SOA_CheckReq("SetDrvSeatHeatingStruct.DrvSeatHeatingReq 4 traceback2"); // 预期结果 TC_CANTest SOA CheckReq SetDrvSeatHeatingStruct.DrvSeatHeatingReq 4 traceback2
  g_EM_Equipment_Swc_TC_4G_Time_Delay_Second("2"); // 测试步骤 TC_Sleep 2
  g_EM_Equipment_Swc_TC_IG("ON"); // 测试步骤 TC_IG ON
  gTC_CANTest_SOA_CheckReq_Prepare("SetDrvSeatVentilationStruct.DrvSeatVentilationReq 1 traceback2"); // 预期结果 TC_CANTest SOA CheckReq SetDrvSeatVentilationStruct.DrvSeatVentilationReq 1 traceback2
  gTC_CANTest_SOA_CheckReq_Prepare("SetDrvSeatHeatingStruct.DrvSeatHeatingReq 1 traceback2"); // 预期结果 TC_CANTest SOA CheckReq SetDrvSeatHeatingStruct.DrvSeatHeatingReq 1 traceback2
  g_CAN_Bus_Swc_Set("I_LDCU_BodySysSt1.I_LDCU_PowerMode 1"); // 测试步骤 TC_CANTest SET I_LDCU_BodySysSt1.I_LDCU_PowerMode 1
  gTC_CANTest_SOA_CheckReq("SetDrvSeatVentilationStruct.DrvSeatVentilationReq 1 traceback2"); // 预期结果 TC_CANTest SOA CheckReq SetDrvSeatVentilationStruct.DrvSeatVentilationReq 1 traceback2
  gTC_CANTest_SOA_CheckReq("SetDrvSeatHeatingStruct.DrvSeatHeatingReq 1 traceback2"); // 预期结果 TC_CANTest SOA CheckReq SetDrvSeatHeatingStruct.DrvSeatHeatingReq 1 traceback2
}

testcase SYS_CDCU_zhujiazuoyitongfengjiarejiyi_0200()
{
  TestDescription("主驾座椅通风加热记忆-2");
  teststep("warning","原始用例id为SYS-CDCU-主驾座椅通风加热记忆-0200");
  gTC_CANTest_SOA_SetSever("DrvSeatFuncStStruct.DrvSeatVentilationSt:2"); // 测试步骤 TC_CANTest SOA SetServer DrvSeatFuncStStruct.DrvSeatVentilationSt:2
  gTC_CANTest_SOA_SetSever("DrvSeatFuncStStruct.DrvSeatHeatSt:2"); // 测试步骤 TC_CANTest SOA SetServer DrvSeatFuncStStruct.DrvSeatHeatSt:2
  g_EM_Equipment_Swc_TC_4G_Time_Delay_Second("1"); // 测试步骤 TC_Sleep 1
  g_EM_Equipment_Swc_TC_IG("OFF"); // 测试步骤 TC_IG OFF
  gTC_CANTest_SOA_CheckReq_Prepare("SetDrvSeatVentilationStruct.DrvSeatVentilationReq 4 traceback2"); // 预期结果 TC_CANTest SOA CheckReq SetDrvSeatVentilationStruct.DrvSeatVentilationReq 4 traceback2
  gTC_CANTest_SOA_CheckReq_Prepare("SetDrvSeatHeatingStruct.DrvSeatHeatingReq 4 traceback2"); // 预期结果 TC_CANTest SOA CheckReq SetDrvSeatHeatingStruct.DrvSeatHeatingReq 4 traceback2
  g_CAN_Bus_Swc_Set("I_LDCU_BodySysSt1.I_LDCU_PowerMode 0"); // 测试步骤 TC_CANTest SET I_LDCU_BodySysSt1.I_LDCU_PowerMode 0
  gTC_CANTest_SOA_CheckReq("SetDrvSeatVentilationStruct.DrvSeatVentilationReq 4 traceback2"); // 预期结果 TC_CANTest SOA CheckReq SetDrvSeatVentilationStruct.DrvSeatVentilationReq 4 traceback2
  gTC_CANTest_SOA_CheckReq("SetDrvSeatHeatingStruct.DrvSeatHeatingReq 4 traceback2"); // 预期结果 TC_CANTest SOA CheckReq SetDrvSeatHeatingStruct.DrvSeatHeatingReq 4 traceback2
  g_EM_Equipment_Swc_TC_4G_Time_Delay_Second("2"); // 测试步骤 TC_Sleep 2
  g_EM_Equipment_Swc_TC_IG("ON"); // 测试步骤 TC_IG ON
  gTC_CANTest_SOA_CheckReq_Prepare("SetDrvSeatVentilationStruct.DrvSeatVentilationReq 2 traceback2"); // 预期结果 TC_CANTest SOA CheckReq SetDrvSeatVentilationStruct.DrvSeatVentilationReq 2 traceback2
  gTC_CANTest_SOA_CheckReq_Prepare("SetDrvSeatHeatingStruct.DrvSeatHeatingReq 2 traceback2"); // 预期结果 TC_CANTest SOA CheckReq SetDrvSeatHeatingStruct.DrvSeatHeatingReq 2 traceback2
  g_CAN_Bus_Swc_Set("I_LDCU_BodySysSt1.I_LDCU_PowerMode 1"); // 测试步骤 TC_CANTest SET I_LDCU_BodySysSt1.I_LDCU_PowerMode 1
  gTC_CANTest_SOA_CheckReq("SetDrvSeatVentilationStruct.DrvSeatVentilationReq 2 traceback2"); // 预期结果 TC_CANTest SOA CheckReq SetDrvSeatVentilationStruct.DrvSeatVentilationReq 2 traceback2
  gTC_CANTest_SOA_CheckReq("SetDrvSeatHeatingStruct.DrvSeatHeatingReq 2 traceback2"); // 预期结果 TC_CANTest SOA CheckReq SetDrvSeatHeatingStruct.DrvSeatHeatingReq 2 traceback2
}

testcase SYS_CDCU_zhujiazuoyitongfengjiarejiyi_0201()
{
  TestDescription("主驾座椅通风加热记忆-3");
  teststep("warning","原始用例id为SYS-CDCU-主驾座椅通风加热记忆-0201");
  gTC_CANTest_SOA_SetSever("DrvSeatFuncStStruct.DrvSeatVentilationSt:3"); // 测试步骤 TC_CANTest SOA SetServer DrvSeatFuncStStruct.DrvSeatVentilationSt:3
  gTC_CANTest_SOA_SetSever("DrvSeatFuncStStruct.DrvSeatHeatSt:3"); // 测试步骤 TC_CANTest SOA SetServer DrvSeatFuncStStruct.DrvSeatHeatSt:3
  g_EM_Equipment_Swc_TC_4G_Time_Delay_Second("1"); // 测试步骤 TC_Sleep 1
  g_EM_Equipment_Swc_TC_IG("OFF"); // 测试步骤 TC_IG OFF
  gTC_CANTest_SOA_CheckReq_Prepare("SetDrvSeatVentilationStruct.DrvSeatVentilationReq 4 traceback2"); // 预期结果 TC_CANTest SOA CheckReq SetDrvSeatVentilationStruct.DrvSeatVentilationReq 4 traceback2
  gTC_CANTest_SOA_CheckReq_Prepare("SetDrvSeatHeatingStruct.DrvSeatHeatingReq 4 traceback2"); // 预期结果 TC_CANTest SOA CheckReq SetDrvSeatHeatingStruct.DrvSeatHeatingReq 4 traceback2
  g_CAN_Bus_Swc_Set("I_LDCU_BodySysSt1.I_LDCU_PowerMode 0"); // 测试步骤 TC_CANTest SET I_LDCU_BodySysSt1.I_LDCU_PowerMode 0
  gTC_CANTest_SOA_CheckReq("SetDrvSeatVentilationStruct.DrvSeatVentilationReq 4 traceback2"); // 预期结果 TC_CANTest SOA CheckReq SetDrvSeatVentilationStruct.DrvSeatVentilationReq 4 traceback2
  gTC_CANTest_SOA_CheckReq("SetDrvSeatHeatingStruct.DrvSeatHeatingReq 4 traceback2"); // 预期结果 TC_CANTest SOA CheckReq SetDrvSeatHeatingStruct.DrvSeatHeatingReq 4 traceback2
  g_EM_Equipment_Swc_TC_4G_Time_Delay_Second("2"); // 测试步骤 TC_Sleep 2
  g_EM_Equipment_Swc_TC_IG("ON"); // 测试步骤 TC_IG ON
  gTC_CANTest_SOA_CheckReq_Prepare("SetDrvSeatVentilationStruct.DrvSeatVentilationReq 3 traceback2"); // 预期结果 TC_CANTest SOA CheckReq SetDrvSeatVentilationStruct.DrvSeatVentilationReq 3 traceback2
  gTC_CANTest_SOA_CheckReq_Prepare("SetDrvSeatHeatingStruct.DrvSeatHeatingReq 3 traceback2"); // 预期结果 TC_CANTest SOA CheckReq SetDrvSeatHeatingStruct.DrvSeatHeatingReq 3 traceback2
  g_CAN_Bus_Swc_Set("I_LDCU_BodySysSt1.I_LDCU_PowerMode 1"); // 测试步骤 TC_CANTest SET I_LDCU_BodySysSt1.I_LDCU_PowerMode 1
  gTC_CANTest_SOA_CheckReq("SetDrvSeatVentilationStruct.DrvSeatVentilationReq 3 traceback2"); // 预期结果 TC_CANTest SOA CheckReq SetDrvSeatVentilationStruct.DrvSeatVentilationReq 3 traceback2
  gTC_CANTest_SOA_CheckReq("SetDrvSeatHeatingStruct.DrvSeatHeatingReq 3 traceback2"); // 预期结果 TC_CANTest SOA CheckReq SetDrvSeatHeatingStruct.DrvSeatHeatingReq 3 traceback2
}

testcase SYS_CDCU_zhujiazuoyitongfengjiarejiyi_0202()
{
  TestDescription("主驾座椅通风加热记忆-3");
  teststep("warning","原始用例id为SYS-CDCU-主驾座椅通风加热记忆-0202");
  gTC_CANTest_SOA_SetSever("DrvSeatFuncStStruct.DrvSeatVentilationSt:3"); // 测试步骤 TC_CANTest SOA SetServer DrvSeatFuncStStruct.DrvSeatVentilationSt:3
  gTC_CANTest_SOA_SetSever("DrvSeatFuncStStruct.DrvSeatHeatSt:3"); // 测试步骤 TC_CANTest SOA SetServer DrvSeatFuncStStruct.DrvSeatHeatSt:3
  g_EM_Equipment_Swc_TC_4G_Time_Delay_Second("1"); // 测试步骤 TC_Sleep 1
  g_EM_Equipment_Swc_TC_IG("OFF"); // 测试步骤 TC_IG OFF
  gTC_CANTest_SOA_CheckReq_Prepare("SetDrvSeatVentilationStruct.DrvSeatVentilationReq 4 traceback2"); // 预期结果 TC_CANTest SOA CheckReq SetDrvSeatVentilationStruct.DrvSeatVentilationReq 4 traceback2
  gTC_CANTest_SOA_CheckReq_Prepare("SetDrvSeatHeatingStruct.DrvSeatHeatingReq 4 traceback2"); // 预期结果 TC_CANTest SOA CheckReq SetDrvSeatHeatingStruct.DrvSeatHeatingReq 4 traceback2
  g_CAN_Bus_Swc_Set("I_LDCU_BodySysSt1.I_LDCU_PowerMode 0"); // 测试步骤 TC_CANTest SET I_LDCU_BodySysSt1.I_LDCU_PowerMode 0
  gTC_CANTest_SOA_CheckReq("SetDrvSeatVentilationStruct.DrvSeatVentilationReq 4 traceback2"); // 预期结果 TC_CANTest SOA CheckReq SetDrvSeatVentilationStruct.DrvSeatVentilationReq 4 traceback2
  gTC_CANTest_SOA_CheckReq("SetDrvSeatHeatingStruct.DrvSeatHeatingReq 4 traceback2"); // 预期结果 TC_CANTest SOA CheckReq SetDrvSeatHeatingStruct.DrvSeatHeatingReq 4 traceback2
  g_EM_Equipment_Swc_TC_4G_Time_Delay_Second("2"); // 测试步骤 TC_Sleep 2
  g_EM_Equipment_Swc_TC_IG("ON"); // 测试步骤 TC_IG ON
  gTC_CANTest_SOA_CheckReq_Prepare("SetDrvSeatVentilationStruct.DrvSeatVentilationReq 3 traceback2"); // 预期结果 TC_CANTest SOA CheckReq SetDrvSeatVentilationStruct.DrvSeatVentilationReq 3 traceback2
  gTC_CANTest_SOA_CheckReq_Prepare("SetDrvSeatHeatingStruct.DrvSeatHeatingReq 3 traceback2"); // 预期结果 TC_CANTest SOA CheckReq SetDrvSeatHeatingStruct.DrvSeatHeatingReq 3 traceback2
  g_CAN_Bus_Swc_Set("I_LDCU_BodySysSt1.I_LDCU_PowerMode 1"); // 测试步骤 TC_CANTest SET I_LDCU_BodySysSt1.I_LDCU_PowerMode 1
  gTC_CANTest_SOA_CheckReq("SetDrvSeatVentilationStruct.DrvSeatVentilationReq 3 traceback2"); // 预期结果 TC_CANTest SOA CheckReq SetDrvSeatVentilationStruct.DrvSeatVentilationReq 3 traceback2
  gTC_CANTest_SOA_CheckReq("SetDrvSeatHeatingStruct.DrvSeatHeatingReq 3 traceback2"); // 预期结果 TC_CANTest SOA CheckReq SetDrvSeatHeatingStruct.DrvSeatHeatingReq 3 traceback2
}
