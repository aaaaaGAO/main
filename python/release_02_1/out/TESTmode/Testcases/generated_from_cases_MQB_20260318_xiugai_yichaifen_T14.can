/*@!Encoding: 936*/

includes
{
}

variables
{
}

testcase SYS_CDCU_dianyuanguanliT14_0001()
{
  TestDescription("前置环境设置-1");
  teststep("warning","原始用例id为SYS-CDCU-电源管理T14-0001");
  g_EM_Equipment_Swc_TC_PW("OFF"); // 测试步骤 TC_PW OFF
  g_EM_Equipment_Swc_TC_IG("OFF"); // 测试步骤 TC_IG OFF
  g_EM_Equipment_Swc_TC_4G_Time_Delay_Second("1"); // 测试步骤 TC_Sleep 1
  g_EM_Equipment_Swc_TC_PW("ON"); // 测试步骤 TC_PW ON
  g_EM_Equipment_Swc_TC_IG("ON"); // 测试步骤 TC_IG ON
  g_EM_Equipment_Swc_TC_4G_Time_Delay_Second("3"); // 测试步骤 TC_Sleep 3
  g_EM_Equipment_Swc_TC_Set_InputVolt_V_WithCh("12&CH1"); // 测试步骤 TC_Set_InputVolt_V_WithCh 12&CH1
  g_EM_Equipment_Swc_TC_4G_Time_Delay_Second("5"); // 测试步骤 TC_Sleep 5
  g_EM_UDS_CAN_Swc_Diag("10 03"); // 测试步骤 TC_CANTest Diag 10 03
  g_EM_UDS_CAN_Swc_TC_CheckDiagRes("50 03 *"); // 预期结果 TC_CheckDiagRes 50 03 *
  g_EM_UDS_CAN_Swc_Diag_SA_01_02(); // 测试步骤 TC_CANTest Diag SA_01_02//一级解锁
  g_EM_UDS_CAN_Swc_TC_CheckDiagRes("67 02"); // 预期结果 TC_CheckDiagRes 67 02
  g_EM_UDS_CAN_Swc_Diag("2E CF 00 00 00 00 00 00 00 00 00 00 00"); // 测试步骤 TC_CANTest Diag 2E CF 00 00 00 00 00 00 00 00 00 00 00
  g_EM_UDS_CAN_Swc_TC_CheckDiagRes("6E CF 00"); // 预期结果 TC_CheckDiagRes 6E CF 00
  g_EM_UDS_CAN_Swc_Diag("2E CF 0A 00"); // 测试步骤 TC_CANTest Diag 2E CF 0A 00//KL30 唤醒及屏幕点亮功能使能
  g_EM_UDS_CAN_Swc_TC_CheckDiagRes("6E CF 0A"); // 预期结果 TC_CheckDiagRes 6E CF 0A
  g_CAN_Bus_Swc_Disable_AllSentMessage(); // 测试步骤 TC_CANTest Disable AllSentMessage
}

testcase SYS_CDCU_dianyuanguanliT14_0002()
{
  TestDescription("正常电压上电 power mode = off BUB_BOOST_EN由高电平变为低电平");
  teststep("warning","原始用例id为SYS-CDCU-电源管理T14-0002");
  g_EM_Equipment_Swc_TC_Set_InputVolt_V_WithCh("6.8&CH1"); // 测试步骤 TC_Set_InputVolt_V_WithCh 6.8&CH1
  g_EM_Equipment_Swc_TC_4G_Time_Delay_Second("6"); // 测试步骤 TC_Sleep 6
  g_EM_Uart_Swc_Ser_CheckRaw("1070080004"); // 预期结果 TC_CANTest Ser CheckRaw 1070080004//BACKUP_MODE
  g_EM_Equipment_Swc_TC_IG("OFF"); // 测试步骤 TC_IG OFF
  g_CAN_Bus_Swc_Set("I_LDCU_BodySysSt1.I_LDCU_PowerMode 0"); // 测试步骤 TC_CANTest SET I_LDCU_BodySysSt1.I_LDCU_PowerMode 0
  g_EM_Equipment_Swc_TC_Set_InputVolt_V_WithCh("12&CH1"); // 测试步骤 TC_Set_InputVolt_V_WithCh 12&CH1
  g_EM_Uart_Swc_Ser_CheckRaw("1070080001"); // 预期结果 TC_CANTest Ser CheckRaw 1070080001 // (MCU 通知SOC电源模式切换 normal) 每5S打印一次Send SOC Wake Req而后打印SOC Already Wake
}

testcase SYS_CDCU_dianyuanguanliT14_0003()
{
  TestDescription("一级欠压上电 power mode = off BUB_BOOST_EN由高电平变为低电平");
  teststep("warning","原始用例id为SYS-CDCU-电源管理T14-0003");
  g_EM_Equipment_Swc_TC_Set_InputVolt_V_WithCh("6.8&CH1"); // 测试步骤 TC_Set_InputVolt_V_WithCh 6.8&CH1
  g_EM_Equipment_Swc_TC_4G_Time_Delay_Second("6"); // 测试步骤 TC_Sleep 6
  g_EM_Uart_Swc_Ser_CheckRaw("1070080004"); // 预期结果 TC_CANTest Ser CheckRaw 1070080004//BACKUP_MODE
  g_EM_Equipment_Swc_TC_IG("OFF"); // 测试步骤 TC_IG OFF
  g_CAN_Bus_Swc_Set("I_LDCU_BodySysSt1.I_LDCU_PowerMode 0"); // 测试步骤 TC_CANTest SET I_LDCU_BodySysSt1.I_LDCU_PowerMode 0
  g_EM_Equipment_Swc_TC_Set_InputVolt_V_WithCh("7.8&CH1"); // 测试步骤 TC_Set_InputVolt_V_WithCh 7.8&CH1
  g_EM_Uart_Swc_Ser_CheckRaw("1070080001"); // 预期结果 TC_CANTest Ser CheckRaw 1070080001 // (MCU 通知SOC电源模式切换 normal) 每5S打印一次Send SOC Wake Req而后打印SOC Already Wake
}

testcase SYS_CDCU_dianyuanguanliT14_0004()
{
  TestDescription("一级过压上电 power mode = off BUB_BOOST_EN由高电平变为低电平");
  teststep("warning","原始用例id为SYS-CDCU-电源管理T14-0004");
  g_EM_Equipment_Swc_TC_Set_InputVolt_V_WithCh("6.8&CH1"); // 测试步骤 TC_Set_InputVolt_V_WithCh 6.8&CH1
  g_EM_Equipment_Swc_TC_4G_Time_Delay_Second("6"); // 测试步骤 TC_Sleep 6
  g_EM_Uart_Swc_Ser_CheckRaw("1070080004"); // 预期结果 TC_CANTest Ser CheckRaw 1070080004//BACKUP_MODE
  g_EM_Equipment_Swc_TC_IG("OFF"); // 测试步骤 TC_IG OFF
  g_CAN_Bus_Swc_Set("I_LDCU_BodySysSt1.I_LDCU_PowerMode 0"); // 测试步骤 TC_CANTest SET I_LDCU_BodySysSt1.I_LDCU_PowerMode 0
  g_EM_Equipment_Swc_TC_Set_InputVolt_V_WithCh("17&CH1"); // 测试步骤 TC_Set_InputVolt_V_WithCh 17&CH1
  g_EM_Uart_Swc_Ser_CheckRaw("1070080001"); // 预期结果 TC_CANTest Ser CheckRaw 1070080001 // (MCU 通知SOC电源模式切换 normal) 每5S打印一次Send SOC Wake Req而后打印SOC Already Wake
}

testcase SYS_CDCU_dianyuanguanliT14_0005()
{
  TestDescription("正常电压上电 power mode = remote on BUB_BOOST_EN由高电平变为低电平");
  teststep("warning","原始用例id为SYS-CDCU-电源管理T14-0005");
  g_EM_Equipment_Swc_TC_Set_InputVolt_V_WithCh("6.8&CH1"); // 测试步骤 TC_Set_InputVolt_V_WithCh 6.8&CH1
  g_EM_Equipment_Swc_TC_4G_Time_Delay_Second("6"); // 测试步骤 TC_Sleep 6
  g_EM_Uart_Swc_Ser_CheckRaw("1070080004"); // 预期结果 TC_CANTest Ser CheckRaw 1070080004//BACKUP_MODE
  g_EM_Equipment_Swc_TC_IG("ON"); // 测试步骤 TC_IG ON
  g_CAN_Bus_Swc_Set("I_LDCU_BodySysSt1.I_LDCU_PowerMode 2"); // 测试步骤 TC_CANTest SET I_LDCU_BodySysSt1.I_LDCU_PowerMode 2
  g_EM_Equipment_Swc_TC_Set_InputVolt_V_WithCh("12&CH1"); // 测试步骤 TC_Set_InputVolt_V_WithCh 12&CH1
  g_EM_Uart_Swc_Ser_CheckRaw("1070080001"); // 预期结果 TC_CANTest Ser CheckRaw 1070080001 // (MCU 通知SOC电源模式切换 normal) 每5S打印一次Send SOC Wake Req而后打印SOC Already Wake
}

testcase SYS_CDCU_dianyuanguanliT14_0006()
{
  TestDescription("一级欠压上电 power mode = remote on BUB_BOOST_EN由高电平变为低电平");
  teststep("warning","原始用例id为SYS-CDCU-电源管理T14-0006");
  g_EM_Equipment_Swc_TC_Set_InputVolt_V_WithCh("6.8&CH1"); // 测试步骤 TC_Set_InputVolt_V_WithCh 6.8&CH1
  g_EM_Equipment_Swc_TC_4G_Time_Delay_Second("6"); // 测试步骤 TC_Sleep 6
  g_EM_Uart_Swc_Ser_CheckRaw("1070080004"); // 预期结果 TC_CANTest Ser CheckRaw 1070080004//BACKUP_MODE
  g_EM_Equipment_Swc_TC_IG("ON"); // 测试步骤 TC_IG ON
  g_CAN_Bus_Swc_Set("I_LDCU_BodySysSt1.I_LDCU_PowerMode 2"); // 测试步骤 TC_CANTest SET I_LDCU_BodySysSt1.I_LDCU_PowerMode 2
  g_EM_Equipment_Swc_TC_Set_InputVolt_V_WithCh("7.8&CH1"); // 测试步骤 TC_Set_InputVolt_V_WithCh 7.8&CH1
  g_EM_Uart_Swc_Ser_CheckRaw("1070080001"); // 预期结果 TC_CANTest Ser CheckRaw 1070080001 // (MCU 通知SOC电源模式切换 normal) 每5S打印一次Send SOC Wake Req而后打印SOC Already Wake
}

testcase SYS_CDCU_dianyuanguanliT14_0007()
{
  TestDescription("一级过压上电 power mode = remote on BUB_BOOST_EN由高电平变为低电平");
  teststep("warning","原始用例id为SYS-CDCU-电源管理T14-0007");
  g_EM_Equipment_Swc_TC_Set_InputVolt_V_WithCh("6.8&CH1"); // 测试步骤 TC_Set_InputVolt_V_WithCh 6.8&CH1
  g_EM_Equipment_Swc_TC_4G_Time_Delay_Second("6"); // 测试步骤 TC_Sleep 6
  g_EM_Uart_Swc_Ser_CheckRaw("1070080004"); // 预期结果 TC_CANTest Ser CheckRaw 1070080004//BACKUP_MODE
  g_EM_Equipment_Swc_TC_IG("ON"); // 测试步骤 TC_IG ON
  g_CAN_Bus_Swc_Set("I_LDCU_BodySysSt1.I_LDCU_PowerMode 2"); // 测试步骤 TC_CANTest SET I_LDCU_BodySysSt1.I_LDCU_PowerMode 2
  g_EM_Equipment_Swc_TC_Set_InputVolt_V_WithCh("17&CH1"); // 测试步骤 TC_Set_InputVolt_V_WithCh 17&CH1
  g_EM_Uart_Swc_Ser_CheckRaw("1070080001"); // 预期结果 TC_CANTest Ser CheckRaw 1070080001 // (MCU 通知SOC电源模式切换 normal) 每5S打印一次Send SOC Wake Req而后打印SOC Already Wake
}

testcase SYS_CDCU_dianyuanguanliT14_0008()
{
  TestDescription("恢复环境");
  teststep("warning","原始用例id为SYS-CDCU-电源管理T14-0008");
  g_EM_Equipment_Swc_TC_Set_InputVolt_V_WithCh("12&CH1"); // 测试步骤 TC_Set_InputVolt_V_WithCh 12&CH1
  g_EM_Equipment_Swc_TC_IG("ON"); // 测试步骤 TC_IG ON
  g_CAN_Bus_Swc_AllCANDataDefaultAllCh(); // 测试步骤 TC_CANTest SET AllCANDataDefaultAllCh
  g_EM_Equipment_Swc_TC_4G_Time_Delay_Second("3"); // 测试步骤 TC_Sleep 3
  g_CAN_Bus_Swc_Disable_AllSentMessage(); // 测试步骤 TC_CANTest Disable AllSentMessage
}
