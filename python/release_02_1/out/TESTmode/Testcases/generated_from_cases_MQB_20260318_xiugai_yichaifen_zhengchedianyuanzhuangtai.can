/*@!Encoding: 936*/

includes
{
}

variables
{
}

testcase SYS_CDCU_zhengchedianyuanzhuangtai_0001()
{
  TestDescription("前置环境设置-1");
  teststep("warning","原始用例id为SYS-CDCU-整车电源状态-0001");
  g_EM_Equipment_Swc_TC_4G_Time_Delay_Second("1"); // 测试步骤 TC_Sleep 1
  g_EM_Equipment_Swc_TC_PW("ON"); // 测试步骤 TC_PW ON
  g_EM_Equipment_Swc_TC_IG("ON"); // 测试步骤 TC_IG ON
  g_EM_Equipment_Swc_TC_4G_Time_Delay_Second("1"); // 测试步骤 TC_Sleep 1
  g_CAN_Bus_Swc_AllCANDataDefaultAllCh(); // 测试步骤 TC_CANTest SET AllCANDataDefaultAllCh
  g_EM_Equipment_Swc_TC_4G_Time_Delay_Second("1"); // 测试步骤 TC_Sleep 1
  g_CAN_Bus_Swc_Disable_AllSentMessage(); // 测试步骤 TC_CANTest Disable AllSentMessage
  g_EM_Equipment_Swc_TC_4G_Time_Delay_Second("1"); // 测试步骤 TC_Sleep 1
  gTC_CANTest_SOA_StopSomeipPeriod("0x30 0x8002 00000000 0.05 239.172.20.0:55551 @LDCU"); // 测试步骤 TC_CANTest SOA StopSomeipPeriod 0x30 0x8002 00000000 0.05 239.172.20.0:55551 @LDCU
  gTC_CANTest_SOA_StopSomeipPeriod("0x30 0x8002 01000000 0.05 239.172.20.0:55551 @LDCU"); // 测试步骤 TC_CANTest SOA StopSomeipPeriod 0x30 0x8002 01000000 0.05 239.172.20.0:55551 @LDCU
  gTC_CANTest_SOA_StopSomeipPeriod("0x30 0x8002 02000000 0.05 239.172.20.0:55551 @LDCU"); // 测试步骤 TC_CANTest SOA StopSomeipPeriod 0x30 0x8002 02000000 0.05 239.172.20.0:55551 @LDCU
  gTC_CANTest_SOA_StopSomeipPeriod("0x30 0x8002 03000000 0.05 239.172.20.0:55551 @LDCU"); // 测试步骤 TC_CANTest SOA StopSomeipPeriod 0x30 0x8002 03000000 0.05 239.172.20.0:55551 @LDCU
}

testcase SYS_CDCU_zhengchedianyuanzhuangtai_0002()
{
  TestDescription("IG+CAN信号-2");
  teststep("warning","原始用例id为SYS-CDCU-整车电源状态-0002");
  g_EM_Equipment_Swc_TC_IG("ON"); // 测试步骤 TC_IG ON
  g_EM_Equipment_Swc_TC_4G_Time_Delay_Second("1"); // 测试步骤 TC_Sleep 1
  g_CAN_Bus_Swc_Set("I_LDCU_BodySysSt1.I_LDCU_PowerMode 0x02"); // 测试步骤 TC_CANTest SET I_LDCU_BodySysSt1.I_LDCU_PowerMode 0x02
  g_EM_Uart_Swc_Ser_CheckRaw("0970010002 timeoutS3"); // 预期结果 TC_CANTest Ser CheckRaw 0970010002 timeoutS3
  g_CAN_Bus_Swc_Check("I_CDCU_State.I_CDCU_KL15State 2"); // 预期结果 TC_CANTest Check I_CDCU_State.I_CDCU_KL15State 2
}

testcase SYS_CDCU_zhengchedianyuanzhuangtai_0003()
{
  TestDescription("IG+CAN信号-3");
  teststep("warning","原始用例id为SYS-CDCU-整车电源状态-0003");
  g_EM_Equipment_Swc_TC_IG("ON"); // 测试步骤 TC_IG ON
  g_EM_Equipment_Swc_TC_4G_Time_Delay_Second("1"); // 测试步骤 TC_Sleep 1
  g_CAN_Bus_Swc_Set("I_LDCU_BodySysSt1.I_LDCU_PowerMode 0x00"); // 测试步骤 TC_CANTest SET I_LDCU_BodySysSt1.I_LDCU_PowerMode 0x00
  g_EM_Uart_Swc_Ser_CheckRaw("0970010001 timeoutS3"); // 预期结果 TC_CANTest Ser CheckRaw 0970010001 timeoutS3
  g_CAN_Bus_Swc_Check("I_CDCU_State.I_CDCU_KL15State 1"); // 预期结果 TC_CANTest Check I_CDCU_State.I_CDCU_KL15State 1
}

testcase SYS_CDCU_zhengchedianyuanzhuangtai_0004()
{
  TestDescription("IG+CAN信号-4");
  teststep("warning","原始用例id为SYS-CDCU-整车电源状态-0004");
  g_EM_Equipment_Swc_TC_IG("ON"); // 测试步骤 TC_IG ON
  g_CAN_Bus_Swc_Set("I_LDCU_BodySysSt1.I_LDCU_PowerMode 0x02"); // 测试步骤 TC_CANTest SET I_LDCU_BodySysSt1.I_LDCU_PowerMode 0x02
  g_EM_Uart_Swc_Ser_CheckRaw("0970010002 timeoutS3"); // 预期结果 TC_CANTest Ser CheckRaw 0970010002 timeoutS3
  g_EM_Equipment_Swc_TC_4G_Time_Delay_Second("1"); // 测试步骤 TC_Sleep 1
  g_CAN_Bus_Swc_Check("I_CDCU_State.I_CDCU_KL15State 2"); // 预期结果 TC_CANTest Check I_CDCU_State.I_CDCU_KL15State 2
  g_CAN_Bus_Swc_Set("I_LDCU_BodySysSt1.I_LDCU_PowerMode 0x01"); // 测试步骤 TC_CANTest SET I_LDCU_BodySysSt1.I_LDCU_PowerMode 0x01
  g_EM_Uart_Swc_Ser_CheckRaw("0970010001 timeoutS3"); // 预期结果 TC_CANTest Ser CheckRaw 0970010001 timeoutS3
  g_CAN_Bus_Swc_Check("I_CDCU_State.I_CDCU_KL15State 1"); // 预期结果 TC_CANTest Check I_CDCU_State.I_CDCU_KL15State 1
}

testcase SYS_CDCU_zhengchedianyuanzhuangtai_0005()
{
  TestDescription("IG+CAN信号-5");
  teststep("warning","原始用例id为SYS-CDCU-整车电源状态-0005");
  g_EM_Equipment_Swc_TC_IG("ON"); // 测试步骤 TC_IG ON
  g_CAN_Bus_Swc_Set("I_LDCU_BodySysSt1.I_LDCU_PowerMode 0x02"); // 测试步骤 TC_CANTest SET I_LDCU_BodySysSt1.I_LDCU_PowerMode 0x02
  g_EM_Uart_Swc_Ser_CheckRaw("0970010002 timeoutS3"); // 预期结果 TC_CANTest Ser CheckRaw 0970010002 timeoutS3
  g_EM_Equipment_Swc_TC_4G_Time_Delay_Second("1"); // 测试步骤 TC_Sleep 1
  g_CAN_Bus_Swc_Check("I_CDCU_State.I_CDCU_KL15State 2"); // 预期结果 TC_CANTest Check I_CDCU_State.I_CDCU_KL15State 2
  g_CAN_Bus_Swc_Set("I_LDCU_BodySysSt1.I_LDCU_PowerMode 0x03"); // 测试步骤 TC_CANTest SET I_LDCU_BodySysSt1.I_LDCU_PowerMode 0x03
  g_EM_Uart_Swc_Ser_CheckRaw("0970010001 timeoutS3"); // 预期结果 TC_CANTest Ser CheckRaw 0970010001 timeoutS3
  g_CAN_Bus_Swc_Check("I_CDCU_State.I_CDCU_KL15State 1"); // 预期结果 TC_CANTest Check I_CDCU_State.I_CDCU_KL15State 1
}

testcase SYS_CDCU_zhengchedianyuanzhuangtai_0006()
{
  TestDescription("IG+CAN信号-6");
  teststep("warning","原始用例id为SYS-CDCU-整车电源状态-0006");
  g_EM_Equipment_Swc_TC_IG("OFF"); // 测试步骤 TC_IG OFF
  g_CAN_Bus_Swc_Set("I_LDCU_NM.I_LDCU_NMActiveWakeupBit 1"); // 测试步骤 TC_CANTest SET I_LDCU_NM.I_LDCU_NMActiveWakeupBit 1
  g_EM_Equipment_Swc_TC_4G_Time_Delay_Second("1"); // 测试步骤 TC_Sleep 1
  g_EM_Uart_Swc_Ser_CheckRaw("0970010000 timeoutS3"); // 预期结果 TC_CANTest Ser CheckRaw 0970010000 timeoutS3
  g_CAN_Bus_Swc_Set("I_LDCU_BodySysSt1.I_LDCU_PowerMode 0x00"); // 测试步骤 TC_CANTest SET I_LDCU_BodySysSt1.I_LDCU_PowerMode 0x00
  g_CAN_Bus_Swc_Check("I_CDCU_State.I_CDCU_KL15State 0"); // 预期结果 TC_CANTest Check I_CDCU_State.I_CDCU_KL15State 0
}

testcase SYS_CDCU_zhengchedianyuanzhuangtai_0007()
{
  TestDescription("IG+CAN信号-7");
  teststep("warning","原始用例id为SYS-CDCU-整车电源状态-0007");
  g_EM_Equipment_Swc_TC_IG("OFF"); // 测试步骤 TC_IG OFF
  g_CAN_Bus_Swc_Set("I_LDCU_NM.I_LDCU_NMActiveWakeupBit 1"); // 测试步骤 TC_CANTest SET I_LDCU_NM.I_LDCU_NMActiveWakeupBit 1
  g_EM_Equipment_Swc_TC_4G_Time_Delay_Second("1"); // 测试步骤 TC_Sleep 1
  g_EM_Uart_Swc_Ser_CheckRaw("0970010000 timeoutS3"); // 预期结果 TC_CANTest Ser CheckRaw 0970010000 timeoutS3
  g_CAN_Bus_Swc_Set("I_LDCU_BodySysSt1.I_LDCU_PowerMode 0x01"); // 测试步骤 TC_CANTest SET I_LDCU_BodySysSt1.I_LDCU_PowerMode 0x01
  g_CAN_Bus_Swc_Check("I_CDCU_State.I_CDCU_KL15State 0"); // 预期结果 TC_CANTest Check I_CDCU_State.I_CDCU_KL15State 0
}

testcase SYS_CDCU_zhengchedianyuanzhuangtai_0008()
{
  TestDescription("IG+CAN信号-8");
  teststep("warning","原始用例id为SYS-CDCU-整车电源状态-0008");
  g_EM_Equipment_Swc_TC_IG("OFF"); // 测试步骤 TC_IG OFF
  g_CAN_Bus_Swc_Set("I_LDCU_NM.I_LDCU_NMActiveWakeupBit 1"); // 测试步骤 TC_CANTest SET I_LDCU_NM.I_LDCU_NMActiveWakeupBit 1
  g_EM_Equipment_Swc_TC_4G_Time_Delay_Second("1"); // 测试步骤 TC_Sleep 1
  g_EM_Uart_Swc_Ser_CheckRaw("0970010000 timeoutS3"); // 预期结果 TC_CANTest Ser CheckRaw 0970010000 timeoutS3
  g_CAN_Bus_Swc_Set("I_LDCU_BodySysSt1.I_LDCU_PowerMode 0x02"); // 测试步骤 TC_CANTest SET I_LDCU_BodySysSt1.I_LDCU_PowerMode 0x02
  g_CAN_Bus_Swc_Check("I_CDCU_State.I_CDCU_KL15State 0"); // 预期结果 TC_CANTest Check I_CDCU_State.I_CDCU_KL15State 0
}

testcase SYS_CDCU_zhengchedianyuanzhuangtai_0009()
{
  TestDescription("IG+CAN信号-9");
  teststep("warning","原始用例id为SYS-CDCU-整车电源状态-0009");
  g_EM_Equipment_Swc_TC_IG("OFF"); // 测试步骤 TC_IG OFF
  g_CAN_Bus_Swc_Set("I_LDCU_NM.I_LDCU_NMActiveWakeupBit 1"); // 测试步骤 TC_CANTest SET I_LDCU_NM.I_LDCU_NMActiveWakeupBit 1
  g_EM_Equipment_Swc_TC_4G_Time_Delay_Second("1"); // 测试步骤 TC_Sleep 1
  g_EM_Uart_Swc_Ser_CheckRaw("0970010000 timeoutS3"); // 预期结果 TC_CANTest Ser CheckRaw 0970010000 timeoutS3
  g_CAN_Bus_Swc_Set("I_LDCU_BodySysSt1.I_LDCU_PowerMode 0x03"); // 测试步骤 TC_CANTest SET I_LDCU_BodySysSt1.I_LDCU_PowerMode 0x03
  g_CAN_Bus_Swc_Check("I_CDCU_State.I_CDCU_KL15State 0"); // 预期结果 TC_CANTest Check I_CDCU_State.I_CDCU_KL15State 0
}

testcase SYS_CDCU_zhengchedianyuanzhuangtai_0010()
{
  TestDescription("测试前置条件重置-10");
  teststep("warning","原始用例id为SYS-CDCU-整车电源状态-0010");
  g_EM_Equipment_Swc_TC_PW("OFF"); // 测试步骤 TC_PW OFF
  g_EM_Equipment_Swc_TC_IG("OFF"); // 测试步骤 TC_IG OFF
  g_EM_Equipment_Swc_TC_4G_Time_Delay_Second("2"); // 测试步骤 TC_Sleep 2
  g_EM_Uart_Swc_Ser_CheckRaw("0770010004"); // 预期结果 TC_CANTest Ser CheckRaw 0770010004//（normal）SOC Power Normal
  g_EM_Equipment_Swc_TC_PW("ON"); // 测试步骤 TC_PW ON
  g_EM_Equipment_Swc_TC_IG("ON"); // 测试步骤 TC_IG ON
  g_EM_Equipment_Swc_TC_4G_Time_Delay_Second("5"); // 测试步骤 TC_Sleep 5
  g_CAN_Bus_Swc_AllCANDataDefault(); // 测试步骤 TC_CANTest SET AllCANDataDefault
  g_EM_Equipment_Swc_TC_4G_Time_Delay_Second("2"); // 测试步骤 TC_Sleep 2
  g_CAN_Bus_Swc_Disable_AllSentMessage(); // 测试步骤 TC_CANTest Disable AllSentMessage
  g_EM_Equipment_Swc_TC_4G_Time_Delay_Second("2"); // 测试步骤 TC_Sleep 2
  gTC_CANTest_SOA_StopSomeipPeriod("0x30 0x8002 00000000 0.05 239.172.20.0:55551 @LDCU"); // 测试步骤 TC_CANTest SOA StopSomeipPeriod 0x30 0x8002 00000000 0.05 239.172.20.0:55551 @LDCU
  gTC_CANTest_SOA_StopSomeipPeriod("0x30 0x8002 01000000 0.05 239.172.20.0:55551 @LDCU"); // 测试步骤 TC_CANTest SOA StopSomeipPeriod 0x30 0x8002 01000000 0.05 239.172.20.0:55551 @LDCU
  gTC_CANTest_SOA_StopSomeipPeriod("0x30 0x8002 02000000 0.05 239.172.20.0:55551 @LDCU"); // 测试步骤 TC_CANTest SOA StopSomeipPeriod 0x30 0x8002 02000000 0.05 239.172.20.0:55551 @LDCU
  gTC_CANTest_SOA_StopSomeipPeriod("0x30 0x8002 03000000 0.05 239.172.20.0:55551 @LDCU"); // 测试步骤 TC_CANTest SOA StopSomeipPeriod 0x30 0x8002 03000000 0.05 239.172.20.0:55551 @LDCU
}

testcase SYS_CDCU_zhengchedianyuanzhuangtai_0011()
{
  TestDescription("IG+SOMEIP信号-11");
  teststep("warning","原始用例id为SYS-CDCU-整车电源状态-0011");
  g_EM_Equipment_Swc_TC_IG("ON"); // 测试步骤 TC_IG ON
  g_EM_Equipment_Swc_TC_4G_Time_Delay_Second("1"); // 测试步骤 TC_Sleep 1
  gTC_CANTest_SOA_SendSomeipPeriod("0x30 0x8002 02000000 0.05 239.172.20.0:55551 @LDCU"); // 测试步骤 TC_CANTest SOA SendSomeipPeriod 0x30 0x8002 02000000 0.05 239.172.20.0:55551 @LDCU
  g_EM_Equipment_Swc_TC_4G_Time_Delay_Second("0.1"); // 测试步骤 TC_Sleep 0.1
  g_EM_Uart_Swc_Ser_CheckRaw("0970010002 timeoutS3"); // 预期结果 TC_CANTest Ser CheckRaw 0970010002 timeoutS3
  gTC_CANTest_SOA_StopSomeipPeriod("0x30 0x8002 02000000 0.05 239.172.20.0:55551 @LDCU"); // 测试步骤 TC_CANTest SOA StopSomeipPeriod 0x30 0x8002 02000000 0.05 239.172.20.0:55551 @LDCU
  g_CAN_Bus_Swc_Check("I_CDCU_State.I_CDCU_KL15State 2"); // 预期结果 TC_CANTest Check I_CDCU_State.I_CDCU_KL15State 2
}

testcase SYS_CDCU_zhengchedianyuanzhuangtai_0012()
{
  TestDescription("IG+SOMEIP信号-12");
  teststep("warning","原始用例id为SYS-CDCU-整车电源状态-0012");
  g_EM_Equipment_Swc_TC_IG("ON"); // 测试步骤 TC_IG ON
  g_EM_Equipment_Swc_TC_4G_Time_Delay_Second("1"); // 测试步骤 TC_Sleep 1
  gTC_CANTest_SOA_SendSomeipPeriod("0x30 0x8002 00000000 0.05 239.172.20.0:55551 @LDCU"); // 测试步骤 TC_CANTest SOA SendSomeipPeriod 0x30 0x8002 00000000 0.05 239.172.20.0:55551 @LDCU
  g_EM_Equipment_Swc_TC_4G_Time_Delay_Second("0.1"); // 测试步骤 TC_Sleep 0.1
  g_EM_Uart_Swc_Ser_CheckRaw("0970010001 timeoutS3"); // 预期结果 TC_CANTest Ser CheckRaw 0970010001 timeoutS3
  gTC_CANTest_SOA_StopSomeipPeriod("0x30 0x8002 00000000 0.05 239.172.20.0:55551 @LDCU"); // 测试步骤 TC_CANTest SOA StopSomeipPeriod 0x30 0x8002 00000000 0.05 239.172.20.0:55551 @LDCU
  g_CAN_Bus_Swc_Check("I_CDCU_State.I_CDCU_KL15State 1"); // 预期结果 TC_CANTest Check I_CDCU_State.I_CDCU_KL15State 1
}

testcase SYS_CDCU_zhengchedianyuanzhuangtai_0013()
{
  TestDescription("IG+SOMEIP信号-13");
  teststep("warning","原始用例id为SYS-CDCU-整车电源状态-0013");
  g_EM_Equipment_Swc_TC_IG("ON"); // 测试步骤 TC_IG ON
  gTC_CANTest_SOA_SendSomeipPeriod("0x30 0x8002 02000000 0.05 239.172.20.0:55551 @LDCU"); // 测试步骤 TC_CANTest SOA SendSomeipPeriod 0x30 0x8002 02000000 0.05 239.172.20.0:55551 @LDCU
  g_EM_Uart_Swc_Ser_CheckRaw("0970010002 timeoutS3"); // 预期结果 TC_CANTest Ser CheckRaw 0970010002 timeoutS3
  g_EM_Equipment_Swc_TC_4G_Time_Delay_Second("0.1"); // 测试步骤 TC_Sleep 0.1
  g_CAN_Bus_Swc_Check("I_CDCU_State.I_CDCU_KL15State 2"); // 预期结果 TC_CANTest Check I_CDCU_State.I_CDCU_KL15State 2
  gTC_CANTest_SOA_StopSomeipPeriod("0x30 0x8002 02000000 0.05 239.172.20.0:55551 @LDCU"); // 测试步骤 TC_CANTest SOA StopSomeipPeriod 0x30 0x8002 02000000 0.05 239.172.20.0:55551 @LDCU
  gTC_CANTest_SOA_SendSomeipPeriod("0x30 0x8002 01000000 0.05 239.172.20.0:55551 @LDCU"); // 测试步骤 TC_CANTest SOA SendSomeipPeriod 0x30 0x8002 01000000 0.05 239.172.20.0:55551 @LDCU
  g_EM_Uart_Swc_Ser_CheckRaw("0970010001 timeoutS3"); // 预期结果 TC_CANTest Ser CheckRaw 0970010001 timeoutS3
  g_EM_Equipment_Swc_TC_4G_Time_Delay_Second("0.1"); // 测试步骤 TC_Sleep 0.1
  g_CAN_Bus_Swc_Check("I_CDCU_State.I_CDCU_KL15State 1"); // 预期结果 TC_CANTest Check I_CDCU_State.I_CDCU_KL15State 1
  gTC_CANTest_SOA_StopSomeipPeriod("0x30 0x8002 01000000 0.05 239.172.20.0:55551 @LDCU"); // 测试步骤 TC_CANTest SOA StopSomeipPeriod 0x30 0x8002 01000000 0.05 239.172.20.0:55551 @LDCU
}

testcase SYS_CDCU_zhengchedianyuanzhuangtai_0014()
{
  TestDescription("IG+SOMEIP信号-14");
  teststep("warning","原始用例id为SYS-CDCU-整车电源状态-0014");
  g_EM_Equipment_Swc_TC_IG("ON"); // 测试步骤 TC_IG ON
  gTC_CANTest_SOA_SendSomeipPeriod("0x30 0x8002 02000000 0.05 239.172.20.0:55551 @LDCU"); // 测试步骤 TC_CANTest SOA SendSomeipPeriod 0x30 0x8002 02000000 0.05 239.172.20.0:55551 @LDCU
  g_EM_Uart_Swc_Ser_CheckRaw("0970010002 timeoutS3"); // 预期结果 TC_CANTest Ser CheckRaw 0970010002 timeoutS3
  g_EM_Equipment_Swc_TC_4G_Time_Delay_Second("0.1"); // 测试步骤 TC_Sleep 0.1
  g_CAN_Bus_Swc_Check("I_CDCU_State.I_CDCU_KL15State 2"); // 预期结果 TC_CANTest Check I_CDCU_State.I_CDCU_KL15State 2
  gTC_CANTest_SOA_StopSomeipPeriod("0x30 0x8002 02000000 0.05 239.172.20.0:55551 @LDCU"); // 测试步骤 TC_CANTest SOA StopSomeipPeriod 0x30 0x8002 02000000 0.05 239.172.20.0:55551 @LDCU
  gTC_CANTest_SOA_SendSomeipPeriod("0x30 0x8002 03000000 0.05 239.172.20.0:55551 @LDCU"); // 测试步骤 TC_CANTest SOA SendSomeipPeriod 0x30 0x8002 03000000 0.05 239.172.20.0:55551 @LDCU
  g_EM_Uart_Swc_Ser_CheckRaw("0970010001 timeoutS3"); // 预期结果 TC_CANTest Ser CheckRaw 0970010001 timeoutS3
  g_EM_Equipment_Swc_TC_4G_Time_Delay_Second("0.1"); // 测试步骤 TC_Sleep 0.1
  g_CAN_Bus_Swc_Check("I_CDCU_State.I_CDCU_KL15State 1"); // 预期结果 TC_CANTest Check I_CDCU_State.I_CDCU_KL15State 1
  gTC_CANTest_SOA_StopSomeipPeriod("0x30 0x8002 03000000 0.05 239.172.20.0:55551 @LDCU"); // 测试步骤 TC_CANTest SOA StopSomeipPeriod 0x30 0x8002 03000000 0.05 239.172.20.0:55551 @LDCU
}

testcase SYS_CDCU_zhengchedianyuanzhuangtai_0015()
{
  TestDescription("IG+SOMEIP信号-15");
  teststep("warning","原始用例id为SYS-CDCU-整车电源状态-0015");
  g_EM_Equipment_Swc_TC_IG("OFF"); // 测试步骤 TC_IG OFF
  g_CAN_Bus_Swc_Set("I_LDCU_NM.I_LDCU_NMActiveWakeupBit 1"); // 测试步骤 TC_CANTest SET I_LDCU_NM.I_LDCU_NMActiveWakeupBit 1
  g_EM_Equipment_Swc_TC_4G_Time_Delay_Second("1"); // 测试步骤 TC_Sleep 1
  gTC_CANTest_SOA_SendSomeipPeriod("0x30 0x8002 00000000 0.05 239.172.20.0:55551 @LDCU"); // 测试步骤 TC_CANTest SOA SendSomeipPeriod 0x30 0x8002 00000000 0.05 239.172.20.0:55551 @LDCU
  g_EM_Equipment_Swc_TC_4G_Time_Delay_Second("0.1"); // 测试步骤 TC_Sleep 0.1
  g_EM_Uart_Swc_Ser_CheckRaw("0970010000 timeoutS3"); // 预期结果 TC_CANTest Ser CheckRaw 0970010000 timeoutS3
  gTC_CANTest_SOA_StopSomeipPeriod("0x30 0x8002 00000000 0.05 239.172.20.0:55551 @LDCU"); // 测试步骤 TC_CANTest SOA StopSomeipPeriod 0x30 0x8002 00000000 0.05 239.172.20.0:55551 @LDCU
  g_CAN_Bus_Swc_Check("I_CDCU_State.I_CDCU_KL15State 0"); // 预期结果 TC_CANTest Check I_CDCU_State.I_CDCU_KL15State 0
}

testcase SYS_CDCU_zhengchedianyuanzhuangtai_0016()
{
  TestDescription("IG+SOMEIP信号-16");
  teststep("warning","原始用例id为SYS-CDCU-整车电源状态-0016");
  g_EM_Equipment_Swc_TC_IG("OFF"); // 测试步骤 TC_IG OFF
  g_CAN_Bus_Swc_Set("I_LDCU_NM.I_LDCU_NMActiveWakeupBit 1"); // 测试步骤 TC_CANTest SET I_LDCU_NM.I_LDCU_NMActiveWakeupBit 1
  g_EM_Equipment_Swc_TC_4G_Time_Delay_Second("1"); // 测试步骤 TC_Sleep 1
  gTC_CANTest_SOA_SendSomeipPeriod("0x30 0x8002 01000000 0.05 239.172.20.0:55551 @LDCU"); // 测试步骤 TC_CANTest SOA SendSomeipPeriod 0x30 0x8002 01000000 0.05 239.172.20.0:55551 @LDCU
  g_EM_Equipment_Swc_TC_4G_Time_Delay_Second("0.1"); // 测试步骤 TC_Sleep 0.1
  g_EM_Uart_Swc_Ser_CheckRaw("0970010000 timeoutS3"); // 预期结果 TC_CANTest Ser CheckRaw 0970010000 timeoutS3
  gTC_CANTest_SOA_StopSomeipPeriod("0x30 0x8002 01000000 0.05 239.172.20.0:55551 @LDCU"); // 测试步骤 TC_CANTest SOA StopSomeipPeriod 0x30 0x8002 01000000 0.05 239.172.20.0:55551 @LDCU
  g_CAN_Bus_Swc_Check("I_CDCU_State.I_CDCU_KL15State 0"); // 预期结果 TC_CANTest Check I_CDCU_State.I_CDCU_KL15State 0
}

testcase SYS_CDCU_zhengchedianyuanzhuangtai_0017()
{
  TestDescription("IG+SOMEIP信号-17");
  teststep("warning","原始用例id为SYS-CDCU-整车电源状态-0017");
  g_EM_Equipment_Swc_TC_IG("OFF"); // 测试步骤 TC_IG OFF
  g_CAN_Bus_Swc_Set("I_LDCU_NM.I_LDCU_NMActiveWakeupBit 1"); // 测试步骤 TC_CANTest SET I_LDCU_NM.I_LDCU_NMActiveWakeupBit 1
  g_EM_Equipment_Swc_TC_4G_Time_Delay_Second("1"); // 测试步骤 TC_Sleep 1
  gTC_CANTest_SOA_SendSomeipPeriod("0x30 0x8002 02000000 0.05 239.172.20.0:55551 @LDCU"); // 测试步骤 TC_CANTest SOA SendSomeipPeriod 0x30 0x8002 02000000 0.05 239.172.20.0:55551 @LDCU
  g_EM_Equipment_Swc_TC_4G_Time_Delay_Second("0.1"); // 测试步骤 TC_Sleep 0.1
  g_EM_Uart_Swc_Ser_CheckRaw("0970010000 timeoutS3"); // 预期结果 TC_CANTest Ser CheckRaw 0970010000 timeoutS3
  gTC_CANTest_SOA_StopSomeipPeriod("0x30 0x8002 02000000 0.05 239.172.20.0:55551 @LDCU"); // 测试步骤 TC_CANTest SOA StopSomeipPeriod 0x30 0x8002 02000000 0.05 239.172.20.0:55551 @LDCU
  g_CAN_Bus_Swc_Check("I_CDCU_State.I_CDCU_KL15State 0"); // 预期结果 TC_CANTest Check I_CDCU_State.I_CDCU_KL15State 0
}

testcase SYS_CDCU_zhengchedianyuanzhuangtai_0018()
{
  TestDescription("IG+SOMEIP信号-18");
  teststep("warning","原始用例id为SYS-CDCU-整车电源状态-0018");
  g_EM_Equipment_Swc_TC_IG("OFF"); // 测试步骤 TC_IG OFF
  g_CAN_Bus_Swc_Set("I_LDCU_NM.I_LDCU_NMActiveWakeupBit 1"); // 测试步骤 TC_CANTest SET I_LDCU_NM.I_LDCU_NMActiveWakeupBit 1
  g_EM_Equipment_Swc_TC_4G_Time_Delay_Second("1"); // 测试步骤 TC_Sleep 1
  gTC_CANTest_SOA_SendSomeipPeriod("0x30 0x8002 03000000 0.05 239.172.20.0:55551 @LDCU"); // 测试步骤 TC_CANTest SOA SendSomeipPeriod 0x30 0x8002 03000000 0.05 239.172.20.0:55551 @LDCU
  g_EM_Equipment_Swc_TC_4G_Time_Delay_Second("0.1"); // 测试步骤 TC_Sleep 0.1
  g_EM_Uart_Swc_Ser_CheckRaw("0970010000 timeoutS3"); // 预期结果 TC_CANTest Ser CheckRaw 0970010000 timeoutS3
  gTC_CANTest_SOA_StopSomeipPeriod("0x30 0x8002 03000000 0.05 239.172.20.0:55551 @LDCU"); // 测试步骤 TC_CANTest SOA StopSomeipPeriod 0x30 0x8002 03000000 0.05 239.172.20.0:55551 @LDCU
  g_CAN_Bus_Swc_Check("I_CDCU_State.I_CDCU_KL15State 0"); // 预期结果 TC_CANTest Check I_CDCU_State.I_CDCU_KL15State 0
}

testcase SYS_CDCU_zhengchedianyuanzhuangtai_0019()
{
  TestDescription("前置环境设置-19");
  teststep("warning","原始用例id为SYS-CDCU-整车电源状态-0019");
  g_EM_Equipment_Swc_TC_PW("OFF"); // 测试步骤 TC_PW OFF
  g_EM_Equipment_Swc_TC_IG("OFF"); // 测试步骤 TC_IG OFF
  g_EM_Equipment_Swc_TC_4G_Time_Delay_Second("2"); // 测试步骤 TC_Sleep 2
  g_EM_Equipment_Swc_TC_PW("ON"); // 测试步骤 TC_PW ON
  g_EM_Equipment_Swc_TC_IG("ON"); // 测试步骤 TC_IG ON
  g_EM_Equipment_Swc_TC_4G_Time_Delay_Second("5"); // 测试步骤 TC_Sleep 5
  g_CAN_Bus_Swc_AllCANDataDefault(); // 测试步骤 TC_CANTest SET AllCANDataDefault
  g_EM_Equipment_Swc_TC_4G_Time_Delay_Second("2"); // 测试步骤 TC_Sleep 2
  g_CAN_Bus_Swc_Disable_AllSentMessage(); // 测试步骤 TC_CANTest Disable AllSentMessage
  g_EM_Equipment_Swc_TC_4G_Time_Delay_Second("2"); // 测试步骤 TC_Sleep 2
  gTC_CANTest_SOA_StopSomeipPeriod("0x30 0x8002 00000000 0.05 239.172.20.0:55551 @LDCU"); // 测试步骤 TC_CANTest SOA StopSomeipPeriod 0x30 0x8002 00000000 0.05 239.172.20.0:55551 @LDCU
  gTC_CANTest_SOA_StopSomeipPeriod("0x30 0x8002 01000000 0.05 239.172.20.0:55551 @LDCU"); // 测试步骤 TC_CANTest SOA StopSomeipPeriod 0x30 0x8002 01000000 0.05 239.172.20.0:55551 @LDCU
  gTC_CANTest_SOA_StopSomeipPeriod("0x30 0x8002 02000000 0.05 239.172.20.0:55551 @LDCU"); // 测试步骤 TC_CANTest SOA StopSomeipPeriod 0x30 0x8002 02000000 0.05 239.172.20.0:55551 @LDCU
  gTC_CANTest_SOA_StopSomeipPeriod("0x30 0x8002 03000000 0.05 239.172.20.0:55551 @LDCU"); // 测试步骤 TC_CANTest SOA StopSomeipPeriod 0x30 0x8002 03000000 0.05 239.172.20.0:55551 @LDCU
}

testcase SYS_CDCU_zhengchedianyuanzhuangtai_0020()
{
  TestDescription("IGON+CAN信号丢失-20 先判断硬线状态，在判断信号。如果硬线状态是ON并且信号是remote on的话就是remote on ,其他的是local on;如果硬线是off的话 就是off");
  teststep("warning","原始用例id为SYS-CDCU-整车电源状态-0020");
  g_EM_Equipment_Swc_TC_IG("ON"); // 测试步骤 TC_IG ON
  g_CAN_Bus_Swc_AllCANDataDefaultAllCh(); // 测试步骤 TC_CANTest SET AllCANDataDefaultAllCh
  g_EM_Equipment_Swc_TC_4G_Time_Delay_Second("2"); // 测试步骤 TC_Sleep 2
  g_CAN_Bus_Swc_Disable_AllSentMessage(); // 测试步骤 TC_CANTest Disable AllSentMessage
  g_CAN_Bus_Swc_Set("I_LDCU_BodySysSt1.I_LDCU_PowerMode 0x02"); // 测试步骤 TC_CANTest SET I_LDCU_BodySysSt1.I_LDCU_PowerMode 0x02
  g_EM_Equipment_Swc_TC_4G_Time_Delay_Second("2"); // 测试步骤 TC_Sleep 2
  g_CAN_Bus_Swc_Disable("I_LDCU_BodySysSt1"); // 测试步骤 TC_CANTest Disable I_LDCU_BodySysSt1
  g_EM_Uart_Swc_Ser_CheckRaw("0970010002 timeoutS3"); // 预期结果 TC_CANTest Ser CheckRaw 0970010002 timeoutS3
  g_EM_Equipment_Swc_TC_4G_Time_Delay_Second("5"); // 测试步骤 TC_Sleep 5
  g_CAN_Bus_Swc_Check("I_CDCU_State.I_CDCU_KL15State 2"); // 预期结果 TC_CANTest Check I_CDCU_State.I_CDCU_KL15State 2
  g_CAN_Bus_Swc_Set("I_LDCU_BodySysSt1.I_LDCU_PowerMode 0x00"); // 测试步骤 TC_CANTest SET I_LDCU_BodySysSt1.I_LDCU_PowerMode 0x00
  g_EM_Equipment_Swc_TC_4G_Time_Delay_Second("2"); // 测试步骤 TC_Sleep 2
  g_CAN_Bus_Swc_Disable("I_LDCU_BodySysSt1"); // 测试步骤 TC_CANTest Disable I_LDCU_BodySysSt1
  g_EM_Equipment_Swc_TC_4G_Time_Delay_Second("5"); // 测试步骤 TC_Sleep 5
  g_EM_Uart_Swc_Ser_CheckRaw("0970010001 timeoutS3"); // 预期结果 TC_CANTest Ser CheckRaw 0970010001 timeoutS3
  g_CAN_Bus_Swc_Check("I_CDCU_State.I_CDCU_KL15State 1"); // 预期结果 TC_CANTest Check I_CDCU_State.I_CDCU_KL15State 1
  g_CAN_Bus_Swc_Set("I_LDCU_BodySysSt1.I_LDCU_PowerMode 0x02"); // 测试步骤 TC_CANTest SET I_LDCU_BodySysSt1.I_LDCU_PowerMode 0x02
  g_EM_Uart_Swc_Ser_CheckRaw("0970010002 timeoutS3"); // 预期结果 TC_CANTest Ser CheckRaw 0970010002 timeoutS3
  g_CAN_Bus_Swc_Check("I_CDCU_State.I_CDCU_KL15State 2"); // 预期结果 TC_CANTest Check I_CDCU_State.I_CDCU_KL15State 2
  g_CAN_Bus_Swc_Set("I_LDCU_BodySysSt1.I_LDCU_PowerMode 0x01"); // 测试步骤 TC_CANTest SET I_LDCU_BodySysSt1.I_LDCU_PowerMode 0x01
  g_EM_Equipment_Swc_TC_4G_Time_Delay_Second("2"); // 测试步骤 TC_Sleep 2
  g_CAN_Bus_Swc_Disable("I_LDCU_BodySysSt1"); // 测试步骤 TC_CANTest Disable I_LDCU_BodySysSt1
  g_EM_Equipment_Swc_TC_4G_Time_Delay_Second("5"); // 测试步骤 TC_Sleep 5
  g_EM_Uart_Swc_Ser_CheckRaw("0970010001 timeoutS3"); // 预期结果 TC_CANTest Ser CheckRaw 0970010001 timeoutS3
  g_CAN_Bus_Swc_Check("I_CDCU_State.I_CDCU_KL15State 1"); // 预期结果 TC_CANTest Check I_CDCU_State.I_CDCU_KL15State 1
  g_CAN_Bus_Swc_Set("I_LDCU_BodySysSt1.I_LDCU_PowerMode 0x02"); // 测试步骤 TC_CANTest SET I_LDCU_BodySysSt1.I_LDCU_PowerMode 0x02
  g_EM_Uart_Swc_Ser_CheckRaw("0970010002 timeoutS3"); // 预期结果 TC_CANTest Ser CheckRaw 0970010002 timeoutS3
  g_CAN_Bus_Swc_Check("I_CDCU_State.I_CDCU_KL15State 2"); // 预期结果 TC_CANTest Check I_CDCU_State.I_CDCU_KL15State 2
  g_CAN_Bus_Swc_Set("I_LDCU_BodySysSt1.I_LDCU_PowerMode 0x01"); // 测试步骤 TC_CANTest SET I_LDCU_BodySysSt1.I_LDCU_PowerMode 0x01
  g_EM_Equipment_Swc_TC_4G_Time_Delay_Second("2"); // 测试步骤 TC_Sleep 2
  g_CAN_Bus_Swc_Disable("I_LDCU_BodySysSt1"); // 测试步骤 TC_CANTest Disable I_LDCU_BodySysSt1
  g_EM_Equipment_Swc_TC_4G_Time_Delay_Second("5"); // 测试步骤 TC_Sleep 5
  g_EM_Uart_Swc_Ser_CheckRaw("0970010001 timeoutS3"); // 预期结果 TC_CANTest Ser CheckRaw 0970010001 timeoutS3
  g_CAN_Bus_Swc_Check("I_CDCU_State.I_CDCU_KL15State 1"); // 预期结果 TC_CANTest Check I_CDCU_State.I_CDCU_KL15State 1
  g_CAN_Bus_Swc_Set("I_LDCU_BodySysSt1.I_LDCU_PowerMode 0x02"); // 测试步骤 TC_CANTest SET I_LDCU_BodySysSt1.I_LDCU_PowerMode 0x02
  g_EM_Uart_Swc_Ser_CheckRaw("0970010002 timeoutS3"); // 预期结果 TC_CANTest Ser CheckRaw 0970010002 timeoutS3
  g_CAN_Bus_Swc_Check("I_CDCU_State.I_CDCU_KL15State 2"); // 预期结果 TC_CANTest Check I_CDCU_State.I_CDCU_KL15State 2
  g_CAN_Bus_Swc_Set("I_LDCU_BodySysSt1.I_LDCU_PowerMode 0x03"); // 测试步骤 TC_CANTest SET I_LDCU_BodySysSt1.I_LDCU_PowerMode 0x03
  g_EM_Equipment_Swc_TC_4G_Time_Delay_Second("2"); // 测试步骤 TC_Sleep 2
  g_CAN_Bus_Swc_Disable("I_LDCU_BodySysSt1"); // 测试步骤 TC_CANTest Disable I_LDCU_BodySysSt1
  g_EM_Equipment_Swc_TC_4G_Time_Delay_Second("5"); // 测试步骤 TC_Sleep 5
  g_EM_Uart_Swc_Ser_CheckRaw("0970010001 timeoutS3"); // 预期结果 TC_CANTest Ser CheckRaw 0970010001 timeoutS3
  g_EM_Equipment_Swc_TC_4G_Time_Delay_Second("0.1"); // 测试步骤 TC_Sleep 0.1
  g_CAN_Bus_Swc_Check("I_CDCU_State.I_CDCU_KL15State 1"); // 预期结果 TC_CANTest Check I_CDCU_State.I_CDCU_KL15State 1
}

testcase SYS_CDCU_zhengchedianyuanzhuangtai_0021()
{
  TestDescription("前置环境设置-1");
  teststep("warning","原始用例id为SYS-CDCU-整车电源状态-0021");
  g_EM_Equipment_Swc_TC_PW("OFF"); // 测试步骤 TC_PW OFF
  g_EM_Equipment_Swc_TC_IG("OFF"); // 测试步骤 TC_IG OFF
  g_EM_Equipment_Swc_TC_4G_Time_Delay_Second("2"); // 测试步骤 TC_Sleep 2
  g_EM_Equipment_Swc_TC_PW("ON"); // 测试步骤 TC_PW ON
  g_EM_Equipment_Swc_TC_IG("ON"); // 测试步骤 TC_IG ON
  g_EM_Equipment_Swc_TC_4G_Time_Delay_Second("5"); // 测试步骤 TC_Sleep 5
  g_CAN_Bus_Swc_AllCANDataDefault(); // 测试步骤 TC_CANTest SET AllCANDataDefault
  g_EM_Equipment_Swc_TC_4G_Time_Delay_Second("2"); // 测试步骤 TC_Sleep 2
  g_CAN_Bus_Swc_Disable_AllSentMessage(); // 测试步骤 TC_CANTest Disable AllSentMessage
  g_EM_Equipment_Swc_TC_4G_Time_Delay_Second("2"); // 测试步骤 TC_Sleep 2
  gTC_CANTest_SOA_StopSomeipPeriod("0x30 0x8002 00000000 0.05 239.172.20.0:55551 @LDCU"); // 测试步骤 TC_CANTest SOA StopSomeipPeriod 0x30 0x8002 00000000 0.05 239.172.20.0:55551 @LDCU
  gTC_CANTest_SOA_StopSomeipPeriod("0x30 0x8002 01000000 0.05 239.172.20.0:55551 @LDCU"); // 测试步骤 TC_CANTest SOA StopSomeipPeriod 0x30 0x8002 01000000 0.05 239.172.20.0:55551 @LDCU
  gTC_CANTest_SOA_StopSomeipPeriod("0x30 0x8002 02000000 0.05 239.172.20.0:55551 @LDCU"); // 测试步骤 TC_CANTest SOA StopSomeipPeriod 0x30 0x8002 02000000 0.05 239.172.20.0:55551 @LDCU
  gTC_CANTest_SOA_StopSomeipPeriod("0x30 0x8002 03000000 0.05 239.172.20.0:55551 @LDCU"); // 测试步骤 TC_CANTest SOA StopSomeipPeriod 0x30 0x8002 03000000 0.05 239.172.20.0:55551 @LDCU
}

testcase SYS_CDCU_zhengchedianyuanzhuangtai_0022()
{
  TestDescription("IGON+SOMEIP信号丢失-21");
  teststep("warning","原始用例id为SYS-CDCU-整车电源状态-0022");
  g_EM_Equipment_Swc_TC_IG("ON"); // 测试步骤 TC_IG ON
  g_CAN_Bus_Swc_AllCANDataDefaultAllCh(); // 测试步骤 TC_CANTest SET AllCANDataDefaultAllCh
  g_EM_Equipment_Swc_TC_4G_Time_Delay_Second("2"); // 测试步骤 TC_Sleep 2
  g_CAN_Bus_Swc_Disable_AllSentMessage(); // 测试步骤 TC_CANTest Disable AllSentMessage
  gTC_CANTest_SOA_SendSomeipPeriod("0x30 0x8002 02000000 0.05 239.172.20.0:55551 @LDCU"); // 测试步骤 TC_CANTest SOA SendSomeipPeriod 0x30 0x8002 02000000 0.05 239.172.20.0:55551 @LDCU
  g_EM_Equipment_Swc_TC_4G_Time_Delay_Second("2"); // 测试步骤 TC_Sleep 2
  gTC_CANTest_SOA_StopSomeipPeriod("0x30 0x8002 02000000 0.05 239.172.20.0:55551 @LDCU"); // 测试步骤 TC_CANTest SOA StopSomeipPeriod 0x30 0x8002 02000000 0.05 239.172.20.0:55551 @LDCU
  g_EM_Equipment_Swc_TC_4G_Time_Delay_Second("5"); // 测试步骤 TC_Sleep 5
  g_EM_Uart_Swc_Ser_CheckRaw("0970010002 timeoutS3"); // 预期结果 TC_CANTest Ser CheckRaw 0970010002 timeoutS3
  g_EM_Equipment_Swc_TC_4G_Time_Delay_Second("0.1"); // 测试步骤 TC_Sleep 0.1
  g_CAN_Bus_Swc_Check("I_CDCU_State.I_CDCU_KL15State 2"); // 预期结果 TC_CANTest Check I_CDCU_State.I_CDCU_KL15State 2
  gTC_CANTest_SOA_SendSomeipPeriod("0x30 0x8002 00000000 0.05 239.172.20.0:55551 @LDCU"); // 测试步骤 TC_CANTest SOA SendSomeipPeriod 0x30 0x8002 00000000 0.05 239.172.20.0:55551 @LDCU
  g_EM_Equipment_Swc_TC_4G_Time_Delay_Second("2"); // 测试步骤 TC_Sleep 2
  gTC_CANTest_SOA_StopSomeipPeriod("0x30 0x8002 00000000 0.05 239.172.20.0:55551 @LDCU"); // 测试步骤 TC_CANTest SOA StopSomeipPeriod 0x30 0x8002 00000000 0.05 239.172.20.0:55551 @LDCU
  g_EM_Equipment_Swc_TC_4G_Time_Delay_Second("5"); // 测试步骤 TC_Sleep 5
  g_EM_Uart_Swc_Ser_CheckRaw("0970010001 timeoutS3"); // 预期结果 TC_CANTest Ser CheckRaw 0970010001 timeoutS3
  g_EM_Equipment_Swc_TC_4G_Time_Delay_Second("0.1"); // 测试步骤 TC_Sleep 0.1
  g_CAN_Bus_Swc_Check("I_CDCU_State.I_CDCU_KL15State 1"); // 预期结果 TC_CANTest Check I_CDCU_State.I_CDCU_KL15State 1
  gTC_CANTest_SOA_SendSomeipPeriod("0x30 0x8002 01000000 0.05 239.172.20.0:55551 @LDCU"); // 测试步骤 TC_CANTest SOA SendSomeipPeriod 0x30 0x8002 01000000 0.05 239.172.20.0:55551 @LDCU
  g_EM_Equipment_Swc_TC_4G_Time_Delay_Second("2"); // 测试步骤 TC_Sleep 2
  gTC_CANTest_SOA_StopSomeipPeriod("0x30 0x8002 01000000 0.05 239.172.20.0:55551 @LDCU"); // 测试步骤 TC_CANTest SOA StopSomeipPeriod 0x30 0x8002 01000000 0.05 239.172.20.0:55551 @LDCU
  g_EM_Equipment_Swc_TC_4G_Time_Delay_Second("5"); // 测试步骤 TC_Sleep 5
  g_EM_Uart_Swc_Ser_CheckRaw("0970010001 timeoutS3"); // 预期结果 TC_CANTest Ser CheckRaw 0970010001 timeoutS3
  g_EM_Equipment_Swc_TC_4G_Time_Delay_Second("0.1"); // 测试步骤 TC_Sleep 0.1
  g_CAN_Bus_Swc_Check("I_CDCU_State.I_CDCU_KL15State 1"); // 预期结果 TC_CANTest Check I_CDCU_State.I_CDCU_KL15State 1
  gTC_CANTest_SOA_SendSomeipPeriod("0x30 0x8002 03000000 0.05 239.172.20.0:55551 @LDCU"); // 测试步骤 TC_CANTest SOA SendSomeipPeriod 0x30 0x8002 03000000 0.05 239.172.20.0:55551 @LDCU
  g_EM_Equipment_Swc_TC_4G_Time_Delay_Second("2"); // 测试步骤 TC_Sleep 2
  gTC_CANTest_SOA_StopSomeipPeriod("0x30 0x8002 03000000 0.05 239.172.20.0:55551 @LDCU"); // 测试步骤 TC_CANTest SOA StopSomeipPeriod 0x30 0x8002 03000000 0.05 239.172.20.0:55551 @LDCU
  g_EM_Equipment_Swc_TC_4G_Time_Delay_Second("5"); // 测试步骤 TC_Sleep 5
  g_EM_Uart_Swc_Ser_CheckRaw("0970010001 timeoutS3"); // 预期结果 TC_CANTest Ser CheckRaw 0970010001 timeoutS3
  g_EM_Equipment_Swc_TC_4G_Time_Delay_Second("0.1"); // 测试步骤 TC_Sleep 0.1
  g_CAN_Bus_Swc_Check("I_CDCU_State.I_CDCU_KL15State 1"); // 预期结果 TC_CANTest Check I_CDCU_State.I_CDCU_KL15State 1
}

testcase SYS_CDCU_zhengchedianyuanzhuangtai_0023()
{
  TestDescription("测试前置条件重置-22");
  teststep("warning","原始用例id为SYS-CDCU-整车电源状态-0023");
  g_EM_Equipment_Swc_TC_PW("OFF"); // 测试步骤 TC_PW OFF
  g_EM_Equipment_Swc_TC_IG("OFF"); // 测试步骤 TC_IG OFF
  g_EM_Equipment_Swc_TC_4G_Time_Delay_Second("2"); // 测试步骤 TC_Sleep 2
  g_EM_Equipment_Swc_TC_PW("ON"); // 测试步骤 TC_PW ON
  g_EM_Equipment_Swc_TC_IG("ON"); // 测试步骤 TC_IG ON
  g_EM_Equipment_Swc_TC_4G_Time_Delay_Second("5"); // 测试步骤 TC_Sleep 5
  g_CAN_Bus_Swc_AllCANDataDefault(); // 测试步骤 TC_CANTest SET AllCANDataDefault
  g_EM_Equipment_Swc_TC_4G_Time_Delay_Second("2"); // 测试步骤 TC_Sleep 2
  g_CAN_Bus_Swc_Disable_AllSentMessage(); // 测试步骤 TC_CANTest Disable AllSentMessage
  g_EM_Equipment_Swc_TC_4G_Time_Delay_Second("2"); // 测试步骤 TC_Sleep 2
  gTC_CANTest_SOA_StopSomeipPeriod("0x30 0x8002 00000000 0.05 239.172.20.0:55551 @LDCU"); // 测试步骤 TC_CANTest SOA StopSomeipPeriod 0x30 0x8002 00000000 0.05 239.172.20.0:55551 @LDCU
  gTC_CANTest_SOA_StopSomeipPeriod("0x30 0x8002 01000000 0.05 239.172.20.0:55551 @LDCU"); // 测试步骤 TC_CANTest SOA StopSomeipPeriod 0x30 0x8002 01000000 0.05 239.172.20.0:55551 @LDCU
  gTC_CANTest_SOA_StopSomeipPeriod("0x30 0x8002 02000000 0.05 239.172.20.0:55551 @LDCU"); // 测试步骤 TC_CANTest SOA StopSomeipPeriod 0x30 0x8002 02000000 0.05 239.172.20.0:55551 @LDCU
  gTC_CANTest_SOA_StopSomeipPeriod("0x30 0x8002 03000000 0.05 239.172.20.0:55551 @LDCU"); // 测试步骤 TC_CANTest SOA StopSomeipPeriod 0x30 0x8002 03000000 0.05 239.172.20.0:55551 @LDCU
}

testcase SYS_CDCU_zhengchedianyuanzhuangtai_0024()
{
  TestDescription("IGON+SOMEIP信号&CAN信号都未收到过-23");
  teststep("warning","原始用例id为SYS-CDCU-整车电源状态-0024");
  g_EM_Equipment_Swc_TC_PW("OFF"); // 测试步骤 TC_PW OFF
  g_EM_Equipment_Swc_TC_IG("OFF"); // 测试步骤 TC_IG OFF
  g_EM_Equipment_Swc_TC_4G_Time_Delay_Second("3"); // 测试步骤 TC_Sleep 3
  g_EM_Equipment_Swc_TC_PW("ON"); // 测试步骤 TC_PW ON
  g_EM_Equipment_Swc_TC_IG("ON"); // 测试步骤 TC_IG ON
  g_EM_Equipment_Swc_TC_4G_Time_Delay_Second("1"); // 测试步骤 TC_Sleep 1
  g_EM_Uart_Swc_Ser_CheckRaw("0970010001 timeoutS3"); // 预期结果 TC_CANTest Ser CheckRaw 0970010001 timeoutS3
  g_CAN_Bus_Swc_Check("I_CDCU_State.I_CDCU_KL15State 1"); // 预期结果 TC_CANTest Check I_CDCU_State.I_CDCU_KL15State 1
}

testcase SYS_CDCU_zhengchedianyuanzhuangtai_0025()
{
  TestDescription("IGOFF+SOMEIP信号&CAN信号都未收到过-23");
  teststep("warning","原始用例id为SYS-CDCU-整车电源状态-0025");
  g_EM_Equipment_Swc_TC_PW("ON"); // 测试步骤 TC_PW ON
  g_EM_Equipment_Swc_TC_IG("OFF"); // 测试步骤 TC_IG OFF
  g_CAN_Bus_Swc_Set("I_LDCU_NM.I_LDCU_NMActiveWakeupBit 1"); // 测试步骤 TC_CANTest SET I_LDCU_NM.I_LDCU_NMActiveWakeupBit 1
  g_EM_Equipment_Swc_TC_4G_Time_Delay_Second("3"); // 测试步骤 TC_Sleep 3
  g_EM_Uart_Swc_Ser_CheckRaw("0970010000 timeoutS3"); // 预期结果 TC_CANTest Ser CheckRaw 0970010000 timeoutS3
  g_CAN_Bus_Swc_Check("I_CDCU_State.I_CDCU_KL15State 0"); // 预期结果 TC_CANTest Check I_CDCU_State.I_CDCU_KL15State 0
}

testcase SYS_CDCU_zhengchedianyuanzhuangtai_0026()
{
  TestDescription("重置电源状态-25");
  teststep("warning","原始用例id为SYS-CDCU-整车电源状态-0026");
  g_EM_Equipment_Swc_TC_PW("ON"); // 测试步骤 TC_PW ON
  g_EM_Equipment_Swc_TC_IG("ON"); // 测试步骤 TC_IG ON
  g_CAN_Bus_Swc_AllCANDataDefaultAllCh(); // 测试步骤 TC_CANTest SET AllCANDataDefaultAllCh
  g_EM_Equipment_Swc_TC_4G_Time_Delay_Second("2"); // 测试步骤 TC_Sleep 2
  g_CAN_Bus_Swc_Disable_AllSentMessage(); // 测试步骤 TC_CANTest Disable AllSentMessage
}

testcase SYS_CDCU_zhengchedianyuanzhuangtai_0027()
{
  TestDescription("UART:7008");
  teststep("warning","原始用例id为SYS-CDCU-整车电源状态-0027");
  g_EM_Equipment_Swc_TC_4G_Time_Delay_Second("3"); // 测试步骤 TC_Sleep 3
  g_EM_Equipment_Swc_TC_PW("ON"); // 测试步骤 TC_PW ON
  g_EM_Equipment_Swc_TC_IG("ON"); // 测试步骤 TC_IG ON
  g_EM_Uart_Swc_Ser_CheckRaw("08700200**2E|2F timeoutS10"); // 预期结果 TC_CANTest Ser CheckRaw 08700200**2E|2F timeoutS10
}
