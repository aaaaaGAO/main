/*@!Encoding: 936*/

includes
{
}

variables
{
}

testcase SYS_CDCU_mensuo_0002()
{
  TestDescription("远程临停锁(档位=P档)");
  teststep("warning","原始用例id为SYS-CDCU-门锁-0002");
  g_CAN_Bus_Swc_Set("I_LDCU_BodySysSt1.I_LDCU_PowerMode 1"); // 测试步骤 TC_CANTest SET I_LDCU_BodySysSt1.I_LDCU_PowerMode 1
  g_CAN_Bus_Swc_Set("C_IPB_SpdInfoF.C_IPB_VehSpd 1,C_IPB_VehSpdVD 1"); // 测试步骤 TC_CANTest SET C_IPB_SpdInfoF.C_IPB_VehSpd 1,C_IPB_VehSpdVD 1//车速
  g_CAN_Bus_Swc_Set("C_LDCU_SysSt.C_LDCU_EVSysReadySt 2,C_LDCU_CurrentGearLev 4"); // 测试步骤 TC_CANTest SET C_LDCU_SysSt.C_LDCU_EVSysReadySt 2,C_LDCU_CurrentGearLev 4//高压与档位
  gTC_CANTest_SOA_SetSever("FRDoorSwSt1Struct.PsngrDoorAjarSt:0"); // 测试步骤 TC_CANTest SOA SetServer FRDoorSwSt1Struct.PsngrDoorAjarSt:0
  gTC_CANTest_SOA_SetSever("RRDoorSwSt1Struct.RRDoorAjarSt:0"); // 测试步骤 TC_CANTest SOA SetServer RRDoorSwSt1Struct.RRDoorAjarSt:0
  gTC_CANTest_SOA_SetSever("FRDoorSwSt1Struct.BonnetAjarSt:0"); // 测试步骤 TC_CANTest SOA SetServer FRDoorSwSt1Struct.BonnetAjarSt:0
  gTC_CANTest_SOA_SetSever("FLDoorSwSt1Struct.DriverDoorAjarSt:0"); // 测试步骤 TC_CANTest SOA SetServer FLDoorSwSt1Struct.DriverDoorAjarSt:0//主驾门
  gTC_CANTest_SOA_SetSever("RLDoorSwSt1Struct.RLDoorAjarSt:0"); // 测试步骤 TC_CANTest SOA SetServer RLDoorSwSt1Struct.RLDoorAjarSt:0//左后门
  gTC_CANTest_SOA_SetSever("TgateStsStruct.TrOpenerSts:1"); // 测试步骤 TC_CANTest SOA SetServer TgateStsStruct.TrOpenerSts:1
  gTC_CANTest_SOA_SetSever("DrvSeatOccupancyStStruct.DrvSeatOccupancySt:0"); // 测试步骤 TC_CANTest SOA SetServer DrvSeatOccupancyStStruct.DrvSeatOccupancySt:0//主驾占位
  g_EM_SOAClient_Swc_SOA_CHECK_Prepare("Veh_SetDoorOriLockStRespStruct.Veh_SetDoorOriLockStNRC 0"); // 预期结果 TC_CANTest SOA check Veh_SetDoorOriLockStRespStruct.Veh_SetDoorOriLockStNRC 0
  gTC_CANTest_SOA_CheckReq_Prepare("SetDoorOriLockStCmdStruct.SetDoorOriLockStCmd 6 traceback3"); // 预期结果 TC_CANTest SOA CheckReq SetDoorOriLockStCmdStruct.SetDoorOriLockStCmd 6 traceback3
  g_EM_SOAClient_Swc_SOA_CHECK_Prepare("Veh_DoorLockService_ErrStruct.OpeNRC 0 traceback3"); // 预期结果 TC_CANTest SOA check Veh_DoorLockService_ErrStruct.OpeNRC 0 traceback3 //
  g_EM_SOAClient_Swc_SOA_REQ("Veh_SetDoorOriLockStCmdStruct.Veh_SetDoorOriLockStCmd:6&ServiceExecuteFeedbackFlag:2&UserID:0x01010001"); // 测试步骤 TC_CANTest SOA REQ Veh_SetDoorOriLockStCmdStruct.Veh_SetDoorOriLockStCmd:6&ServiceExecuteFeedbackFlag:2&UserID:0x01010001
  g_EM_SOAClient_Swc_SOA_CHECK("Veh_SetDoorOriLockStRespStruct.Veh_SetDoorOriLockStNRC 0"); // 预期结果 TC_CANTest SOA check Veh_SetDoorOriLockStRespStruct.Veh_SetDoorOriLockStNRC 0
  gTC_CANTest_SOA_CheckReq("SetDoorOriLockStCmdStruct.SetDoorOriLockStCmd 6 traceback3"); // 预期结果 TC_CANTest SOA CheckReq SetDoorOriLockStCmdStruct.SetDoorOriLockStCmd 6 traceback3
  g_EM_SOAClient_Swc_SOA_CHECK("Veh_DoorLockService_ErrStruct.OpeNRC 0 traceback3"); // 预期结果 TC_CANTest SOA check Veh_DoorLockService_ErrStruct.OpeNRC 0 traceback3 //
}
