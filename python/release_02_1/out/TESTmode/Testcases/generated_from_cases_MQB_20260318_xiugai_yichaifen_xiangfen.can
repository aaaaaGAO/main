/*@!Encoding: 936*/

includes
{
}

variables
{
}

testcase SYS_CDCU_xiangfen_0001()
{
  TestDescription("前置条件");
  teststep("warning","原始用例id为SYS-CDCU-香氛-0001");
  g_EM_Equipment_Swc_TC_PW("OFF"); // 测试步骤 TC_PW OFF
  g_EM_Equipment_Swc_TC_IG("OFF"); // 测试步骤 TC_IG OFF
  g_EM_Equipment_Swc_TC_4G_Time_Delay_Second("2"); // 测试步骤 TC_Sleep 2
  g_EM_Equipment_Swc_TC_PW("ON"); // 测试步骤 TC_PW ON
  g_EM_Equipment_Swc_TC_IG("ON"); // 测试步骤 TC_IG ON
  gTC_CANTest_SOA_Set8001Delay("0"); // 测试步骤 TC_CANTest SOA Set8001Delay 0
  g_EM_SOAClient_Swc_SOA_StopSubPeriod(); // 测试步骤 TC_CANTest SOA StopSubPeriod//停止所有订阅
  g_CAN_Bus_Swc_AllCANDataDefaultAllCh(); // 测试步骤 TC_CANTest SET AllCANDataDefaultAllCh
  g_CAN_Bus_Swc_Disable_AllSentMessage(); // 测试步骤 TC_CANTest Disable AllSentMessage
  g_CAN_Bus_Swc_ClearCheckEvent(); // 测试步骤 TC_CANTest ClearCheckEvent
  g_EM_Equipment_Swc_TC_4G_Time_Delay_Second("1"); // 测试步骤 TC_Sleep 1
  g_EM_UDS_ETH_Swc_DOIP_Disconnect(); // 测试步骤 TC_CANTest DOIP Disconnect
  g_EM_SOAClient_Swc_SOA_SubPeriod("Veh_SFSService_ErrGrp 1"); // 测试步骤 TC_CANTest SOA SubPeriod Veh_SFSService_ErrGrp 1
  g_EM_SOAClient_Swc_SOA_SubPeriod("SOAEngineInterState 1"); // 测试步骤 TC_CANTest SOA SubPeriod SOAEngineInterState 1
  g_EM_SOAClient_Swc_SOA_SubPeriod("SFSSt 1"); // 测试步骤 TC_CANTest SOA SubPeriod SFSSt 1
  g_EM_UDS_CAN_Swc_Diag("10 03"); // 测试步骤 TC_CANTest Diag 10 03
  g_EM_UDS_CAN_Swc_Diag_SA_01_02(); // 测试步骤 TC_CANTest Diag SA_01_02//一级解锁
  g_EM_UDS_CAN_Swc_Diag("2E CF 01 01 00 1E 00 0C 00 00 00 00 00"); // 测试步骤 TC_CANTest Diag 2E CF 01 01 00 1E 00 0C 00 00 00 00 00//配置香氛
  g_EM_UDS_CAN_Swc_TC_CheckDiagReply("6E CF 01"); // 预期结果 TC_CheckDiagReply 6E CF 01
  g_EM_UDS_CAN_Swc_Diag("2E CF 03 00 00 00 00 00 00 01 00 00 00 00 00 00 00 00 00 00 00 00 00"); // 测试步骤 TC_CANTest Diag 2E CF 03 00 00 00 00 00 00 01 00 00 00 00 00 00 00 00 00 00 00 00 00//配置lin香氛节点
  g_EM_UDS_CAN_Swc_TC_CheckDiagReply("6E CF 03"); // 预期结果 TC_CheckDiagReply 6E CF 03
  g_EM_Equipment_Swc_TC_4G_Time_Delay_Second("1"); // 测试步骤 TC_Sleep 1
}

testcase SYS_CDCU_xiangfen_0003()
{
  TestDescription("初次上电默认浓度 Local on");
  teststep("warning","原始用例id为SYS-CDCU-香氛-0003");
  g_CAN_Bus_Swc_Set("I_LDCU_BodySysSt1.I_LDCU_PowerMode 1"); // 测试步骤 TC_CANTest SET I_LDCU_BodySysSt1.I_LDCU_PowerMode 1
  g_EM_SOAClient_Swc_SOA_REQ("Veh_SetSFSConStruct.Veh_SetSFSCon:1&ServiceExecuteFeedbackFlag:2&MemoryReq:1"); // 测试步骤 TC_CANTest SOA REQ Veh_SetSFSConStruct.Veh_SetSFSCon:1&ServiceExecuteFeedbackFlag:2&MemoryReq:1//low
  g_EM_Equipment_Swc_TC_4G_Time_Delay_Second("2"); // 测试步骤 TC_Sleep 2
  g_EM_LIN_Swc_LIN_Send("C4_FRS_CurrentIntensity 3 CH4"); // 测试步骤 TC_LINTest LIN Send C4_FRS_CurrentIntensity 3 CH4//引擎转发香氛通道真实值-high
  g_EM_LIN_Swc_LIN_Send("C4_FRS_active_container 0x3 CH4"); // 测试步骤 TC_LINTest LIN Send C4_FRS_active_container 0x3 CH4//引擎转发香氛通道真实值-ch3
  g_EM_LIN_Swc_LIN_Send("C4_FRS_FragranceID_Container_1 0x3F CH4"); // 测试步骤 TC_LINTest LIN Send C4_FRS_FragranceID_Container_1 0x3F CH4//当前通道有效-ch3
  g_EM_LIN_Swc_LIN_Send("C4_FRS_FragranceID_Container_2 0x3F CH4"); // 测试步骤 TC_LINTest LIN Send C4_FRS_FragranceID_Container_2 0x3F CH4//当前通道有效-ch3
  g_EM_LIN_Swc_LIN_Send("C4_FRS_FragranceID_Container_3 0x3F CH4"); // 测试步骤 TC_LINTest LIN Send C4_FRS_FragranceID_Container_3 0x3F CH4//当前通道有效-ch3
  g_CAN_Bus_Swc_Set("C_LDCU_SysSt.C_LDCU_EVSysReadySt 2"); // 测试步骤 TC_CANTest SET C_LDCU_SysSt.C_LDCU_EVSysReadySt 2//上高压
  g_EM_LIN_Swc_LIN_Check("C4_FRS_IntensityReq 3 CH4"); // 预期结果 TC_LINTest LIN Check C4_FRS_IntensityReq 3 CH4
}

testcase SYS_CDCU_xiangfen_0004()
{
  TestDescription("香氛开启 Local on");
  teststep("warning","原始用例id为SYS-CDCU-香氛-0004");
  g_CAN_Bus_Swc_Set("I_LDCU_BodySysSt1.I_LDCU_PowerMode 1"); // 测试步骤 TC_CANTest SET I_LDCU_BodySysSt1.I_LDCU_PowerMode 1
  g_EM_LIN_Swc_LIN_Send("C4_FRS_CurrentIntensity 10 CH4"); // 测试步骤 TC_LINTest LIN Send C4_FRS_CurrentIntensity 10 CH4//引擎转发香氛通道真实值-high
  g_EM_LIN_Swc_LIN_Send("C4_FRS_active_container 0x3 CH4"); // 测试步骤 TC_LINTest LIN Send C4_FRS_active_container 0x3 CH4//引擎转发香氛通道真实值-ch3
  g_EM_LIN_Swc_LIN_Send("C4_FRS_FragranceID_Container_1 0x3F CH4"); // 测试步骤 TC_LINTest LIN Send C4_FRS_FragranceID_Container_1 0x3F CH4//当前通道有效-ch3
  g_EM_LIN_Swc_LIN_Send("C4_FRS_FragranceID_Container_2 0x3F CH4"); // 测试步骤 TC_LINTest LIN Send C4_FRS_FragranceID_Container_2 0x3F CH4//当前通道有效-ch3
  g_EM_LIN_Swc_LIN_Send("C4_FRS_FragranceID_Container_3 0x3F CH4"); // 测试步骤 TC_LINTest LIN Send C4_FRS_FragranceID_Container_3 0x3F CH4//当前通道有效-ch3
  g_CAN_Bus_Swc_Set("C_LDCU_SysSt.C_LDCU_EVSysReadySt 2"); // 测试步骤 TC_CANTest SET C_LDCU_SysSt.C_LDCU_EVSysReadySt 2//上高压
  g_EM_SOAClient_Swc_SOA_CHECK_Prepare("Veh_SetSFSChanelRespStruct.Veh_SetSFSChanelNRC 0"); // 预期结果 TC_CANTest SOA check Veh_SetSFSChanelRespStruct.Veh_SetSFSChanelNRC 0
  g_EM_SOAClient_Swc_SOA_CHECK_Prepare("Veh_SFSService_ErrStruct.OpeNRC 0 traceback8"); // 预期结果 TC_CANTest SOA check Veh_SFSService_ErrStruct.OpeNRC 0 traceback8//
  g_EM_SOAClient_Swc_SOA_REQ("Veh_SetSFSChanelStruct.Veh_SetSFSChanel:3&ServiceExecuteFeedbackFlag:2&MemoryReq:1"); // 测试步骤 TC_CANTest SOA REQ Veh_SetSFSChanelStruct.Veh_SetSFSChanel:3&ServiceExecuteFeedbackFlag:2&MemoryReq:1//ON
  g_EM_SOAClient_Swc_SOA_CHECK("Veh_SetSFSChanelRespStruct.Veh_SetSFSChanelNRC 0"); // 预期结果 TC_CANTest SOA check Veh_SetSFSChanelRespStruct.Veh_SetSFSChanelNRC 0
  g_EM_SOAClient_Swc_SOA_CHECK("Veh_SFSService_ErrStruct.OpeNRC 0 traceback8"); // 预期结果 TC_CANTest SOA check Veh_SFSService_ErrStruct.OpeNRC 0 traceback8//
  g_EM_SOAClient_Swc_SOA_CHECK_Prepare("Veh_SetSFSConRespStruct.Veh_SetSFSConNRC 0"); // 预期结果 TC_CANTest SOA check Veh_SetSFSConRespStruct.Veh_SetSFSConNRC 0
  g_EM_SOAClient_Swc_SOA_CHECK_Prepare("Veh_SFSService_ErrStruct.OpeNRC 0 traceback8"); // 预期结果 TC_CANTest SOA check Veh_SFSService_ErrStruct.OpeNRC 0 traceback8//
  g_EM_SOAClient_Swc_SOA_REQ("Veh_SetSFSConStruct.Veh_SetSFSCon:2&ServiceExecuteFeedbackFlag:2&MemoryReq:1"); // 测试步骤 TC_CANTest SOA REQ Veh_SetSFSConStruct.Veh_SetSFSCon:2&ServiceExecuteFeedbackFlag:2&MemoryReq:1//High
  g_EM_SOAClient_Swc_SOA_CHECK("Veh_SetSFSConRespStruct.Veh_SetSFSConNRC 0"); // 预期结果 TC_CANTest SOA check Veh_SetSFSConRespStruct.Veh_SetSFSConNRC 0
  g_EM_SOAClient_Swc_SOA_CHECK("Veh_SFSService_ErrStruct.OpeNRC 0 traceback8"); // 预期结果 TC_CANTest SOA check Veh_SFSService_ErrStruct.OpeNRC 0 traceback8//
  g_EM_SOAClient_Swc_SOA_CHECK_Prepare("Veh_TurnOnOffSFSRespStruct.Veh_TurnOnOffSFSNRC 0"); // 预期结果 TC_CANTest SOA check Veh_TurnOnOffSFSRespStruct.Veh_TurnOnOffSFSNRC 0
  g_EM_SOAClient_Swc_SOA_CHECK_Prepare("Veh_SFSService_ErrStruct.OpeNRC 0 traceback5"); // 预期结果 TC_CANTest SOA check Veh_SFSService_ErrStruct.OpeNRC 0 traceback5//
  g_EM_SOAClient_Swc_SOA_REQ("Veh_TurnOnOffSFSStruct.Veh_TurnOnOffSFS:1&ServiceExecuteFeedbackFlag:2"); // 测试步骤 TC_CANTest SOA REQ Veh_TurnOnOffSFSStruct.Veh_TurnOnOffSFS:1&ServiceExecuteFeedbackFlag:2//ON
  g_EM_SOAClient_Swc_SOA_CHECK("Veh_TurnOnOffSFSRespStruct.Veh_TurnOnOffSFSNRC 0"); // 预期结果 TC_CANTest SOA check Veh_TurnOnOffSFSRespStruct.Veh_TurnOnOffSFSNRC 0
  g_EM_LIN_Swc_LIN_Check("C4_FRS_IntensityReq 10 CH4"); // 预期结果 TC_LINTest LIN Check C4_FRS_IntensityReq 10 CH4
  g_EM_LIN_Swc_LIN_Check("C4_FRS_ChannelSelect 3 CH4"); // 预期结果 TC_LINTest LIN Check C4_FRS_ChannelSelect 3 CH4
  g_EM_SOAClient_Swc_SOA_CHECK("Veh_SFSService_ErrStruct.OpeNRC 0 traceback5"); // 预期结果 TC_CANTest SOA check Veh_SFSService_ErrStruct.OpeNRC 0 traceback5//
}

testcase SYS_CDCU_xiangfen_0005()
{
  TestDescription("香氛开启(远控) Local on");
  teststep("warning","原始用例id为SYS-CDCU-香氛-0005");
  g_EM_SOAClient_Swc_SOA_CHECK_Prepare("Veh_SFSService_ErrStruct.OpeNRC 1 traceback8"); // 预期结果 TC_CANTest SOA check Veh_SFSService_ErrStruct.OpeNRC 1 traceback8
  g_EM_SOAClient_Swc_SOA_REQ("Veh_TurnOnOffSFSStruct.Veh_TurnOnOffSFS:1&ServiceExecuteFeedbackFlag:2&UserID:0x01010001&Time:1"); // 测试步骤 TC_CANTest SOA REQ Veh_TurnOnOffSFSStruct.Veh_TurnOnOffSFS:1&ServiceExecuteFeedbackFlag:2&UserID:0x01010001&Time:1//ON
  g_EM_SOAClient_Swc_SOA_CHECK("Veh_SFSService_ErrStruct.OpeNRC 1 traceback8"); // 预期结果 TC_CANTest SOA check Veh_SFSService_ErrStruct.OpeNRC 1 traceback8
}

testcase SYS_CDCU_xiangfen_0006()
{
  TestDescription("香氛开启---失败 Local on");
  teststep("warning","原始用例id为SYS-CDCU-香氛-0006");
  g_EM_LIN_Swc_LIN_Send("C4_FRS_CurrentIntensity 0 CH4"); // 测试步骤 TC_LINTest LIN Send C4_FRS_CurrentIntensity 0 CH4//引擎转发香氛通道真实值-closed
  g_EM_Equipment_Swc_TC_4G_Time_Delay_Second("5"); // 测试步骤 TC_Sleep 5
  g_EM_SOAClient_Swc_SOA_CHECK_Prepare("Veh_TurnOnOffSFSRespStruct.Veh_TurnOnOffSFSNRC 0"); // 预期结果 TC_CANTest SOA check Veh_TurnOnOffSFSRespStruct.Veh_TurnOnOffSFSNRC 0
  g_EM_SOAClient_Swc_SOA_CHECK_Prepare("Veh_SFSService_ErrStruct.OpeNRC 0xFFFFFFFF traceback18"); // 预期结果 TC_CANTest SOA check Veh_SFSService_ErrStruct.OpeNRC 0xFFFFFFFF traceback18
  g_EM_SOAClient_Swc_SOA_REQ("Veh_TurnOnOffSFSStruct.Veh_TurnOnOffSFS:1&ServiceExecuteFeedbackFlag:2"); // 测试步骤 TC_CANTest SOA REQ Veh_TurnOnOffSFSStruct.Veh_TurnOnOffSFS:1&ServiceExecuteFeedbackFlag:2//ON
  g_EM_SOAClient_Swc_SOA_CHECK("Veh_TurnOnOffSFSRespStruct.Veh_TurnOnOffSFSNRC 0"); // 预期结果 TC_CANTest SOA check Veh_TurnOnOffSFSRespStruct.Veh_TurnOnOffSFSNRC 0
  g_EM_LIN_Swc_LIN_Check("C4_FRS_IntensityReq 10 CH4"); // 预期结果 TC_LINTest LIN Check C4_FRS_IntensityReq 10 CH4
  g_EM_LIN_Swc_LIN_Check("C4_FRS_ChannelSelect 3 CH4"); // 预期结果 TC_LINTest LIN Check C4_FRS_ChannelSelect 3 CH4
  g_EM_Equipment_Swc_TC_4G_Time_Delay_Second("15"); // 测试步骤 TC_Sleep 15
  g_EM_SOAClient_Swc_SOA_CHECK("Veh_SFSService_ErrStruct.OpeNRC 0xFFFFFFFF traceback18"); // 预期结果 TC_CANTest SOA check Veh_SFSService_ErrStruct.OpeNRC 0xFFFFFFFF traceback18
}

testcase SYS_CDCU_xiangfen_0007()
{
  TestDescription("关闭 Local on");
  teststep("warning","原始用例id为SYS-CDCU-香氛-0007");
  g_EM_LIN_Swc_LIN_Send("C4_FRS_CurrentIntensity 0 CH4"); // 测试步骤 TC_LINTest LIN Send C4_FRS_CurrentIntensity 0 CH4//引擎转发香氛通道真实值-low
  g_CAN_Bus_Swc_Set("C_LDCU_SysSt.C_LDCU_EVSysReadySt 0"); // 测试步骤 TC_CANTest SET C_LDCU_SysSt.C_LDCU_EVSysReadySt 0
  g_EM_Equipment_Swc_TC_4G_Time_Delay_Second("1"); // 测试步骤 TC_Sleep 1
  g_EM_SOAClient_Swc_SOA_CHECK_Prepare("Veh_TurnOnOffSFSRespStruct.Veh_TurnOnOffSFSNRC 0"); // 预期结果 TC_CANTest SOA check Veh_TurnOnOffSFSRespStruct.Veh_TurnOnOffSFSNRC 0
  g_EM_SOAClient_Swc_SOA_CHECK_Prepare("Veh_SFSService_ErrStruct.OpeNRC 0 traceback8"); // 预期结果 TC_CANTest SOA check Veh_SFSService_ErrStruct.OpeNRC 0 traceback8//
  g_EM_SOAClient_Swc_SOA_REQ("Veh_TurnOnOffSFSStruct.Veh_TurnOnOffSFS:2&ServiceExecuteFeedbackFlag:2"); // 测试步骤 TC_CANTest SOA REQ Veh_TurnOnOffSFSStruct.Veh_TurnOnOffSFS:2&ServiceExecuteFeedbackFlag:2//OFF
  g_EM_SOAClient_Swc_SOA_CHECK("Veh_TurnOnOffSFSRespStruct.Veh_TurnOnOffSFSNRC 0"); // 预期结果 TC_CANTest SOA check Veh_TurnOnOffSFSRespStruct.Veh_TurnOnOffSFSNRC 0
  g_EM_LIN_Swc_LIN_Check("C4_FRS_IntensityReq 0 CH4"); // 预期结果 TC_LINTest LIN Check C4_FRS_IntensityReq 0 CH4
  g_EM_SOAClient_Swc_SOA_CHECK("Veh_SFSService_ErrStruct.OpeNRC 0 traceback8"); // 预期结果 TC_CANTest SOA check Veh_SFSService_ErrStruct.OpeNRC 0 traceback8//
}

testcase SYS_CDCU_xiangfen_0008()
{
  TestDescription("关闭(远控) Local on");
  teststep("warning","原始用例id为SYS-CDCU-香氛-0008");
  g_EM_LIN_Swc_LIN_Send("C4_FRS_CurrentIntensity 0 CH4"); // 测试步骤 TC_LINTest LIN Send C4_FRS_CurrentIntensity 0 CH4
  g_EM_Equipment_Swc_TC_4G_Time_Delay_Second("1"); // 测试步骤 TC_Sleep 1
  g_EM_SOAClient_Swc_SOA_CHECK_Prepare("Veh_SFSService_ErrStruct.OpeNRC 1 traceback8"); // 预期结果 TC_CANTest SOA check Veh_SFSService_ErrStruct.OpeNRC 1 traceback8
  g_EM_SOAClient_Swc_SOA_REQ("Veh_TurnOnOffSFSStruct.Veh_TurnOnOffSFS:2&ServiceExecuteFeedbackFlag:2&UserID:0x01010001&Time:1"); // 测试步骤 TC_CANTest SOA REQ Veh_TurnOnOffSFSStruct.Veh_TurnOnOffSFS:2&ServiceExecuteFeedbackFlag:2&UserID:0x01010001&Time:1//OFF
  g_EM_SOAClient_Swc_SOA_CHECK("Veh_SFSService_ErrStruct.OpeNRC 1 traceback8"); // 预期结果 TC_CANTest SOA check Veh_SFSService_ErrStruct.OpeNRC 1 traceback8
}

testcase SYS_CDCU_xiangfen_0009()
{
  TestDescription("关闭---失败 Local on");
  teststep("warning","原始用例id为SYS-CDCU-香氛-0009");
  g_EM_LIN_Swc_LIN_Send("C4_FRS_CurrentIntensity 3 CH4"); // 测试步骤 TC_LINTest LIN Send C4_FRS_CurrentIntensity 3 CH4
  g_CAN_Bus_Swc_Set("C_LDCU_SysSt.C_LDCU_EVSysReadySt 0"); // 测试步骤 TC_CANTest SET C_LDCU_SysSt.C_LDCU_EVSysReadySt 0
  g_EM_Equipment_Swc_TC_4G_Time_Delay_Second("1"); // 测试步骤 TC_Sleep 1
  g_EM_SOAClient_Swc_SOA_CHECK_Prepare("Veh_TurnOnOffSFSRespStruct.Veh_TurnOnOffSFSNRC 0"); // 预期结果 TC_CANTest SOA check Veh_TurnOnOffSFSRespStruct.Veh_TurnOnOffSFSNRC 0
  g_EM_SOAClient_Swc_SOA_CHECK_Prepare("Veh_SFSService_ErrStruct.OpeNRC 0xFFFFFFFF traceback18"); // 预期结果 TC_CANTest SOA check Veh_SFSService_ErrStruct.OpeNRC 0xFFFFFFFF traceback18
  g_EM_SOAClient_Swc_SOA_REQ("Veh_TurnOnOffSFSStruct.Veh_TurnOnOffSFS:2&ServiceExecuteFeedbackFlag:2"); // 测试步骤 TC_CANTest SOA REQ Veh_TurnOnOffSFSStruct.Veh_TurnOnOffSFS:2&ServiceExecuteFeedbackFlag:2//OFF
  g_EM_SOAClient_Swc_SOA_CHECK("Veh_TurnOnOffSFSRespStruct.Veh_TurnOnOffSFSNRC 0"); // 预期结果 TC_CANTest SOA check Veh_TurnOnOffSFSRespStruct.Veh_TurnOnOffSFSNRC 0
  g_EM_LIN_Swc_LIN_Check("C4_FRS_IntensityReq 0 CH4"); // 预期结果 TC_LINTest LIN Check C4_FRS_IntensityReq 0 CH4
  g_EM_Equipment_Swc_TC_4G_Time_Delay_Second("15"); // 测试步骤 TC_Sleep 15
  g_EM_SOAClient_Swc_SOA_CHECK("Veh_SFSService_ErrStruct.OpeNRC 0xFFFFFFFF traceback18"); // 预期结果 TC_CANTest SOA check Veh_SFSService_ErrStruct.OpeNRC 0xFFFFFFFF traceback18
}

testcase SYS_CDCU_xiangfen_0010()
{
  TestDescription("香氛通道选择 Local on");
  teststep("warning","原始用例id为SYS-CDCU-香氛-0010");
  g_EM_SOAClient_Swc_SOA_REQ("Veh_TurnOnOffSFSStruct.Veh_TurnOnOffSFS:1&ServiceExecuteFeedbackFlag:2"); // 测试步骤 TC_CANTest SOA REQ Veh_TurnOnOffSFSStruct.Veh_TurnOnOffSFS:1&ServiceExecuteFeedbackFlag:2//ON
  g_CAN_Bus_Swc_Set("C_LDCU_SysSt.C_LDCU_EVSysReadySt 2"); // 测试步骤 TC_CANTest SET C_LDCU_SysSt.C_LDCU_EVSysReadySt 2
  g_EM_LIN_Swc_LIN_Send("C4_FRS_active_container 0x1 CH4"); // 测试步骤 TC_LINTest LIN Send C4_FRS_active_container 0x1 CH4//ch1
  g_EM_LIN_Swc_LIN_Send("C4_FRS_CurrentIntensity 10 CH4"); // 测试步骤 TC_LINTest LIN Send C4_FRS_CurrentIntensity 10 CH4//-high
  g_EM_Equipment_Swc_TC_4G_Time_Delay_Second("1"); // 测试步骤 TC_Sleep 1
  g_EM_SOAClient_Swc_SOA_CHECK_Prepare("Veh_SetSFSChanelRespStruct.Veh_SetSFSChanelNRC 0"); // 预期结果 TC_CANTest SOA check Veh_SetSFSChanelRespStruct.Veh_SetSFSChanelNRC 0
  g_EM_SOAClient_Swc_SOA_CHECK_Prepare("Veh_SFSService_ErrStruct.OpeNRC 0 traceback8"); // 预期结果 TC_CANTest SOA check Veh_SFSService_ErrStruct.OpeNRC 0 traceback8//
  g_EM_SOAClient_Swc_SOA_REQ("Veh_SetSFSChanelStruct.Veh_SetSFSChanel:1&ServiceExecuteFeedbackFlag:2"); // 测试步骤 TC_CANTest SOA REQ Veh_SetSFSChanelStruct.Veh_SetSFSChanel:1&ServiceExecuteFeedbackFlag:2//通道1
  g_EM_SOAClient_Swc_SOA_CHECK("Veh_SetSFSChanelRespStruct.Veh_SetSFSChanelNRC 0"); // 预期结果 TC_CANTest SOA check Veh_SetSFSChanelRespStruct.Veh_SetSFSChanelNRC 0
  g_EM_LIN_Swc_LIN_Check("C4_FRS_ChannelSelect 1 CH4"); // 预期结果 TC_LINTest LIN Check C4_FRS_ChannelSelect 1 CH4
  g_EM_SOAClient_Swc_SOA_CHECK("Veh_SFSService_ErrStruct.OpeNRC 0 traceback8"); // 预期结果 TC_CANTest SOA check Veh_SFSService_ErrStruct.OpeNRC 0 traceback8//
}

testcase SYS_CDCU_xiangfen_0011()
{
  TestDescription("香氛通道选择 Local on");
  teststep("warning","原始用例id为SYS-CDCU-香氛-0011");
  g_EM_LIN_Swc_LIN_Send("C4_FRS_active_container 0x2 CH4"); // 测试步骤 TC_LINTest LIN Send C4_FRS_active_container 0x2 CH4//ch2
  g_EM_Equipment_Swc_TC_4G_Time_Delay_Second("1"); // 测试步骤 TC_Sleep 1
  g_EM_SOAClient_Swc_SOA_CHECK_Prepare("Veh_SetSFSChanelRespStruct.Veh_SetSFSChanelNRC 0"); // 预期结果 TC_CANTest SOA check Veh_SetSFSChanelRespStruct.Veh_SetSFSChanelNRC 0
  g_EM_SOAClient_Swc_SOA_CHECK_Prepare("Veh_SFSService_ErrStruct.OpeNRC 0 traceback8"); // 预期结果 TC_CANTest SOA check Veh_SFSService_ErrStruct.OpeNRC 0 traceback8//
  g_EM_SOAClient_Swc_SOA_REQ("Veh_SetSFSChanelStruct.Veh_SetSFSChanel:2&ServiceExecuteFeedbackFlag:2"); // 测试步骤 TC_CANTest SOA REQ Veh_SetSFSChanelStruct.Veh_SetSFSChanel:2&ServiceExecuteFeedbackFlag:2//通道2
  g_EM_SOAClient_Swc_SOA_CHECK("Veh_SetSFSChanelRespStruct.Veh_SetSFSChanelNRC 0"); // 预期结果 TC_CANTest SOA check Veh_SetSFSChanelRespStruct.Veh_SetSFSChanelNRC 0
  g_EM_LIN_Swc_LIN_Check("C4_FRS_ChannelSelect 2 CH4"); // 预期结果 TC_LINTest LIN Check C4_FRS_ChannelSelect 2 CH4
  g_EM_SOAClient_Swc_SOA_CHECK("Veh_SFSService_ErrStruct.OpeNRC 0 traceback8"); // 预期结果 TC_CANTest SOA check Veh_SFSService_ErrStruct.OpeNRC 0 traceback8//
}

testcase SYS_CDCU_xiangfen_0012()
{
  TestDescription("香氛通道选择 Local on");
  teststep("warning","原始用例id为SYS-CDCU-香氛-0012");
  g_EM_LIN_Swc_LIN_Send("C4_FRS_active_container 0x3 CH4"); // 测试步骤 TC_LINTest LIN Send C4_FRS_active_container 0x3 CH4//ch3
  g_EM_Equipment_Swc_TC_4G_Time_Delay_Second("1"); // 测试步骤 TC_Sleep 1
  g_EM_SOAClient_Swc_SOA_CHECK_Prepare("Veh_SetSFSChanelRespStruct.Veh_SetSFSChanelNRC 0"); // 预期结果 TC_CANTest SOA check Veh_SetSFSChanelRespStruct.Veh_SetSFSChanelNRC 0
  g_EM_SOAClient_Swc_SOA_CHECK_Prepare("Veh_SFSService_ErrStruct.OpeNRC 0 traceback8"); // 预期结果 TC_CANTest SOA check Veh_SFSService_ErrStruct.OpeNRC 0 traceback8//
  g_EM_SOAClient_Swc_SOA_REQ("Veh_SetSFSChanelStruct.Veh_SetSFSChanel:3&ServiceExecuteFeedbackFlag:2&MemoryReq:1"); // 测试步骤 TC_CANTest SOA REQ Veh_SetSFSChanelStruct.Veh_SetSFSChanel:3&ServiceExecuteFeedbackFlag:2&MemoryReq:1//通道3
  g_EM_SOAClient_Swc_SOA_CHECK("Veh_SetSFSChanelRespStruct.Veh_SetSFSChanelNRC 0"); // 预期结果 TC_CANTest SOA check Veh_SetSFSChanelRespStruct.Veh_SetSFSChanelNRC 0
  g_EM_LIN_Swc_LIN_Check("C4_FRS_ChannelSelect 3 CH4"); // 预期结果 TC_LINTest LIN Check C4_FRS_ChannelSelect 3 CH4
  g_EM_SOAClient_Swc_SOA_CHECK("Veh_SFSService_ErrStruct.OpeNRC 0 traceback8"); // 预期结果 TC_CANTest SOA check Veh_SFSService_ErrStruct.OpeNRC 0 traceback8//
}

testcase SYS_CDCU_xiangfen_0013()
{
  TestDescription("香氛通道选择(远控) Local on");
  teststep("warning","原始用例id为SYS-CDCU-香氛-0013");
  g_EM_SOAClient_Swc_SOA_CHECK_Prepare("Veh_SFSService_ErrStruct.OpeNRC 1 traceback8"); // 预期结果 TC_CANTest SOA check Veh_SFSService_ErrStruct.OpeNRC 1 traceback8
  g_EM_SOAClient_Swc_SOA_CHECK_Prepare("Veh_SFSService_ErrStruct.OpeErrInfo[0-1]:0x9 traceback10"); // 预期结果 TC_CANTest SOA check Veh_SFSService_ErrStruct.OpeErrInfo[0-1]:0x9 traceback10
  g_EM_SOAClient_Swc_SOA_REQ("Veh_SetSFSChanelStruct.Veh_SetSFSChanel:1&ServiceExecuteFeedbackFlag:2&UserID:0x01010001&Time:1"); // 测试步骤 TC_CANTest SOA REQ Veh_SetSFSChanelStruct.Veh_SetSFSChanel:1&ServiceExecuteFeedbackFlag:2&UserID:0x01010001&Time:1//通道1
  g_EM_SOAClient_Swc_SOA_CHECK("Veh_SFSService_ErrStruct.OpeNRC 1 traceback8"); // 预期结果 TC_CANTest SOA check Veh_SFSService_ErrStruct.OpeNRC 1 traceback8
  g_EM_SOAClient_Swc_SOA_CHECK("Veh_SFSService_ErrStruct.OpeErrInfo[0-1]:0x9 traceback10"); // 预期结果 TC_CANTest SOA check Veh_SFSService_ErrStruct.OpeErrInfo[0-1]:0x9 traceback10
}

testcase SYS_CDCU_xiangfen_0014()
{
  TestDescription("香氛通道选择(当前active通道0)浓度记忆10通道选择3 Local on");
  teststep("warning","原始用例id为SYS-CDCU-香氛-0014");
  g_EM_LIN_Swc_LIN_Send("C4_FRS_CurrentIntensity 10 CH4"); // 测试步骤 TC_LINTest LIN Send C4_FRS_CurrentIntensity 10 CH4
  g_EM_Equipment_Swc_TC_4G_Time_Delay_Second("1"); // 测试步骤 TC_Sleep 1
  g_EM_SOAClient_Swc_SOA_CHECK_Prepare("Veh_SetSFSConRespStruct.Veh_SetSFSConNRC 0"); // 预期结果 TC_CANTest SOA check Veh_SetSFSConRespStruct.Veh_SetSFSConNRC 0
  g_EM_SOAClient_Swc_SOA_CHECK_Prepare("Veh_SFSService_ErrStruct.OpeNRC 0 traceback8"); // 预期结果 TC_CANTest SOA check Veh_SFSService_ErrStruct.OpeNRC 0 traceback8//
  g_EM_SOAClient_Swc_SOA_REQ("Veh_SetSFSConStruct.Veh_SetSFSCon:2&ServiceExecuteFeedbackFlag:2&MemoryReq:1"); // 测试步骤 TC_CANTest SOA REQ Veh_SetSFSConStruct.Veh_SetSFSCon:2&ServiceExecuteFeedbackFlag:2&MemoryReq:1//High
  g_EM_SOAClient_Swc_SOA_CHECK("Veh_SetSFSConRespStruct.Veh_SetSFSConNRC 0"); // 预期结果 TC_CANTest SOA check Veh_SetSFSConRespStruct.Veh_SetSFSConNRC 0
  g_EM_LIN_Swc_LIN_Check("C4_FRS_IntensityReq 10 CH4"); // 预期结果 TC_LINTest LIN Check C4_FRS_IntensityReq 10 CH4
  g_EM_SOAClient_Swc_SOA_CHECK("Veh_SFSService_ErrStruct.OpeNRC 0 traceback8"); // 预期结果 TC_CANTest SOA check Veh_SFSService_ErrStruct.OpeNRC 0 traceback8//
  g_EM_LIN_Swc_LIN_Send("C4_FRS_active_container 0x0 CH4"); // 测试步骤 TC_LINTest LIN Send C4_FRS_active_container 0x0 CH4//ch3
  g_EM_LIN_Swc_LIN_Send("C4_FRS_CurrentIntensity 0 CH4"); // 测试步骤 TC_LINTest LIN Send C4_FRS_CurrentIntensity 0 CH4//引擎转发香氛通道真实值-closed
  g_EM_Equipment_Swc_TC_4G_Time_Delay_Second("1"); // 测试步骤 TC_Sleep 1
  g_EM_SOAClient_Swc_SOA_CHECK_Prepare("Veh_SetSFSChanelRespStruct.Veh_SetSFSChanelNRC 0"); // 预期结果 TC_CANTest SOA check Veh_SetSFSChanelRespStruct.Veh_SetSFSChanelNRC 0
  g_EM_SOAClient_Swc_SOA_CHECK_Prepare("Veh_SFSService_ErrStruct.OpeNRC 0 traceback8"); // 预期结果 TC_CANTest SOA check Veh_SFSService_ErrStruct.OpeNRC 0 traceback8//
  g_EM_SOAClient_Swc_SOA_REQ("Veh_SetSFSChanelStruct.Veh_SetSFSChanel:3&ServiceExecuteFeedbackFlag:2&MemoryReq:1"); // 测试步骤 TC_CANTest SOA REQ Veh_SetSFSChanelStruct.Veh_SetSFSChanel:3&ServiceExecuteFeedbackFlag:2&MemoryReq:1//通道3
  g_EM_SOAClient_Swc_SOA_CHECK("Veh_SetSFSChanelRespStruct.Veh_SetSFSChanelNRC 0"); // 预期结果 TC_CANTest SOA check Veh_SetSFSChanelRespStruct.Veh_SetSFSChanelNRC 0
  g_EM_LIN_Swc_LIN_Check("C4_FRS_ChannelSelect 3 CH4"); // 预期结果 TC_LINTest LIN Check C4_FRS_ChannelSelect 3 CH4
  g_EM_LIN_Swc_LIN_Send("C4_FRS_active_container 0x3 CH4"); // 测试步骤 TC_LINTest LIN Send C4_FRS_active_container 0x3 CH4//ch3
  g_EM_LIN_Swc_LIN_Check("C4_FRS_IntensityReq 10 CH4"); // 预期结果 TC_LINTest LIN Check C4_FRS_IntensityReq 10 CH4
  g_EM_LIN_Swc_LIN_Send("C4_FRS_CurrentIntensity 10 CH4"); // 测试步骤 TC_LINTest LIN Send C4_FRS_CurrentIntensity 10 CH4//引擎转发香氛通道真实值-10
  g_EM_SOAClient_Swc_SOA_CHECK("Veh_SFSService_ErrStruct.OpeNRC 0 traceback8"); // 预期结果 TC_CANTest SOA check Veh_SFSService_ErrStruct.OpeNRC 0 traceback8//
}

testcase SYS_CDCU_xiangfen_0015()
{
  TestDescription("香氛通道选择(当前active通道0)浓度记忆10通道选择2 Local on");
  teststep("warning","原始用例id为SYS-CDCU-香氛-0015");
  g_EM_LIN_Swc_LIN_Send("C4_FRS_active_container 0x0 CH4"); // 测试步骤 TC_LINTest LIN Send C4_FRS_active_container 0x0 CH4//ch3
  g_EM_LIN_Swc_LIN_Send("C4_FRS_CurrentIntensity 0 CH4"); // 测试步骤 TC_LINTest LIN Send C4_FRS_CurrentIntensity 0 CH4//引擎转发香氛通道真实值-closed
  g_EM_Equipment_Swc_TC_4G_Time_Delay_Second("1"); // 测试步骤 TC_Sleep 1
  g_EM_SOAClient_Swc_SOA_CHECK_Prepare("Veh_SetSFSChanelRespStruct.Veh_SetSFSChanelNRC 0"); // 预期结果 TC_CANTest SOA check Veh_SetSFSChanelRespStruct.Veh_SetSFSChanelNRC 0
  g_EM_SOAClient_Swc_SOA_CHECK_Prepare("Veh_SFSService_ErrStruct.OpeNRC 0 traceback8"); // 预期结果 TC_CANTest SOA check Veh_SFSService_ErrStruct.OpeNRC 0 traceback8//
  g_EM_SOAClient_Swc_SOA_REQ("Veh_SetSFSChanelStruct.Veh_SetSFSChanel:2&ServiceExecuteFeedbackFlag:2&MemoryReq:1"); // 测试步骤 TC_CANTest SOA REQ Veh_SetSFSChanelStruct.Veh_SetSFSChanel:2&ServiceExecuteFeedbackFlag:2&MemoryReq:1//通道3
  g_EM_SOAClient_Swc_SOA_CHECK("Veh_SetSFSChanelRespStruct.Veh_SetSFSChanelNRC 0"); // 预期结果 TC_CANTest SOA check Veh_SetSFSChanelRespStruct.Veh_SetSFSChanelNRC 0
  g_EM_LIN_Swc_LIN_Check("C4_FRS_ChannelSelect 2 CH4"); // 预期结果 TC_LINTest LIN Check C4_FRS_ChannelSelect 2 CH4
  g_EM_LIN_Swc_LIN_Send("C4_FRS_active_container 0x2 CH4"); // 测试步骤 TC_LINTest LIN Send C4_FRS_active_container 0x2 CH4//ch3
  g_EM_LIN_Swc_LIN_Check("C4_FRS_IntensityReq 10 CH4"); // 预期结果 TC_LINTest LIN Check C4_FRS_IntensityReq 10 CH4
  g_EM_LIN_Swc_LIN_Send("C4_FRS_CurrentIntensity 10 CH4"); // 测试步骤 TC_LINTest LIN Send C4_FRS_CurrentIntensity 10 CH4//引擎转发香氛通道真实值-10
  g_EM_SOAClient_Swc_SOA_CHECK("Veh_SFSService_ErrStruct.OpeNRC 0 traceback8"); // 预期结果 TC_CANTest SOA check Veh_SFSService_ErrStruct.OpeNRC 0 traceback8//
}

testcase SYS_CDCU_xiangfen_0016()
{
  TestDescription("香氛通道选择(当前active通道0)浓度记忆10通道选择1 Local on");
  teststep("warning","原始用例id为SYS-CDCU-香氛-0016");
  g_EM_LIN_Swc_LIN_Send("C4_FRS_active_container 0x0 CH4"); // 测试步骤 TC_LINTest LIN Send C4_FRS_active_container 0x0 CH4//ch3
  g_EM_LIN_Swc_LIN_Send("C4_FRS_CurrentIntensity 0 CH4"); // 测试步骤 TC_LINTest LIN Send C4_FRS_CurrentIntensity 0 CH4//引擎转发香氛通道真实值-closed
  g_EM_Equipment_Swc_TC_4G_Time_Delay_Second("1"); // 测试步骤 TC_Sleep 1
  g_EM_SOAClient_Swc_SOA_CHECK_Prepare("Veh_SetSFSChanelRespStruct.Veh_SetSFSChanelNRC 0"); // 预期结果 TC_CANTest SOA check Veh_SetSFSChanelRespStruct.Veh_SetSFSChanelNRC 0
  g_EM_SOAClient_Swc_SOA_CHECK_Prepare("Veh_SFSService_ErrStruct.OpeNRC 0 traceback8"); // 预期结果 TC_CANTest SOA check Veh_SFSService_ErrStruct.OpeNRC 0 traceback8//
  g_EM_SOAClient_Swc_SOA_REQ("Veh_SetSFSChanelStruct.Veh_SetSFSChanel:1&ServiceExecuteFeedbackFlag:2&MemoryReq:1"); // 测试步骤 TC_CANTest SOA REQ Veh_SetSFSChanelStruct.Veh_SetSFSChanel:1&ServiceExecuteFeedbackFlag:2&MemoryReq:1//通道3
  g_EM_SOAClient_Swc_SOA_CHECK("Veh_SetSFSChanelRespStruct.Veh_SetSFSChanelNRC 0"); // 预期结果 TC_CANTest SOA check Veh_SetSFSChanelRespStruct.Veh_SetSFSChanelNRC 0
  g_EM_LIN_Swc_LIN_Check("C4_FRS_ChannelSelect 1 CH4"); // 预期结果 TC_LINTest LIN Check C4_FRS_ChannelSelect 1 CH4
  g_EM_LIN_Swc_LIN_Send("C4_FRS_active_container 0x1 CH4"); // 测试步骤 TC_LINTest LIN Send C4_FRS_active_container 0x1 CH4//ch3
  g_EM_LIN_Swc_LIN_Check("C4_FRS_IntensityReq 10 CH4"); // 预期结果 TC_LINTest LIN Check C4_FRS_IntensityReq 10 CH4
  g_EM_LIN_Swc_LIN_Send("C4_FRS_CurrentIntensity 10 CH4"); // 测试步骤 TC_LINTest LIN Send C4_FRS_CurrentIntensity 10 CH4//引擎转发香氛通道真实值-10
  g_EM_SOAClient_Swc_SOA_CHECK("Veh_SFSService_ErrStruct.OpeNRC 0 traceback8"); // 预期结果 TC_CANTest SOA check Veh_SFSService_ErrStruct.OpeNRC 0 traceback8//
}

testcase SYS_CDCU_xiangfen_0017()
{
  TestDescription("香氛通道选择(当前active通道0)浓度记忆3 Local on");
  teststep("warning","原始用例id为SYS-CDCU-香氛-0017");
  g_EM_LIN_Swc_LIN_Send("C4_FRS_CurrentIntensity 3 CH4"); // 测试步骤 TC_LINTest LIN Send C4_FRS_CurrentIntensity 3 CH4
  g_EM_Equipment_Swc_TC_4G_Time_Delay_Second("1"); // 测试步骤 TC_Sleep 1
  g_EM_SOAClient_Swc_SOA_CHECK_Prepare("Veh_SetSFSConRespStruct.Veh_SetSFSConNRC 0"); // 预期结果 TC_CANTest SOA check Veh_SetSFSConRespStruct.Veh_SetSFSConNRC 0
  g_EM_SOAClient_Swc_SOA_CHECK_Prepare("Veh_SFSService_ErrStruct.OpeNRC 0 traceback8"); // 预期结果 TC_CANTest SOA check Veh_SFSService_ErrStruct.OpeNRC 0 traceback8//
  g_EM_SOAClient_Swc_SOA_REQ("Veh_SetSFSConStruct.Veh_SetSFSCon:1&ServiceExecuteFeedbackFlag:2&MemoryReq:1"); // 测试步骤 TC_CANTest SOA REQ Veh_SetSFSConStruct.Veh_SetSFSCon:1&ServiceExecuteFeedbackFlag:2&MemoryReq:1//High
  g_EM_SOAClient_Swc_SOA_CHECK("Veh_SetSFSConRespStruct.Veh_SetSFSConNRC 0"); // 预期结果 TC_CANTest SOA check Veh_SetSFSConRespStruct.Veh_SetSFSConNRC 0
  g_EM_LIN_Swc_LIN_Check("C4_FRS_IntensityReq 3 CH4"); // 预期结果 TC_LINTest LIN Check C4_FRS_IntensityReq 3 CH4
  g_EM_SOAClient_Swc_SOA_CHECK("Veh_SFSService_ErrStruct.OpeNRC 0 traceback8"); // 预期结果 TC_CANTest SOA check Veh_SFSService_ErrStruct.OpeNRC 0 traceback8//
  g_EM_LIN_Swc_LIN_Send("C4_FRS_active_container 0x0 CH4"); // 测试步骤 TC_LINTest LIN Send C4_FRS_active_container 0x0 CH4//ch3
  g_EM_LIN_Swc_LIN_Send("C4_FRS_CurrentIntensity 0 CH4"); // 测试步骤 TC_LINTest LIN Send C4_FRS_CurrentIntensity 0 CH4//引擎转发香氛通道真实值-closed
  g_EM_Equipment_Swc_TC_4G_Time_Delay_Second("1"); // 测试步骤 TC_Sleep 1
  g_EM_SOAClient_Swc_SOA_CHECK_Prepare("Veh_SetSFSChanelRespStruct.Veh_SetSFSChanelNRC 0"); // 预期结果 TC_CANTest SOA check Veh_SetSFSChanelRespStruct.Veh_SetSFSChanelNRC 0
  g_EM_SOAClient_Swc_SOA_CHECK_Prepare("Veh_SFSService_ErrStruct.OpeNRC 0 traceback8"); // 预期结果 TC_CANTest SOA check Veh_SFSService_ErrStruct.OpeNRC 0 traceback8//
  g_EM_SOAClient_Swc_SOA_REQ("Veh_SetSFSChanelStruct.Veh_SetSFSChanel:3&ServiceExecuteFeedbackFlag:2&MemoryReq:1"); // 测试步骤 TC_CANTest SOA REQ Veh_SetSFSChanelStruct.Veh_SetSFSChanel:3&ServiceExecuteFeedbackFlag:2&MemoryReq:1//通道3
  g_EM_SOAClient_Swc_SOA_CHECK("Veh_SetSFSChanelRespStruct.Veh_SetSFSChanelNRC 0"); // 预期结果 TC_CANTest SOA check Veh_SetSFSChanelRespStruct.Veh_SetSFSChanelNRC 0
  g_EM_LIN_Swc_LIN_Check("C4_FRS_ChannelSelect 3 CH4"); // 预期结果 TC_LINTest LIN Check C4_FRS_ChannelSelect 3 CH4
  g_EM_LIN_Swc_LIN_Send("C4_FRS_active_container 0x3 CH4"); // 测试步骤 TC_LINTest LIN Send C4_FRS_active_container 0x3 CH4//ch3
  g_EM_LIN_Swc_LIN_Check("C4_FRS_IntensityReq 3 CH4"); // 预期结果 TC_LINTest LIN Check C4_FRS_IntensityReq 3 CH4
  g_EM_LIN_Swc_LIN_Send("C4_FRS_CurrentIntensity 3 CH4"); // 测试步骤 TC_LINTest LIN Send C4_FRS_CurrentIntensity 3 CH4//引擎转发香氛通道真实值-3
  g_EM_SOAClient_Swc_SOA_CHECK("Veh_SFSService_ErrStruct.OpeNRC 0 traceback8"); // 预期结果 TC_CANTest SOA check Veh_SFSService_ErrStruct.OpeNRC 0 traceback8//
}

testcase SYS_CDCU_xiangfen_0018()
{
  TestDescription("香氛通道选择(当前active通道0)浓度记忆3通道选择2 Local on");
  teststep("warning","原始用例id为SYS-CDCU-香氛-0018");
  g_EM_LIN_Swc_LIN_Send("C4_FRS_active_container 0x0 CH4"); // 测试步骤 TC_LINTest LIN Send C4_FRS_active_container 0x0 CH4//ch3
  g_EM_LIN_Swc_LIN_Send("C4_FRS_CurrentIntensity 0 CH4"); // 测试步骤 TC_LINTest LIN Send C4_FRS_CurrentIntensity 0 CH4//引擎转发香氛通道真实值-closed
  g_EM_Equipment_Swc_TC_4G_Time_Delay_Second("1"); // 测试步骤 TC_Sleep 1
  g_EM_SOAClient_Swc_SOA_CHECK_Prepare("Veh_SetSFSChanelRespStruct.Veh_SetSFSChanelNRC 0"); // 预期结果 TC_CANTest SOA check Veh_SetSFSChanelRespStruct.Veh_SetSFSChanelNRC 0
  g_EM_SOAClient_Swc_SOA_CHECK_Prepare("Veh_SFSService_ErrStruct.OpeNRC 0 traceback8"); // 预期结果 TC_CANTest SOA check Veh_SFSService_ErrStruct.OpeNRC 0 traceback8//
  g_EM_SOAClient_Swc_SOA_REQ("Veh_SetSFSChanelStruct.Veh_SetSFSChanel:2&ServiceExecuteFeedbackFlag:2&MemoryReq:1"); // 测试步骤 TC_CANTest SOA REQ Veh_SetSFSChanelStruct.Veh_SetSFSChanel:2&ServiceExecuteFeedbackFlag:2&MemoryReq:1//通道3
  g_EM_SOAClient_Swc_SOA_CHECK("Veh_SetSFSChanelRespStruct.Veh_SetSFSChanelNRC 0"); // 预期结果 TC_CANTest SOA check Veh_SetSFSChanelRespStruct.Veh_SetSFSChanelNRC 0
  g_EM_LIN_Swc_LIN_Check("C4_FRS_ChannelSelect 2 CH4"); // 预期结果 TC_LINTest LIN Check C4_FRS_ChannelSelect 2 CH4
  g_EM_LIN_Swc_LIN_Send("C4_FRS_active_container 0x2 CH4"); // 测试步骤 TC_LINTest LIN Send C4_FRS_active_container 0x2 CH4//ch3
  g_EM_LIN_Swc_LIN_Check("C4_FRS_IntensityReq 3 CH4"); // 预期结果 TC_LINTest LIN Check C4_FRS_IntensityReq 3 CH4
  g_EM_LIN_Swc_LIN_Send("C4_FRS_CurrentIntensity 3 CH4"); // 测试步骤 TC_LINTest LIN Send C4_FRS_CurrentIntensity 3 CH4//引擎转发香氛通道真实值-3
  g_EM_SOAClient_Swc_SOA_CHECK("Veh_SFSService_ErrStruct.OpeNRC 0 traceback8"); // 预期结果 TC_CANTest SOA check Veh_SFSService_ErrStruct.OpeNRC 0 traceback8//
}

testcase SYS_CDCU_xiangfen_0019()
{
  TestDescription("香氛通道选择(当前active通道0)浓度记忆3通道选择1 Local on");
  teststep("warning","原始用例id为SYS-CDCU-香氛-0019");
  g_EM_LIN_Swc_LIN_Send("C4_FRS_active_container 0x0 CH4"); // 测试步骤 TC_LINTest LIN Send C4_FRS_active_container 0x0 CH4//ch3
  g_EM_LIN_Swc_LIN_Send("C4_FRS_CurrentIntensity 0 CH4"); // 测试步骤 TC_LINTest LIN Send C4_FRS_CurrentIntensity 0 CH4//引擎转发香氛通道真实值-closed
  g_EM_Equipment_Swc_TC_4G_Time_Delay_Second("1"); // 测试步骤 TC_Sleep 1
  g_EM_SOAClient_Swc_SOA_CHECK_Prepare("Veh_SetSFSChanelRespStruct.Veh_SetSFSChanelNRC 0"); // 预期结果 TC_CANTest SOA check Veh_SetSFSChanelRespStruct.Veh_SetSFSChanelNRC 0
  g_EM_SOAClient_Swc_SOA_CHECK_Prepare("Veh_SFSService_ErrStruct.OpeNRC 0 traceback8"); // 预期结果 TC_CANTest SOA check Veh_SFSService_ErrStruct.OpeNRC 0 traceback8//
  g_EM_SOAClient_Swc_SOA_REQ("Veh_SetSFSChanelStruct.Veh_SetSFSChanel:1&ServiceExecuteFeedbackFlag:2&MemoryReq:1"); // 测试步骤 TC_CANTest SOA REQ Veh_SetSFSChanelStruct.Veh_SetSFSChanel:1&ServiceExecuteFeedbackFlag:2&MemoryReq:1//通道3
  g_EM_SOAClient_Swc_SOA_CHECK("Veh_SetSFSChanelRespStruct.Veh_SetSFSChanelNRC 0"); // 预期结果 TC_CANTest SOA check Veh_SetSFSChanelRespStruct.Veh_SetSFSChanelNRC 0
  g_EM_LIN_Swc_LIN_Check("C4_FRS_ChannelSelect 1 CH4"); // 预期结果 TC_LINTest LIN Check C4_FRS_ChannelSelect 1 CH4
  g_EM_LIN_Swc_LIN_Send("C4_FRS_active_container 0x1 CH4"); // 测试步骤 TC_LINTest LIN Send C4_FRS_active_container 0x1 CH4//ch3
  g_EM_LIN_Swc_LIN_Check("C4_FRS_IntensityReq 3 CH4"); // 预期结果 TC_LINTest LIN Check C4_FRS_IntensityReq 3 CH4
  g_EM_LIN_Swc_LIN_Send("C4_FRS_CurrentIntensity 3 CH4"); // 测试步骤 TC_LINTest LIN Send C4_FRS_CurrentIntensity 3 CH4//引擎转发香氛通道真实值-3
  g_EM_SOAClient_Swc_SOA_CHECK("Veh_SFSService_ErrStruct.OpeNRC 0 traceback8"); // 预期结果 TC_CANTest SOA check Veh_SFSService_ErrStruct.OpeNRC 0 traceback8//
}

testcase SYS_CDCU_xiangfen_0020()
{
  TestDescription("香氛通道选择(当前active通道0)浓度记忆6 Local on");
  teststep("warning","原始用例id为SYS-CDCU-香氛-0020");
  g_EM_LIN_Swc_LIN_Send("C4_FRS_CurrentIntensity 3 CH4"); // 测试步骤 TC_LINTest LIN Send C4_FRS_CurrentIntensity 3 CH4
  g_EM_Equipment_Swc_TC_4G_Time_Delay_Second("1"); // 测试步骤 TC_Sleep 1
  g_EM_SOAClient_Swc_SOA_CHECK_Prepare("Veh_SetSFSConRespStruct.Veh_SetSFSConNRC 0"); // 预期结果 TC_CANTest SOA check Veh_SetSFSConRespStruct.Veh_SetSFSConNRC 0
  g_EM_SOAClient_Swc_SOA_CHECK_Prepare("Veh_SFSService_ErrStruct.OpeNRC 0 traceback8"); // 预期结果 TC_CANTest SOA check Veh_SFSService_ErrStruct.OpeNRC 0 traceback8//
  g_EM_SOAClient_Swc_SOA_REQ("Veh_SetSFSConStruct.Veh_SetSFSCon:3&ServiceExecuteFeedbackFlag:2&MemoryReq:1"); // 测试步骤 TC_CANTest SOA REQ Veh_SetSFSConStruct.Veh_SetSFSCon:3&ServiceExecuteFeedbackFlag:2&MemoryReq:1//High
  g_EM_SOAClient_Swc_SOA_CHECK("Veh_SetSFSConRespStruct.Veh_SetSFSConNRC 0"); // 预期结果 TC_CANTest SOA check Veh_SetSFSConRespStruct.Veh_SetSFSConNRC 0
  g_EM_LIN_Swc_LIN_Check("C4_FRS_IntensityReq 6 CH4"); // 预期结果 TC_LINTest LIN Check C4_FRS_IntensityReq 6 CH4
  g_EM_SOAClient_Swc_SOA_CHECK("Veh_SFSService_ErrStruct.OpeNRC 0 traceback8"); // 预期结果 TC_CANTest SOA check Veh_SFSService_ErrStruct.OpeNRC 0 traceback8//
  g_EM_LIN_Swc_LIN_Send("C4_FRS_active_container 0x0 CH4"); // 测试步骤 TC_LINTest LIN Send C4_FRS_active_container 0x0 CH4//ch3
  g_EM_LIN_Swc_LIN_Send("C4_FRS_CurrentIntensity 0 CH4"); // 测试步骤 TC_LINTest LIN Send C4_FRS_CurrentIntensity 0 CH4//引擎转发香氛通道真实值-closed
  g_EM_Equipment_Swc_TC_4G_Time_Delay_Second("1"); // 测试步骤 TC_Sleep 1
  g_EM_SOAClient_Swc_SOA_CHECK_Prepare("Veh_SetSFSChanelRespStruct.Veh_SetSFSChanelNRC 0"); // 预期结果 TC_CANTest SOA check Veh_SetSFSChanelRespStruct.Veh_SetSFSChanelNRC 0
  g_EM_SOAClient_Swc_SOA_CHECK_Prepare("Veh_SFSService_ErrStruct.OpeNRC 0 traceback8"); // 预期结果 TC_CANTest SOA check Veh_SFSService_ErrStruct.OpeNRC 0 traceback8//
  g_EM_SOAClient_Swc_SOA_REQ("Veh_SetSFSChanelStruct.Veh_SetSFSChanel:3&ServiceExecuteFeedbackFlag:2&MemoryReq:1"); // 测试步骤 TC_CANTest SOA REQ Veh_SetSFSChanelStruct.Veh_SetSFSChanel:3&ServiceExecuteFeedbackFlag:2&MemoryReq:1//通道3
  g_EM_SOAClient_Swc_SOA_CHECK("Veh_SetSFSChanelRespStruct.Veh_SetSFSChanelNRC 0"); // 预期结果 TC_CANTest SOA check Veh_SetSFSChanelRespStruct.Veh_SetSFSChanelNRC 0
  g_EM_LIN_Swc_LIN_Check("C4_FRS_ChannelSelect 3 CH4"); // 预期结果 TC_LINTest LIN Check C4_FRS_ChannelSelect 3 CH4
  g_EM_LIN_Swc_LIN_Send("C4_FRS_active_container 0x3 CH4"); // 测试步骤 TC_LINTest LIN Send C4_FRS_active_container 0x3 CH4//ch3
  g_EM_LIN_Swc_LIN_Check("C4_FRS_IntensityReq 6 CH4"); // 预期结果 TC_LINTest LIN Check C4_FRS_IntensityReq 6 CH4
  g_EM_LIN_Swc_LIN_Send("C4_FRS_CurrentIntensity 6 CH4"); // 测试步骤 TC_LINTest LIN Send C4_FRS_CurrentIntensity 6 CH4//引擎转发香氛通道真实值-3
  g_EM_SOAClient_Swc_SOA_CHECK("Veh_SFSService_ErrStruct.OpeNRC 0 traceback8"); // 预期结果 TC_CANTest SOA check Veh_SFSService_ErrStruct.OpeNRC 0 traceback8//
}

testcase SYS_CDCU_xiangfen_0021()
{
  TestDescription("香氛通道选择(当前active通道0)浓度记忆6通道选择2 Local on");
  teststep("warning","原始用例id为SYS-CDCU-香氛-0021");
  g_EM_LIN_Swc_LIN_Send("C4_FRS_active_container 0x0 CH4"); // 测试步骤 TC_LINTest LIN Send C4_FRS_active_container 0x0 CH4//ch3
  g_EM_LIN_Swc_LIN_Send("C4_FRS_CurrentIntensity 0 CH4"); // 测试步骤 TC_LINTest LIN Send C4_FRS_CurrentIntensity 0 CH4//引擎转发香氛通道真实值-closed
  g_EM_Equipment_Swc_TC_4G_Time_Delay_Second("1"); // 测试步骤 TC_Sleep 1
  g_EM_SOAClient_Swc_SOA_CHECK_Prepare("Veh_SetSFSChanelRespStruct.Veh_SetSFSChanelNRC 0"); // 预期结果 TC_CANTest SOA check Veh_SetSFSChanelRespStruct.Veh_SetSFSChanelNRC 0
  g_EM_SOAClient_Swc_SOA_CHECK_Prepare("Veh_SFSService_ErrStruct.OpeNRC 0 traceback8"); // 预期结果 TC_CANTest SOA check Veh_SFSService_ErrStruct.OpeNRC 0 traceback8//
  g_EM_SOAClient_Swc_SOA_REQ("Veh_SetSFSChanelStruct.Veh_SetSFSChanel:2&ServiceExecuteFeedbackFlag:2&MemoryReq:1"); // 测试步骤 TC_CANTest SOA REQ Veh_SetSFSChanelStruct.Veh_SetSFSChanel:2&ServiceExecuteFeedbackFlag:2&MemoryReq:1//通道3
  g_EM_SOAClient_Swc_SOA_CHECK("Veh_SetSFSChanelRespStruct.Veh_SetSFSChanelNRC 0"); // 预期结果 TC_CANTest SOA check Veh_SetSFSChanelRespStruct.Veh_SetSFSChanelNRC 0
  g_EM_LIN_Swc_LIN_Check("C4_FRS_ChannelSelect 2 CH4"); // 预期结果 TC_LINTest LIN Check C4_FRS_ChannelSelect 2 CH4
  g_EM_LIN_Swc_LIN_Send("C4_FRS_active_container 0x2 CH4"); // 测试步骤 TC_LINTest LIN Send C4_FRS_active_container 0x2 CH4//ch3
  g_EM_LIN_Swc_LIN_Check("C4_FRS_IntensityReq 6 CH4"); // 预期结果 TC_LINTest LIN Check C4_FRS_IntensityReq 6 CH4
  g_EM_LIN_Swc_LIN_Send("C4_FRS_CurrentIntensity 6 CH4"); // 测试步骤 TC_LINTest LIN Send C4_FRS_CurrentIntensity 6 CH4//引擎转发香氛通道真实值-3
  g_EM_SOAClient_Swc_SOA_CHECK("Veh_SFSService_ErrStruct.OpeNRC 0 traceback8"); // 预期结果 TC_CANTest SOA check Veh_SFSService_ErrStruct.OpeNRC 0 traceback8//
}

testcase SYS_CDCU_xiangfen_0022()
{
  TestDescription("香氛通道选择(当前active通道0)浓度记忆6通道选择1 Local on");
  teststep("warning","原始用例id为SYS-CDCU-香氛-0022");
  g_EM_LIN_Swc_LIN_Send("C4_FRS_active_container 0x0 CH4"); // 测试步骤 TC_LINTest LIN Send C4_FRS_active_container 0x0 CH4//ch3
  g_EM_LIN_Swc_LIN_Send("C4_FRS_CurrentIntensity 0 CH4"); // 测试步骤 TC_LINTest LIN Send C4_FRS_CurrentIntensity 0 CH4//引擎转发香氛通道真实值-closed
  g_EM_Equipment_Swc_TC_4G_Time_Delay_Second("1"); // 测试步骤 TC_Sleep 1
  g_EM_SOAClient_Swc_SOA_CHECK_Prepare("Veh_SetSFSChanelRespStruct.Veh_SetSFSChanelNRC 0"); // 预期结果 TC_CANTest SOA check Veh_SetSFSChanelRespStruct.Veh_SetSFSChanelNRC 0
  g_EM_SOAClient_Swc_SOA_CHECK_Prepare("Veh_SFSService_ErrStruct.OpeNRC 0 traceback8"); // 预期结果 TC_CANTest SOA check Veh_SFSService_ErrStruct.OpeNRC 0 traceback8//
  g_EM_SOAClient_Swc_SOA_REQ("Veh_SetSFSChanelStruct.Veh_SetSFSChanel:1&ServiceExecuteFeedbackFlag:2&MemoryReq:1"); // 测试步骤 TC_CANTest SOA REQ Veh_SetSFSChanelStruct.Veh_SetSFSChanel:1&ServiceExecuteFeedbackFlag:2&MemoryReq:1//通道3
  g_EM_SOAClient_Swc_SOA_CHECK("Veh_SetSFSChanelRespStruct.Veh_SetSFSChanelNRC 0"); // 预期结果 TC_CANTest SOA check Veh_SetSFSChanelRespStruct.Veh_SetSFSChanelNRC 0
  g_EM_LIN_Swc_LIN_Check("C4_FRS_ChannelSelect 1 CH4"); // 预期结果 TC_LINTest LIN Check C4_FRS_ChannelSelect 1 CH4
  g_EM_LIN_Swc_LIN_Send("C4_FRS_active_container 0x1 CH4"); // 测试步骤 TC_LINTest LIN Send C4_FRS_active_container 0x1 CH4//ch3
  g_EM_LIN_Swc_LIN_Check("C4_FRS_IntensityReq 6 CH4"); // 预期结果 TC_LINTest LIN Check C4_FRS_IntensityReq 6 CH4
  g_EM_LIN_Swc_LIN_Send("C4_FRS_CurrentIntensity 6 CH4"); // 测试步骤 TC_LINTest LIN Send C4_FRS_CurrentIntensity 6 CH4//引擎转发香氛通道真实值-3
  g_EM_SOAClient_Swc_SOA_CHECK("Veh_SFSService_ErrStruct.OpeNRC 0 traceback8"); // 预期结果 TC_CANTest SOA check Veh_SFSService_ErrStruct.OpeNRC 0 traceback8//
}

testcase SYS_CDCU_xiangfen_0023()
{
  TestDescription("香氛通道选择---失败 Local on");
  teststep("warning","原始用例id为SYS-CDCU-香氛-0023");
  g_EM_LIN_Swc_LIN_Send("C4_FRS_active_container 0x2 CH4"); // 测试步骤 TC_LINTest LIN Send C4_FRS_active_container 0x2 CH4//ch2
  g_EM_Equipment_Swc_TC_4G_Time_Delay_Second("1"); // 测试步骤 TC_Sleep 1
  g_EM_SOAClient_Swc_SOA_CHECK_Prepare("Veh_SetSFSChanelRespStruct.Veh_SetSFSChanelNRC 0"); // 预期结果 TC_CANTest SOA check Veh_SetSFSChanelRespStruct.Veh_SetSFSChanelNRC 0
  g_EM_SOAClient_Swc_SOA_CHECK_Prepare("Veh_SFSService_ErrStruct.OpeNRC 0xFFFFFFFF traceback17"); // 预期结果 TC_CANTest SOA check Veh_SFSService_ErrStruct.OpeNRC 0xFFFFFFFF traceback17//
  g_EM_SOAClient_Swc_SOA_REQ("Veh_SetSFSChanelStruct.Veh_SetSFSChanel:1&ServiceExecuteFeedbackFlag:2"); // 测试步骤 TC_CANTest SOA REQ Veh_SetSFSChanelStruct.Veh_SetSFSChanel:1&ServiceExecuteFeedbackFlag:2//通道1
  g_EM_SOAClient_Swc_SOA_CHECK("Veh_SetSFSChanelRespStruct.Veh_SetSFSChanelNRC 0"); // 预期结果 TC_CANTest SOA check Veh_SetSFSChanelRespStruct.Veh_SetSFSChanelNRC 0
  g_EM_LIN_Swc_LIN_Check("C4_FRS_ChannelSelect 1 CH4"); // 预期结果 TC_LINTest LIN Check C4_FRS_ChannelSelect 1 CH4
  g_EM_Equipment_Swc_TC_4G_Time_Delay_Second("15"); // 测试步骤 TC_Sleep 15
  g_EM_SOAClient_Swc_SOA_CHECK("Veh_SFSService_ErrStruct.OpeNRC 0xFFFFFFFF traceback17"); // 预期结果 TC_CANTest SOA check Veh_SFSService_ErrStruct.OpeNRC 0xFFFFFFFF traceback17//
}

testcase SYS_CDCU_xiangfen_0024()
{
  TestDescription("香氛浓度调节---low Local on");
  teststep("warning","原始用例id为SYS-CDCU-香氛-0024");
  g_EM_LIN_Swc_LIN_Send("C4_FRS_CurrentIntensity 3 CH4"); // 测试步骤 TC_LINTest LIN Send C4_FRS_CurrentIntensity 3 CH4
  g_EM_Equipment_Swc_TC_4G_Time_Delay_Second("1"); // 测试步骤 TC_Sleep 1
  g_EM_SOAClient_Swc_SOA_CHECK_Prepare("Veh_SetSFSConRespStruct.Veh_SetSFSConNRC 0"); // 预期结果 TC_CANTest SOA check Veh_SetSFSConRespStruct.Veh_SetSFSConNRC 0
  g_EM_SOAClient_Swc_SOA_CHECK_Prepare("Veh_SFSService_ErrStruct.OpeNRC 0 traceback8"); // 预期结果 TC_CANTest SOA check Veh_SFSService_ErrStruct.OpeNRC 0 traceback8//
  g_EM_SOAClient_Swc_SOA_REQ("Veh_SetSFSConStruct.Veh_SetSFSCon:1&ServiceExecuteFeedbackFlag:2"); // 测试步骤 TC_CANTest SOA REQ Veh_SetSFSConStruct.Veh_SetSFSCon:1&ServiceExecuteFeedbackFlag:2//Low
  g_EM_SOAClient_Swc_SOA_CHECK("Veh_SetSFSConRespStruct.Veh_SetSFSConNRC 0"); // 预期结果 TC_CANTest SOA check Veh_SetSFSConRespStruct.Veh_SetSFSConNRC 0
  g_EM_LIN_Swc_LIN_Check("C4_FRS_IntensityReq 3 CH4"); // 预期结果 TC_LINTest LIN Check C4_FRS_IntensityReq 3 CH4
  g_EM_SOAClient_Swc_SOA_CHECK("Veh_SFSService_ErrStruct.OpeNRC 0 traceback8"); // 预期结果 TC_CANTest SOA check Veh_SFSService_ErrStruct.OpeNRC 0 traceback8//
}

testcase SYS_CDCU_xiangfen_0025()
{
  TestDescription("香氛浓度调节---high Local on");
  teststep("warning","原始用例id为SYS-CDCU-香氛-0025");
  g_EM_LIN_Swc_LIN_Send("C4_FRS_CurrentIntensity 10 CH4"); // 测试步骤 TC_LINTest LIN Send C4_FRS_CurrentIntensity 10 CH4
  g_EM_Equipment_Swc_TC_4G_Time_Delay_Second("1"); // 测试步骤 TC_Sleep 1
  g_EM_SOAClient_Swc_SOA_CHECK_Prepare("Veh_SetSFSConRespStruct.Veh_SetSFSConNRC 0"); // 预期结果 TC_CANTest SOA check Veh_SetSFSConRespStruct.Veh_SetSFSConNRC 0
  g_EM_SOAClient_Swc_SOA_CHECK_Prepare("Veh_SFSService_ErrStruct.OpeNRC 0 traceback8"); // 预期结果 TC_CANTest SOA check Veh_SFSService_ErrStruct.OpeNRC 0 traceback8//
  g_EM_SOAClient_Swc_SOA_REQ("Veh_SetSFSConStruct.Veh_SetSFSCon:2&ServiceExecuteFeedbackFlag:2&MemoryReq:1"); // 测试步骤 TC_CANTest SOA REQ Veh_SetSFSConStruct.Veh_SetSFSCon:2&ServiceExecuteFeedbackFlag:2&MemoryReq:1//High
  g_EM_SOAClient_Swc_SOA_CHECK("Veh_SetSFSConRespStruct.Veh_SetSFSConNRC 0"); // 预期结果 TC_CANTest SOA check Veh_SetSFSConRespStruct.Veh_SetSFSConNRC 0
  g_EM_LIN_Swc_LIN_Check("C4_FRS_IntensityReq 10 CH4"); // 预期结果 TC_LINTest LIN Check C4_FRS_IntensityReq 10 CH4
  g_EM_SOAClient_Swc_SOA_CHECK("Veh_SFSService_ErrStruct.OpeNRC 0 traceback8"); // 预期结果 TC_CANTest SOA check Veh_SFSService_ErrStruct.OpeNRC 0 traceback8//
}

testcase SYS_CDCU_xiangfen_0026()
{
  TestDescription("香氛浓度调节---mid Local on");
  teststep("warning","原始用例id为SYS-CDCU-香氛-0026");
  g_EM_LIN_Swc_LIN_Send("C4_FRS_CurrentIntensity 6 CH4"); // 测试步骤 TC_LINTest LIN Send C4_FRS_CurrentIntensity 6 CH4
  g_EM_Equipment_Swc_TC_4G_Time_Delay_Second("1"); // 测试步骤 TC_Sleep 1
  g_EM_SOAClient_Swc_SOA_CHECK_Prepare("Veh_SetSFSConRespStruct.Veh_SetSFSConNRC 0"); // 预期结果 TC_CANTest SOA check Veh_SetSFSConRespStruct.Veh_SetSFSConNRC 0
  g_EM_SOAClient_Swc_SOA_CHECK_Prepare("Veh_SFSService_ErrStruct.OpeNRC 0 traceback8"); // 预期结果 TC_CANTest SOA check Veh_SFSService_ErrStruct.OpeNRC 0 traceback8//
  g_EM_SOAClient_Swc_SOA_REQ("Veh_SetSFSConStruct.Veh_SetSFSCon:3&ServiceExecuteFeedbackFlag:2"); // 测试步骤 TC_CANTest SOA REQ Veh_SetSFSConStruct.Veh_SetSFSCon:3&ServiceExecuteFeedbackFlag:2//Mid
  g_EM_SOAClient_Swc_SOA_CHECK("Veh_SetSFSConRespStruct.Veh_SetSFSConNRC 0"); // 预期结果 TC_CANTest SOA check Veh_SetSFSConRespStruct.Veh_SetSFSConNRC 0
  g_EM_LIN_Swc_LIN_Check("C4_FRS_IntensityReq 6 CH4"); // 预期结果 TC_LINTest LIN Check C4_FRS_IntensityReq 6 CH4
  g_EM_SOAClient_Swc_SOA_CHECK("Veh_SFSService_ErrStruct.OpeNRC 0 traceback8"); // 预期结果 TC_CANTest SOA check Veh_SFSService_ErrStruct.OpeNRC 0 traceback8//
}

testcase SYS_CDCU_xiangfen_0027()
{
  TestDescription("香氛浓度调节(远控) Local on");
  teststep("warning","原始用例id为SYS-CDCU-香氛-0027");
  g_EM_SOAClient_Swc_SOA_CHECK_Prepare("Veh_SFSService_ErrStruct.OpeNRC 1 traceback8"); // 预期结果 TC_CANTest SOA check Veh_SFSService_ErrStruct.OpeNRC 1 traceback8
  g_EM_SOAClient_Swc_SOA_CHECK_Prepare("Veh_SFSService_ErrStruct.OpeErrInfo[0-1]:0x9 traceback10"); // 预期结果 TC_CANTest SOA check Veh_SFSService_ErrStruct.OpeErrInfo[0-1]:0x9 traceback10
  g_EM_SOAClient_Swc_SOA_REQ("Veh_SetSFSConStruct.Veh_SetSFSCon:1&ServiceExecuteFeedbackFlag:2&UserID:0x01010001"); // 测试步骤 TC_CANTest SOA REQ Veh_SetSFSConStruct.Veh_SetSFSCon:1&ServiceExecuteFeedbackFlag:2&UserID:0x01010001//Low
  g_EM_SOAClient_Swc_SOA_CHECK("Veh_SFSService_ErrStruct.OpeNRC 1 traceback8"); // 预期结果 TC_CANTest SOA check Veh_SFSService_ErrStruct.OpeNRC 1 traceback8
  g_EM_SOAClient_Swc_SOA_CHECK("Veh_SFSService_ErrStruct.OpeErrInfo[0-1]:0x9 traceback10"); // 预期结果 TC_CANTest SOA check Veh_SFSService_ErrStruct.OpeErrInfo[0-1]:0x9 traceback10
}

testcase SYS_CDCU_xiangfen_0028()
{
  TestDescription("香氛浓度调节---失败 Local on");
  teststep("warning","原始用例id为SYS-CDCU-香氛-0028");
  g_EM_LIN_Swc_LIN_Send("C4_FRS_CurrentIntensity 6 CH4"); // 测试步骤 TC_LINTest LIN Send C4_FRS_CurrentIntensity 6 CH4
  g_EM_Equipment_Swc_TC_4G_Time_Delay_Second("1"); // 测试步骤 TC_Sleep 1
  g_EM_SOAClient_Swc_SOA_CHECK_Prepare("Veh_SetSFSConRespStruct.Veh_SetSFSConNRC 0"); // 预期结果 TC_CANTest SOA check Veh_SetSFSConRespStruct.Veh_SetSFSConNRC 0
  g_EM_SOAClient_Swc_SOA_CHECK_Prepare("Veh_SFSService_ErrStruct.OpeNRC 0xFFFFFFFF traceback18"); // 预期结果 TC_CANTest SOA check Veh_SFSService_ErrStruct.OpeNRC 0xFFFFFFFF traceback18
  g_EM_SOAClient_Swc_SOA_REQ("Veh_SetSFSConStruct.Veh_SetSFSCon:1&ServiceExecuteFeedbackFlag:2"); // 测试步骤 TC_CANTest SOA REQ Veh_SetSFSConStruct.Veh_SetSFSCon:1&ServiceExecuteFeedbackFlag:2//Low
  g_EM_SOAClient_Swc_SOA_CHECK("Veh_SetSFSConRespStruct.Veh_SetSFSConNRC 0"); // 预期结果 TC_CANTest SOA check Veh_SetSFSConRespStruct.Veh_SetSFSConNRC 0
  g_EM_LIN_Swc_LIN_Check("C4_FRS_IntensityReq 3 CH4"); // 预期结果 TC_LINTest LIN Check C4_FRS_IntensityReq 3 CH4
  g_EM_Equipment_Swc_TC_4G_Time_Delay_Second("15"); // 测试步骤 TC_Sleep 15
  g_EM_SOAClient_Swc_SOA_CHECK("Veh_SFSService_ErrStruct.OpeNRC 0xFFFFFFFF traceback18"); // 预期结果 TC_CANTest SOA check Veh_SFSService_ErrStruct.OpeNRC 0xFFFFFFFF traceback18
}

testcase SYS_CDCU_xiangfen_0029()
{
  TestDescription("香氛浓度调节---low 通道记忆1 当前通道浓度无效 Local on");
  teststep("warning","原始用例id为SYS-CDCU-香氛-0029");
  g_EM_LIN_Swc_LIN_Send("C4_FRS_active_container 0x1 CH4"); // 测试步骤 TC_LINTest LIN Send C4_FRS_active_container 0x1 CH4//ch3
  g_EM_Equipment_Swc_TC_4G_Time_Delay_Second("1"); // 测试步骤 TC_Sleep 1
  g_EM_SOAClient_Swc_SOA_CHECK_Prepare("Veh_SetSFSChanelRespStruct.Veh_SetSFSChanelNRC 0"); // 预期结果 TC_CANTest SOA check Veh_SetSFSChanelRespStruct.Veh_SetSFSChanelNRC 0
  g_EM_SOAClient_Swc_SOA_CHECK_Prepare("Veh_SFSService_ErrStruct.OpeNRC 0 traceback8"); // 预期结果 TC_CANTest SOA check Veh_SFSService_ErrStruct.OpeNRC 0 traceback8//
  g_EM_SOAClient_Swc_SOA_REQ("Veh_SetSFSChanelStruct.Veh_SetSFSChanel:1&ServiceExecuteFeedbackFlag:2&MemoryReq:1"); // 测试步骤 TC_CANTest SOA REQ Veh_SetSFSChanelStruct.Veh_SetSFSChanel:1&ServiceExecuteFeedbackFlag:2&MemoryReq:1//通道3
  g_EM_SOAClient_Swc_SOA_CHECK("Veh_SetSFSChanelRespStruct.Veh_SetSFSChanelNRC 0"); // 预期结果 TC_CANTest SOA check Veh_SetSFSChanelRespStruct.Veh_SetSFSChanelNRC 0
  g_EM_LIN_Swc_LIN_Check("C4_FRS_ChannelSelect 1 CH4"); // 预期结果 TC_LINTest LIN Check C4_FRS_ChannelSelect 1 CH4
  g_EM_SOAClient_Swc_SOA_CHECK("Veh_SFSService_ErrStruct.OpeNRC 0 traceback8"); // 预期结果 TC_CANTest SOA check Veh_SFSService_ErrStruct.OpeNRC 0 traceback8//
  g_EM_LIN_Swc_LIN_Send("C4_FRS_active_container 0x0 CH4"); // 测试步骤 TC_LINTest LIN Send C4_FRS_active_container 0x0 CH4//引擎转发香氛通道真实值
  g_EM_LIN_Swc_LIN_Send("C4_FRS_CurrentIntensity 0 CH4"); // 测试步骤 TC_LINTest LIN Send C4_FRS_CurrentIntensity 0 CH4//引擎转发香氛浓度真实值-closed
  g_EM_Equipment_Swc_TC_4G_Time_Delay_Second("1"); // 测试步骤 TC_Sleep 1
  g_EM_SOAClient_Swc_SOA_CHECK_Prepare("Veh_SetSFSConRespStruct.Veh_SetSFSConNRC 0"); // 预期结果 TC_CANTest SOA check Veh_SetSFSConRespStruct.Veh_SetSFSConNRC 0
  g_EM_SOAClient_Swc_SOA_CHECK_Prepare("Veh_SFSService_ErrStruct.OpeNRC 0 traceback8"); // 预期结果 TC_CANTest SOA check Veh_SFSService_ErrStruct.OpeNRC 0 traceback8//
  g_EM_SOAClient_Swc_SOA_REQ("Veh_SetSFSConStruct.Veh_SetSFSCon:1&ServiceExecuteFeedbackFlag:2&MemoryReq:1"); // 测试步骤 TC_CANTest SOA REQ Veh_SetSFSConStruct.Veh_SetSFSCon:1&ServiceExecuteFeedbackFlag:2&MemoryReq:1//Low
  g_EM_SOAClient_Swc_SOA_CHECK("Veh_SetSFSConRespStruct.Veh_SetSFSConNRC 0"); // 预期结果 TC_CANTest SOA check Veh_SetSFSConRespStruct.Veh_SetSFSConNRC 0
  g_EM_LIN_Swc_LIN_Check("C4_FRS_IntensityReq 3 CH4"); // 预期结果 TC_LINTest LIN Check C4_FRS_IntensityReq 3 CH4
  g_EM_LIN_Swc_LIN_Send("C4_FRS_CurrentIntensity 3 CH4"); // 测试步骤 TC_LINTest LIN Send C4_FRS_CurrentIntensity 3 CH4//引擎转发香氛通道真实值-closed
  g_EM_LIN_Swc_LIN_Check("C4_FRS_ChannelSelect 1 CH4"); // 预期结果 TC_LINTest LIN Check C4_FRS_ChannelSelect 1 CH4
  g_EM_LIN_Swc_LIN_Send("C4_FRS_active_container 0x1 CH4"); // 测试步骤 TC_LINTest LIN Send C4_FRS_active_container 0x1 CH4//ch3
  g_EM_SOAClient_Swc_SOA_CHECK("Veh_SFSService_ErrStruct.OpeNRC 0 traceback8"); // 预期结果 TC_CANTest SOA check Veh_SFSService_ErrStruct.OpeNRC 0 traceback8//
}

testcase SYS_CDCU_xiangfen_0030()
{
  TestDescription("香氛浓度调节---high 通道记忆1 当前通道浓度无效 Local on");
  teststep("warning","原始用例id为SYS-CDCU-香氛-0030");
  g_EM_LIN_Swc_LIN_Send("C4_FRS_active_container 0x0 CH4"); // 测试步骤 TC_LINTest LIN Send C4_FRS_active_container 0x0 CH4//引擎转发香氛通道真实值
  g_EM_LIN_Swc_LIN_Send("C4_FRS_CurrentIntensity 0 CH4"); // 测试步骤 TC_LINTest LIN Send C4_FRS_CurrentIntensity 0 CH4//引擎转发香氛浓度真实值-closed
  g_EM_Equipment_Swc_TC_4G_Time_Delay_Second("1"); // 测试步骤 TC_Sleep 1
  g_EM_SOAClient_Swc_SOA_CHECK_Prepare("Veh_SetSFSConRespStruct.Veh_SetSFSConNRC 0"); // 预期结果 TC_CANTest SOA check Veh_SetSFSConRespStruct.Veh_SetSFSConNRC 0
  g_EM_SOAClient_Swc_SOA_CHECK_Prepare("Veh_SFSService_ErrStruct.OpeNRC 0 traceback8"); // 预期结果 TC_CANTest SOA check Veh_SFSService_ErrStruct.OpeNRC 0 traceback8//
  g_EM_SOAClient_Swc_SOA_REQ("Veh_SetSFSConStruct.Veh_SetSFSCon:2&ServiceExecuteFeedbackFlag:2&MemoryReq:1"); // 测试步骤 TC_CANTest SOA REQ Veh_SetSFSConStruct.Veh_SetSFSCon:2&ServiceExecuteFeedbackFlag:2&MemoryReq:1//Low
  g_EM_SOAClient_Swc_SOA_CHECK("Veh_SetSFSConRespStruct.Veh_SetSFSConNRC 0"); // 预期结果 TC_CANTest SOA check Veh_SetSFSConRespStruct.Veh_SetSFSConNRC 0
  g_EM_LIN_Swc_LIN_Check("C4_FRS_IntensityReq 10 CH4"); // 预期结果 TC_LINTest LIN Check C4_FRS_IntensityReq 10 CH4
  g_EM_LIN_Swc_LIN_Send("C4_FRS_CurrentIntensity 10 CH4"); // 测试步骤 TC_LINTest LIN Send C4_FRS_CurrentIntensity 10 CH4//引擎转发香氛通道真实值-closed
  g_EM_LIN_Swc_LIN_Check("C4_FRS_ChannelSelect 1 CH4"); // 预期结果 TC_LINTest LIN Check C4_FRS_ChannelSelect 1 CH4
  g_EM_LIN_Swc_LIN_Send("C4_FRS_active_container 0x1 CH4"); // 测试步骤 TC_LINTest LIN Send C4_FRS_active_container 0x1 CH4//ch3
  g_EM_SOAClient_Swc_SOA_CHECK("Veh_SFSService_ErrStruct.OpeNRC 0 traceback8"); // 预期结果 TC_CANTest SOA check Veh_SFSService_ErrStruct.OpeNRC 0 traceback8//
}

testcase SYS_CDCU_xiangfen_0031()
{
  TestDescription("香氛浓度调节---mid 通道记忆1 当前通道浓度无效 Local on");
  teststep("warning","原始用例id为SYS-CDCU-香氛-0031");
  g_EM_LIN_Swc_LIN_Send("C4_FRS_active_container 0x0 CH4"); // 测试步骤 TC_LINTest LIN Send C4_FRS_active_container 0x0 CH4//引擎转发香氛通道真实值
  g_EM_LIN_Swc_LIN_Send("C4_FRS_CurrentIntensity 0 CH4"); // 测试步骤 TC_LINTest LIN Send C4_FRS_CurrentIntensity 0 CH4//引擎转发香氛浓度真实值-closed
  g_EM_Equipment_Swc_TC_4G_Time_Delay_Second("1"); // 测试步骤 TC_Sleep 1
  g_EM_SOAClient_Swc_SOA_CHECK_Prepare("Veh_SetSFSConRespStruct.Veh_SetSFSConNRC 0"); // 预期结果 TC_CANTest SOA check Veh_SetSFSConRespStruct.Veh_SetSFSConNRC 0
  g_EM_SOAClient_Swc_SOA_CHECK_Prepare("Veh_SFSService_ErrStruct.OpeNRC 0 traceback8"); // 预期结果 TC_CANTest SOA check Veh_SFSService_ErrStruct.OpeNRC 0 traceback8//
  g_EM_SOAClient_Swc_SOA_REQ("Veh_SetSFSConStruct.Veh_SetSFSCon:3&ServiceExecuteFeedbackFlag:2&MemoryReq:1"); // 测试步骤 TC_CANTest SOA REQ Veh_SetSFSConStruct.Veh_SetSFSCon:3&ServiceExecuteFeedbackFlag:2&MemoryReq:1//Low
  g_EM_SOAClient_Swc_SOA_CHECK("Veh_SetSFSConRespStruct.Veh_SetSFSConNRC 0"); // 预期结果 TC_CANTest SOA check Veh_SetSFSConRespStruct.Veh_SetSFSConNRC 0
  g_EM_LIN_Swc_LIN_Check("C4_FRS_IntensityReq 6 CH4"); // 预期结果 TC_LINTest LIN Check C4_FRS_IntensityReq 6 CH4
  g_EM_LIN_Swc_LIN_Send("C4_FRS_CurrentIntensity 6 CH4"); // 测试步骤 TC_LINTest LIN Send C4_FRS_CurrentIntensity 6 CH4//引擎转发香氛通道真实值-closed
  g_EM_LIN_Swc_LIN_Check("C4_FRS_ChannelSelect 1 CH4"); // 预期结果 TC_LINTest LIN Check C4_FRS_ChannelSelect 1 CH4
  g_EM_LIN_Swc_LIN_Send("C4_FRS_active_container 0x1 CH4"); // 测试步骤 TC_LINTest LIN Send C4_FRS_active_container 0x1 CH4//ch3
  g_EM_SOAClient_Swc_SOA_CHECK("Veh_SFSService_ErrStruct.OpeNRC 0 traceback8"); // 预期结果 TC_CANTest SOA check Veh_SFSService_ErrStruct.OpeNRC 0 traceback8//
}

testcase SYS_CDCU_xiangfen_0032()
{
  TestDescription("香氛浓度调节---low 通道记忆2 当前通道浓度无效 Local on");
  teststep("warning","原始用例id为SYS-CDCU-香氛-0032");
  g_EM_LIN_Swc_LIN_Send("C4_FRS_active_container 0x2 CH4"); // 测试步骤 TC_LINTest LIN Send C4_FRS_active_container 0x2 CH4//ch3
  g_EM_Equipment_Swc_TC_4G_Time_Delay_Second("1"); // 测试步骤 TC_Sleep 1
  g_EM_SOAClient_Swc_SOA_CHECK_Prepare("Veh_SetSFSChanelRespStruct.Veh_SetSFSChanelNRC 0"); // 预期结果 TC_CANTest SOA check Veh_SetSFSChanelRespStruct.Veh_SetSFSChanelNRC 0
  g_EM_SOAClient_Swc_SOA_CHECK_Prepare("Veh_SFSService_ErrStruct.OpeNRC 0 traceback8"); // 预期结果 TC_CANTest SOA check Veh_SFSService_ErrStruct.OpeNRC 0 traceback8//
  g_EM_SOAClient_Swc_SOA_REQ("Veh_SetSFSChanelStruct.Veh_SetSFSChanel:2&ServiceExecuteFeedbackFlag:2&MemoryReq:1"); // 测试步骤 TC_CANTest SOA REQ Veh_SetSFSChanelStruct.Veh_SetSFSChanel:2&ServiceExecuteFeedbackFlag:2&MemoryReq:1//通道3
  g_EM_SOAClient_Swc_SOA_CHECK("Veh_SetSFSChanelRespStruct.Veh_SetSFSChanelNRC 0"); // 预期结果 TC_CANTest SOA check Veh_SetSFSChanelRespStruct.Veh_SetSFSChanelNRC 0
  g_EM_LIN_Swc_LIN_Check("C4_FRS_ChannelSelect 2 CH4"); // 预期结果 TC_LINTest LIN Check C4_FRS_ChannelSelect 2 CH4
  g_EM_SOAClient_Swc_SOA_CHECK("Veh_SFSService_ErrStruct.OpeNRC 0 traceback8"); // 预期结果 TC_CANTest SOA check Veh_SFSService_ErrStruct.OpeNRC 0 traceback8//
  g_EM_LIN_Swc_LIN_Send("C4_FRS_active_container 0x0 CH4"); // 测试步骤 TC_LINTest LIN Send C4_FRS_active_container 0x0 CH4//引擎转发香氛通道真实值
  g_EM_LIN_Swc_LIN_Send("C4_FRS_CurrentIntensity 0 CH4"); // 测试步骤 TC_LINTest LIN Send C4_FRS_CurrentIntensity 0 CH4//引擎转发香氛浓度真实值-closed
  g_EM_Equipment_Swc_TC_4G_Time_Delay_Second("1"); // 测试步骤 TC_Sleep 1
  g_EM_SOAClient_Swc_SOA_CHECK_Prepare("Veh_SetSFSConRespStruct.Veh_SetSFSConNRC 0"); // 预期结果 TC_CANTest SOA check Veh_SetSFSConRespStruct.Veh_SetSFSConNRC 0
  g_EM_SOAClient_Swc_SOA_CHECK_Prepare("Veh_SFSService_ErrStruct.OpeNRC 0 traceback8"); // 预期结果 TC_CANTest SOA check Veh_SFSService_ErrStruct.OpeNRC 0 traceback8//
  g_EM_SOAClient_Swc_SOA_REQ("Veh_SetSFSConStruct.Veh_SetSFSCon:1&ServiceExecuteFeedbackFlag:2&MemoryReq:1"); // 测试步骤 TC_CANTest SOA REQ Veh_SetSFSConStruct.Veh_SetSFSCon:1&ServiceExecuteFeedbackFlag:2&MemoryReq:1//Low
  g_EM_SOAClient_Swc_SOA_CHECK("Veh_SetSFSConRespStruct.Veh_SetSFSConNRC 0"); // 预期结果 TC_CANTest SOA check Veh_SetSFSConRespStruct.Veh_SetSFSConNRC 0
  g_EM_LIN_Swc_LIN_Check("C4_FRS_IntensityReq 3 CH4"); // 预期结果 TC_LINTest LIN Check C4_FRS_IntensityReq 3 CH4
  g_EM_LIN_Swc_LIN_Send("C4_FRS_CurrentIntensity 3 CH4"); // 测试步骤 TC_LINTest LIN Send C4_FRS_CurrentIntensity 3 CH4//引擎转发香氛通道真实值-closed
  g_EM_LIN_Swc_LIN_Check("C4_FRS_ChannelSelect 2 CH4"); // 预期结果 TC_LINTest LIN Check C4_FRS_ChannelSelect 2 CH4
  g_EM_LIN_Swc_LIN_Send("C4_FRS_active_container 0x2 CH4"); // 测试步骤 TC_LINTest LIN Send C4_FRS_active_container 0x2 CH4//ch3
  g_EM_SOAClient_Swc_SOA_CHECK("Veh_SFSService_ErrStruct.OpeNRC 0 traceback8"); // 预期结果 TC_CANTest SOA check Veh_SFSService_ErrStruct.OpeNRC 0 traceback8//
}

testcase SYS_CDCU_xiangfen_0033()
{
  TestDescription("香氛浓度调节---high 通道记忆2 当前通道浓度无效 Local on");
  teststep("warning","原始用例id为SYS-CDCU-香氛-0033");
  g_EM_LIN_Swc_LIN_Send("C4_FRS_active_container 0x0 CH4"); // 测试步骤 TC_LINTest LIN Send C4_FRS_active_container 0x0 CH4//引擎转发香氛通道真实值
  g_EM_LIN_Swc_LIN_Send("C4_FRS_CurrentIntensity 0 CH4"); // 测试步骤 TC_LINTest LIN Send C4_FRS_CurrentIntensity 0 CH4//引擎转发香氛浓度真实值-closed
  g_EM_Equipment_Swc_TC_4G_Time_Delay_Second("1"); // 测试步骤 TC_Sleep 1
  g_EM_SOAClient_Swc_SOA_CHECK_Prepare("Veh_SetSFSConRespStruct.Veh_SetSFSConNRC 0"); // 预期结果 TC_CANTest SOA check Veh_SetSFSConRespStruct.Veh_SetSFSConNRC 0
  g_EM_SOAClient_Swc_SOA_CHECK_Prepare("Veh_SFSService_ErrStruct.OpeNRC 0 traceback8"); // 预期结果 TC_CANTest SOA check Veh_SFSService_ErrStruct.OpeNRC 0 traceback8//
  g_EM_SOAClient_Swc_SOA_REQ("Veh_SetSFSConStruct.Veh_SetSFSCon:2&ServiceExecuteFeedbackFlag:2&MemoryReq:1"); // 测试步骤 TC_CANTest SOA REQ Veh_SetSFSConStruct.Veh_SetSFSCon:2&ServiceExecuteFeedbackFlag:2&MemoryReq:1//Low
  g_EM_SOAClient_Swc_SOA_CHECK("Veh_SetSFSConRespStruct.Veh_SetSFSConNRC 0"); // 预期结果 TC_CANTest SOA check Veh_SetSFSConRespStruct.Veh_SetSFSConNRC 0
  g_EM_LIN_Swc_LIN_Check("C4_FRS_IntensityReq 10 CH4"); // 预期结果 TC_LINTest LIN Check C4_FRS_IntensityReq 10 CH4
  g_EM_LIN_Swc_LIN_Send("C4_FRS_CurrentIntensity 10 CH4"); // 测试步骤 TC_LINTest LIN Send C4_FRS_CurrentIntensity 10 CH4//引擎转发香氛通道真实值-closed
  g_EM_LIN_Swc_LIN_Check("C4_FRS_ChannelSelect 2 CH4"); // 预期结果 TC_LINTest LIN Check C4_FRS_ChannelSelect 2 CH4
  g_EM_LIN_Swc_LIN_Send("C4_FRS_active_container 0x2 CH4"); // 测试步骤 TC_LINTest LIN Send C4_FRS_active_container 0x2 CH4//ch3
  g_EM_SOAClient_Swc_SOA_CHECK("Veh_SFSService_ErrStruct.OpeNRC 0 traceback8"); // 预期结果 TC_CANTest SOA check Veh_SFSService_ErrStruct.OpeNRC 0 traceback8//
}

testcase SYS_CDCU_xiangfen_0034()
{
  TestDescription("香氛浓度调节---mid 通道记忆2 当前通道浓度无效 Local on");
  teststep("warning","原始用例id为SYS-CDCU-香氛-0034");
  g_EM_LIN_Swc_LIN_Send("C4_FRS_active_container 0x0 CH4"); // 测试步骤 TC_LINTest LIN Send C4_FRS_active_container 0x0 CH4//引擎转发香氛通道真实值
  g_EM_LIN_Swc_LIN_Send("C4_FRS_CurrentIntensity 0 CH4"); // 测试步骤 TC_LINTest LIN Send C4_FRS_CurrentIntensity 0 CH4//引擎转发香氛浓度真实值-closed
  g_EM_Equipment_Swc_TC_4G_Time_Delay_Second("1"); // 测试步骤 TC_Sleep 1
  g_EM_SOAClient_Swc_SOA_CHECK_Prepare("Veh_SetSFSConRespStruct.Veh_SetSFSConNRC 0"); // 预期结果 TC_CANTest SOA check Veh_SetSFSConRespStruct.Veh_SetSFSConNRC 0
  g_EM_SOAClient_Swc_SOA_CHECK_Prepare("Veh_SFSService_ErrStruct.OpeNRC 0 traceback8"); // 预期结果 TC_CANTest SOA check Veh_SFSService_ErrStruct.OpeNRC 0 traceback8//
  g_EM_SOAClient_Swc_SOA_REQ("Veh_SetSFSConStruct.Veh_SetSFSCon:3&ServiceExecuteFeedbackFlag:2&MemoryReq:1"); // 测试步骤 TC_CANTest SOA REQ Veh_SetSFSConStruct.Veh_SetSFSCon:3&ServiceExecuteFeedbackFlag:2&MemoryReq:1//Low
  g_EM_SOAClient_Swc_SOA_CHECK("Veh_SetSFSConRespStruct.Veh_SetSFSConNRC 0"); // 预期结果 TC_CANTest SOA check Veh_SetSFSConRespStruct.Veh_SetSFSConNRC 0
  g_EM_LIN_Swc_LIN_Check("C4_FRS_IntensityReq 6 CH4"); // 预期结果 TC_LINTest LIN Check C4_FRS_IntensityReq 6 CH4
  g_EM_LIN_Swc_LIN_Send("C4_FRS_CurrentIntensity 6 CH4"); // 测试步骤 TC_LINTest LIN Send C4_FRS_CurrentIntensity 6 CH4//引擎转发香氛通道真实值-closed
  g_EM_LIN_Swc_LIN_Check("C4_FRS_ChannelSelect 2 CH4"); // 预期结果 TC_LINTest LIN Check C4_FRS_ChannelSelect 2 CH4
  g_EM_LIN_Swc_LIN_Send("C4_FRS_active_container 0x2 CH4"); // 测试步骤 TC_LINTest LIN Send C4_FRS_active_container 0x2 CH4//ch3
  g_EM_SOAClient_Swc_SOA_CHECK("Veh_SFSService_ErrStruct.OpeNRC 0 traceback8"); // 预期结果 TC_CANTest SOA check Veh_SFSService_ErrStruct.OpeNRC 0 traceback8//
}

testcase SYS_CDCU_xiangfen_0035()
{
  TestDescription("香氛浓度调节---low 通道记忆3 当前通道浓度无效 Local on");
  teststep("warning","原始用例id为SYS-CDCU-香氛-0035");
  g_EM_LIN_Swc_LIN_Send("C4_FRS_active_container 0x3 CH4"); // 测试步骤 TC_LINTest LIN Send C4_FRS_active_container 0x3 CH4//ch3
  g_EM_Equipment_Swc_TC_4G_Time_Delay_Second("1"); // 测试步骤 TC_Sleep 1
  g_EM_SOAClient_Swc_SOA_CHECK_Prepare("Veh_SetSFSChanelRespStruct.Veh_SetSFSChanelNRC 0"); // 预期结果 TC_CANTest SOA check Veh_SetSFSChanelRespStruct.Veh_SetSFSChanelNRC 0
  g_EM_SOAClient_Swc_SOA_CHECK_Prepare("Veh_SFSService_ErrStruct.OpeNRC 0 traceback8"); // 预期结果 TC_CANTest SOA check Veh_SFSService_ErrStruct.OpeNRC 0 traceback8//
  g_EM_SOAClient_Swc_SOA_REQ("Veh_SetSFSChanelStruct.Veh_SetSFSChanel:3&ServiceExecuteFeedbackFlag:2&MemoryReq:1"); // 测试步骤 TC_CANTest SOA REQ Veh_SetSFSChanelStruct.Veh_SetSFSChanel:3&ServiceExecuteFeedbackFlag:2&MemoryReq:1//通道3
  g_EM_SOAClient_Swc_SOA_CHECK("Veh_SetSFSChanelRespStruct.Veh_SetSFSChanelNRC 0"); // 预期结果 TC_CANTest SOA check Veh_SetSFSChanelRespStruct.Veh_SetSFSChanelNRC 0
  g_EM_LIN_Swc_LIN_Check("C4_FRS_ChannelSelect 3 CH4"); // 预期结果 TC_LINTest LIN Check C4_FRS_ChannelSelect 3 CH4
  g_EM_SOAClient_Swc_SOA_CHECK("Veh_SFSService_ErrStruct.OpeNRC 0 traceback8"); // 预期结果 TC_CANTest SOA check Veh_SFSService_ErrStruct.OpeNRC 0 traceback8//
  g_EM_LIN_Swc_LIN_Send("C4_FRS_active_container 0x0 CH4"); // 测试步骤 TC_LINTest LIN Send C4_FRS_active_container 0x0 CH4//引擎转发香氛通道真实值
  g_EM_LIN_Swc_LIN_Send("C4_FRS_CurrentIntensity 0 CH4"); // 测试步骤 TC_LINTest LIN Send C4_FRS_CurrentIntensity 0 CH4//引擎转发香氛浓度真实值-closed
  g_EM_Equipment_Swc_TC_4G_Time_Delay_Second("1"); // 测试步骤 TC_Sleep 1
  g_EM_SOAClient_Swc_SOA_CHECK_Prepare("Veh_SetSFSConRespStruct.Veh_SetSFSConNRC 0"); // 预期结果 TC_CANTest SOA check Veh_SetSFSConRespStruct.Veh_SetSFSConNRC 0
  g_EM_SOAClient_Swc_SOA_CHECK_Prepare("Veh_SFSService_ErrStruct.OpeNRC 0 traceback8"); // 预期结果 TC_CANTest SOA check Veh_SFSService_ErrStruct.OpeNRC 0 traceback8//
  g_EM_SOAClient_Swc_SOA_REQ("Veh_SetSFSConStruct.Veh_SetSFSCon:1&ServiceExecuteFeedbackFlag:2&MemoryReq:1"); // 测试步骤 TC_CANTest SOA REQ Veh_SetSFSConStruct.Veh_SetSFSCon:1&ServiceExecuteFeedbackFlag:2&MemoryReq:1//Low
  g_EM_SOAClient_Swc_SOA_CHECK("Veh_SetSFSConRespStruct.Veh_SetSFSConNRC 0"); // 预期结果 TC_CANTest SOA check Veh_SetSFSConRespStruct.Veh_SetSFSConNRC 0
  g_EM_LIN_Swc_LIN_Check("C4_FRS_IntensityReq 3 CH4"); // 预期结果 TC_LINTest LIN Check C4_FRS_IntensityReq 3 CH4
  g_EM_LIN_Swc_LIN_Send("C4_FRS_CurrentIntensity 3 CH4"); // 测试步骤 TC_LINTest LIN Send C4_FRS_CurrentIntensity 3 CH4//引擎转发香氛通道真实值-closed
  g_EM_LIN_Swc_LIN_Check("C4_FRS_ChannelSelect 3 CH4"); // 预期结果 TC_LINTest LIN Check C4_FRS_ChannelSelect 3 CH4
  g_EM_LIN_Swc_LIN_Send("C4_FRS_active_container 0x3 CH4"); // 测试步骤 TC_LINTest LIN Send C4_FRS_active_container 0x3 CH4//ch3
  g_EM_SOAClient_Swc_SOA_CHECK("Veh_SFSService_ErrStruct.OpeNRC 0 traceback8"); // 预期结果 TC_CANTest SOA check Veh_SFSService_ErrStruct.OpeNRC 0 traceback8//
}

testcase SYS_CDCU_xiangfen_0036()
{
  TestDescription("香氛浓度调节---high 通道记忆3 当前通道浓度无效 Local on");
  teststep("warning","原始用例id为SYS-CDCU-香氛-0036");
  g_EM_LIN_Swc_LIN_Send("C4_FRS_active_container 0x0 CH4"); // 测试步骤 TC_LINTest LIN Send C4_FRS_active_container 0x0 CH4//引擎转发香氛通道真实值
  g_EM_LIN_Swc_LIN_Send("C4_FRS_CurrentIntensity 0 CH4"); // 测试步骤 TC_LINTest LIN Send C4_FRS_CurrentIntensity 0 CH4//引擎转发香氛浓度真实值-closed
  g_EM_Equipment_Swc_TC_4G_Time_Delay_Second("1"); // 测试步骤 TC_Sleep 1
  g_EM_SOAClient_Swc_SOA_CHECK_Prepare("Veh_SetSFSConRespStruct.Veh_SetSFSConNRC 0"); // 预期结果 TC_CANTest SOA check Veh_SetSFSConRespStruct.Veh_SetSFSConNRC 0
  g_EM_SOAClient_Swc_SOA_CHECK_Prepare("Veh_SFSService_ErrStruct.OpeNRC 0 traceback8"); // 预期结果 TC_CANTest SOA check Veh_SFSService_ErrStruct.OpeNRC 0 traceback8//
  g_EM_SOAClient_Swc_SOA_REQ("Veh_SetSFSConStruct.Veh_SetSFSCon:2&ServiceExecuteFeedbackFlag:2&MemoryReq:1"); // 测试步骤 TC_CANTest SOA REQ Veh_SetSFSConStruct.Veh_SetSFSCon:2&ServiceExecuteFeedbackFlag:2&MemoryReq:1//Low
  g_EM_SOAClient_Swc_SOA_CHECK("Veh_SetSFSConRespStruct.Veh_SetSFSConNRC 0"); // 预期结果 TC_CANTest SOA check Veh_SetSFSConRespStruct.Veh_SetSFSConNRC 0
  g_EM_LIN_Swc_LIN_Check("C4_FRS_IntensityReq 10 CH4"); // 预期结果 TC_LINTest LIN Check C4_FRS_IntensityReq 10 CH4
  g_EM_LIN_Swc_LIN_Send("C4_FRS_CurrentIntensity 10 CH4"); // 测试步骤 TC_LINTest LIN Send C4_FRS_CurrentIntensity 10 CH4//引擎转发香氛通道真实值-closed
  g_EM_LIN_Swc_LIN_Check("C4_FRS_ChannelSelect 3 CH4"); // 预期结果 TC_LINTest LIN Check C4_FRS_ChannelSelect 3 CH4
  g_EM_LIN_Swc_LIN_Send("C4_FRS_active_container 0x3 CH4"); // 测试步骤 TC_LINTest LIN Send C4_FRS_active_container 0x3 CH4//ch3
  g_EM_SOAClient_Swc_SOA_CHECK("Veh_SFSService_ErrStruct.OpeNRC 0 traceback8"); // 预期结果 TC_CANTest SOA check Veh_SFSService_ErrStruct.OpeNRC 0 traceback8//
}

testcase SYS_CDCU_xiangfen_0037()
{
  TestDescription("香氛浓度调节---mid 通道记忆3 当前通道浓度无效 Local on");
  teststep("warning","原始用例id为SYS-CDCU-香氛-0037");
  g_EM_LIN_Swc_LIN_Send("C4_FRS_active_container 0x0 CH4"); // 测试步骤 TC_LINTest LIN Send C4_FRS_active_container 0x0 CH4//引擎转发香氛通道真实值
  g_EM_LIN_Swc_LIN_Send("C4_FRS_CurrentIntensity 0 CH4"); // 测试步骤 TC_LINTest LIN Send C4_FRS_CurrentIntensity 0 CH4//引擎转发香氛浓度真实值-closed
  g_EM_Equipment_Swc_TC_4G_Time_Delay_Second("1"); // 测试步骤 TC_Sleep 1
  g_EM_SOAClient_Swc_SOA_CHECK_Prepare("Veh_SetSFSConRespStruct.Veh_SetSFSConNRC 0"); // 预期结果 TC_CANTest SOA check Veh_SetSFSConRespStruct.Veh_SetSFSConNRC 0
  g_EM_SOAClient_Swc_SOA_CHECK_Prepare("Veh_SFSService_ErrStruct.OpeNRC 0 traceback8"); // 预期结果 TC_CANTest SOA check Veh_SFSService_ErrStruct.OpeNRC 0 traceback8//
  g_EM_SOAClient_Swc_SOA_REQ("Veh_SetSFSConStruct.Veh_SetSFSCon:3&ServiceExecuteFeedbackFlag:2&MemoryReq:1"); // 测试步骤 TC_CANTest SOA REQ Veh_SetSFSConStruct.Veh_SetSFSCon:3&ServiceExecuteFeedbackFlag:2&MemoryReq:1//Low
  g_EM_SOAClient_Swc_SOA_CHECK("Veh_SetSFSConRespStruct.Veh_SetSFSConNRC 0"); // 预期结果 TC_CANTest SOA check Veh_SetSFSConRespStruct.Veh_SetSFSConNRC 0
  g_EM_LIN_Swc_LIN_Check("C4_FRS_IntensityReq 6 CH4"); // 预期结果 TC_LINTest LIN Check C4_FRS_IntensityReq 6 CH4
  g_EM_LIN_Swc_LIN_Send("C4_FRS_CurrentIntensity 6 CH4"); // 测试步骤 TC_LINTest LIN Send C4_FRS_CurrentIntensity 6 CH4//引擎转发香氛通道真实值-closed
  g_EM_LIN_Swc_LIN_Check("C4_FRS_ChannelSelect 3 CH4"); // 预期结果 TC_LINTest LIN Check C4_FRS_ChannelSelect 3 CH4
  g_EM_LIN_Swc_LIN_Send("C4_FRS_active_container 0x3 CH4"); // 测试步骤 TC_LINTest LIN Send C4_FRS_active_container 0x3 CH4//ch3
  g_EM_SOAClient_Swc_SOA_CHECK("Veh_SFSService_ErrStruct.OpeNRC 0 traceback8"); // 预期结果 TC_CANTest SOA check Veh_SFSService_ErrStruct.OpeNRC 0 traceback8//
}

testcase SYS_CDCU_xiangfen_0038()
{
  TestDescription("香氛浓度调节---low 通道记忆1 当前通道有效 浓度无效 Local on");
  teststep("warning","原始用例id为SYS-CDCU-香氛-0038");
  g_EM_LIN_Swc_LIN_Send("C4_FRS_active_container 0x1 CH4"); // 测试步骤 TC_LINTest LIN Send C4_FRS_active_container 0x1 CH4//ch3
  g_EM_Equipment_Swc_TC_4G_Time_Delay_Second("1"); // 测试步骤 TC_Sleep 1
  g_EM_SOAClient_Swc_SOA_CHECK_Prepare("Veh_SetSFSChanelRespStruct.Veh_SetSFSChanelNRC 0"); // 预期结果 TC_CANTest SOA check Veh_SetSFSChanelRespStruct.Veh_SetSFSChanelNRC 0
  g_EM_SOAClient_Swc_SOA_CHECK_Prepare("Veh_SFSService_ErrStruct.OpeNRC 0 traceback8"); // 预期结果 TC_CANTest SOA check Veh_SFSService_ErrStruct.OpeNRC 0 traceback8//
  g_EM_SOAClient_Swc_SOA_REQ("Veh_SetSFSChanelStruct.Veh_SetSFSChanel:1&ServiceExecuteFeedbackFlag:2&MemoryReq:1"); // 测试步骤 TC_CANTest SOA REQ Veh_SetSFSChanelStruct.Veh_SetSFSChanel:1&ServiceExecuteFeedbackFlag:2&MemoryReq:1//通道3
  g_EM_SOAClient_Swc_SOA_CHECK("Veh_SetSFSChanelRespStruct.Veh_SetSFSChanelNRC 0"); // 预期结果 TC_CANTest SOA check Veh_SetSFSChanelRespStruct.Veh_SetSFSChanelNRC 0
  g_EM_LIN_Swc_LIN_Check("C4_FRS_ChannelSelect 1 CH4"); // 预期结果 TC_LINTest LIN Check C4_FRS_ChannelSelect 1 CH4
  g_EM_SOAClient_Swc_SOA_CHECK("Veh_SFSService_ErrStruct.OpeNRC 0 traceback8"); // 预期结果 TC_CANTest SOA check Veh_SFSService_ErrStruct.OpeNRC 0 traceback8//
  g_EM_LIN_Swc_LIN_Send("C4_FRS_active_container 0x1 CH4"); // 测试步骤 TC_LINTest LIN Send C4_FRS_active_container 0x1 CH4//引擎转发香氛通道真实值
  g_EM_LIN_Swc_LIN_Send("C4_FRS_CurrentIntensity 0 CH4"); // 测试步骤 TC_LINTest LIN Send C4_FRS_CurrentIntensity 0 CH4//引擎转发香氛浓度真实值-closed
  g_EM_Equipment_Swc_TC_4G_Time_Delay_Second("1"); // 测试步骤 TC_Sleep 1
  g_EM_SOAClient_Swc_SOA_CHECK_Prepare("Veh_SetSFSConRespStruct.Veh_SetSFSConNRC 0"); // 预期结果 TC_CANTest SOA check Veh_SetSFSConRespStruct.Veh_SetSFSConNRC 0
  g_EM_SOAClient_Swc_SOA_CHECK_Prepare("Veh_SFSService_ErrStruct.OpeNRC 0 traceback8"); // 预期结果 TC_CANTest SOA check Veh_SFSService_ErrStruct.OpeNRC 0 traceback8//
  g_EM_SOAClient_Swc_SOA_REQ("Veh_SetSFSConStruct.Veh_SetSFSCon:1&ServiceExecuteFeedbackFlag:2&MemoryReq:1"); // 测试步骤 TC_CANTest SOA REQ Veh_SetSFSConStruct.Veh_SetSFSCon:1&ServiceExecuteFeedbackFlag:2&MemoryReq:1//Low
  g_EM_SOAClient_Swc_SOA_CHECK("Veh_SetSFSConRespStruct.Veh_SetSFSConNRC 0"); // 预期结果 TC_CANTest SOA check Veh_SetSFSConRespStruct.Veh_SetSFSConNRC 0
  g_EM_LIN_Swc_LIN_Check("C4_FRS_IntensityReq 3 CH4"); // 预期结果 TC_LINTest LIN Check C4_FRS_IntensityReq 3 CH4
  g_EM_LIN_Swc_LIN_Send("C4_FRS_CurrentIntensity 3 CH4"); // 测试步骤 TC_LINTest LIN Send C4_FRS_CurrentIntensity 3 CH4//引擎转发香氛通道真实值-closed
  g_EM_LIN_Swc_LIN_Check("C4_FRS_ChannelSelect 1 CH4"); // 预期结果 TC_LINTest LIN Check C4_FRS_ChannelSelect 1 CH4
  g_EM_LIN_Swc_LIN_Send("C4_FRS_active_container 0x1 CH4"); // 测试步骤 TC_LINTest LIN Send C4_FRS_active_container 0x1 CH4//ch3
  g_EM_SOAClient_Swc_SOA_CHECK("Veh_SFSService_ErrStruct.OpeNRC 0 traceback8"); // 预期结果 TC_CANTest SOA check Veh_SFSService_ErrStruct.OpeNRC 0 traceback8//
}

testcase SYS_CDCU_xiangfen_0039()
{
  TestDescription("香氛浓度调节---high 通道记忆1 当前通道有效浓度无效 Local on");
  teststep("warning","原始用例id为SYS-CDCU-香氛-0039");
  g_EM_LIN_Swc_LIN_Send("C4_FRS_active_container 0x1 CH4"); // 测试步骤 TC_LINTest LIN Send C4_FRS_active_container 0x1 CH4//引擎转发香氛通道真实值
  g_EM_LIN_Swc_LIN_Send("C4_FRS_CurrentIntensity 0 CH4"); // 测试步骤 TC_LINTest LIN Send C4_FRS_CurrentIntensity 0 CH4//引擎转发香氛浓度真实值-closed
  g_EM_Equipment_Swc_TC_4G_Time_Delay_Second("1"); // 测试步骤 TC_Sleep 1
  g_EM_SOAClient_Swc_SOA_CHECK_Prepare("Veh_SetSFSConRespStruct.Veh_SetSFSConNRC 0"); // 预期结果 TC_CANTest SOA check Veh_SetSFSConRespStruct.Veh_SetSFSConNRC 0
  g_EM_SOAClient_Swc_SOA_CHECK_Prepare("Veh_SFSService_ErrStruct.OpeNRC 0 traceback8"); // 预期结果 TC_CANTest SOA check Veh_SFSService_ErrStruct.OpeNRC 0 traceback8//
  g_EM_SOAClient_Swc_SOA_REQ("Veh_SetSFSConStruct.Veh_SetSFSCon:2&ServiceExecuteFeedbackFlag:2&MemoryReq:1"); // 测试步骤 TC_CANTest SOA REQ Veh_SetSFSConStruct.Veh_SetSFSCon:2&ServiceExecuteFeedbackFlag:2&MemoryReq:1//Low
  g_EM_SOAClient_Swc_SOA_CHECK("Veh_SetSFSConRespStruct.Veh_SetSFSConNRC 0"); // 预期结果 TC_CANTest SOA check Veh_SetSFSConRespStruct.Veh_SetSFSConNRC 0
  g_EM_LIN_Swc_LIN_Check("C4_FRS_IntensityReq 10 CH4"); // 预期结果 TC_LINTest LIN Check C4_FRS_IntensityReq 10 CH4
  g_EM_LIN_Swc_LIN_Send("C4_FRS_CurrentIntensity 10 CH4"); // 测试步骤 TC_LINTest LIN Send C4_FRS_CurrentIntensity 10 CH4//引擎转发香氛通道真实值-closed
  g_EM_LIN_Swc_LIN_Check("C4_FRS_ChannelSelect 1 CH4"); // 预期结果 TC_LINTest LIN Check C4_FRS_ChannelSelect 1 CH4
  g_EM_LIN_Swc_LIN_Send("C4_FRS_active_container 0x1 CH4"); // 测试步骤 TC_LINTest LIN Send C4_FRS_active_container 0x1 CH4//ch3
  g_EM_SOAClient_Swc_SOA_CHECK("Veh_SFSService_ErrStruct.OpeNRC 0 traceback8"); // 预期结果 TC_CANTest SOA check Veh_SFSService_ErrStruct.OpeNRC 0 traceback8//
}

testcase SYS_CDCU_xiangfen_0040()
{
  TestDescription("香氛浓度调节---mid 通道记忆1 当前通道有效浓度无效 Local on");
  teststep("warning","原始用例id为SYS-CDCU-香氛-0040");
  g_EM_LIN_Swc_LIN_Send("C4_FRS_active_container 0x1 CH4"); // 测试步骤 TC_LINTest LIN Send C4_FRS_active_container 0x1 CH4//引擎转发香氛通道真实值
  g_EM_LIN_Swc_LIN_Send("C4_FRS_CurrentIntensity 0 CH4"); // 测试步骤 TC_LINTest LIN Send C4_FRS_CurrentIntensity 0 CH4//引擎转发香氛浓度真实值-closed
  g_EM_Equipment_Swc_TC_4G_Time_Delay_Second("1"); // 测试步骤 TC_Sleep 1
  g_EM_SOAClient_Swc_SOA_CHECK_Prepare("Veh_SetSFSConRespStruct.Veh_SetSFSConNRC 0"); // 预期结果 TC_CANTest SOA check Veh_SetSFSConRespStruct.Veh_SetSFSConNRC 0
  g_EM_SOAClient_Swc_SOA_CHECK_Prepare("Veh_SFSService_ErrStruct.OpeNRC 0 traceback8"); // 预期结果 TC_CANTest SOA check Veh_SFSService_ErrStruct.OpeNRC 0 traceback8//
  g_EM_SOAClient_Swc_SOA_REQ("Veh_SetSFSConStruct.Veh_SetSFSCon:3&ServiceExecuteFeedbackFlag:2&MemoryReq:1"); // 测试步骤 TC_CANTest SOA REQ Veh_SetSFSConStruct.Veh_SetSFSCon:3&ServiceExecuteFeedbackFlag:2&MemoryReq:1//Low
  g_EM_SOAClient_Swc_SOA_CHECK("Veh_SetSFSConRespStruct.Veh_SetSFSConNRC 0"); // 预期结果 TC_CANTest SOA check Veh_SetSFSConRespStruct.Veh_SetSFSConNRC 0
  g_EM_LIN_Swc_LIN_Check("C4_FRS_IntensityReq 6 CH4"); // 预期结果 TC_LINTest LIN Check C4_FRS_IntensityReq 6 CH4
  g_EM_LIN_Swc_LIN_Send("C4_FRS_CurrentIntensity 6 CH4"); // 测试步骤 TC_LINTest LIN Send C4_FRS_CurrentIntensity 6 CH4//引擎转发香氛通道真实值-closed
  g_EM_LIN_Swc_LIN_Check("C4_FRS_ChannelSelect 1 CH4"); // 预期结果 TC_LINTest LIN Check C4_FRS_ChannelSelect 1 CH4
  g_EM_LIN_Swc_LIN_Send("C4_FRS_active_container 0x1 CH4"); // 测试步骤 TC_LINTest LIN Send C4_FRS_active_container 0x1 CH4//ch3
  g_EM_SOAClient_Swc_SOA_CHECK("Veh_SFSService_ErrStruct.OpeNRC 0 traceback8"); // 预期结果 TC_CANTest SOA check Veh_SFSService_ErrStruct.OpeNRC 0 traceback8//
}

testcase SYS_CDCU_xiangfen_0041()
{
  TestDescription("香氛浓度调节---low 通道记忆2 当前通道有效浓度无效 Local on");
  teststep("warning","原始用例id为SYS-CDCU-香氛-0041");
  g_EM_LIN_Swc_LIN_Send("C4_FRS_active_container 0x2 CH4"); // 测试步骤 TC_LINTest LIN Send C4_FRS_active_container 0x2 CH4//ch3
  g_EM_Equipment_Swc_TC_4G_Time_Delay_Second("1"); // 测试步骤 TC_Sleep 1
  g_EM_SOAClient_Swc_SOA_CHECK_Prepare("Veh_SetSFSChanelRespStruct.Veh_SetSFSChanelNRC 0"); // 预期结果 TC_CANTest SOA check Veh_SetSFSChanelRespStruct.Veh_SetSFSChanelNRC 0
  g_EM_SOAClient_Swc_SOA_CHECK_Prepare("Veh_SFSService_ErrStruct.OpeNRC 0 traceback8"); // 预期结果 TC_CANTest SOA check Veh_SFSService_ErrStruct.OpeNRC 0 traceback8//
  g_EM_SOAClient_Swc_SOA_REQ("Veh_SetSFSChanelStruct.Veh_SetSFSChanel:2&ServiceExecuteFeedbackFlag:2&MemoryReq:1"); // 测试步骤 TC_CANTest SOA REQ Veh_SetSFSChanelStruct.Veh_SetSFSChanel:2&ServiceExecuteFeedbackFlag:2&MemoryReq:1//通道3
  g_EM_SOAClient_Swc_SOA_CHECK("Veh_SetSFSChanelRespStruct.Veh_SetSFSChanelNRC 0"); // 预期结果 TC_CANTest SOA check Veh_SetSFSChanelRespStruct.Veh_SetSFSChanelNRC 0
  g_EM_LIN_Swc_LIN_Check("C4_FRS_ChannelSelect 2 CH4"); // 预期结果 TC_LINTest LIN Check C4_FRS_ChannelSelect 2 CH4
  g_EM_SOAClient_Swc_SOA_CHECK("Veh_SFSService_ErrStruct.OpeNRC 0 traceback8"); // 预期结果 TC_CANTest SOA check Veh_SFSService_ErrStruct.OpeNRC 0 traceback8//
  g_EM_LIN_Swc_LIN_Send("C4_FRS_active_container 0x2 CH4"); // 测试步骤 TC_LINTest LIN Send C4_FRS_active_container 0x2 CH4//引擎转发香氛通道真实值
  g_EM_LIN_Swc_LIN_Send("C4_FRS_CurrentIntensity 0 CH4"); // 测试步骤 TC_LINTest LIN Send C4_FRS_CurrentIntensity 0 CH4//引擎转发香氛浓度真实值-closed
  g_EM_Equipment_Swc_TC_4G_Time_Delay_Second("1"); // 测试步骤 TC_Sleep 1
  g_EM_SOAClient_Swc_SOA_CHECK_Prepare("Veh_SetSFSConRespStruct.Veh_SetSFSConNRC 0"); // 预期结果 TC_CANTest SOA check Veh_SetSFSConRespStruct.Veh_SetSFSConNRC 0
  g_EM_SOAClient_Swc_SOA_CHECK_Prepare("Veh_SFSService_ErrStruct.OpeNRC 0 traceback8"); // 预期结果 TC_CANTest SOA check Veh_SFSService_ErrStruct.OpeNRC 0 traceback8//
  g_EM_SOAClient_Swc_SOA_REQ("Veh_SetSFSConStruct.Veh_SetSFSCon:1&ServiceExecuteFeedbackFlag:2&MemoryReq:1"); // 测试步骤 TC_CANTest SOA REQ Veh_SetSFSConStruct.Veh_SetSFSCon:1&ServiceExecuteFeedbackFlag:2&MemoryReq:1//Low
  g_EM_SOAClient_Swc_SOA_CHECK("Veh_SetSFSConRespStruct.Veh_SetSFSConNRC 0"); // 预期结果 TC_CANTest SOA check Veh_SetSFSConRespStruct.Veh_SetSFSConNRC 0
  g_EM_LIN_Swc_LIN_Check("C4_FRS_IntensityReq 3 CH4"); // 预期结果 TC_LINTest LIN Check C4_FRS_IntensityReq 3 CH4
  g_EM_LIN_Swc_LIN_Send("C4_FRS_CurrentIntensity 3 CH4"); // 测试步骤 TC_LINTest LIN Send C4_FRS_CurrentIntensity 3 CH4//引擎转发香氛通道真实值-closed
  g_EM_LIN_Swc_LIN_Check("C4_FRS_ChannelSelect 2 CH4"); // 预期结果 TC_LINTest LIN Check C4_FRS_ChannelSelect 2 CH4
  g_EM_LIN_Swc_LIN_Send("C4_FRS_active_container 0x2 CH4"); // 测试步骤 TC_LINTest LIN Send C4_FRS_active_container 0x2 CH4//ch3
  g_EM_SOAClient_Swc_SOA_CHECK("Veh_SFSService_ErrStruct.OpeNRC 0 traceback8"); // 预期结果 TC_CANTest SOA check Veh_SFSService_ErrStruct.OpeNRC 0 traceback8//
}

testcase SYS_CDCU_xiangfen_0042()
{
  TestDescription("香氛浓度调节---high 通道记忆2 当前通道有效浓度无效 Local on");
  teststep("warning","原始用例id为SYS-CDCU-香氛-0042");
  g_EM_LIN_Swc_LIN_Send("C4_FRS_active_container 0x2 CH4"); // 测试步骤 TC_LINTest LIN Send C4_FRS_active_container 0x2 CH4//引擎转发香氛通道真实值
  g_EM_LIN_Swc_LIN_Send("C4_FRS_CurrentIntensity 0 CH4"); // 测试步骤 TC_LINTest LIN Send C4_FRS_CurrentIntensity 0 CH4//引擎转发香氛浓度真实值-closed
  g_EM_Equipment_Swc_TC_4G_Time_Delay_Second("1"); // 测试步骤 TC_Sleep 1
  g_EM_SOAClient_Swc_SOA_CHECK_Prepare("Veh_SetSFSConRespStruct.Veh_SetSFSConNRC 0"); // 预期结果 TC_CANTest SOA check Veh_SetSFSConRespStruct.Veh_SetSFSConNRC 0
  g_EM_SOAClient_Swc_SOA_CHECK_Prepare("Veh_SFSService_ErrStruct.OpeNRC 0 traceback8"); // 预期结果 TC_CANTest SOA check Veh_SFSService_ErrStruct.OpeNRC 0 traceback8//
  g_EM_SOAClient_Swc_SOA_REQ("Veh_SetSFSConStruct.Veh_SetSFSCon:2&ServiceExecuteFeedbackFlag:2&MemoryReq:1"); // 测试步骤 TC_CANTest SOA REQ Veh_SetSFSConStruct.Veh_SetSFSCon:2&ServiceExecuteFeedbackFlag:2&MemoryReq:1//Low
  g_EM_SOAClient_Swc_SOA_CHECK("Veh_SetSFSConRespStruct.Veh_SetSFSConNRC 0"); // 预期结果 TC_CANTest SOA check Veh_SetSFSConRespStruct.Veh_SetSFSConNRC 0
  g_EM_LIN_Swc_LIN_Check("C4_FRS_IntensityReq 10 CH4"); // 预期结果 TC_LINTest LIN Check C4_FRS_IntensityReq 10 CH4
  g_EM_LIN_Swc_LIN_Send("C4_FRS_CurrentIntensity 10 CH4"); // 测试步骤 TC_LINTest LIN Send C4_FRS_CurrentIntensity 10 CH4//引擎转发香氛通道真实值-closed
  g_EM_LIN_Swc_LIN_Check("C4_FRS_ChannelSelect 2 CH4"); // 预期结果 TC_LINTest LIN Check C4_FRS_ChannelSelect 2 CH4
  g_EM_LIN_Swc_LIN_Send("C4_FRS_active_container 0x2 CH4"); // 测试步骤 TC_LINTest LIN Send C4_FRS_active_container 0x2 CH4//ch3
  g_EM_SOAClient_Swc_SOA_CHECK("Veh_SFSService_ErrStruct.OpeNRC 0 traceback8"); // 预期结果 TC_CANTest SOA check Veh_SFSService_ErrStruct.OpeNRC 0 traceback8//
}

testcase SYS_CDCU_xiangfen_0043()
{
  TestDescription("香氛浓度调节---mid 通道记忆2 当前通道有效浓度无效 Local on");
  teststep("warning","原始用例id为SYS-CDCU-香氛-0043");
  g_EM_LIN_Swc_LIN_Send("C4_FRS_active_container 0x2 CH4"); // 测试步骤 TC_LINTest LIN Send C4_FRS_active_container 0x2 CH4//引擎转发香氛通道真实值
  g_EM_LIN_Swc_LIN_Send("C4_FRS_CurrentIntensity 0 CH4"); // 测试步骤 TC_LINTest LIN Send C4_FRS_CurrentIntensity 0 CH4//引擎转发香氛浓度真实值-closed
  g_EM_Equipment_Swc_TC_4G_Time_Delay_Second("1"); // 测试步骤 TC_Sleep 1
  g_EM_SOAClient_Swc_SOA_CHECK_Prepare("Veh_SetSFSConRespStruct.Veh_SetSFSConNRC 0"); // 预期结果 TC_CANTest SOA check Veh_SetSFSConRespStruct.Veh_SetSFSConNRC 0
  g_EM_SOAClient_Swc_SOA_CHECK_Prepare("Veh_SFSService_ErrStruct.OpeNRC 0 traceback8"); // 预期结果 TC_CANTest SOA check Veh_SFSService_ErrStruct.OpeNRC 0 traceback8//
  g_EM_SOAClient_Swc_SOA_REQ("Veh_SetSFSConStruct.Veh_SetSFSCon:3&ServiceExecuteFeedbackFlag:2&MemoryReq:1"); // 测试步骤 TC_CANTest SOA REQ Veh_SetSFSConStruct.Veh_SetSFSCon:3&ServiceExecuteFeedbackFlag:2&MemoryReq:1//Low
  g_EM_SOAClient_Swc_SOA_CHECK("Veh_SetSFSConRespStruct.Veh_SetSFSConNRC 0"); // 预期结果 TC_CANTest SOA check Veh_SetSFSConRespStruct.Veh_SetSFSConNRC 0
  g_EM_LIN_Swc_LIN_Check("C4_FRS_IntensityReq 6 CH4"); // 预期结果 TC_LINTest LIN Check C4_FRS_IntensityReq 6 CH4
  g_EM_LIN_Swc_LIN_Send("C4_FRS_CurrentIntensity 6 CH4"); // 测试步骤 TC_LINTest LIN Send C4_FRS_CurrentIntensity 6 CH4//引擎转发香氛通道真实值-closed
  g_EM_LIN_Swc_LIN_Check("C4_FRS_ChannelSelect 2 CH4"); // 预期结果 TC_LINTest LIN Check C4_FRS_ChannelSelect 2 CH4
  g_EM_LIN_Swc_LIN_Send("C4_FRS_active_container 0x2 CH4"); // 测试步骤 TC_LINTest LIN Send C4_FRS_active_container 0x2 CH4//ch3
  g_EM_SOAClient_Swc_SOA_CHECK("Veh_SFSService_ErrStruct.OpeNRC 0 traceback8"); // 预期结果 TC_CANTest SOA check Veh_SFSService_ErrStruct.OpeNRC 0 traceback8//
}

testcase SYS_CDCU_xiangfen_0044()
{
  TestDescription("香氛浓度调节---low 通道记忆3 当前通道有效浓度无效 Local on");
  teststep("warning","原始用例id为SYS-CDCU-香氛-0044");
  g_EM_LIN_Swc_LIN_Send("C4_FRS_active_container 0x3 CH4"); // 测试步骤 TC_LINTest LIN Send C4_FRS_active_container 0x3 CH4//ch3
  g_EM_Equipment_Swc_TC_4G_Time_Delay_Second("1"); // 测试步骤 TC_Sleep 1
  g_EM_SOAClient_Swc_SOA_CHECK_Prepare("Veh_SetSFSChanelRespStruct.Veh_SetSFSChanelNRC 0"); // 预期结果 TC_CANTest SOA check Veh_SetSFSChanelRespStruct.Veh_SetSFSChanelNRC 0
  g_EM_SOAClient_Swc_SOA_CHECK_Prepare("Veh_SFSService_ErrStruct.OpeNRC 0 traceback8"); // 预期结果 TC_CANTest SOA check Veh_SFSService_ErrStruct.OpeNRC 0 traceback8//
  g_EM_SOAClient_Swc_SOA_REQ("Veh_SetSFSChanelStruct.Veh_SetSFSChanel:3&ServiceExecuteFeedbackFlag:2&MemoryReq:1"); // 测试步骤 TC_CANTest SOA REQ Veh_SetSFSChanelStruct.Veh_SetSFSChanel:3&ServiceExecuteFeedbackFlag:2&MemoryReq:1//通道3
  g_EM_SOAClient_Swc_SOA_CHECK("Veh_SetSFSChanelRespStruct.Veh_SetSFSChanelNRC 0"); // 预期结果 TC_CANTest SOA check Veh_SetSFSChanelRespStruct.Veh_SetSFSChanelNRC 0
  g_EM_LIN_Swc_LIN_Check("C4_FRS_ChannelSelect 3 CH4"); // 预期结果 TC_LINTest LIN Check C4_FRS_ChannelSelect 3 CH4
  g_EM_SOAClient_Swc_SOA_CHECK("Veh_SFSService_ErrStruct.OpeNRC 0 traceback8"); // 预期结果 TC_CANTest SOA check Veh_SFSService_ErrStruct.OpeNRC 0 traceback8//
  g_EM_LIN_Swc_LIN_Send("C4_FRS_active_container 0x3 CH4"); // 测试步骤 TC_LINTest LIN Send C4_FRS_active_container 0x3 CH4//引擎转发香氛通道真实值
  g_EM_LIN_Swc_LIN_Send("C4_FRS_CurrentIntensity 0 CH4"); // 测试步骤 TC_LINTest LIN Send C4_FRS_CurrentIntensity 0 CH4//引擎转发香氛浓度真实值-closed
  g_EM_Equipment_Swc_TC_4G_Time_Delay_Second("1"); // 测试步骤 TC_Sleep 1
  g_EM_SOAClient_Swc_SOA_CHECK_Prepare("Veh_SetSFSConRespStruct.Veh_SetSFSConNRC 0"); // 预期结果 TC_CANTest SOA check Veh_SetSFSConRespStruct.Veh_SetSFSConNRC 0
  g_EM_SOAClient_Swc_SOA_CHECK_Prepare("Veh_SFSService_ErrStruct.OpeNRC 0 traceback8"); // 预期结果 TC_CANTest SOA check Veh_SFSService_ErrStruct.OpeNRC 0 traceback8//
  g_EM_SOAClient_Swc_SOA_REQ("Veh_SetSFSConStruct.Veh_SetSFSCon:1&ServiceExecuteFeedbackFlag:2&MemoryReq:1"); // 测试步骤 TC_CANTest SOA REQ Veh_SetSFSConStruct.Veh_SetSFSCon:1&ServiceExecuteFeedbackFlag:2&MemoryReq:1//Low
  g_EM_SOAClient_Swc_SOA_CHECK("Veh_SetSFSConRespStruct.Veh_SetSFSConNRC 0"); // 预期结果 TC_CANTest SOA check Veh_SetSFSConRespStruct.Veh_SetSFSConNRC 0
  g_EM_LIN_Swc_LIN_Check("C4_FRS_IntensityReq 3 CH4"); // 预期结果 TC_LINTest LIN Check C4_FRS_IntensityReq 3 CH4
  g_EM_LIN_Swc_LIN_Send("C4_FRS_CurrentIntensity 3 CH4"); // 测试步骤 TC_LINTest LIN Send C4_FRS_CurrentIntensity 3 CH4//引擎转发香氛通道真实值-closed
  g_EM_LIN_Swc_LIN_Check("C4_FRS_ChannelSelect 3 CH4"); // 预期结果 TC_LINTest LIN Check C4_FRS_ChannelSelect 3 CH4
  g_EM_LIN_Swc_LIN_Send("C4_FRS_active_container 0x3 CH4"); // 测试步骤 TC_LINTest LIN Send C4_FRS_active_container 0x3 CH4//ch3
  g_EM_SOAClient_Swc_SOA_CHECK("Veh_SFSService_ErrStruct.OpeNRC 0 traceback8"); // 预期结果 TC_CANTest SOA check Veh_SFSService_ErrStruct.OpeNRC 0 traceback8//
}

testcase SYS_CDCU_xiangfen_0045()
{
  TestDescription("香氛浓度调节---mid 通道记忆3 当前通道有效浓度无效 Local on");
  teststep("warning","原始用例id为SYS-CDCU-香氛-0045");
  g_EM_LIN_Swc_LIN_Send("C4_FRS_active_container 0x3 CH4"); // 测试步骤 TC_LINTest LIN Send C4_FRS_active_container 0x3 CH4//引擎转发香氛通道真实值
  g_EM_LIN_Swc_LIN_Send("C4_FRS_CurrentIntensity 0 CH4"); // 测试步骤 TC_LINTest LIN Send C4_FRS_CurrentIntensity 0 CH4//引擎转发香氛浓度真实值-closed
  g_EM_Equipment_Swc_TC_4G_Time_Delay_Second("1"); // 测试步骤 TC_Sleep 1
  g_EM_SOAClient_Swc_SOA_CHECK_Prepare("Veh_SetSFSConRespStruct.Veh_SetSFSConNRC 0"); // 预期结果 TC_CANTest SOA check Veh_SetSFSConRespStruct.Veh_SetSFSConNRC 0
  g_EM_SOAClient_Swc_SOA_CHECK_Prepare("Veh_SFSService_ErrStruct.OpeNRC 0 traceback8"); // 预期结果 TC_CANTest SOA check Veh_SFSService_ErrStruct.OpeNRC 0 traceback8//
  g_EM_SOAClient_Swc_SOA_REQ("Veh_SetSFSConStruct.Veh_SetSFSCon:3&ServiceExecuteFeedbackFlag:2&MemoryReq:1"); // 测试步骤 TC_CANTest SOA REQ Veh_SetSFSConStruct.Veh_SetSFSCon:3&ServiceExecuteFeedbackFlag:2&MemoryReq:1//Low
  g_EM_SOAClient_Swc_SOA_CHECK("Veh_SetSFSConRespStruct.Veh_SetSFSConNRC 0"); // 预期结果 TC_CANTest SOA check Veh_SetSFSConRespStruct.Veh_SetSFSConNRC 0
  g_EM_LIN_Swc_LIN_Check("C4_FRS_IntensityReq 6 CH4"); // 预期结果 TC_LINTest LIN Check C4_FRS_IntensityReq 6 CH4
  g_EM_LIN_Swc_LIN_Send("C4_FRS_CurrentIntensity 6 CH4"); // 测试步骤 TC_LINTest LIN Send C4_FRS_CurrentIntensity 6 CH4//引擎转发香氛通道真实值-closed
  g_EM_LIN_Swc_LIN_Check("C4_FRS_ChannelSelect 3 CH4"); // 预期结果 TC_LINTest LIN Check C4_FRS_ChannelSelect 3 CH4
  g_EM_LIN_Swc_LIN_Send("C4_FRS_active_container 0x3 CH4"); // 测试步骤 TC_LINTest LIN Send C4_FRS_active_container 0x3 CH4//ch3
  g_EM_SOAClient_Swc_SOA_CHECK("Veh_SFSService_ErrStruct.OpeNRC 0 traceback8"); // 预期结果 TC_CANTest SOA check Veh_SFSService_ErrStruct.OpeNRC 0 traceback8//
}

testcase SYS_CDCU_xiangfen_0046()
{
  TestDescription("香氛浓度调节---high 通道记忆3 当前通道有效浓度无效 Local on");
  teststep("warning","原始用例id为SYS-CDCU-香氛-0046");
  g_EM_LIN_Swc_LIN_Send("C4_FRS_active_container 0x3 CH4"); // 测试步骤 TC_LINTest LIN Send C4_FRS_active_container 0x3 CH4//引擎转发香氛通道真实值
  g_EM_LIN_Swc_LIN_Send("C4_FRS_CurrentIntensity 0 CH4"); // 测试步骤 TC_LINTest LIN Send C4_FRS_CurrentIntensity 0 CH4//引擎转发香氛浓度真实值-closed
  g_EM_Equipment_Swc_TC_4G_Time_Delay_Second("1"); // 测试步骤 TC_Sleep 1
  g_EM_SOAClient_Swc_SOA_CHECK_Prepare("Veh_SetSFSConRespStruct.Veh_SetSFSConNRC 0"); // 预期结果 TC_CANTest SOA check Veh_SetSFSConRespStruct.Veh_SetSFSConNRC 0
  g_EM_SOAClient_Swc_SOA_CHECK_Prepare("Veh_SFSService_ErrStruct.OpeNRC 0 traceback8"); // 预期结果 TC_CANTest SOA check Veh_SFSService_ErrStruct.OpeNRC 0 traceback8//
  g_EM_SOAClient_Swc_SOA_REQ("Veh_SetSFSConStruct.Veh_SetSFSCon:2&ServiceExecuteFeedbackFlag:2&MemoryReq:1"); // 测试步骤 TC_CANTest SOA REQ Veh_SetSFSConStruct.Veh_SetSFSCon:2&ServiceExecuteFeedbackFlag:2&MemoryReq:1//Low
  g_EM_SOAClient_Swc_SOA_CHECK("Veh_SetSFSConRespStruct.Veh_SetSFSConNRC 0"); // 预期结果 TC_CANTest SOA check Veh_SetSFSConRespStruct.Veh_SetSFSConNRC 0
  g_EM_LIN_Swc_LIN_Check("C4_FRS_IntensityReq 10 CH4"); // 预期结果 TC_LINTest LIN Check C4_FRS_IntensityReq 10 CH4
  g_EM_LIN_Swc_LIN_Send("C4_FRS_CurrentIntensity 10 CH4"); // 测试步骤 TC_LINTest LIN Send C4_FRS_CurrentIntensity 10 CH4//引擎转发香氛通道真实值-closed
  g_EM_LIN_Swc_LIN_Check("C4_FRS_ChannelSelect 3 CH4"); // 预期结果 TC_LINTest LIN Check C4_FRS_ChannelSelect 3 CH4
  g_EM_LIN_Swc_LIN_Send("C4_FRS_active_container 0x3 CH4"); // 测试步骤 TC_LINTest LIN Send C4_FRS_active_container 0x3 CH4//ch3
  g_EM_SOAClient_Swc_SOA_CHECK("Veh_SFSService_ErrStruct.OpeNRC 0 traceback8"); // 预期结果 TC_CANTest SOA check Veh_SFSService_ErrStruct.OpeNRC 0 traceback8//
}

testcase SYS_CDCU_xiangfen_0047()
{
  TestDescription("电源切换香氛记忆 OFF->local on");
  teststep("warning","原始用例id为SYS-CDCU-香氛-0047");
  g_EM_LIN_Swc_LIN_Send("C4_FRS_CurrentIntensity 10 CH4"); // 测试步骤 TC_LINTest LIN Send C4_FRS_CurrentIntensity 10 CH4//引擎转发香氛通道真实值-low
  g_EM_Equipment_Swc_TC_4G_Time_Delay_Second("1"); // 测试步骤 TC_Sleep 1
  g_EM_SOAClient_Swc_SOA_CHECK_Prepare("Veh_TurnOnOffSFSRespStruct.Veh_TurnOnOffSFSNRC 0"); // 预期结果 TC_CANTest SOA check Veh_TurnOnOffSFSRespStruct.Veh_TurnOnOffSFSNRC 0
  g_EM_SOAClient_Swc_SOA_CHECK_Prepare("Veh_SFSService_ErrStruct.OpeNRC 0 traceback8"); // 预期结果 TC_CANTest SOA check Veh_SFSService_ErrStruct.OpeNRC 0 traceback8//
  g_EM_SOAClient_Swc_SOA_REQ("Veh_TurnOnOffSFSStruct.Veh_TurnOnOffSFS:1&ServiceExecuteFeedbackFlag:2&Time:10&MemoryReq:1"); // 测试步骤 TC_CANTest SOA REQ Veh_TurnOnOffSFSStruct.Veh_TurnOnOffSFS:1&ServiceExecuteFeedbackFlag:2&Time:10&MemoryReq:1//ON
  g_EM_SOAClient_Swc_SOA_CHECK("Veh_TurnOnOffSFSRespStruct.Veh_TurnOnOffSFSNRC 0"); // 预期结果 TC_CANTest SOA check Veh_TurnOnOffSFSRespStruct.Veh_TurnOnOffSFSNRC 0
  g_EM_LIN_Swc_LIN_Check("C4_FRS_IntensityReq 10 CH4"); // 预期结果 TC_LINTest LIN Check C4_FRS_IntensityReq 10 CH4
  g_EM_SOAClient_Swc_SOA_CHECK("Veh_SFSService_ErrStruct.OpeNRC 0 traceback8"); // 预期结果 TC_CANTest SOA check Veh_SFSService_ErrStruct.OpeNRC 0 traceback8//
  g_EM_LIN_Swc_LIN_Send("C4_FRS_active_container 0x3 CH4"); // 测试步骤 TC_LINTest LIN Send C4_FRS_active_container 0x3 CH4//ch3
  g_EM_Equipment_Swc_TC_4G_Time_Delay_Second("1"); // 测试步骤 TC_Sleep 1
  g_EM_SOAClient_Swc_SOA_CHECK_Prepare("Veh_SetSFSChanelRespStruct.Veh_SetSFSChanelNRC 0"); // 预期结果 TC_CANTest SOA check Veh_SetSFSChanelRespStruct.Veh_SetSFSChanelNRC 0
  g_EM_SOAClient_Swc_SOA_CHECK_Prepare("Veh_SFSService_ErrStruct.OpeNRC 0 traceback8"); // 预期结果 TC_CANTest SOA check Veh_SFSService_ErrStruct.OpeNRC 0 traceback8//
  g_EM_SOAClient_Swc_SOA_REQ("Veh_SetSFSChanelStruct.Veh_SetSFSChanel:3&ServiceExecuteFeedbackFlag:2&MemoryReq:1"); // 测试步骤 TC_CANTest SOA REQ Veh_SetSFSChanelStruct.Veh_SetSFSChanel:3&ServiceExecuteFeedbackFlag:2&MemoryReq:1//通道3
  g_EM_SOAClient_Swc_SOA_CHECK("Veh_SetSFSChanelRespStruct.Veh_SetSFSChanelNRC 0"); // 预期结果 TC_CANTest SOA check Veh_SetSFSChanelRespStruct.Veh_SetSFSChanelNRC 0
  g_EM_LIN_Swc_LIN_Check("C4_FRS_ChannelSelect 3 CH4"); // 预期结果 TC_LINTest LIN Check C4_FRS_ChannelSelect 3 CH4
  g_EM_SOAClient_Swc_SOA_CHECK("Veh_SFSService_ErrStruct.OpeNRC 0 traceback8"); // 预期结果 TC_CANTest SOA check Veh_SFSService_ErrStruct.OpeNRC 0 traceback8//
  g_EM_LIN_Swc_LIN_Send("C4_FRS_CurrentIntensity 10 CH4"); // 测试步骤 TC_LINTest LIN Send C4_FRS_CurrentIntensity 10 CH4
  g_EM_Equipment_Swc_TC_4G_Time_Delay_Second("1"); // 测试步骤 TC_Sleep 1
  g_EM_SOAClient_Swc_SOA_CHECK_Prepare("Veh_SetSFSConRespStruct.Veh_SetSFSConNRC 0"); // 预期结果 TC_CANTest SOA check Veh_SetSFSConRespStruct.Veh_SetSFSConNRC 0
  g_EM_SOAClient_Swc_SOA_CHECK_Prepare("Veh_SFSService_ErrStruct.OpeNRC 0 traceback8"); // 预期结果 TC_CANTest SOA check Veh_SFSService_ErrStruct.OpeNRC 0 traceback8//
  g_EM_SOAClient_Swc_SOA_CHECK_Prepare("Veh_SFSService_ErrStruct.OpeErrInfo[0-1]:0x00 traceback10"); // 预期结果 TC_CANTest SOA check Veh_SFSService_ErrStruct.OpeErrInfo[0-1]:0x00 traceback10//
  g_EM_SOAClient_Swc_SOA_REQ("Veh_SetSFSConStruct.Veh_SetSFSCon:2&ServiceExecuteFeedbackFlag:2&MemoryReq:1"); // 测试步骤 TC_CANTest SOA REQ Veh_SetSFSConStruct.Veh_SetSFSCon:2&ServiceExecuteFeedbackFlag:2&MemoryReq:1//High
  g_EM_SOAClient_Swc_SOA_CHECK("Veh_SetSFSConRespStruct.Veh_SetSFSConNRC 0"); // 预期结果 TC_CANTest SOA check Veh_SetSFSConRespStruct.Veh_SetSFSConNRC 0
  g_EM_LIN_Swc_LIN_Check("C4_FRS_IntensityReq 10 CH4"); // 预期结果 TC_LINTest LIN Check C4_FRS_IntensityReq 10 CH4
  g_EM_SOAClient_Swc_SOA_CHECK("Veh_SFSService_ErrStruct.OpeNRC 0 traceback8"); // 预期结果 TC_CANTest SOA check Veh_SFSService_ErrStruct.OpeNRC 0 traceback8//
  g_EM_SOAClient_Swc_SOA_CHECK("Veh_SFSService_ErrStruct.OpeErrInfo[0-1]:0x00 traceback10"); // 预期结果 TC_CANTest SOA check Veh_SFSService_ErrStruct.OpeErrInfo[0-1]:0x00 traceback10//
  g_EM_Equipment_Swc_TC_IG("OFF"); // 测试步骤 TC_IG OFF
  g_CAN_Bus_Swc_Set("I_LDCU_BodySysSt1.I_LDCU_PowerMode 0"); // 测试步骤 TC_CANTest SET I_LDCU_BodySysSt1.I_LDCU_PowerMode 0
  g_EM_Equipment_Swc_TC_4G_Time_Delay_Second("1"); // 测试步骤 TC_Sleep 1
  g_EM_LIN_Swc_LIN_Check("C4_FRS_IntensityReq 0 CH4"); // 预期结果 TC_LINTest LIN Check C4_FRS_IntensityReq 0 CH4
  g_EM_Equipment_Swc_TC_IG("ON"); // 测试步骤 TC_IG ON
  g_CAN_Bus_Swc_Set("I_LDCU_BodySysSt1.I_LDCU_PowerMode 1"); // 测试步骤 TC_CANTest SET I_LDCU_BodySysSt1.I_LDCU_PowerMode 1
  g_EM_Equipment_Swc_TC_4G_Time_Delay_Second("1"); // 测试步骤 TC_Sleep 1
  g_EM_LIN_Swc_LIN_Check("C4_FRS_ChannelSelect 3 CH4"); // 预期结果 TC_LINTest LIN Check C4_FRS_ChannelSelect 3 CH4
  g_EM_LIN_Swc_LIN_Check("C4_FRS_IntensityReq 10 CH4"); // 预期结果 TC_LINTest LIN Check C4_FRS_IntensityReq 10 CH4
}

testcase SYS_CDCU_xiangfen_0048()
{
  TestDescription("电源切换香氛记忆 OFF->local on");
  teststep("warning","原始用例id为SYS-CDCU-香氛-0048");
  g_EM_LIN_Swc_LIN_Send("C4_FRS_CurrentIntensity 0 CH4"); // 测试步骤 TC_LINTest LIN Send C4_FRS_CurrentIntensity 0 CH4//引擎转发香氛通道真实值-low
  g_EM_Equipment_Swc_TC_4G_Time_Delay_Second("1"); // 测试步骤 TC_Sleep 1
  g_EM_SOAClient_Swc_SOA_CHECK_Prepare("Veh_TurnOnOffSFSRespStruct.Veh_TurnOnOffSFSNRC 0"); // 预期结果 TC_CANTest SOA check Veh_TurnOnOffSFSRespStruct.Veh_TurnOnOffSFSNRC 0
  g_EM_SOAClient_Swc_SOA_CHECK_Prepare("Veh_SFSService_ErrStruct.OpeNRC 0 traceback8"); // 预期结果 TC_CANTest SOA check Veh_SFSService_ErrStruct.OpeNRC 0 traceback8//
  g_EM_SOAClient_Swc_SOA_REQ("Veh_TurnOnOffSFSStruct.Veh_TurnOnOffSFS:2&ServiceExecuteFeedbackFlag:2&Time:10&MemoryReq:1"); // 测试步骤 TC_CANTest SOA REQ Veh_TurnOnOffSFSStruct.Veh_TurnOnOffSFS:2&ServiceExecuteFeedbackFlag:2&Time:10&MemoryReq:1//ON
  g_EM_SOAClient_Swc_SOA_CHECK("Veh_TurnOnOffSFSRespStruct.Veh_TurnOnOffSFSNRC 0"); // 预期结果 TC_CANTest SOA check Veh_TurnOnOffSFSRespStruct.Veh_TurnOnOffSFSNRC 0
  g_EM_LIN_Swc_LIN_Check("C4_FRS_IntensityReq 0 CH4"); // 预期结果 TC_LINTest LIN Check C4_FRS_IntensityReq 0 CH4
  g_EM_SOAClient_Swc_SOA_CHECK("Veh_SFSService_ErrStruct.OpeNRC 0 traceback8"); // 预期结果 TC_CANTest SOA check Veh_SFSService_ErrStruct.OpeNRC 0 traceback8//
  g_EM_Equipment_Swc_TC_IG("OFF"); // 测试步骤 TC_IG OFF
  g_CAN_Bus_Swc_Set("I_LDCU_BodySysSt1.I_LDCU_PowerMode 0"); // 测试步骤 TC_CANTest SET I_LDCU_BodySysSt1.I_LDCU_PowerMode 0
  g_EM_Equipment_Swc_TC_4G_Time_Delay_Second("1"); // 测试步骤 TC_Sleep 1
  g_EM_LIN_Swc_LIN_Check("C4_FRS_IntensityReq 0 CH4"); // 预期结果 TC_LINTest LIN Check C4_FRS_IntensityReq 0 CH4
  g_EM_Equipment_Swc_TC_IG("ON"); // 测试步骤 TC_IG ON
  g_CAN_Bus_Swc_Set("I_LDCU_BodySysSt1.I_LDCU_PowerMode 1"); // 测试步骤 TC_CANTest SET I_LDCU_BodySysSt1.I_LDCU_PowerMode 1
  g_EM_Equipment_Swc_TC_4G_Time_Delay_Second("1"); // 测试步骤 TC_Sleep 1
  g_EM_LIN_Swc_LIN_Check("C4_FRS_ChannelSelect 3 CH4"); // 预期结果 TC_LINTest LIN Check C4_FRS_ChannelSelect 3 CH4
  g_EM_LIN_Swc_LIN_Check("C4_FRS_IntensityReq 0 CH4"); // 预期结果 TC_LINTest LIN Check C4_FRS_IntensityReq 0 CH4
}

testcase SYS_CDCU_xiangfen_0049()
{
  TestDescription("电源切换香氛记忆 Remote ON->local on");
  teststep("warning","原始用例id为SYS-CDCU-香氛-0049");
  g_EM_LIN_Swc_LIN_Send("C4_FRS_CurrentIntensity 10 CH4"); // 测试步骤 TC_LINTest LIN Send C4_FRS_CurrentIntensity 10 CH4//引擎转发香氛通道真实值-low
  g_EM_Equipment_Swc_TC_4G_Time_Delay_Second("1"); // 测试步骤 TC_Sleep 1
  g_EM_SOAClient_Swc_SOA_CHECK_Prepare("Veh_TurnOnOffSFSRespStruct.Veh_TurnOnOffSFSNRC 0"); // 预期结果 TC_CANTest SOA check Veh_TurnOnOffSFSRespStruct.Veh_TurnOnOffSFSNRC 0
  g_EM_SOAClient_Swc_SOA_CHECK_Prepare("Veh_SFSService_ErrStruct.OpeNRC 0 traceback8"); // 预期结果 TC_CANTest SOA check Veh_SFSService_ErrStruct.OpeNRC 0 traceback8//
  g_EM_SOAClient_Swc_SOA_REQ("Veh_TurnOnOffSFSStruct.Veh_TurnOnOffSFS:1&ServiceExecuteFeedbackFlag:2&Time:10&MemoryReq:1"); // 测试步骤 TC_CANTest SOA REQ Veh_TurnOnOffSFSStruct.Veh_TurnOnOffSFS:1&ServiceExecuteFeedbackFlag:2&Time:10&MemoryReq:1//ON
  g_EM_SOAClient_Swc_SOA_CHECK("Veh_TurnOnOffSFSRespStruct.Veh_TurnOnOffSFSNRC 0"); // 预期结果 TC_CANTest SOA check Veh_TurnOnOffSFSRespStruct.Veh_TurnOnOffSFSNRC 0
  g_EM_LIN_Swc_LIN_Check("C4_FRS_IntensityReq 10 CH4"); // 预期结果 TC_LINTest LIN Check C4_FRS_IntensityReq 10 CH4
  g_EM_SOAClient_Swc_SOA_CHECK("Veh_SFSService_ErrStruct.OpeNRC 0 traceback8"); // 预期结果 TC_CANTest SOA check Veh_SFSService_ErrStruct.OpeNRC 0 traceback8//
  g_EM_LIN_Swc_LIN_Send("C4_FRS_active_container 0x3 CH4"); // 测试步骤 TC_LINTest LIN Send C4_FRS_active_container 0x3 CH4//ch3
  g_EM_Equipment_Swc_TC_4G_Time_Delay_Second("1"); // 测试步骤 TC_Sleep 1
  g_EM_SOAClient_Swc_SOA_CHECK_Prepare("Veh_SetSFSChanelRespStruct.Veh_SetSFSChanelNRC 0"); // 预期结果 TC_CANTest SOA check Veh_SetSFSChanelRespStruct.Veh_SetSFSChanelNRC 0
  g_EM_SOAClient_Swc_SOA_CHECK_Prepare("Veh_SFSService_ErrStruct.OpeNRC 0 traceback8"); // 预期结果 TC_CANTest SOA check Veh_SFSService_ErrStruct.OpeNRC 0 traceback8//
  g_EM_SOAClient_Swc_SOA_REQ("Veh_SetSFSChanelStruct.Veh_SetSFSChanel:3&ServiceExecuteFeedbackFlag:2&MemoryReq:1"); // 测试步骤 TC_CANTest SOA REQ Veh_SetSFSChanelStruct.Veh_SetSFSChanel:3&ServiceExecuteFeedbackFlag:2&MemoryReq:1//通道3
  g_EM_SOAClient_Swc_SOA_CHECK("Veh_SetSFSChanelRespStruct.Veh_SetSFSChanelNRC 0"); // 预期结果 TC_CANTest SOA check Veh_SetSFSChanelRespStruct.Veh_SetSFSChanelNRC 0
  g_EM_LIN_Swc_LIN_Check("C4_FRS_ChannelSelect 3 CH4"); // 预期结果 TC_LINTest LIN Check C4_FRS_ChannelSelect 3 CH4
  g_EM_SOAClient_Swc_SOA_CHECK("Veh_SFSService_ErrStruct.OpeNRC 0 traceback8"); // 预期结果 TC_CANTest SOA check Veh_SFSService_ErrStruct.OpeNRC 0 traceback8//
  g_EM_LIN_Swc_LIN_Send("C4_FRS_CurrentIntensity 10 CH4"); // 测试步骤 TC_LINTest LIN Send C4_FRS_CurrentIntensity 10 CH4
  g_EM_Equipment_Swc_TC_4G_Time_Delay_Second("1"); // 测试步骤 TC_Sleep 1
  g_EM_SOAClient_Swc_SOA_CHECK_Prepare("Veh_SetSFSConRespStruct.Veh_SetSFSConNRC 0"); // 预期结果 TC_CANTest SOA check Veh_SetSFSConRespStruct.Veh_SetSFSConNRC 0
  g_EM_SOAClient_Swc_SOA_CHECK_Prepare("Veh_SFSService_ErrStruct.OpeNRC 0 traceback8"); // 预期结果 TC_CANTest SOA check Veh_SFSService_ErrStruct.OpeNRC 0 traceback8//
  g_EM_SOAClient_Swc_SOA_CHECK_Prepare("Veh_SFSService_ErrStruct.OpeErrInfo[0-1]:0x00 traceback10"); // 预期结果 TC_CANTest SOA check Veh_SFSService_ErrStruct.OpeErrInfo[0-1]:0x00 traceback10//
  g_EM_SOAClient_Swc_SOA_REQ("Veh_SetSFSConStruct.Veh_SetSFSCon:2&ServiceExecuteFeedbackFlag:2&MemoryReq:1"); // 测试步骤 TC_CANTest SOA REQ Veh_SetSFSConStruct.Veh_SetSFSCon:2&ServiceExecuteFeedbackFlag:2&MemoryReq:1//High
  g_EM_SOAClient_Swc_SOA_CHECK("Veh_SetSFSConRespStruct.Veh_SetSFSConNRC 0"); // 预期结果 TC_CANTest SOA check Veh_SetSFSConRespStruct.Veh_SetSFSConNRC 0
  g_EM_LIN_Swc_LIN_Check("C4_FRS_IntensityReq 10 CH4"); // 预期结果 TC_LINTest LIN Check C4_FRS_IntensityReq 10 CH4
  g_EM_SOAClient_Swc_SOA_CHECK("Veh_SFSService_ErrStruct.OpeNRC 0 traceback8"); // 预期结果 TC_CANTest SOA check Veh_SFSService_ErrStruct.OpeNRC 0 traceback8//
  g_EM_SOAClient_Swc_SOA_CHECK("Veh_SFSService_ErrStruct.OpeErrInfo[0-1]:0x00 traceback10"); // 预期结果 TC_CANTest SOA check Veh_SFSService_ErrStruct.OpeErrInfo[0-1]:0x00 traceback10//
  g_EM_Equipment_Swc_TC_IG("ON"); // 测试步骤 TC_IG ON
  g_CAN_Bus_Swc_Set("I_LDCU_BodySysSt1.I_LDCU_PowerMode 2"); // 测试步骤 TC_CANTest SET I_LDCU_BodySysSt1.I_LDCU_PowerMode 2
  g_EM_Equipment_Swc_TC_4G_Time_Delay_Second("1"); // 测试步骤 TC_Sleep 1
  g_EM_LIN_Swc_LIN_Check("C4_FRS_IntensityReq 0 CH4"); // 预期结果 TC_LINTest LIN Check C4_FRS_IntensityReq 0 CH4
  g_EM_Equipment_Swc_TC_IG("ON"); // 测试步骤 TC_IG ON
  g_CAN_Bus_Swc_Set("I_LDCU_BodySysSt1.I_LDCU_PowerMode 1"); // 测试步骤 TC_CANTest SET I_LDCU_BodySysSt1.I_LDCU_PowerMode 1
  g_EM_Equipment_Swc_TC_4G_Time_Delay_Second("1"); // 测试步骤 TC_Sleep 1
  g_EM_LIN_Swc_LIN_Check("C4_FRS_ChannelSelect 3 CH4"); // 预期结果 TC_LINTest LIN Check C4_FRS_ChannelSelect 3 CH4
  g_EM_LIN_Swc_LIN_Check("C4_FRS_IntensityReq 10 CH4"); // 预期结果 TC_LINTest LIN Check C4_FRS_IntensityReq 10 CH4
}

testcase SYS_CDCU_xiangfen_0050()
{
  TestDescription("香氛开启 Remote ON");
  teststep("warning","原始用例id为SYS-CDCU-香氛-0050");
  g_EM_Equipment_Swc_TC_IG("OFF"); // 测试步骤 TC_IG OFF
  g_CAN_Bus_Swc_Set("I_LDCU_BodySysSt1.I_LDCU_PowerMode 0"); // 测试步骤 TC_CANTest SET I_LDCU_BodySysSt1.I_LDCU_PowerMode 0
  g_EM_Equipment_Swc_TC_4G_Time_Delay_Second("1"); // 测试步骤 TC_Sleep 1
  g_EM_Equipment_Swc_TC_IG("ON"); // 测试步骤 TC_IG ON
  g_CAN_Bus_Swc_Set("I_LDCU_BodySysSt1.I_LDCU_PowerMode 2"); // 测试步骤 TC_CANTest SET I_LDCU_BodySysSt1.I_LDCU_PowerMode 2
  g_EM_LIN_Swc_LIN_Send("C4_FRS_CurrentIntensity 10 CH4"); // 测试步骤 TC_LINTest LIN Send C4_FRS_CurrentIntensity 10 CH4
  g_EM_LIN_Swc_LIN_Send("C4_FRS_active_container 0x3 CH4"); // 测试步骤 TC_LINTest LIN Send C4_FRS_active_container 0x3 CH4
  g_CAN_Bus_Swc_Set("C_LDCU_SysSt.C_LDCU_EVSysReadySt 0"); // 测试步骤 TC_CANTest SET C_LDCU_SysSt.C_LDCU_EVSysReadySt 0//未高压
  g_EM_Equipment_Swc_TC_4G_Time_Delay_Second("1"); // 测试步骤 TC_Sleep 1
  g_EM_SOAClient_Swc_SOA_CHECK_Prepare("Veh_TurnOnOffSFSRespStruct.Veh_TurnOnOffSFSNRC 0"); // 预期结果 TC_CANTest SOA check Veh_TurnOnOffSFSRespStruct.Veh_TurnOnOffSFSNRC 0
  g_EM_SOAClient_Swc_SOA_CHECK_Prepare("Veh_SFSService_ErrStruct.OpeNRC 0 traceback8"); // 预期结果 TC_CANTest SOA check Veh_SFSService_ErrStruct.OpeNRC 0 traceback8//
  g_EM_SOAClient_Swc_SOA_REQ("Veh_TurnOnOffSFSStruct.Veh_TurnOnOffSFS:1&MemoryReq:1&ServiceExecuteFeedbackFlag:2&Time:10"); // 测试步骤 TC_CANTest SOA REQ Veh_TurnOnOffSFSStruct.Veh_TurnOnOffSFS:1&MemoryReq:1&ServiceExecuteFeedbackFlag:2&Time:10//ON
  g_EM_SOAClient_Swc_SOA_CHECK("Veh_TurnOnOffSFSRespStruct.Veh_TurnOnOffSFSNRC 0"); // 预期结果 TC_CANTest SOA check Veh_TurnOnOffSFSRespStruct.Veh_TurnOnOffSFSNRC 0
  gTC_CANTest_SOA_CheckReq_Prepare("HighVoltageCtrlStruct.HighVoltageCtrl 2"); // 预期结果 TC_CANTest SOA CheckReq HighVoltageCtrlStruct.HighVoltageCtrl 2//请求上高压
  g_EM_SOAClient_Swc_SOA_CHECK_Prepare("SOAEngineInterSignalStruct.SFSHVReq 1"); // 预期结果 TC_CANTest SOA check SOAEngineInterSignalStruct.SFSHVReq 1//请求上高压
  g_CAN_Bus_Swc_Set("C_LDCU_SysSt.C_LDCU_EVSysReadySt 2"); // 测试步骤 TC_CANTest SET C_LDCU_SysSt.C_LDCU_EVSysReadySt 2//高压
  gTC_CANTest_SOA_CheckReq("HighVoltageCtrlStruct.HighVoltageCtrl 2"); // 预期结果 TC_CANTest SOA CheckReq HighVoltageCtrlStruct.HighVoltageCtrl 2//请求上高压
  g_EM_SOAClient_Swc_SOA_CHECK("SOAEngineInterSignalStruct.SFSHVReq 1"); // 预期结果 TC_CANTest SOA check SOAEngineInterSignalStruct.SFSHVReq 1//请求上高压
  g_EM_LIN_Swc_LIN_Check("C4_FRS_IntensityReq 10 CH4"); // 预期结果 TC_LINTest LIN Check C4_FRS_IntensityReq 10 CH4
  g_EM_LIN_Swc_LIN_Check("C4_FRS_ChannelSelect 3 CH4"); // 预期结果 TC_LINTest LIN Check C4_FRS_ChannelSelect 3 CH4
  g_EM_SOAClient_Swc_SOA_CHECK("Veh_SFSService_ErrStruct.OpeNRC 0 traceback8"); // 预期结果 TC_CANTest SOA check Veh_SFSService_ErrStruct.OpeNRC 0 traceback8//
}

testcase SYS_CDCU_xiangfen_0051()
{
  TestDescription("关闭 Remote ON");
  teststep("warning","原始用例id为SYS-CDCU-香氛-0051");
  g_EM_LIN_Swc_LIN_Send("C4_FRS_CurrentIntensity 0 CH4"); // 测试步骤 TC_LINTest LIN Send C4_FRS_CurrentIntensity 0 CH4//引擎转发香氛通道真实值-low
  g_EM_Equipment_Swc_TC_4G_Time_Delay_Second("1"); // 测试步骤 TC_Sleep 1
  g_EM_SOAClient_Swc_SOA_CHECK_Prepare("Veh_TurnOnOffSFSRespStruct.Veh_TurnOnOffSFSNRC 0"); // 预期结果 TC_CANTest SOA check Veh_TurnOnOffSFSRespStruct.Veh_TurnOnOffSFSNRC 0
  g_EM_SOAClient_Swc_SOA_CHECK_Prepare("Veh_SFSService_ErrStruct.OpeNRC 0 traceback8"); // 预期结果 TC_CANTest SOA check Veh_SFSService_ErrStruct.OpeNRC 0 traceback8//
  g_EM_SOAClient_Swc_SOA_REQ("Veh_TurnOnOffSFSStruct.Veh_TurnOnOffSFS:2&ServiceExecuteFeedbackFlag:2"); // 测试步骤 TC_CANTest SOA REQ Veh_TurnOnOffSFSStruct.Veh_TurnOnOffSFS:2&ServiceExecuteFeedbackFlag:2//OFF
  g_EM_SOAClient_Swc_SOA_CHECK("Veh_TurnOnOffSFSRespStruct.Veh_TurnOnOffSFSNRC 0"); // 预期结果 TC_CANTest SOA check Veh_TurnOnOffSFSRespStruct.Veh_TurnOnOffSFSNRC 0
  g_EM_LIN_Swc_LIN_Check("C4_FRS_IntensityReq 0 CH4"); // 预期结果 TC_LINTest LIN Check C4_FRS_IntensityReq 0 CH4
  g_EM_SOAClient_Swc_SOA_CHECK("Veh_SFSService_ErrStruct.OpeNRC 0 traceback8"); // 预期结果 TC_CANTest SOA check Veh_SFSService_ErrStruct.OpeNRC 0 traceback8//
}

testcase SYS_CDCU_xiangfen_0052()
{
  TestDescription("香氛开启 Remote ON上高压失败");
  teststep("warning","原始用例id为SYS-CDCU-香氛-0052");
  g_EM_Equipment_Swc_TC_IG("OFF"); // 测试步骤 TC_IG OFF
  g_CAN_Bus_Swc_Set("I_LDCU_BodySysSt1.I_LDCU_PowerMode 0"); // 测试步骤 TC_CANTest SET I_LDCU_BodySysSt1.I_LDCU_PowerMode 0
  g_EM_Equipment_Swc_TC_4G_Time_Delay_Second("1"); // 测试步骤 TC_Sleep 1
  g_EM_Equipment_Swc_TC_IG("ON"); // 测试步骤 TC_IG ON
  g_CAN_Bus_Swc_Set("I_LDCU_BodySysSt1.I_LDCU_PowerMode 2"); // 测试步骤 TC_CANTest SET I_LDCU_BodySysSt1.I_LDCU_PowerMode 2
  g_EM_LIN_Swc_LIN_Send("C4_FRS_CurrentIntensity 10 CH4"); // 测试步骤 TC_LINTest LIN Send C4_FRS_CurrentIntensity 10 CH4
  g_EM_LIN_Swc_LIN_Send("C4_FRS_active_container 0x3 CH4"); // 测试步骤 TC_LINTest LIN Send C4_FRS_active_container 0x3 CH4
  g_CAN_Bus_Swc_Set("C_LDCU_SysSt.C_LDCU_EVSysReadySt 0"); // 测试步骤 TC_CANTest SET C_LDCU_SysSt.C_LDCU_EVSysReadySt 0//未高压
  g_EM_Equipment_Swc_TC_4G_Time_Delay_Second("1"); // 测试步骤 TC_Sleep 1
  g_EM_SOAClient_Swc_SOA_CHECK_Prepare("Veh_TurnOnOffSFSRespStruct.Veh_TurnOnOffSFSNRC 0"); // 预期结果 TC_CANTest SOA check Veh_TurnOnOffSFSRespStruct.Veh_TurnOnOffSFSNRC 0
  g_EM_SOAClient_Swc_SOA_CHECK_Prepare("Veh_SFSService_ErrStruct.OpeNRC 4 traceback8"); // 预期结果 TC_CANTest SOA check Veh_SFSService_ErrStruct.OpeNRC 4 traceback8//
  g_EM_SOAClient_Swc_SOA_REQ("Veh_TurnOnOffSFSStruct.Veh_TurnOnOffSFS:1&MemoryReq:1&ServiceExecuteFeedbackFlag:2&UserID:0x01010001&Time:10"); // 测试步骤 TC_CANTest SOA REQ Veh_TurnOnOffSFSStruct.Veh_TurnOnOffSFS:1&MemoryReq:1&ServiceExecuteFeedbackFlag:2&UserID:0x01010001&Time:10//ON
  g_EM_SOAClient_Swc_SOA_CHECK("Veh_TurnOnOffSFSRespStruct.Veh_TurnOnOffSFSNRC 0"); // 预期结果 TC_CANTest SOA check Veh_TurnOnOffSFSRespStruct.Veh_TurnOnOffSFSNRC 0
  gTC_CANTest_SOA_CheckReq_Prepare("HighVoltageCtrlStruct.HighVoltageCtrl 2"); // 预期结果 TC_CANTest SOA CheckReq HighVoltageCtrlStruct.HighVoltageCtrl 2//请求上高压
  g_CAN_Bus_Swc_Set("C_LDCU_SysSt.C_LDCU_EVSysReadySt 0"); // 测试步骤 TC_CANTest SET C_LDCU_SysSt.C_LDCU_EVSysReadySt 0//上高压失败
  gTC_CANTest_SOA_CheckReq("HighVoltageCtrlStruct.HighVoltageCtrl 2"); // 预期结果 TC_CANTest SOA CheckReq HighVoltageCtrlStruct.HighVoltageCtrl 2//请求上高压
  g_EM_Equipment_Swc_TC_4G_Time_Delay_Second("11"); // 测试步骤 TC_Sleep 11
  g_EM_SOAClient_Swc_SOA_CHECK_Prepare("SOAEngineInterSignalStruct.SFSHVReq 0"); // 预期结果 TC_CANTest SOA check SOAEngineInterSignalStruct.SFSHVReq 0//HV OFF
  g_EM_SOAClient_Swc_SOA_CHECK("SOAEngineInterSignalStruct.SFSHVReq 0"); // 预期结果 TC_CANTest SOA check SOAEngineInterSignalStruct.SFSHVReq 0//HV OFF
  g_EM_LIN_Swc_LIN_Check("C4_FRS_IntensityReq 0 CH4"); // 预期结果 TC_LINTest LIN Check C4_FRS_IntensityReq 0 CH4
  g_EM_SOAClient_Swc_SOA_CHECK("Veh_SFSService_ErrStruct.OpeNRC 4 traceback8"); // 预期结果 TC_CANTest SOA check Veh_SFSService_ErrStruct.OpeNRC 4 traceback8//
}

testcase SYS_CDCU_xiangfen_0053()
{
  TestDescription("选择通道(远控)15min释放 Remote ON");
  teststep("warning","原始用例id为SYS-CDCU-香氛-0053");
  g_EM_Equipment_Swc_TC_IG("OFF"); // 测试步骤 TC_IG OFF
  g_CAN_Bus_Swc_Set("I_LDCU_BodySysSt1.I_LDCU_PowerMode 0"); // 测试步骤 TC_CANTest SET I_LDCU_BodySysSt1.I_LDCU_PowerMode 0
  g_EM_Equipment_Swc_TC_4G_Time_Delay_Second("1"); // 测试步骤 TC_Sleep 1
  g_EM_Equipment_Swc_TC_IG("ON"); // 测试步骤 TC_IG ON
  g_CAN_Bus_Swc_Set("I_LDCU_BodySysSt1.I_LDCU_PowerMode 2"); // 测试步骤 TC_CANTest SET I_LDCU_BodySysSt1.I_LDCU_PowerMode 2
  g_EM_LIN_Swc_LIN_Send("C4_FRS_CurrentIntensity 0 CH4"); // 测试步骤 TC_LINTest LIN Send C4_FRS_CurrentIntensity 0 CH4
  g_EM_LIN_Swc_LIN_Send("C4_FRS_active_container 0x3 CH4"); // 测试步骤 TC_LINTest LIN Send C4_FRS_active_container 0x3 CH4
  g_EM_Equipment_Swc_TC_4G_Time_Delay_Second("1"); // 测试步骤 TC_Sleep 1
  g_EM_SOAClient_Swc_SOA_CHECK_Prepare("Veh_SetSFSChanelRespStruct.Veh_SetSFSChanelNRC 0"); // 预期结果 TC_CANTest SOA check Veh_SetSFSChanelRespStruct.Veh_SetSFSChanelNRC 0
  g_EM_SOAClient_Swc_SOA_CHECK_Prepare("Veh_SFSService_ErrStruct.OpeNRC 0 traceback8"); // 预期结果 TC_CANTest SOA check Veh_SFSService_ErrStruct.OpeNRC 0 traceback8//
  g_EM_SOAClient_Swc_SOA_CHECK_Prepare("Veh_SFSService_ErrStruct.OpeErrInfo[0-1]:0x00C8 traceback10"); // 预期结果 TC_CANTest SOA check Veh_SFSService_ErrStruct.OpeErrInfo[0-1]:0x00C8 traceback10//
  g_EM_SOAClient_Swc_SOA_REQ("Veh_SetSFSChanelStruct.Veh_SetSFSChanel:3&ServiceExecuteFeedbackFlag:2&MemoryReq:1&UserID:0x01010001&Time:10"); // 测试步骤 TC_CANTest SOA REQ Veh_SetSFSChanelStruct.Veh_SetSFSChanel:3&ServiceExecuteFeedbackFlag:2&MemoryReq:1&UserID:0x01010001&Time:10//通道3
  g_EM_SOAClient_Swc_SOA_CHECK("Veh_SetSFSChanelRespStruct.Veh_SetSFSChanelNRC 0"); // 预期结果 TC_CANTest SOA check Veh_SetSFSChanelRespStruct.Veh_SetSFSChanelNRC 0
  gTC_CANTest_SOA_CheckReq_Prepare("HighVoltageCtrlStruct.HighVoltageCtrl 2"); // 预期结果 TC_CANTest SOA CheckReq HighVoltageCtrlStruct.HighVoltageCtrl 2//请求上高压
  g_CAN_Bus_Swc_Set("C_LDCU_SysSt.C_LDCU_EVSysReadySt 2"); // 测试步骤 TC_CANTest SET C_LDCU_SysSt.C_LDCU_EVSysReadySt 2//高压
  gTC_CANTest_SOA_CheckReq("HighVoltageCtrlStruct.HighVoltageCtrl 2"); // 预期结果 TC_CANTest SOA CheckReq HighVoltageCtrlStruct.HighVoltageCtrl 2//请求上高压
  g_EM_LIN_Swc_LIN_Check("C4_FRS_IntensityReq 10 CH4"); // 预期结果 TC_LINTest LIN Check C4_FRS_IntensityReq 10 CH4
  g_EM_LIN_Swc_LIN_Send("C4_FRS_CurrentIntensity 3 CH4"); // 测试步骤 TC_LINTest LIN Send C4_FRS_CurrentIntensity 3 CH4
  g_EM_LIN_Swc_LIN_Check("C4_FRS_ChannelSelect 3 CH4"); // 预期结果 TC_LINTest LIN Check C4_FRS_ChannelSelect 3 CH4
  g_EM_SOAClient_Swc_SOA_CHECK("Veh_SFSService_ErrStruct.OpeNRC 0 traceback8"); // 预期结果 TC_CANTest SOA check Veh_SFSService_ErrStruct.OpeNRC 0 traceback8//
  g_EM_SOAClient_Swc_SOA_CHECK("Veh_SFSService_ErrStruct.OpeErrInfo[0-1]:0x00C8 traceback10"); // 预期结果 TC_CANTest SOA check Veh_SFSService_ErrStruct.OpeErrInfo[0-1]:0x00C8 traceback10//
  g_EM_Equipment_Swc_TC_4G_Time_Delay_Second("870"); // 测试步骤 TC_Sleep 870
  g_EM_LIN_Swc_LIN_Check("C4_FRS_IntensityReq 10 CH4"); // 预期结果 TC_LINTest LIN Check C4_FRS_IntensityReq 10 CH4
  g_EM_Equipment_Swc_TC_4G_Time_Delay_Second("50"); // 测试步骤 TC_Sleep 50
  g_EM_LIN_Swc_LIN_Check("C4_FRS_IntensityReq 0 CH4"); // 预期结果 TC_LINTest LIN Check C4_FRS_IntensityReq 0 CH4
}

testcase SYS_CDCU_xiangfen_0054()
{
  TestDescription("选择浓度(远控)15min释放 Remote ON");
  teststep("warning","原始用例id为SYS-CDCU-香氛-0054");
  g_EM_Equipment_Swc_TC_IG("OFF"); // 测试步骤 TC_IG OFF
  g_CAN_Bus_Swc_Set("I_LDCU_BodySysSt1.I_LDCU_PowerMode 0"); // 测试步骤 TC_CANTest SET I_LDCU_BodySysSt1.I_LDCU_PowerMode 0
  g_EM_Equipment_Swc_TC_4G_Time_Delay_Second("1"); // 测试步骤 TC_Sleep 1
  g_EM_Equipment_Swc_TC_IG("ON"); // 测试步骤 TC_IG ON
  g_CAN_Bus_Swc_Set("I_LDCU_BodySysSt1.I_LDCU_PowerMode 2"); // 测试步骤 TC_CANTest SET I_LDCU_BodySysSt1.I_LDCU_PowerMode 2
  g_EM_LIN_Swc_LIN_Send("C4_FRS_CurrentIntensity 3 CH4"); // 测试步骤 TC_LINTest LIN Send C4_FRS_CurrentIntensity 3 CH4
  g_EM_LIN_Swc_LIN_Send("C4_FRS_active_container 0x3 CH4"); // 测试步骤 TC_LINTest LIN Send C4_FRS_active_container 0x3 CH4
  g_EM_Equipment_Swc_TC_4G_Time_Delay_Second("1"); // 测试步骤 TC_Sleep 1
  g_EM_SOAClient_Swc_SOA_CHECK_Prepare("Veh_SetSFSConRespStruct.Veh_SetSFSConNRC 0"); // 预期结果 TC_CANTest SOA check Veh_SetSFSConRespStruct.Veh_SetSFSConNRC 0
  g_EM_SOAClient_Swc_SOA_CHECK_Prepare("Veh_SFSService_ErrStruct.OpeNRC 0 traceback8"); // 预期结果 TC_CANTest SOA check Veh_SFSService_ErrStruct.OpeNRC 0 traceback8//
  g_EM_SOAClient_Swc_SOA_CHECK_Prepare("Veh_SFSService_ErrStruct.OpeErrInfo[0-1]:0x00C8 traceback10"); // 预期结果 TC_CANTest SOA check Veh_SFSService_ErrStruct.OpeErrInfo[0-1]:0x00C8 traceback10//
  g_EM_SOAClient_Swc_SOA_REQ("Veh_SetSFSConStruct.Veh_SetSFSCon:1&ServiceExecuteFeedbackFlag:2&MemoryReq:1&UserID:0x01010001"); // 测试步骤 TC_CANTest SOA REQ Veh_SetSFSConStruct.Veh_SetSFSCon:1&ServiceExecuteFeedbackFlag:2&MemoryReq:1&UserID:0x01010001//Low
  g_EM_SOAClient_Swc_SOA_CHECK("Veh_SetSFSConRespStruct.Veh_SetSFSConNRC 0"); // 预期结果 TC_CANTest SOA check Veh_SetSFSConRespStruct.Veh_SetSFSConNRC 0
  gTC_CANTest_SOA_CheckReq_Prepare("HighVoltageCtrlStruct.HighVoltageCtrl 2"); // 预期结果 TC_CANTest SOA CheckReq HighVoltageCtrlStruct.HighVoltageCtrl 2//请求上高压
  g_CAN_Bus_Swc_Set("C_LDCU_SysSt.C_LDCU_EVSysReadySt 2"); // 测试步骤 TC_CANTest SET C_LDCU_SysSt.C_LDCU_EVSysReadySt 2//高压
  gTC_CANTest_SOA_CheckReq("HighVoltageCtrlStruct.HighVoltageCtrl 2"); // 预期结果 TC_CANTest SOA CheckReq HighVoltageCtrlStruct.HighVoltageCtrl 2//请求上高压
  g_EM_LIN_Swc_LIN_Check("C4_FRS_IntensityReq 3 CH4"); // 预期结果 TC_LINTest LIN Check C4_FRS_IntensityReq 3 CH4
  g_EM_LIN_Swc_LIN_Check("C4_FRS_ChannelSelect 3 CH4"); // 预期结果 TC_LINTest LIN Check C4_FRS_ChannelSelect 3 CH4
  g_EM_SOAClient_Swc_SOA_CHECK("Veh_SFSService_ErrStruct.OpeNRC 0 traceback8"); // 预期结果 TC_CANTest SOA check Veh_SFSService_ErrStruct.OpeNRC 0 traceback8//
  g_EM_SOAClient_Swc_SOA_CHECK("Veh_SFSService_ErrStruct.OpeErrInfo[0-1]:0x00C8 traceback10"); // 预期结果 TC_CANTest SOA check Veh_SFSService_ErrStruct.OpeErrInfo[0-1]:0x00C8 traceback10//
  g_EM_Equipment_Swc_TC_4G_Time_Delay_Second("870"); // 测试步骤 TC_Sleep 870
  g_EM_LIN_Swc_LIN_Check("C4_FRS_IntensityReq 3 CH4"); // 预期结果 TC_LINTest LIN Check C4_FRS_IntensityReq 3 CH4
  g_EM_Equipment_Swc_TC_4G_Time_Delay_Second("50"); // 测试步骤 TC_Sleep 50
  g_EM_LIN_Swc_LIN_Check("C4_FRS_IntensityReq 0 CH4"); // 预期结果 TC_LINTest LIN Check C4_FRS_IntensityReq 0 CH4
}

testcase SYS_CDCU_xiangfen_0055()
{
  TestDescription("香氛开启失败(结果不对) Remote ON");
  teststep("warning","原始用例id为SYS-CDCU-香氛-0055");
  g_EM_LIN_Swc_LIN_Send("C4_FRS_CurrentIntensity 0 CH4"); // 测试步骤 TC_LINTest LIN Send C4_FRS_CurrentIntensity 0 CH4
  g_EM_Equipment_Swc_TC_4G_Time_Delay_Second("1"); // 测试步骤 TC_Sleep 1
  g_EM_SOAClient_Swc_SOA_CHECK_Prepare("Veh_TurnOnOffSFSRespStruct.Veh_TurnOnOffSFSNRC 0"); // 预期结果 TC_CANTest SOA check Veh_TurnOnOffSFSRespStruct.Veh_TurnOnOffSFSNRC 0
  g_EM_SOAClient_Swc_SOA_CHECK_Prepare("Veh_SFSService_ErrStruct.OpeNRC 0xFFFFFFFF traceback18"); // 预期结果 TC_CANTest SOA check Veh_SFSService_ErrStruct.OpeNRC 0xFFFFFFFF traceback18
  g_EM_SOAClient_Swc_SOA_CHECK_Prepare("Veh_SFSService_ErrStruct.OpeErrInfo[0-1]:0x285C traceback8"); // 预期结果 TC_CANTest SOA check Veh_SFSService_ErrStruct.OpeErrInfo[0-1]:0x285C traceback8//
  g_EM_SOAClient_Swc_SOA_REQ("Veh_TurnOnOffSFSStruct.Veh_TurnOnOffSFS:1&MemoryReq:1&ServiceExecuteFeedbackFlag:2&UserID:0x01010001&Time:1"); // 测试步骤 TC_CANTest SOA REQ Veh_TurnOnOffSFSStruct.Veh_TurnOnOffSFS:1&MemoryReq:1&ServiceExecuteFeedbackFlag:2&UserID:0x01010001&Time:1//ON
  g_EM_SOAClient_Swc_SOA_CHECK("Veh_TurnOnOffSFSRespStruct.Veh_TurnOnOffSFSNRC 0"); // 预期结果 TC_CANTest SOA check Veh_TurnOnOffSFSRespStruct.Veh_TurnOnOffSFSNRC 0
  g_EM_LIN_Swc_LIN_Check("C4_FRS_IntensityReq 3 CH4"); // 预期结果 TC_LINTest LIN Check C4_FRS_IntensityReq 3 CH4
  g_EM_Equipment_Swc_TC_4G_Time_Delay_Second("15"); // 测试步骤 TC_Sleep 15
  g_EM_SOAClient_Swc_SOA_CHECK("Veh_SFSService_ErrStruct.OpeNRC 0xFFFFFFFF traceback18"); // 预期结果 TC_CANTest SOA check Veh_SFSService_ErrStruct.OpeNRC 0xFFFFFFFF traceback18
  g_EM_SOAClient_Swc_SOA_CHECK("Veh_SFSService_ErrStruct.OpeErrInfo[0-1]:0x285C traceback8"); // 预期结果 TC_CANTest SOA check Veh_SFSService_ErrStruct.OpeErrInfo[0-1]:0x285C traceback8//
}

testcase SYS_CDCU_xiangfen_0056()
{
  TestDescription("香氛开启---失败 Remote ON");
  teststep("warning","原始用例id为SYS-CDCU-香氛-0056");
  g_EM_SOAClient_Swc_SOA_CHECK_Prepare("Veh_TurnOnOffSFSRespStruct.RespCode 0"); // 预期结果 TC_CANTest SOA check Veh_TurnOnOffSFSRespStruct.RespCode 0
  g_EM_SOAClient_Swc_SOA_CHECK_Prepare("Veh_SFSService_ErrStruct.OpeErrInfo[0-1]:0x01A4 traceback18"); // 预期结果 TC_CANTest SOA check Veh_SFSService_ErrStruct.OpeErrInfo[0-1]:0x01A4 traceback18
  g_EM_SOAClient_Swc_SOA_REQ("Veh_TurnOnOffSFSStruct.Veh_TurnOnOffSFS:1&ReqTimeOut:20&ServiceExecuteFeedbackFlag:2&UserID:0x01010001&Time:1"); // 测试步骤 TC_CANTest SOA REQ Veh_TurnOnOffSFSStruct.Veh_TurnOnOffSFS:1&ReqTimeOut:20&ServiceExecuteFeedbackFlag:2&UserID:0x01010001&Time:1//High
  g_EM_SOAClient_Swc_SOA_CHECK("Veh_TurnOnOffSFSRespStruct.RespCode 0"); // 预期结果 TC_CANTest SOA check Veh_TurnOnOffSFSRespStruct.RespCode 0
  g_EM_Equipment_Swc_TC_4G_Time_Delay_Second("16"); // 测试步骤 TC_Sleep 16
  g_EM_SOAClient_Swc_SOA_CHECK("Veh_SFSService_ErrStruct.OpeErrInfo[0-1]:0x01A4 traceback18"); // 预期结果 TC_CANTest SOA check Veh_SFSService_ErrStruct.OpeErrInfo[0-1]:0x01A4 traceback18
}

testcase SYS_CDCU_xiangfen_0057()
{
  TestDescription("香氛开启失败(异常下高压失败) Remote ON");
  teststep("warning","原始用例id为SYS-CDCU-香氛-0057");
  g_EM_Equipment_Swc_TC_IG("OFF"); // 测试步骤 TC_IG OFF
  g_CAN_Bus_Swc_Set("I_LDCU_BodySysSt1.I_LDCU_PowerMode 0"); // 测试步骤 TC_CANTest SET I_LDCU_BodySysSt1.I_LDCU_PowerMode 0
  g_EM_Equipment_Swc_TC_4G_Time_Delay_Second("1"); // 测试步骤 TC_Sleep 1
  g_EM_Equipment_Swc_TC_IG("ON"); // 测试步骤 TC_IG ON
  g_CAN_Bus_Swc_Set("I_LDCU_BodySysSt1.I_LDCU_PowerMode 2"); // 测试步骤 TC_CANTest SET I_LDCU_BodySysSt1.I_LDCU_PowerMode 2
  g_CAN_Bus_Swc_Set("C_LDCU_SysSt.C_LDCU_EVSysReadySt 2"); // 测试步骤 TC_CANTest SET C_LDCU_SysSt.C_LDCU_EVSysReadySt 2//高压
  g_EM_LIN_Swc_LIN_Send("C4_FRS_CurrentIntensity 10 CH4"); // 测试步骤 TC_LINTest LIN Send C4_FRS_CurrentIntensity 10 CH4
  g_EM_LIN_Swc_LIN_Send("C4_FRS_active_container 0x3 CH4"); // 测试步骤 TC_LINTest LIN Send C4_FRS_active_container 0x3 CH4
  g_EM_Equipment_Swc_TC_4G_Time_Delay_Second("1"); // 测试步骤 TC_Sleep 1
  g_EM_SOAClient_Swc_SOA_CHECK_Prepare("Veh_TurnOnOffSFSRespStruct.Veh_TurnOnOffSFSNRC 0"); // 预期结果 TC_CANTest SOA check Veh_TurnOnOffSFSRespStruct.Veh_TurnOnOffSFSNRC 0
  g_EM_SOAClient_Swc_SOA_CHECK_Prepare("SOAEngineInterSignalStruct.SFSHVReq 1"); // 预期结果 TC_CANTest SOA check SOAEngineInterSignalStruct.SFSHVReq 1//请求上高压
  g_EM_SOAClient_Swc_SOA_REQ("Veh_TurnOnOffSFSStruct.Veh_TurnOnOffSFS:1&MemoryReq:1&ServiceExecuteFeedbackFlag:2&UserID:0x01010001&Time:1"); // 测试步骤 TC_CANTest SOA REQ Veh_TurnOnOffSFSStruct.Veh_TurnOnOffSFS:1&MemoryReq:1&ServiceExecuteFeedbackFlag:2&UserID:0x01010001&Time:1//ON
  g_EM_SOAClient_Swc_SOA_CHECK("Veh_TurnOnOffSFSRespStruct.Veh_TurnOnOffSFSNRC 0"); // 预期结果 TC_CANTest SOA check Veh_TurnOnOffSFSRespStruct.Veh_TurnOnOffSFSNRC 0
  g_EM_SOAClient_Swc_SOA_CHECK("SOAEngineInterSignalStruct.SFSHVReq 1"); // 预期结果 TC_CANTest SOA check SOAEngineInterSignalStruct.SFSHVReq 1//请求上高压
  g_EM_LIN_Swc_LIN_Check("C4_FRS_IntensityReq 10 CH4"); // 预期结果 TC_LINTest LIN Check C4_FRS_IntensityReq 10 CH4
  g_CAN_Bus_Swc_Set("C_LDCU_SysSt.C_LDCU_EVSysReadySt 0"); // 测试步骤 TC_CANTest SET C_LDCU_SysSt.C_LDCU_EVSysReadySt 0//下高压
  g_EM_Equipment_Swc_TC_4G_Time_Delay_Second("5"); // 测试步骤 TC_Sleep 5
  g_EM_SOAClient_Swc_SOA_CHECK_Prepare("SOAEngineInterSignalStruct.SFSHVReq 0"); // 预期结果 TC_CANTest SOA check SOAEngineInterSignalStruct.SFSHVReq 0//下高压
  g_EM_LIN_Swc_LIN_Check("C4_FRS_IntensityReq 0 CH4"); // 预期结果 TC_LINTest LIN Check C4_FRS_IntensityReq 0 CH4
  g_EM_SOAClient_Swc_SOA_CHECK("SOAEngineInterSignalStruct.SFSHVReq 0"); // 预期结果 TC_CANTest SOA check SOAEngineInterSignalStruct.SFSHVReq 0//下高压
}

testcase SYS_CDCU_xiangfen_0058()
{
  TestDescription("关闭 Remote ON");
  teststep("warning","原始用例id为SYS-CDCU-香氛-0058");
  g_EM_LIN_Swc_LIN_Send("C4_FRS_CurrentIntensity 0 CH4"); // 测试步骤 TC_LINTest LIN Send C4_FRS_CurrentIntensity 0 CH4//引擎转发香氛通道真实值-low
  g_EM_Equipment_Swc_TC_4G_Time_Delay_Second("1"); // 测试步骤 TC_Sleep 1
  g_EM_SOAClient_Swc_SOA_CHECK_Prepare("Veh_TurnOnOffSFSRespStruct.Veh_TurnOnOffSFSNRC 0"); // 预期结果 TC_CANTest SOA check Veh_TurnOnOffSFSRespStruct.Veh_TurnOnOffSFSNRC 0
  g_EM_SOAClient_Swc_SOA_CHECK_Prepare("Veh_SFSService_ErrStruct.OpeNRC 0 traceback8"); // 预期结果 TC_CANTest SOA check Veh_SFSService_ErrStruct.OpeNRC 0 traceback8//
  g_EM_SOAClient_Swc_SOA_REQ("Veh_TurnOnOffSFSStruct.Veh_TurnOnOffSFS:2&ServiceExecuteFeedbackFlag:2"); // 测试步骤 TC_CANTest SOA REQ Veh_TurnOnOffSFSStruct.Veh_TurnOnOffSFS:2&ServiceExecuteFeedbackFlag:2//OFF
  g_EM_SOAClient_Swc_SOA_CHECK("Veh_TurnOnOffSFSRespStruct.Veh_TurnOnOffSFSNRC 0"); // 预期结果 TC_CANTest SOA check Veh_TurnOnOffSFSRespStruct.Veh_TurnOnOffSFSNRC 0
  g_EM_LIN_Swc_LIN_Check("C4_FRS_IntensityReq 0 CH4"); // 预期结果 TC_LINTest LIN Check C4_FRS_IntensityReq 0 CH4
  g_EM_SOAClient_Swc_SOA_CHECK("Veh_SFSService_ErrStruct.OpeNRC 0 traceback8"); // 预期结果 TC_CANTest SOA check Veh_SFSService_ErrStruct.OpeNRC 0 traceback8//
}

testcase SYS_CDCU_xiangfen_0059()
{
  TestDescription("关闭(远控) Remote ON");
  teststep("warning","原始用例id为SYS-CDCU-香氛-0059");
  g_EM_LIN_Swc_LIN_Send("C4_FRS_CurrentIntensity 0 CH4"); // 测试步骤 TC_LINTest LIN Send C4_FRS_CurrentIntensity 0 CH4
  g_EM_Equipment_Swc_TC_4G_Time_Delay_Second("1"); // 测试步骤 TC_Sleep 1
  g_EM_SOAClient_Swc_SOA_CHECK_Prepare("Veh_TurnOnOffSFSRespStruct.Veh_TurnOnOffSFSNRC 0"); // 预期结果 TC_CANTest SOA check Veh_TurnOnOffSFSRespStruct.Veh_TurnOnOffSFSNRC 0
  g_EM_SOAClient_Swc_SOA_CHECK_Prepare("Veh_SFSService_ErrStruct.OpeNRC 0 traceback8"); // 预期结果 TC_CANTest SOA check Veh_SFSService_ErrStruct.OpeNRC 0 traceback8//
  g_EM_SOAClient_Swc_SOA_CHECK_Prepare("Veh_SFSService_ErrStruct.OpeErrInfo[0-1]:0x00C8 traceback10"); // 预期结果 TC_CANTest SOA check Veh_SFSService_ErrStruct.OpeErrInfo[0-1]:0x00C8 traceback10//
  g_EM_SOAClient_Swc_SOA_REQ("Veh_TurnOnOffSFSStruct.Veh_TurnOnOffSFS:2&ServiceExecuteFeedbackFlag:2&UserID:0x01010001&Time:1"); // 测试步骤 TC_CANTest SOA REQ Veh_TurnOnOffSFSStruct.Veh_TurnOnOffSFS:2&ServiceExecuteFeedbackFlag:2&UserID:0x01010001&Time:1//OFF
  g_EM_SOAClient_Swc_SOA_CHECK("Veh_TurnOnOffSFSRespStruct.Veh_TurnOnOffSFSNRC 0"); // 预期结果 TC_CANTest SOA check Veh_TurnOnOffSFSRespStruct.Veh_TurnOnOffSFSNRC 0
  g_EM_LIN_Swc_LIN_Check("C4_FRS_IntensityReq 0 CH4"); // 预期结果 TC_LINTest LIN Check C4_FRS_IntensityReq 0 CH4
  g_EM_SOAClient_Swc_SOA_CHECK("Veh_SFSService_ErrStruct.OpeNRC 0 traceback8"); // 预期结果 TC_CANTest SOA check Veh_SFSService_ErrStruct.OpeNRC 0 traceback8//
  g_EM_SOAClient_Swc_SOA_CHECK("Veh_SFSService_ErrStruct.OpeErrInfo[0-1]:0x00C8 traceback10"); // 预期结果 TC_CANTest SOA check Veh_SFSService_ErrStruct.OpeErrInfo[0-1]:0x00C8 traceback10//
}

testcase SYS_CDCU_xiangfen_0060()
{
  TestDescription("关闭(Time计时到) Remote ON");
  teststep("warning","原始用例id为SYS-CDCU-香氛-0060");
  g_EM_LIN_Swc_LIN_Send("C4_FRS_CurrentIntensity 10 CH4"); // 测试步骤 TC_LINTest LIN Send C4_FRS_CurrentIntensity 10 CH4
  g_EM_SOAClient_Swc_SOA_REQ("Veh_SetSFSConStruct.Veh_SetSFSCon:2&ServiceExecuteFeedbackFlag:2&MemoryReq:1&UserID:0x01010001"); // 测试步骤 TC_CANTest SOA REQ Veh_SetSFSConStruct.Veh_SetSFSCon:2&ServiceExecuteFeedbackFlag:2&MemoryReq:1&UserID:0x01010001//high
  g_EM_Equipment_Swc_TC_IG("OFF"); // 测试步骤 TC_IG OFF
  g_CAN_Bus_Swc_Set("I_LDCU_BodySysSt1.I_LDCU_PowerMode 0"); // 测试步骤 TC_CANTest SET I_LDCU_BodySysSt1.I_LDCU_PowerMode 0
  g_EM_Equipment_Swc_TC_4G_Time_Delay_Second("1"); // 测试步骤 TC_Sleep 1
  g_EM_Equipment_Swc_TC_IG("ON"); // 测试步骤 TC_IG ON
  g_CAN_Bus_Swc_Set("I_LDCU_BodySysSt1.I_LDCU_PowerMode 2"); // 测试步骤 TC_CANTest SET I_LDCU_BodySysSt1.I_LDCU_PowerMode 2
  g_CAN_Bus_Swc_Set("C_LDCU_SysSt.C_LDCU_EVSysReadySt 2"); // 测试步骤 TC_CANTest SET C_LDCU_SysSt.C_LDCU_EVSysReadySt 2//高压
  g_EM_LIN_Swc_LIN_Send("C4_FRS_CurrentIntensity 10 CH4"); // 测试步骤 TC_LINTest LIN Send C4_FRS_CurrentIntensity 10 CH4
  g_EM_Equipment_Swc_TC_4G_Time_Delay_Second("1"); // 测试步骤 TC_Sleep 1
  g_EM_SOAClient_Swc_SOA_CHECK_Prepare("Veh_TurnOnOffSFSRespStruct.Veh_TurnOnOffSFSNRC 0"); // 预期结果 TC_CANTest SOA check Veh_TurnOnOffSFSRespStruct.Veh_TurnOnOffSFSNRC 0
  gTC_CANTest_SOA_CheckReq_Prepare("HighVoltageCtrlStruct.HighVoltageCtrl 2"); // 预期结果 TC_CANTest SOA CheckReq HighVoltageCtrlStruct.HighVoltageCtrl 2//请求上高压
  g_EM_SOAClient_Swc_SOA_REQ("Veh_TurnOnOffSFSStruct.Veh_TurnOnOffSFS:1&MemoryReq:1&ServiceExecuteFeedbackFlag:2&UserID:0x01010001&Time:1"); // 测试步骤 TC_CANTest SOA REQ Veh_TurnOnOffSFSStruct.Veh_TurnOnOffSFS:1&MemoryReq:1&ServiceExecuteFeedbackFlag:2&UserID:0x01010001&Time:1//ON
  g_EM_SOAClient_Swc_SOA_CHECK("Veh_TurnOnOffSFSRespStruct.Veh_TurnOnOffSFSNRC 0"); // 预期结果 TC_CANTest SOA check Veh_TurnOnOffSFSRespStruct.Veh_TurnOnOffSFSNRC 0
  gTC_CANTest_SOA_CheckReq("HighVoltageCtrlStruct.HighVoltageCtrl 2"); // 预期结果 TC_CANTest SOA CheckReq HighVoltageCtrlStruct.HighVoltageCtrl 2//请求上高压
  g_EM_LIN_Swc_LIN_Check("C4_FRS_IntensityReq 10 CH4"); // 预期结果 TC_LINTest LIN Check C4_FRS_IntensityReq 10 CH4
  g_EM_Equipment_Swc_TC_4G_Time_Delay_Second("61"); // 测试步骤 TC_Sleep 61
  g_EM_LIN_Swc_LIN_Check("C4_FRS_IntensityReq 0 CH4"); // 预期结果 TC_LINTest LIN Check C4_FRS_IntensityReq 0 CH4
}

testcase SYS_CDCU_xiangfen_0061()
{
  TestDescription("关闭失败 Remote ON");
  teststep("warning","原始用例id为SYS-CDCU-香氛-0061");
  g_EM_LIN_Swc_LIN_Send("C4_FRS_CurrentIntensity 10 CH4"); // 测试步骤 TC_LINTest LIN Send C4_FRS_CurrentIntensity 10 CH4
  g_EM_Equipment_Swc_TC_4G_Time_Delay_Second("1"); // 测试步骤 TC_Sleep 1
  g_EM_SOAClient_Swc_SOA_CHECK_Prepare("Veh_TurnOnOffSFSRespStruct.Veh_TurnOnOffSFSNRC 0"); // 预期结果 TC_CANTest SOA check Veh_TurnOnOffSFSRespStruct.Veh_TurnOnOffSFSNRC 0
  g_EM_SOAClient_Swc_SOA_CHECK_Prepare("Veh_SFSService_ErrStruct.OpeNRC 0xFFFFFFFF traceback18"); // 预期结果 TC_CANTest SOA check Veh_SFSService_ErrStruct.OpeNRC 0xFFFFFFFF traceback18
  g_EM_SOAClient_Swc_SOA_CHECK_Prepare("Veh_SFSService_ErrStruct.OpeErrInfo[0-1]:0x2867 traceback8"); // 预期结果 TC_CANTest SOA check Veh_SFSService_ErrStruct.OpeErrInfo[0-1]:0x2867 traceback8//
  g_EM_SOAClient_Swc_SOA_REQ("Veh_TurnOnOffSFSStruct.Veh_TurnOnOffSFS:2&ServiceExecuteFeedbackFlag:2&UserID:0x01010001&Time:1"); // 测试步骤 TC_CANTest SOA REQ Veh_TurnOnOffSFSStruct.Veh_TurnOnOffSFS:2&ServiceExecuteFeedbackFlag:2&UserID:0x01010001&Time:1//OFF
  g_EM_SOAClient_Swc_SOA_CHECK("Veh_TurnOnOffSFSRespStruct.Veh_TurnOnOffSFSNRC 0"); // 预期结果 TC_CANTest SOA check Veh_TurnOnOffSFSRespStruct.Veh_TurnOnOffSFSNRC 0
  g_EM_LIN_Swc_LIN_Check("C4_FRS_IntensityReq 0 CH4"); // 预期结果 TC_LINTest LIN Check C4_FRS_IntensityReq 0 CH4
  g_EM_Equipment_Swc_TC_4G_Time_Delay_Second("15"); // 测试步骤 TC_Sleep 15
  g_EM_SOAClient_Swc_SOA_CHECK("Veh_SFSService_ErrStruct.OpeNRC 0xFFFFFFFF traceback18"); // 预期结果 TC_CANTest SOA check Veh_SFSService_ErrStruct.OpeNRC 0xFFFFFFFF traceback18
  g_EM_SOAClient_Swc_SOA_CHECK("Veh_SFSService_ErrStruct.OpeErrInfo[0-1]:0x2867 traceback8"); // 预期结果 TC_CANTest SOA check Veh_SFSService_ErrStruct.OpeErrInfo[0-1]:0x2867 traceback8//
}

testcase SYS_CDCU_xiangfen_0062()
{
  TestDescription("香氛关闭---失败 Remote ON");
  teststep("warning","原始用例id为SYS-CDCU-香氛-0062");
  g_EM_SOAClient_Swc_SOA_CHECK_Prepare("Veh_TurnOnOffSFSRespStruct.RespCode 0"); // 预期结果 TC_CANTest SOA check Veh_TurnOnOffSFSRespStruct.RespCode 0
  g_EM_SOAClient_Swc_SOA_CHECK_Prepare("Veh_SFSService_ErrStruct.OpeErrInfo[0-1]:0x01A4 traceback18"); // 预期结果 TC_CANTest SOA check Veh_SFSService_ErrStruct.OpeErrInfo[0-1]:0x01A4 traceback18
  g_EM_SOAClient_Swc_SOA_REQ("Veh_TurnOnOffSFSStruct.Veh_TurnOnOffSFS:2&ReqTimeOut:20&ServiceExecuteFeedbackFlag:2&UserID:0x01010001&Time:1"); // 测试步骤 TC_CANTest SOA REQ Veh_TurnOnOffSFSStruct.Veh_TurnOnOffSFS:2&ReqTimeOut:20&ServiceExecuteFeedbackFlag:2&UserID:0x01010001&Time:1//OFF
  g_EM_SOAClient_Swc_SOA_CHECK("Veh_TurnOnOffSFSRespStruct.RespCode 0"); // 预期结果 TC_CANTest SOA check Veh_TurnOnOffSFSRespStruct.RespCode 0
  g_EM_Equipment_Swc_TC_4G_Time_Delay_Second("16"); // 测试步骤 TC_Sleep 16
  g_EM_SOAClient_Swc_SOA_CHECK("Veh_SFSService_ErrStruct.OpeErrInfo[0-1]:0x01A4 traceback18"); // 预期结果 TC_CANTest SOA check Veh_SFSService_ErrStruct.OpeErrInfo[0-1]:0x01A4 traceback18
}

testcase SYS_CDCU_xiangfen_0063()
{
  TestDescription("香氛通道选择 Remote ON");
  teststep("warning","原始用例id为SYS-CDCU-香氛-0063");
  g_EM_LIN_Swc_LIN_Send("C4_FRS_active_container 0x1 CH4"); // 测试步骤 TC_LINTest LIN Send C4_FRS_active_container 0x1 CH4//ch1
  g_EM_Equipment_Swc_TC_4G_Time_Delay_Second("1"); // 测试步骤 TC_Sleep 1
  g_EM_SOAClient_Swc_SOA_CHECK_Prepare("Veh_SetSFSChanelRespStruct.Veh_SetSFSChanelNRC 0"); // 预期结果 TC_CANTest SOA check Veh_SetSFSChanelRespStruct.Veh_SetSFSChanelNRC 0
  g_EM_SOAClient_Swc_SOA_CHECK_Prepare("Veh_SFSService_ErrStruct.OpeNRC 0 traceback8"); // 预期结果 TC_CANTest SOA check Veh_SFSService_ErrStruct.OpeNRC 0 traceback8//
  g_EM_SOAClient_Swc_SOA_REQ("Veh_SetSFSChanelStruct.Veh_SetSFSChanel:1&ServiceExecuteFeedbackFlag:2"); // 测试步骤 TC_CANTest SOA REQ Veh_SetSFSChanelStruct.Veh_SetSFSChanel:1&ServiceExecuteFeedbackFlag:2//通道1
  g_EM_SOAClient_Swc_SOA_CHECK("Veh_SetSFSChanelRespStruct.Veh_SetSFSChanelNRC 0"); // 预期结果 TC_CANTest SOA check Veh_SetSFSChanelRespStruct.Veh_SetSFSChanelNRC 0
  g_EM_LIN_Swc_LIN_Check("C4_FRS_ChannelSelect 1 CH4"); // 预期结果 TC_LINTest LIN Check C4_FRS_ChannelSelect 1 CH4
  g_EM_SOAClient_Swc_SOA_CHECK("Veh_SFSService_ErrStruct.OpeNRC 0 traceback8"); // 预期结果 TC_CANTest SOA check Veh_SFSService_ErrStruct.OpeNRC 0 traceback8//
}

testcase SYS_CDCU_xiangfen_0064()
{
  TestDescription("香氛通道选择 Remote ON");
  teststep("warning","原始用例id为SYS-CDCU-香氛-0064");
  g_EM_LIN_Swc_LIN_Send("C4_FRS_active_container 0x2 CH4"); // 测试步骤 TC_LINTest LIN Send C4_FRS_active_container 0x2 CH4//ch2
  g_EM_Equipment_Swc_TC_4G_Time_Delay_Second("1"); // 测试步骤 TC_Sleep 1
  g_EM_SOAClient_Swc_SOA_CHECK_Prepare("Veh_SetSFSChanelRespStruct.Veh_SetSFSChanelNRC 0"); // 预期结果 TC_CANTest SOA check Veh_SetSFSChanelRespStruct.Veh_SetSFSChanelNRC 0
  g_EM_SOAClient_Swc_SOA_CHECK_Prepare("Veh_SFSService_ErrStruct.OpeNRC 0 traceback8"); // 预期结果 TC_CANTest SOA check Veh_SFSService_ErrStruct.OpeNRC 0 traceback8//
  g_EM_SOAClient_Swc_SOA_REQ("Veh_SetSFSChanelStruct.Veh_SetSFSChanel:2&ServiceExecuteFeedbackFlag:2"); // 测试步骤 TC_CANTest SOA REQ Veh_SetSFSChanelStruct.Veh_SetSFSChanel:2&ServiceExecuteFeedbackFlag:2//通道2
  g_EM_SOAClient_Swc_SOA_CHECK("Veh_SetSFSChanelRespStruct.Veh_SetSFSChanelNRC 0"); // 预期结果 TC_CANTest SOA check Veh_SetSFSChanelRespStruct.Veh_SetSFSChanelNRC 0
  g_EM_LIN_Swc_LIN_Check("C4_FRS_ChannelSelect 2 CH4"); // 预期结果 TC_LINTest LIN Check C4_FRS_ChannelSelect 2 CH4
  g_EM_SOAClient_Swc_SOA_CHECK("Veh_SFSService_ErrStruct.OpeNRC 0 traceback8"); // 预期结果 TC_CANTest SOA check Veh_SFSService_ErrStruct.OpeNRC 0 traceback8//
}

testcase SYS_CDCU_xiangfen_0065()
{
  TestDescription("香氛通道选择 Remote ON");
  teststep("warning","原始用例id为SYS-CDCU-香氛-0065");
  g_EM_LIN_Swc_LIN_Send("C4_FRS_active_container 0x3 CH4"); // 测试步骤 TC_LINTest LIN Send C4_FRS_active_container 0x3 CH4//ch3
  g_EM_Equipment_Swc_TC_4G_Time_Delay_Second("1"); // 测试步骤 TC_Sleep 1
  g_EM_SOAClient_Swc_SOA_CHECK_Prepare("Veh_SetSFSChanelRespStruct.Veh_SetSFSChanelNRC 0"); // 预期结果 TC_CANTest SOA check Veh_SetSFSChanelRespStruct.Veh_SetSFSChanelNRC 0
  g_EM_SOAClient_Swc_SOA_CHECK_Prepare("Veh_SFSService_ErrStruct.OpeNRC 0 traceback8"); // 预期结果 TC_CANTest SOA check Veh_SFSService_ErrStruct.OpeNRC 0 traceback8//
  g_EM_SOAClient_Swc_SOA_REQ("Veh_SetSFSChanelStruct.Veh_SetSFSChanel:3&ServiceExecuteFeedbackFlag:2"); // 测试步骤 TC_CANTest SOA REQ Veh_SetSFSChanelStruct.Veh_SetSFSChanel:3&ServiceExecuteFeedbackFlag:2//通道3
  g_EM_SOAClient_Swc_SOA_CHECK("Veh_SetSFSChanelRespStruct.Veh_SetSFSChanelNRC 0"); // 预期结果 TC_CANTest SOA check Veh_SetSFSChanelRespStruct.Veh_SetSFSChanelNRC 0
  g_EM_LIN_Swc_LIN_Check("C4_FRS_ChannelSelect 3 CH4"); // 预期结果 TC_LINTest LIN Check C4_FRS_ChannelSelect 3 CH4
  g_EM_SOAClient_Swc_SOA_CHECK("Veh_SFSService_ErrStruct.OpeNRC 0 traceback8"); // 预期结果 TC_CANTest SOA check Veh_SFSService_ErrStruct.OpeNRC 0 traceback8//
}

testcase SYS_CDCU_xiangfen_0066()
{
  TestDescription("香氛通道选择(远控) Remote ON");
  teststep("warning","原始用例id为SYS-CDCU-香氛-0066");
  g_EM_LIN_Swc_LIN_Send("C4_FRS_active_container 0x1 CH4"); // 测试步骤 TC_LINTest LIN Send C4_FRS_active_container 0x1 CH4//ch1
  g_EM_Equipment_Swc_TC_4G_Time_Delay_Second("1"); // 测试步骤 TC_Sleep 1
  g_EM_SOAClient_Swc_SOA_CHECK_Prepare("Veh_SetSFSChanelRespStruct.Veh_SetSFSChanelNRC 0"); // 预期结果 TC_CANTest SOA check Veh_SetSFSChanelRespStruct.Veh_SetSFSChanelNRC 0
  g_EM_SOAClient_Swc_SOA_CHECK_Prepare("Veh_SFSService_ErrStruct.OpeNRC 0 traceback8"); // 预期结果 TC_CANTest SOA check Veh_SFSService_ErrStruct.OpeNRC 0 traceback8//
  g_EM_SOAClient_Swc_SOA_CHECK_Prepare("Veh_SFSService_ErrStruct.OpeErrInfo[0-1]:0x00C8 traceback10"); // 预期结果 TC_CANTest SOA check Veh_SFSService_ErrStruct.OpeErrInfo[0-1]:0x00C8 traceback10//
  g_EM_SOAClient_Swc_SOA_REQ("Veh_SetSFSChanelStruct.Veh_SetSFSChanel:1&ServiceExecuteFeedbackFlag:2&UserID:0x01010001&Time:1"); // 测试步骤 TC_CANTest SOA REQ Veh_SetSFSChanelStruct.Veh_SetSFSChanel:1&ServiceExecuteFeedbackFlag:2&UserID:0x01010001&Time:1//通道1
  g_EM_SOAClient_Swc_SOA_CHECK("Veh_SetSFSChanelRespStruct.Veh_SetSFSChanelNRC 0"); // 预期结果 TC_CANTest SOA check Veh_SetSFSChanelRespStruct.Veh_SetSFSChanelNRC 0
  g_EM_LIN_Swc_LIN_Check("C4_FRS_ChannelSelect 1 CH4"); // 预期结果 TC_LINTest LIN Check C4_FRS_ChannelSelect 1 CH4
  g_EM_SOAClient_Swc_SOA_CHECK("Veh_SFSService_ErrStruct.OpeNRC 0 traceback8"); // 预期结果 TC_CANTest SOA check Veh_SFSService_ErrStruct.OpeNRC 0 traceback8//
  g_EM_SOAClient_Swc_SOA_CHECK("Veh_SFSService_ErrStruct.OpeErrInfo[0-1]:0x00C8 traceback10"); // 预期结果 TC_CANTest SOA check Veh_SFSService_ErrStruct.OpeErrInfo[0-1]:0x00C8 traceback10//
}

testcase SYS_CDCU_xiangfen_0067()
{
  TestDescription("香氛通道选择(远控) Remote ON");
  teststep("warning","原始用例id为SYS-CDCU-香氛-0067");
  g_EM_LIN_Swc_LIN_Send("C4_FRS_active_container 0x2 CH4"); // 测试步骤 TC_LINTest LIN Send C4_FRS_active_container 0x2 CH4//ch2
  g_EM_Equipment_Swc_TC_4G_Time_Delay_Second("1"); // 测试步骤 TC_Sleep 1
  g_EM_SOAClient_Swc_SOA_CHECK_Prepare("Veh_SetSFSChanelRespStruct.Veh_SetSFSChanelNRC 0"); // 预期结果 TC_CANTest SOA check Veh_SetSFSChanelRespStruct.Veh_SetSFSChanelNRC 0
  g_EM_SOAClient_Swc_SOA_CHECK_Prepare("Veh_SFSService_ErrStruct.OpeNRC 0 traceback8"); // 预期结果 TC_CANTest SOA check Veh_SFSService_ErrStruct.OpeNRC 0 traceback8//
  g_EM_SOAClient_Swc_SOA_CHECK_Prepare("Veh_SFSService_ErrStruct.OpeErrInfo[0-1]:0x00C8 traceback10"); // 预期结果 TC_CANTest SOA check Veh_SFSService_ErrStruct.OpeErrInfo[0-1]:0x00C8 traceback10//
  g_EM_SOAClient_Swc_SOA_REQ("Veh_SetSFSChanelStruct.Veh_SetSFSChanel:2&ServiceExecuteFeedbackFlag:2&UserID:0x01010001&Time:1"); // 测试步骤 TC_CANTest SOA REQ Veh_SetSFSChanelStruct.Veh_SetSFSChanel:2&ServiceExecuteFeedbackFlag:2&UserID:0x01010001&Time:1//通道2
  g_EM_SOAClient_Swc_SOA_CHECK("Veh_SetSFSChanelRespStruct.Veh_SetSFSChanelNRC 0"); // 预期结果 TC_CANTest SOA check Veh_SetSFSChanelRespStruct.Veh_SetSFSChanelNRC 0
  g_EM_LIN_Swc_LIN_Check("C4_FRS_ChannelSelect 2 CH4"); // 预期结果 TC_LINTest LIN Check C4_FRS_ChannelSelect 2 CH4
  g_EM_SOAClient_Swc_SOA_CHECK("Veh_SFSService_ErrStruct.OpeNRC 0 traceback8"); // 预期结果 TC_CANTest SOA check Veh_SFSService_ErrStruct.OpeNRC 0 traceback8//
  g_EM_SOAClient_Swc_SOA_CHECK("Veh_SFSService_ErrStruct.OpeErrInfo[0-1]:0x00C8 traceback10"); // 预期结果 TC_CANTest SOA check Veh_SFSService_ErrStruct.OpeErrInfo[0-1]:0x00C8 traceback10//
}

testcase SYS_CDCU_xiangfen_0068()
{
  TestDescription("香氛通道选择(远控) Remote ON");
  teststep("warning","原始用例id为SYS-CDCU-香氛-0068");
  g_EM_LIN_Swc_LIN_Send("C4_FRS_active_container 0x3 CH4"); // 测试步骤 TC_LINTest LIN Send C4_FRS_active_container 0x3 CH4//ch3
  g_EM_Equipment_Swc_TC_4G_Time_Delay_Second("1"); // 测试步骤 TC_Sleep 1
  g_EM_SOAClient_Swc_SOA_CHECK_Prepare("Veh_SetSFSChanelRespStruct.Veh_SetSFSChanelNRC 0"); // 预期结果 TC_CANTest SOA check Veh_SetSFSChanelRespStruct.Veh_SetSFSChanelNRC 0
  g_EM_SOAClient_Swc_SOA_CHECK_Prepare("Veh_SFSService_ErrStruct.OpeNRC 0 traceback8"); // 预期结果 TC_CANTest SOA check Veh_SFSService_ErrStruct.OpeNRC 0 traceback8//
  g_EM_SOAClient_Swc_SOA_CHECK_Prepare("Veh_SFSService_ErrStruct.OpeErrInfo[0-1]:0x00C8 traceback10"); // 预期结果 TC_CANTest SOA check Veh_SFSService_ErrStruct.OpeErrInfo[0-1]:0x00C8 traceback10//
  g_EM_SOAClient_Swc_SOA_REQ("Veh_SetSFSChanelStruct.Veh_SetSFSChanel:3&ServiceExecuteFeedbackFlag:2&UserID:0x01010001&Time:1"); // 测试步骤 TC_CANTest SOA REQ Veh_SetSFSChanelStruct.Veh_SetSFSChanel:3&ServiceExecuteFeedbackFlag:2&UserID:0x01010001&Time:1//通道3
  g_EM_SOAClient_Swc_SOA_CHECK("Veh_SetSFSChanelRespStruct.Veh_SetSFSChanelNRC 0"); // 预期结果 TC_CANTest SOA check Veh_SetSFSChanelRespStruct.Veh_SetSFSChanelNRC 0
  g_EM_LIN_Swc_LIN_Check("C4_FRS_ChannelSelect 3 CH4"); // 预期结果 TC_LINTest LIN Check C4_FRS_ChannelSelect 3 CH4
  g_EM_SOAClient_Swc_SOA_CHECK("Veh_SFSService_ErrStruct.OpeNRC 0 traceback8"); // 预期结果 TC_CANTest SOA check Veh_SFSService_ErrStruct.OpeNRC 0 traceback8//
  g_EM_SOAClient_Swc_SOA_CHECK("Veh_SFSService_ErrStruct.OpeErrInfo[0-1]:0x00C8 traceback10"); // 预期结果 TC_CANTest SOA check Veh_SFSService_ErrStruct.OpeErrInfo[0-1]:0x00C8 traceback10//
}

testcase SYS_CDCU_xiangfen_0069()
{
  TestDescription("香氛通道选择失败 Remote ON");
  teststep("warning","原始用例id为SYS-CDCU-香氛-0069");
  g_EM_LIN_Swc_LIN_Send("C4_FRS_active_container 0x3 CH4"); // 测试步骤 TC_LINTest LIN Send C4_FRS_active_container 0x3 CH4//ch3
  g_EM_Equipment_Swc_TC_4G_Time_Delay_Second("1"); // 测试步骤 TC_Sleep 1
  g_EM_SOAClient_Swc_SOA_CHECK_Prepare("Veh_SetSFSChanelRespStruct.Veh_SetSFSChanelNRC 0"); // 预期结果 TC_CANTest SOA check Veh_SetSFSChanelRespStruct.Veh_SetSFSChanelNRC 0
  g_EM_SOAClient_Swc_SOA_CHECK_Prepare("Veh_SFSService_ErrStruct.OpeNRC 0xFFFFFFFF traceback18"); // 预期结果 TC_CANTest SOA check Veh_SFSService_ErrStruct.OpeNRC 0xFFFFFFFF traceback18
  g_EM_SOAClient_Swc_SOA_CHECK_Prepare("Veh_SFSService_ErrStruct.OpeErrInfo[0-1]:0x285C traceback8"); // 预期结果 TC_CANTest SOA check Veh_SFSService_ErrStruct.OpeErrInfo[0-1]:0x285C traceback8//
  g_EM_SOAClient_Swc_SOA_REQ("Veh_SetSFSChanelStruct.Veh_SetSFSChanel:1&ServiceExecuteFeedbackFlag:2&UserID:0x01010001&Time:1"); // 测试步骤 TC_CANTest SOA REQ Veh_SetSFSChanelStruct.Veh_SetSFSChanel:1&ServiceExecuteFeedbackFlag:2&UserID:0x01010001&Time:1//通道1
  g_EM_SOAClient_Swc_SOA_CHECK("Veh_SetSFSChanelRespStruct.Veh_SetSFSChanelNRC 0"); // 预期结果 TC_CANTest SOA check Veh_SetSFSChanelRespStruct.Veh_SetSFSChanelNRC 0
  g_EM_LIN_Swc_LIN_Check("C4_FRS_ChannelSelect 1 CH4"); // 预期结果 TC_LINTest LIN Check C4_FRS_ChannelSelect 1 CH4
  g_EM_Equipment_Swc_TC_4G_Time_Delay_Second("15"); // 测试步骤 TC_Sleep 15
  g_EM_SOAClient_Swc_SOA_CHECK("Veh_SFSService_ErrStruct.OpeNRC 0xFFFFFFFF traceback18"); // 预期结果 TC_CANTest SOA check Veh_SFSService_ErrStruct.OpeNRC 0xFFFFFFFF traceback18
  g_EM_SOAClient_Swc_SOA_CHECK("Veh_SFSService_ErrStruct.OpeErrInfo[0-1]:0x285C traceback8"); // 预期结果 TC_CANTest SOA check Veh_SFSService_ErrStruct.OpeErrInfo[0-1]:0x285C traceback8//
}

testcase SYS_CDCU_xiangfen_0070()
{
  TestDescription("香氛通道选择失败 Remote ON");
  teststep("warning","原始用例id为SYS-CDCU-香氛-0070");
  g_EM_SOAClient_Swc_SOA_CHECK_Prepare("Veh_SFSService_ErrStruct.OpeNRC 162 traceback8"); // 预期结果 TC_CANTest SOA check Veh_SFSService_ErrStruct.OpeNRC 162 traceback8
  g_EM_SOAClient_Swc_SOA_CHECK_Prepare("Veh_SFSService_ErrStruct.OpeErrInfo[0-1]:0x01A4 traceback10"); // 预期结果 TC_CANTest SOA check Veh_SFSService_ErrStruct.OpeErrInfo[0-1]:0x01A4 traceback10
  g_EM_SOAClient_Swc_SOA_REQ("Veh_SetSFSChanelStruct.Veh_SetSFSChanel:3&ReqTimeOut:20&ServiceExecuteFeedbackFlag:2&UserID:0x01010001&Time:1"); // 测试步骤 TC_CANTest SOA REQ Veh_SetSFSChanelStruct.Veh_SetSFSChanel:3&ReqTimeOut:20&ServiceExecuteFeedbackFlag:2&UserID:0x01010001&Time:1//通道3
  g_EM_SOAClient_Swc_SOA_CHECK("Veh_SFSService_ErrStruct.OpeNRC 162 traceback8"); // 预期结果 TC_CANTest SOA check Veh_SFSService_ErrStruct.OpeNRC 162 traceback8
  g_EM_Equipment_Swc_TC_4G_Time_Delay_Second("2"); // 测试步骤 TC_Sleep 2
  g_EM_SOAClient_Swc_SOA_CHECK("Veh_SFSService_ErrStruct.OpeErrInfo[0-1]:0x01A4 traceback10"); // 预期结果 TC_CANTest SOA check Veh_SFSService_ErrStruct.OpeErrInfo[0-1]:0x01A4 traceback10
}

testcase SYS_CDCU_xiangfen_0071()
{
  TestDescription("香氛通道选择失败 Remote ON");
  teststep("warning","原始用例id为SYS-CDCU-香氛-0071");
  g_CAN_Bus_Swc_Set("C_LDCU_SysSt.C_LDCU_EVSysReadySt 0"); // 测试步骤 TC_CANTest SET C_LDCU_SysSt.C_LDCU_EVSysReadySt 0//下高压
  g_EM_Equipment_Swc_TC_4G_Time_Delay_Second("2"); // 测试步骤 TC_Sleep 2
  g_EM_SOAClient_Swc_SOA_CHECK_Prepare("Veh_SFSService_ErrStruct.OpeNRC 4 traceback17"); // 预期结果 TC_CANTest SOA check Veh_SFSService_ErrStruct.OpeNRC 4 traceback17
  g_EM_SOAClient_Swc_SOA_CHECK_Prepare("Veh_SFSService_ErrStruct.OpeErrInfo[0-1]:0x6 traceback17"); // 预期结果 TC_CANTest SOA check Veh_SFSService_ErrStruct.OpeErrInfo[0-1]:0x6 traceback17
  g_EM_SOAClient_Swc_SOA_REQ("Veh_SetSFSChanelStruct.Veh_SetSFSChanel:3&ServiceExecuteFeedbackFlag:2&UserID:0x01010001&Time:1"); // 测试步骤 TC_CANTest SOA REQ Veh_SetSFSChanelStruct.Veh_SetSFSChanel:3&ServiceExecuteFeedbackFlag:2&UserID:0x01010001&Time:1//通道3
  g_EM_Equipment_Swc_TC_4G_Time_Delay_Second("15"); // 测试步骤 TC_Sleep 15
  g_EM_SOAClient_Swc_SOA_CHECK("Veh_SFSService_ErrStruct.OpeNRC 4 traceback17"); // 预期结果 TC_CANTest SOA check Veh_SFSService_ErrStruct.OpeNRC 4 traceback17
  g_EM_SOAClient_Swc_SOA_CHECK("Veh_SFSService_ErrStruct.OpeErrInfo[0-1]:0x6 traceback17"); // 预期结果 TC_CANTest SOA check Veh_SFSService_ErrStruct.OpeErrInfo[0-1]:0x6 traceback17
}

testcase SYS_CDCU_xiangfen_0072()
{
  TestDescription("香氛通道选择(当前active通道0)浓度记忆10通道选择3 Remote ON");
  teststep("warning","原始用例id为SYS-CDCU-香氛-0072");
  g_EM_LIN_Swc_LIN_Send("C4_FRS_CurrentIntensity 10 CH4"); // 测试步骤 TC_LINTest LIN Send C4_FRS_CurrentIntensity 10 CH4
  g_CAN_Bus_Swc_Set("C_LDCU_SysSt.C_LDCU_EVSysReadySt 2"); // 测试步骤 TC_CANTest SET C_LDCU_SysSt.C_LDCU_EVSysReadySt 2//上高压
  g_EM_SOAClient_Swc_SOA_CHECK_Prepare("Veh_SetSFSConRespStruct.Veh_SetSFSConNRC 0"); // 预期结果 TC_CANTest SOA check Veh_SetSFSConRespStruct.Veh_SetSFSConNRC 0
  g_EM_SOAClient_Swc_SOA_CHECK_Prepare("Veh_SFSService_ErrStruct.OpeNRC 0 traceback8"); // 预期结果 TC_CANTest SOA check Veh_SFSService_ErrStruct.OpeNRC 0 traceback8//
  g_EM_SOAClient_Swc_SOA_REQ("Veh_SetSFSConStruct.Veh_SetSFSCon:2&ServiceExecuteFeedbackFlag:2&MemoryReq:1&UserID:0x01010001"); // 测试步骤 TC_CANTest SOA REQ Veh_SetSFSConStruct.Veh_SetSFSCon:2&ServiceExecuteFeedbackFlag:2&MemoryReq:1&UserID:0x01010001//High
  g_EM_SOAClient_Swc_SOA_CHECK("Veh_SetSFSConRespStruct.Veh_SetSFSConNRC 0"); // 预期结果 TC_CANTest SOA check Veh_SetSFSConRespStruct.Veh_SetSFSConNRC 0
  g_EM_LIN_Swc_LIN_Check("C4_FRS_IntensityReq 10 CH4"); // 预期结果 TC_LINTest LIN Check C4_FRS_IntensityReq 10 CH4
  g_EM_SOAClient_Swc_SOA_CHECK("Veh_SFSService_ErrStruct.OpeNRC 0 traceback8"); // 预期结果 TC_CANTest SOA check Veh_SFSService_ErrStruct.OpeNRC 0 traceback8//
  g_EM_LIN_Swc_LIN_Send("C4_FRS_active_container 0x0 CH4"); // 测试步骤 TC_LINTest LIN Send C4_FRS_active_container 0x0 CH4//ch3
  g_EM_LIN_Swc_LIN_Send("C4_FRS_CurrentIntensity 0 CH4"); // 测试步骤 TC_LINTest LIN Send C4_FRS_CurrentIntensity 0 CH4//引擎转发香氛通道真实值-closed
  g_EM_Equipment_Swc_TC_4G_Time_Delay_Second("1"); // 测试步骤 TC_Sleep 1
  g_EM_SOAClient_Swc_SOA_CHECK_Prepare("Veh_SetSFSChanelRespStruct.Veh_SetSFSChanelNRC 0"); // 预期结果 TC_CANTest SOA check Veh_SetSFSChanelRespStruct.Veh_SetSFSChanelNRC 0
  g_EM_SOAClient_Swc_SOA_CHECK_Prepare("Veh_SFSService_ErrStruct.OpeNRC 0 traceback8"); // 预期结果 TC_CANTest SOA check Veh_SFSService_ErrStruct.OpeNRC 0 traceback8//
  g_EM_SOAClient_Swc_SOA_REQ("Veh_SetSFSChanelStruct.Veh_SetSFSChanel:3&ServiceExecuteFeedbackFlag:2&MemoryReq:1&UserID:0x01010001&Time:10"); // 测试步骤 TC_CANTest SOA REQ Veh_SetSFSChanelStruct.Veh_SetSFSChanel:3&ServiceExecuteFeedbackFlag:2&MemoryReq:1&UserID:0x01010001&Time:10//通道3
  g_EM_SOAClient_Swc_SOA_CHECK("Veh_SetSFSChanelRespStruct.Veh_SetSFSChanelNRC 0"); // 预期结果 TC_CANTest SOA check Veh_SetSFSChanelRespStruct.Veh_SetSFSChanelNRC 0
  g_EM_LIN_Swc_LIN_Check("C4_FRS_ChannelSelect 3 CH4"); // 预期结果 TC_LINTest LIN Check C4_FRS_ChannelSelect 3 CH4
  g_EM_LIN_Swc_LIN_Send("C4_FRS_active_container 0x3 CH4"); // 测试步骤 TC_LINTest LIN Send C4_FRS_active_container 0x3 CH4//ch3
  g_EM_LIN_Swc_LIN_Check("C4_FRS_IntensityReq 10 CH4"); // 预期结果 TC_LINTest LIN Check C4_FRS_IntensityReq 10 CH4
  g_EM_LIN_Swc_LIN_Send("C4_FRS_CurrentIntensity 10 CH4"); // 测试步骤 TC_LINTest LIN Send C4_FRS_CurrentIntensity 10 CH4//引擎转发香氛通道真实值-10
  g_EM_SOAClient_Swc_SOA_CHECK("Veh_SFSService_ErrStruct.OpeNRC 0 traceback8"); // 预期结果 TC_CANTest SOA check Veh_SFSService_ErrStruct.OpeNRC 0 traceback8//
}

testcase SYS_CDCU_xiangfen_0073()
{
  TestDescription("香氛通道选择(当前active通道0)浓度记忆10通道选择2 Remote ON");
  teststep("warning","原始用例id为SYS-CDCU-香氛-0073");
  g_EM_LIN_Swc_LIN_Send("C4_FRS_active_container 0x0 CH4"); // 测试步骤 TC_LINTest LIN Send C4_FRS_active_container 0x0 CH4//ch3
  g_EM_LIN_Swc_LIN_Send("C4_FRS_CurrentIntensity 0 CH4"); // 测试步骤 TC_LINTest LIN Send C4_FRS_CurrentIntensity 0 CH4//引擎转发香氛通道真实值-closed
  g_EM_Equipment_Swc_TC_4G_Time_Delay_Second("1"); // 测试步骤 TC_Sleep 1
  g_EM_SOAClient_Swc_SOA_CHECK_Prepare("Veh_SetSFSChanelRespStruct.Veh_SetSFSChanelNRC 0"); // 预期结果 TC_CANTest SOA check Veh_SetSFSChanelRespStruct.Veh_SetSFSChanelNRC 0
  g_EM_SOAClient_Swc_SOA_CHECK_Prepare("Veh_SFSService_ErrStruct.OpeNRC 0 traceback8"); // 预期结果 TC_CANTest SOA check Veh_SFSService_ErrStruct.OpeNRC 0 traceback8//
  g_EM_SOAClient_Swc_SOA_REQ("Veh_SetSFSChanelStruct.Veh_SetSFSChanel:2&ServiceExecuteFeedbackFlag:2&MemoryReq:1&UserID:0x01010001&Time:10"); // 测试步骤 TC_CANTest SOA REQ Veh_SetSFSChanelStruct.Veh_SetSFSChanel:2&ServiceExecuteFeedbackFlag:2&MemoryReq:1&UserID:0x01010001&Time:10//通道3
  g_EM_SOAClient_Swc_SOA_CHECK("Veh_SetSFSChanelRespStruct.Veh_SetSFSChanelNRC 0"); // 预期结果 TC_CANTest SOA check Veh_SetSFSChanelRespStruct.Veh_SetSFSChanelNRC 0
  g_EM_LIN_Swc_LIN_Check("C4_FRS_ChannelSelect 2 CH4"); // 预期结果 TC_LINTest LIN Check C4_FRS_ChannelSelect 2 CH4
  g_EM_LIN_Swc_LIN_Send("C4_FRS_active_container 0x2 CH4"); // 测试步骤 TC_LINTest LIN Send C4_FRS_active_container 0x2 CH4//ch3
  g_EM_LIN_Swc_LIN_Check("C4_FRS_IntensityReq 10 CH4"); // 预期结果 TC_LINTest LIN Check C4_FRS_IntensityReq 10 CH4
  g_EM_LIN_Swc_LIN_Send("C4_FRS_CurrentIntensity 10 CH4"); // 测试步骤 TC_LINTest LIN Send C4_FRS_CurrentIntensity 10 CH4//引擎转发香氛通道真实值-10
  g_EM_SOAClient_Swc_SOA_CHECK("Veh_SFSService_ErrStruct.OpeNRC 0 traceback8"); // 预期结果 TC_CANTest SOA check Veh_SFSService_ErrStruct.OpeNRC 0 traceback8//
}

testcase SYS_CDCU_xiangfen_0074()
{
  TestDescription("香氛通道选择(当前active通道0)浓度记忆10通道选择1 Remote ON");
  teststep("warning","原始用例id为SYS-CDCU-香氛-0074");
  g_EM_LIN_Swc_LIN_Send("C4_FRS_active_container 0x0 CH4"); // 测试步骤 TC_LINTest LIN Send C4_FRS_active_container 0x0 CH4//ch3
  g_EM_LIN_Swc_LIN_Send("C4_FRS_CurrentIntensity 0 CH4"); // 测试步骤 TC_LINTest LIN Send C4_FRS_CurrentIntensity 0 CH4//引擎转发香氛通道真实值-closed
  g_EM_Equipment_Swc_TC_4G_Time_Delay_Second("1"); // 测试步骤 TC_Sleep 1
  g_EM_SOAClient_Swc_SOA_CHECK_Prepare("Veh_SetSFSChanelRespStruct.Veh_SetSFSChanelNRC 0"); // 预期结果 TC_CANTest SOA check Veh_SetSFSChanelRespStruct.Veh_SetSFSChanelNRC 0
  g_EM_SOAClient_Swc_SOA_CHECK_Prepare("Veh_SFSService_ErrStruct.OpeNRC 0 traceback8"); // 预期结果 TC_CANTest SOA check Veh_SFSService_ErrStruct.OpeNRC 0 traceback8//
  g_EM_SOAClient_Swc_SOA_REQ("Veh_SetSFSChanelStruct.Veh_SetSFSChanel:1&ServiceExecuteFeedbackFlag:2&MemoryReq:1&UserID:0x01010001&Time:10"); // 测试步骤 TC_CANTest SOA REQ Veh_SetSFSChanelStruct.Veh_SetSFSChanel:1&ServiceExecuteFeedbackFlag:2&MemoryReq:1&UserID:0x01010001&Time:10//通道3
  g_EM_SOAClient_Swc_SOA_CHECK("Veh_SetSFSChanelRespStruct.Veh_SetSFSChanelNRC 0"); // 预期结果 TC_CANTest SOA check Veh_SetSFSChanelRespStruct.Veh_SetSFSChanelNRC 0
  g_EM_LIN_Swc_LIN_Check("C4_FRS_ChannelSelect 1 CH4"); // 预期结果 TC_LINTest LIN Check C4_FRS_ChannelSelect 1 CH4
  g_EM_LIN_Swc_LIN_Send("C4_FRS_active_container 0x1 CH4"); // 测试步骤 TC_LINTest LIN Send C4_FRS_active_container 0x1 CH4//ch3
  g_EM_LIN_Swc_LIN_Check("C4_FRS_IntensityReq 10 CH4"); // 预期结果 TC_LINTest LIN Check C4_FRS_IntensityReq 10 CH4
  g_EM_LIN_Swc_LIN_Send("C4_FRS_CurrentIntensity 10 CH4"); // 测试步骤 TC_LINTest LIN Send C4_FRS_CurrentIntensity 10 CH4//引擎转发香氛通道真实值-10
  g_EM_SOAClient_Swc_SOA_CHECK("Veh_SFSService_ErrStruct.OpeNRC 0 traceback8"); // 预期结果 TC_CANTest SOA check Veh_SFSService_ErrStruct.OpeNRC 0 traceback8//
}

testcase SYS_CDCU_xiangfen_0075()
{
  TestDescription("香氛通道选择(当前active通道0)浓度记忆3 Remote ON");
  teststep("warning","原始用例id为SYS-CDCU-香氛-0075");
  g_EM_LIN_Swc_LIN_Send("C4_FRS_CurrentIntensity 3 CH4"); // 测试步骤 TC_LINTest LIN Send C4_FRS_CurrentIntensity 3 CH4
  g_EM_Equipment_Swc_TC_4G_Time_Delay_Second("1"); // 测试步骤 TC_Sleep 1
  g_EM_SOAClient_Swc_SOA_CHECK_Prepare("Veh_SetSFSConRespStruct.Veh_SetSFSConNRC 0"); // 预期结果 TC_CANTest SOA check Veh_SetSFSConRespStruct.Veh_SetSFSConNRC 0
  g_EM_SOAClient_Swc_SOA_CHECK_Prepare("Veh_SFSService_ErrStruct.OpeNRC 0 traceback8"); // 预期结果 TC_CANTest SOA check Veh_SFSService_ErrStruct.OpeNRC 0 traceback8//
  g_EM_SOAClient_Swc_SOA_REQ("Veh_SetSFSConStruct.Veh_SetSFSCon:1&ServiceExecuteFeedbackFlag:2&MemoryReq:1&UserID:0x01010001"); // 测试步骤 TC_CANTest SOA REQ Veh_SetSFSConStruct.Veh_SetSFSCon:1&ServiceExecuteFeedbackFlag:2&MemoryReq:1&UserID:0x01010001//High
  g_EM_SOAClient_Swc_SOA_CHECK("Veh_SetSFSConRespStruct.Veh_SetSFSConNRC 0"); // 预期结果 TC_CANTest SOA check Veh_SetSFSConRespStruct.Veh_SetSFSConNRC 0
  g_EM_LIN_Swc_LIN_Check("C4_FRS_IntensityReq 3 CH4"); // 预期结果 TC_LINTest LIN Check C4_FRS_IntensityReq 3 CH4
  g_EM_SOAClient_Swc_SOA_CHECK("Veh_SFSService_ErrStruct.OpeNRC 0 traceback8"); // 预期结果 TC_CANTest SOA check Veh_SFSService_ErrStruct.OpeNRC 0 traceback8//
  g_EM_LIN_Swc_LIN_Send("C4_FRS_active_container 0x0 CH4"); // 测试步骤 TC_LINTest LIN Send C4_FRS_active_container 0x0 CH4//ch3
  g_EM_LIN_Swc_LIN_Send("C4_FRS_CurrentIntensity 0 CH4"); // 测试步骤 TC_LINTest LIN Send C4_FRS_CurrentIntensity 0 CH4//引擎转发香氛通道真实值-closed
  g_EM_Equipment_Swc_TC_4G_Time_Delay_Second("1"); // 测试步骤 TC_Sleep 1
  g_EM_SOAClient_Swc_SOA_CHECK_Prepare("Veh_SetSFSChanelRespStruct.Veh_SetSFSChanelNRC 0"); // 预期结果 TC_CANTest SOA check Veh_SetSFSChanelRespStruct.Veh_SetSFSChanelNRC 0
  g_EM_SOAClient_Swc_SOA_CHECK_Prepare("Veh_SFSService_ErrStruct.OpeNRC 0 traceback8"); // 预期结果 TC_CANTest SOA check Veh_SFSService_ErrStruct.OpeNRC 0 traceback8//
  g_EM_SOAClient_Swc_SOA_REQ("Veh_SetSFSChanelStruct.Veh_SetSFSChanel:3&ServiceExecuteFeedbackFlag:2&MemoryReq:1&UserID:0x01010001&Time:10"); // 测试步骤 TC_CANTest SOA REQ Veh_SetSFSChanelStruct.Veh_SetSFSChanel:3&ServiceExecuteFeedbackFlag:2&MemoryReq:1&UserID:0x01010001&Time:10//通道3
  g_EM_SOAClient_Swc_SOA_CHECK("Veh_SetSFSChanelRespStruct.Veh_SetSFSChanelNRC 0"); // 预期结果 TC_CANTest SOA check Veh_SetSFSChanelRespStruct.Veh_SetSFSChanelNRC 0
  g_EM_LIN_Swc_LIN_Check("C4_FRS_ChannelSelect 3 CH4"); // 预期结果 TC_LINTest LIN Check C4_FRS_ChannelSelect 3 CH4
  g_EM_LIN_Swc_LIN_Send("C4_FRS_active_container 0x3 CH4"); // 测试步骤 TC_LINTest LIN Send C4_FRS_active_container 0x3 CH4//ch3
  g_EM_LIN_Swc_LIN_Check("C4_FRS_IntensityReq 3 CH4"); // 预期结果 TC_LINTest LIN Check C4_FRS_IntensityReq 3 CH4
  g_EM_LIN_Swc_LIN_Send("C4_FRS_CurrentIntensity 3 CH4"); // 测试步骤 TC_LINTest LIN Send C4_FRS_CurrentIntensity 3 CH4//引擎转发香氛通道真实值-3
  g_EM_SOAClient_Swc_SOA_CHECK("Veh_SFSService_ErrStruct.OpeNRC 0 traceback8"); // 预期结果 TC_CANTest SOA check Veh_SFSService_ErrStruct.OpeNRC 0 traceback8//
}

testcase SYS_CDCU_xiangfen_0076()
{
  TestDescription("香氛通道选择(当前active通道0)浓度记忆3通道选择2 Remote ON");
  teststep("warning","原始用例id为SYS-CDCU-香氛-0076");
  g_EM_LIN_Swc_LIN_Send("C4_FRS_active_container 0x0 CH4"); // 测试步骤 TC_LINTest LIN Send C4_FRS_active_container 0x0 CH4//ch3
  g_EM_LIN_Swc_LIN_Send("C4_FRS_CurrentIntensity 0 CH4"); // 测试步骤 TC_LINTest LIN Send C4_FRS_CurrentIntensity 0 CH4//引擎转发香氛通道真实值-closed
  g_EM_Equipment_Swc_TC_4G_Time_Delay_Second("1"); // 测试步骤 TC_Sleep 1
  g_EM_SOAClient_Swc_SOA_CHECK_Prepare("Veh_SetSFSChanelRespStruct.Veh_SetSFSChanelNRC 0"); // 预期结果 TC_CANTest SOA check Veh_SetSFSChanelRespStruct.Veh_SetSFSChanelNRC 0
  g_EM_SOAClient_Swc_SOA_CHECK_Prepare("Veh_SFSService_ErrStruct.OpeNRC 0 traceback8"); // 预期结果 TC_CANTest SOA check Veh_SFSService_ErrStruct.OpeNRC 0 traceback8//
  g_EM_SOAClient_Swc_SOA_REQ("Veh_SetSFSChanelStruct.Veh_SetSFSChanel:2&ServiceExecuteFeedbackFlag:2&MemoryReq:1&UserID:0x01010001&Time:10"); // 测试步骤 TC_CANTest SOA REQ Veh_SetSFSChanelStruct.Veh_SetSFSChanel:2&ServiceExecuteFeedbackFlag:2&MemoryReq:1&UserID:0x01010001&Time:10//通道3
  g_EM_SOAClient_Swc_SOA_CHECK("Veh_SetSFSChanelRespStruct.Veh_SetSFSChanelNRC 0"); // 预期结果 TC_CANTest SOA check Veh_SetSFSChanelRespStruct.Veh_SetSFSChanelNRC 0
  g_EM_LIN_Swc_LIN_Check("C4_FRS_ChannelSelect 2 CH4"); // 预期结果 TC_LINTest LIN Check C4_FRS_ChannelSelect 2 CH4
  g_EM_LIN_Swc_LIN_Send("C4_FRS_active_container 0x2 CH4"); // 测试步骤 TC_LINTest LIN Send C4_FRS_active_container 0x2 CH4//ch3
  g_EM_LIN_Swc_LIN_Check("C4_FRS_IntensityReq 3 CH4"); // 预期结果 TC_LINTest LIN Check C4_FRS_IntensityReq 3 CH4
  g_EM_LIN_Swc_LIN_Send("C4_FRS_CurrentIntensity 3 CH4"); // 测试步骤 TC_LINTest LIN Send C4_FRS_CurrentIntensity 3 CH4//引擎转发香氛通道真实值-3
  g_EM_SOAClient_Swc_SOA_CHECK("Veh_SFSService_ErrStruct.OpeNRC 0 traceback8"); // 预期结果 TC_CANTest SOA check Veh_SFSService_ErrStruct.OpeNRC 0 traceback8//
}

testcase SYS_CDCU_xiangfen_0077()
{
  TestDescription("香氛通道选择(当前active通道0)浓度记忆3通道选择1 Remote ON");
  teststep("warning","原始用例id为SYS-CDCU-香氛-0077");
  g_EM_LIN_Swc_LIN_Send("C4_FRS_active_container 0x0 CH4"); // 测试步骤 TC_LINTest LIN Send C4_FRS_active_container 0x0 CH4//ch3
  g_EM_LIN_Swc_LIN_Send("C4_FRS_CurrentIntensity 0 CH4"); // 测试步骤 TC_LINTest LIN Send C4_FRS_CurrentIntensity 0 CH4//引擎转发香氛通道真实值-closed
  g_EM_Equipment_Swc_TC_4G_Time_Delay_Second("1"); // 测试步骤 TC_Sleep 1
  g_EM_SOAClient_Swc_SOA_CHECK_Prepare("Veh_SetSFSChanelRespStruct.Veh_SetSFSChanelNRC 0"); // 预期结果 TC_CANTest SOA check Veh_SetSFSChanelRespStruct.Veh_SetSFSChanelNRC 0
  g_EM_SOAClient_Swc_SOA_CHECK_Prepare("Veh_SFSService_ErrStruct.OpeNRC 0 traceback8"); // 预期结果 TC_CANTest SOA check Veh_SFSService_ErrStruct.OpeNRC 0 traceback8//
  g_EM_SOAClient_Swc_SOA_REQ("Veh_SetSFSChanelStruct.Veh_SetSFSChanel:1&ServiceExecuteFeedbackFlag:2&MemoryReq:1&UserID:0x01010001&Time:10"); // 测试步骤 TC_CANTest SOA REQ Veh_SetSFSChanelStruct.Veh_SetSFSChanel:1&ServiceExecuteFeedbackFlag:2&MemoryReq:1&UserID:0x01010001&Time:10//通道3
  g_EM_SOAClient_Swc_SOA_CHECK("Veh_SetSFSChanelRespStruct.Veh_SetSFSChanelNRC 0"); // 预期结果 TC_CANTest SOA check Veh_SetSFSChanelRespStruct.Veh_SetSFSChanelNRC 0
  g_EM_LIN_Swc_LIN_Check("C4_FRS_ChannelSelect 1 CH4"); // 预期结果 TC_LINTest LIN Check C4_FRS_ChannelSelect 1 CH4
  g_EM_LIN_Swc_LIN_Send("C4_FRS_active_container 0x1 CH4"); // 测试步骤 TC_LINTest LIN Send C4_FRS_active_container 0x1 CH4//ch3
  g_EM_LIN_Swc_LIN_Check("C4_FRS_IntensityReq 3 CH4"); // 预期结果 TC_LINTest LIN Check C4_FRS_IntensityReq 3 CH4
  g_EM_LIN_Swc_LIN_Send("C4_FRS_CurrentIntensity 3 CH4"); // 测试步骤 TC_LINTest LIN Send C4_FRS_CurrentIntensity 3 CH4//引擎转发香氛通道真实值-3
  g_EM_SOAClient_Swc_SOA_CHECK("Veh_SFSService_ErrStruct.OpeNRC 0 traceback8"); // 预期结果 TC_CANTest SOA check Veh_SFSService_ErrStruct.OpeNRC 0 traceback8//
}

testcase SYS_CDCU_xiangfen_0078()
{
  TestDescription("香氛通道选择(当前active通道0)浓度记忆6 Remote ON");
  teststep("warning","原始用例id为SYS-CDCU-香氛-0078");
  g_EM_LIN_Swc_LIN_Send("C4_FRS_CurrentIntensity 3 CH4"); // 测试步骤 TC_LINTest LIN Send C4_FRS_CurrentIntensity 3 CH4
  g_EM_Equipment_Swc_TC_4G_Time_Delay_Second("1"); // 测试步骤 TC_Sleep 1
  g_EM_SOAClient_Swc_SOA_CHECK_Prepare("Veh_SetSFSConRespStruct.Veh_SetSFSConNRC 0"); // 预期结果 TC_CANTest SOA check Veh_SetSFSConRespStruct.Veh_SetSFSConNRC 0
  g_EM_SOAClient_Swc_SOA_CHECK_Prepare("Veh_SFSService_ErrStruct.OpeNRC 0 traceback8"); // 预期结果 TC_CANTest SOA check Veh_SFSService_ErrStruct.OpeNRC 0 traceback8//
  g_EM_SOAClient_Swc_SOA_REQ("Veh_SetSFSConStruct.Veh_SetSFSCon:3&ServiceExecuteFeedbackFlag:2&MemoryReq:1&UserID:0x01010001"); // 测试步骤 TC_CANTest SOA REQ Veh_SetSFSConStruct.Veh_SetSFSCon:3&ServiceExecuteFeedbackFlag:2&MemoryReq:1&UserID:0x01010001//High
  g_EM_SOAClient_Swc_SOA_CHECK("Veh_SetSFSConRespStruct.Veh_SetSFSConNRC 0"); // 预期结果 TC_CANTest SOA check Veh_SetSFSConRespStruct.Veh_SetSFSConNRC 0
  g_EM_LIN_Swc_LIN_Check("C4_FRS_IntensityReq 6 CH4"); // 预期结果 TC_LINTest LIN Check C4_FRS_IntensityReq 6 CH4
  g_EM_SOAClient_Swc_SOA_CHECK("Veh_SFSService_ErrStruct.OpeNRC 0 traceback8"); // 预期结果 TC_CANTest SOA check Veh_SFSService_ErrStruct.OpeNRC 0 traceback8//
  g_EM_LIN_Swc_LIN_Send("C4_FRS_active_container 0x0 CH4"); // 测试步骤 TC_LINTest LIN Send C4_FRS_active_container 0x0 CH4//ch3
  g_EM_LIN_Swc_LIN_Send("C4_FRS_CurrentIntensity 0 CH4"); // 测试步骤 TC_LINTest LIN Send C4_FRS_CurrentIntensity 0 CH4//引擎转发香氛通道真实值-closed
  g_EM_Equipment_Swc_TC_4G_Time_Delay_Second("1"); // 测试步骤 TC_Sleep 1
  g_EM_SOAClient_Swc_SOA_CHECK_Prepare("Veh_SetSFSChanelRespStruct.Veh_SetSFSChanelNRC 0"); // 预期结果 TC_CANTest SOA check Veh_SetSFSChanelRespStruct.Veh_SetSFSChanelNRC 0
  g_EM_SOAClient_Swc_SOA_CHECK_Prepare("Veh_SFSService_ErrStruct.OpeNRC 0 traceback8"); // 预期结果 TC_CANTest SOA check Veh_SFSService_ErrStruct.OpeNRC 0 traceback8//
  g_EM_SOAClient_Swc_SOA_REQ("Veh_SetSFSChanelStruct.Veh_SetSFSChanel:3&ServiceExecuteFeedbackFlag:2&MemoryReq:1&UserID:0x01010001&Time:10"); // 测试步骤 TC_CANTest SOA REQ Veh_SetSFSChanelStruct.Veh_SetSFSChanel:3&ServiceExecuteFeedbackFlag:2&MemoryReq:1&UserID:0x01010001&Time:10//通道3
  g_EM_SOAClient_Swc_SOA_CHECK("Veh_SetSFSChanelRespStruct.Veh_SetSFSChanelNRC 0"); // 预期结果 TC_CANTest SOA check Veh_SetSFSChanelRespStruct.Veh_SetSFSChanelNRC 0
  g_EM_LIN_Swc_LIN_Check("C4_FRS_ChannelSelect 3 CH4"); // 预期结果 TC_LINTest LIN Check C4_FRS_ChannelSelect 3 CH4
  g_EM_LIN_Swc_LIN_Send("C4_FRS_active_container 0x3 CH4"); // 测试步骤 TC_LINTest LIN Send C4_FRS_active_container 0x3 CH4//ch3
  g_EM_LIN_Swc_LIN_Check("C4_FRS_IntensityReq 6 CH4"); // 预期结果 TC_LINTest LIN Check C4_FRS_IntensityReq 6 CH4
  g_EM_LIN_Swc_LIN_Send("C4_FRS_CurrentIntensity 6 CH4"); // 测试步骤 TC_LINTest LIN Send C4_FRS_CurrentIntensity 6 CH4//引擎转发香氛通道真实值-3
  g_EM_SOAClient_Swc_SOA_CHECK("Veh_SFSService_ErrStruct.OpeNRC 0 traceback8"); // 预期结果 TC_CANTest SOA check Veh_SFSService_ErrStruct.OpeNRC 0 traceback8//
}

testcase SYS_CDCU_xiangfen_0079()
{
  TestDescription("香氛通道选择(当前active通道0)浓度记忆6通道选择2 Remote ON");
  teststep("warning","原始用例id为SYS-CDCU-香氛-0079");
  g_EM_LIN_Swc_LIN_Send("C4_FRS_active_container 0x0 CH4"); // 测试步骤 TC_LINTest LIN Send C4_FRS_active_container 0x0 CH4//ch3
  g_EM_LIN_Swc_LIN_Send("C4_FRS_CurrentIntensity 0 CH4"); // 测试步骤 TC_LINTest LIN Send C4_FRS_CurrentIntensity 0 CH4//引擎转发香氛通道真实值-closed
  g_EM_Equipment_Swc_TC_4G_Time_Delay_Second("1"); // 测试步骤 TC_Sleep 1
  g_EM_SOAClient_Swc_SOA_CHECK_Prepare("Veh_SetSFSChanelRespStruct.Veh_SetSFSChanelNRC 0"); // 预期结果 TC_CANTest SOA check Veh_SetSFSChanelRespStruct.Veh_SetSFSChanelNRC 0
  g_EM_SOAClient_Swc_SOA_CHECK_Prepare("Veh_SFSService_ErrStruct.OpeNRC 0 traceback8"); // 预期结果 TC_CANTest SOA check Veh_SFSService_ErrStruct.OpeNRC 0 traceback8//
  g_EM_SOAClient_Swc_SOA_REQ("Veh_SetSFSChanelStruct.Veh_SetSFSChanel:2&ServiceExecuteFeedbackFlag:2&MemoryReq:1&UserID:0x01010001&Time:10"); // 测试步骤 TC_CANTest SOA REQ Veh_SetSFSChanelStruct.Veh_SetSFSChanel:2&ServiceExecuteFeedbackFlag:2&MemoryReq:1&UserID:0x01010001&Time:10//通道3
  g_EM_SOAClient_Swc_SOA_CHECK("Veh_SetSFSChanelRespStruct.Veh_SetSFSChanelNRC 0"); // 预期结果 TC_CANTest SOA check Veh_SetSFSChanelRespStruct.Veh_SetSFSChanelNRC 0
  g_EM_LIN_Swc_LIN_Check("C4_FRS_ChannelSelect 2 CH4"); // 预期结果 TC_LINTest LIN Check C4_FRS_ChannelSelect 2 CH4
  g_EM_LIN_Swc_LIN_Send("C4_FRS_active_container 0x2 CH4"); // 测试步骤 TC_LINTest LIN Send C4_FRS_active_container 0x2 CH4//ch3
  g_EM_LIN_Swc_LIN_Check("C4_FRS_IntensityReq 6 CH4"); // 预期结果 TC_LINTest LIN Check C4_FRS_IntensityReq 6 CH4
  g_EM_LIN_Swc_LIN_Send("C4_FRS_CurrentIntensity 6 CH4"); // 测试步骤 TC_LINTest LIN Send C4_FRS_CurrentIntensity 6 CH4//引擎转发香氛通道真实值-3
  g_EM_SOAClient_Swc_SOA_CHECK("Veh_SFSService_ErrStruct.OpeNRC 0 traceback8"); // 预期结果 TC_CANTest SOA check Veh_SFSService_ErrStruct.OpeNRC 0 traceback8//
}

testcase SYS_CDCU_xiangfen_0080()
{
  TestDescription("香氛通道选择(当前active通道0)浓度记忆6通道选择1 Remote ON");
  teststep("warning","原始用例id为SYS-CDCU-香氛-0080");
  g_EM_LIN_Swc_LIN_Send("C4_FRS_active_container 0x0 CH4"); // 测试步骤 TC_LINTest LIN Send C4_FRS_active_container 0x0 CH4//ch3
  g_EM_LIN_Swc_LIN_Send("C4_FRS_CurrentIntensity 0 CH4"); // 测试步骤 TC_LINTest LIN Send C4_FRS_CurrentIntensity 0 CH4//引擎转发香氛通道真实值-closed
  g_EM_Equipment_Swc_TC_4G_Time_Delay_Second("1"); // 测试步骤 TC_Sleep 1
  g_EM_SOAClient_Swc_SOA_CHECK_Prepare("Veh_SetSFSChanelRespStruct.Veh_SetSFSChanelNRC 0"); // 预期结果 TC_CANTest SOA check Veh_SetSFSChanelRespStruct.Veh_SetSFSChanelNRC 0
  g_EM_SOAClient_Swc_SOA_CHECK_Prepare("Veh_SFSService_ErrStruct.OpeNRC 0 traceback8"); // 预期结果 TC_CANTest SOA check Veh_SFSService_ErrStruct.OpeNRC 0 traceback8//
  g_EM_SOAClient_Swc_SOA_REQ("Veh_SetSFSChanelStruct.Veh_SetSFSChanel:1&ServiceExecuteFeedbackFlag:2&MemoryReq:1&UserID:0x01010001&Time:10"); // 测试步骤 TC_CANTest SOA REQ Veh_SetSFSChanelStruct.Veh_SetSFSChanel:1&ServiceExecuteFeedbackFlag:2&MemoryReq:1&UserID:0x01010001&Time:10//通道3
  g_EM_SOAClient_Swc_SOA_CHECK("Veh_SetSFSChanelRespStruct.Veh_SetSFSChanelNRC 0"); // 预期结果 TC_CANTest SOA check Veh_SetSFSChanelRespStruct.Veh_SetSFSChanelNRC 0
  g_EM_LIN_Swc_LIN_Check("C4_FRS_ChannelSelect 1 CH4"); // 预期结果 TC_LINTest LIN Check C4_FRS_ChannelSelect 1 CH4
  g_EM_LIN_Swc_LIN_Send("C4_FRS_active_container 0x1 CH4"); // 测试步骤 TC_LINTest LIN Send C4_FRS_active_container 0x1 CH4//ch3
  g_EM_LIN_Swc_LIN_Check("C4_FRS_IntensityReq 6 CH4"); // 预期结果 TC_LINTest LIN Check C4_FRS_IntensityReq 6 CH4
  g_EM_LIN_Swc_LIN_Send("C4_FRS_CurrentIntensity 6 CH4"); // 测试步骤 TC_LINTest LIN Send C4_FRS_CurrentIntensity 6 CH4//引擎转发香氛通道真实值-3
  g_EM_SOAClient_Swc_SOA_CHECK("Veh_SFSService_ErrStruct.OpeNRC 0 traceback8"); // 预期结果 TC_CANTest SOA check Veh_SFSService_ErrStruct.OpeNRC 0 traceback8//
}

testcase SYS_CDCU_xiangfen_0081()
{
  TestDescription("香氛浓度调节 Remote ON");
  teststep("warning","原始用例id为SYS-CDCU-香氛-0081");
  g_CAN_Bus_Swc_Set("C_LDCU_SysSt.C_LDCU_EVSysReadySt 2"); // 测试步骤 TC_CANTest SET C_LDCU_SysSt.C_LDCU_EVSysReadySt 2//上高压
  g_EM_LIN_Swc_LIN_Send("C4_FRS_CurrentIntensity 3 CH4"); // 测试步骤 TC_LINTest LIN Send C4_FRS_CurrentIntensity 3 CH4
  g_EM_Equipment_Swc_TC_4G_Time_Delay_Second("1"); // 测试步骤 TC_Sleep 1
  g_EM_SOAClient_Swc_SOA_CHECK_Prepare("Veh_SetSFSConRespStruct.Veh_SetSFSConNRC 0"); // 预期结果 TC_CANTest SOA check Veh_SetSFSConRespStruct.Veh_SetSFSConNRC 0
  g_EM_SOAClient_Swc_SOA_CHECK_Prepare("Veh_SFSService_ErrStruct.OpeNRC 0 traceback8"); // 预期结果 TC_CANTest SOA check Veh_SFSService_ErrStruct.OpeNRC 0 traceback8//
  g_EM_SOAClient_Swc_SOA_REQ("Veh_SetSFSConStruct.Veh_SetSFSCon:1&ServiceExecuteFeedbackFlag:2"); // 测试步骤 TC_CANTest SOA REQ Veh_SetSFSConStruct.Veh_SetSFSCon:1&ServiceExecuteFeedbackFlag:2//Low
  g_EM_SOAClient_Swc_SOA_CHECK("Veh_SetSFSConRespStruct.Veh_SetSFSConNRC 0"); // 预期结果 TC_CANTest SOA check Veh_SetSFSConRespStruct.Veh_SetSFSConNRC 0
  g_EM_LIN_Swc_LIN_Check("C4_FRS_IntensityReq 3 CH4"); // 预期结果 TC_LINTest LIN Check C4_FRS_IntensityReq 3 CH4
  g_EM_SOAClient_Swc_SOA_CHECK("Veh_SFSService_ErrStruct.OpeNRC 0 traceback8"); // 预期结果 TC_CANTest SOA check Veh_SFSService_ErrStruct.OpeNRC 0 traceback8//
}

testcase SYS_CDCU_xiangfen_0082()
{
  TestDescription("香氛浓度调节 Remote ON");
  teststep("warning","原始用例id为SYS-CDCU-香氛-0082");
  g_EM_LIN_Swc_LIN_Send("C4_FRS_CurrentIntensity 10 CH4"); // 测试步骤 TC_LINTest LIN Send C4_FRS_CurrentIntensity 10 CH4
  g_EM_Equipment_Swc_TC_4G_Time_Delay_Second("1"); // 测试步骤 TC_Sleep 1
  g_EM_SOAClient_Swc_SOA_CHECK_Prepare("Veh_SetSFSConRespStruct.Veh_SetSFSConNRC 0"); // 预期结果 TC_CANTest SOA check Veh_SetSFSConRespStruct.Veh_SetSFSConNRC 0
  g_EM_SOAClient_Swc_SOA_CHECK_Prepare("Veh_SFSService_ErrStruct.OpeNRC 0 traceback8"); // 预期结果 TC_CANTest SOA check Veh_SFSService_ErrStruct.OpeNRC 0 traceback8//
  g_EM_SOAClient_Swc_SOA_REQ("Veh_SetSFSConStruct.Veh_SetSFSCon:2&ServiceExecuteFeedbackFlag:2"); // 测试步骤 TC_CANTest SOA REQ Veh_SetSFSConStruct.Veh_SetSFSCon:2&ServiceExecuteFeedbackFlag:2//High
  g_EM_SOAClient_Swc_SOA_CHECK("Veh_SetSFSConRespStruct.Veh_SetSFSConNRC 0"); // 预期结果 TC_CANTest SOA check Veh_SetSFSConRespStruct.Veh_SetSFSConNRC 0
  g_EM_LIN_Swc_LIN_Check("C4_FRS_IntensityReq 10 CH4"); // 预期结果 TC_LINTest LIN Check C4_FRS_IntensityReq 10 CH4
  g_EM_SOAClient_Swc_SOA_CHECK("Veh_SFSService_ErrStruct.OpeNRC 0 traceback8"); // 预期结果 TC_CANTest SOA check Veh_SFSService_ErrStruct.OpeNRC 0 traceback8//
}

testcase SYS_CDCU_xiangfen_0083()
{
  TestDescription("香氛浓度调节 Remote ON");
  teststep("warning","原始用例id为SYS-CDCU-香氛-0083");
  g_EM_LIN_Swc_LIN_Send("C4_FRS_CurrentIntensity 6 CH4"); // 测试步骤 TC_LINTest LIN Send C4_FRS_CurrentIntensity 6 CH4
  g_EM_Equipment_Swc_TC_4G_Time_Delay_Second("1"); // 测试步骤 TC_Sleep 1
  g_EM_SOAClient_Swc_SOA_CHECK_Prepare("Veh_SetSFSConRespStruct.Veh_SetSFSConNRC 0"); // 预期结果 TC_CANTest SOA check Veh_SetSFSConRespStruct.Veh_SetSFSConNRC 0
  g_EM_SOAClient_Swc_SOA_CHECK_Prepare("Veh_SFSService_ErrStruct.OpeNRC 0 traceback8"); // 预期结果 TC_CANTest SOA check Veh_SFSService_ErrStruct.OpeNRC 0 traceback8//
  g_EM_SOAClient_Swc_SOA_REQ("Veh_SetSFSConStruct.Veh_SetSFSCon:3&ServiceExecuteFeedbackFlag:2"); // 测试步骤 TC_CANTest SOA REQ Veh_SetSFSConStruct.Veh_SetSFSCon:3&ServiceExecuteFeedbackFlag:2//High
  g_EM_SOAClient_Swc_SOA_CHECK("Veh_SetSFSConRespStruct.Veh_SetSFSConNRC 0"); // 预期结果 TC_CANTest SOA check Veh_SetSFSConRespStruct.Veh_SetSFSConNRC 0
  g_EM_LIN_Swc_LIN_Check("C4_FRS_IntensityReq 6 CH4"); // 预期结果 TC_LINTest LIN Check C4_FRS_IntensityReq 6 CH4
  g_EM_SOAClient_Swc_SOA_CHECK("Veh_SFSService_ErrStruct.OpeNRC 0 traceback8"); // 预期结果 TC_CANTest SOA check Veh_SFSService_ErrStruct.OpeNRC 0 traceback8//
}

testcase SYS_CDCU_xiangfen_0084()
{
  TestDescription("香氛浓度调节(远控) Remote ON");
  teststep("warning","原始用例id为SYS-CDCU-香氛-0084");
  g_EM_LIN_Swc_LIN_Send("C4_FRS_CurrentIntensity 3 CH4"); // 测试步骤 TC_LINTest LIN Send C4_FRS_CurrentIntensity 3 CH4
  g_EM_Equipment_Swc_TC_4G_Time_Delay_Second("1"); // 测试步骤 TC_Sleep 1
  g_EM_SOAClient_Swc_SOA_CHECK_Prepare("Veh_SetSFSConRespStruct.Veh_SetSFSConNRC 0"); // 预期结果 TC_CANTest SOA check Veh_SetSFSConRespStruct.Veh_SetSFSConNRC 0
  g_EM_SOAClient_Swc_SOA_CHECK_Prepare("Veh_SFSService_ErrStruct.OpeNRC 0 traceback8"); // 预期结果 TC_CANTest SOA check Veh_SFSService_ErrStruct.OpeNRC 0 traceback8//
  g_EM_SOAClient_Swc_SOA_CHECK_Prepare("Veh_SFSService_ErrStruct.OpeErrInfo[0-1]:0x00C8 traceback10"); // 预期结果 TC_CANTest SOA check Veh_SFSService_ErrStruct.OpeErrInfo[0-1]:0x00C8 traceback10//
  g_EM_SOAClient_Swc_SOA_REQ("Veh_SetSFSConStruct.Veh_SetSFSCon:1&ServiceExecuteFeedbackFlag:2&UserID:0x01010001"); // 测试步骤 TC_CANTest SOA REQ Veh_SetSFSConStruct.Veh_SetSFSCon:1&ServiceExecuteFeedbackFlag:2&UserID:0x01010001//Low
  g_EM_SOAClient_Swc_SOA_CHECK("Veh_SetSFSConRespStruct.Veh_SetSFSConNRC 0"); // 预期结果 TC_CANTest SOA check Veh_SetSFSConRespStruct.Veh_SetSFSConNRC 0
  g_EM_LIN_Swc_LIN_Check("C4_FRS_IntensityReq 3 CH4"); // 预期结果 TC_LINTest LIN Check C4_FRS_IntensityReq 3 CH4
  g_EM_SOAClient_Swc_SOA_CHECK("Veh_SFSService_ErrStruct.OpeNRC 0 traceback8"); // 预期结果 TC_CANTest SOA check Veh_SFSService_ErrStruct.OpeNRC 0 traceback8//
  g_EM_SOAClient_Swc_SOA_CHECK("Veh_SFSService_ErrStruct.OpeErrInfo[0-1]:0x00C8 traceback10"); // 预期结果 TC_CANTest SOA check Veh_SFSService_ErrStruct.OpeErrInfo[0-1]:0x00C8 traceback10//
}

testcase SYS_CDCU_xiangfen_0085()
{
  TestDescription("香氛浓度调节(远控) Remote ON");
  teststep("warning","原始用例id为SYS-CDCU-香氛-0085");
  g_EM_LIN_Swc_LIN_Send("C4_FRS_CurrentIntensity 10 CH4"); // 测试步骤 TC_LINTest LIN Send C4_FRS_CurrentIntensity 10 CH4
  g_EM_Equipment_Swc_TC_4G_Time_Delay_Second("1"); // 测试步骤 TC_Sleep 1
  g_EM_SOAClient_Swc_SOA_CHECK_Prepare("Veh_SetSFSConRespStruct.Veh_SetSFSConNRC 0"); // 预期结果 TC_CANTest SOA check Veh_SetSFSConRespStruct.Veh_SetSFSConNRC 0
  g_EM_SOAClient_Swc_SOA_CHECK_Prepare("Veh_SFSService_ErrStruct.OpeNRC 0 traceback8"); // 预期结果 TC_CANTest SOA check Veh_SFSService_ErrStruct.OpeNRC 0 traceback8//
  g_EM_SOAClient_Swc_SOA_CHECK_Prepare("Veh_SFSService_ErrStruct.OpeErrInfo[0-1]:0x00C8 traceback10"); // 预期结果 TC_CANTest SOA check Veh_SFSService_ErrStruct.OpeErrInfo[0-1]:0x00C8 traceback10//
  g_EM_SOAClient_Swc_SOA_REQ("Veh_SetSFSConStruct.Veh_SetSFSCon:2&ServiceExecuteFeedbackFlag:2&UserID:0x01010001"); // 测试步骤 TC_CANTest SOA REQ Veh_SetSFSConStruct.Veh_SetSFSCon:2&ServiceExecuteFeedbackFlag:2&UserID:0x01010001//High
  g_EM_SOAClient_Swc_SOA_CHECK("Veh_SetSFSConRespStruct.Veh_SetSFSConNRC 0"); // 预期结果 TC_CANTest SOA check Veh_SetSFSConRespStruct.Veh_SetSFSConNRC 0
  g_EM_LIN_Swc_LIN_Check("C4_FRS_IntensityReq 10 CH4"); // 预期结果 TC_LINTest LIN Check C4_FRS_IntensityReq 10 CH4
  g_EM_SOAClient_Swc_SOA_CHECK("Veh_SFSService_ErrStruct.OpeNRC 0 traceback8"); // 预期结果 TC_CANTest SOA check Veh_SFSService_ErrStruct.OpeNRC 0 traceback8//
  g_EM_SOAClient_Swc_SOA_CHECK("Veh_SFSService_ErrStruct.OpeErrInfo[0-1]:0x00C8 traceback10"); // 预期结果 TC_CANTest SOA check Veh_SFSService_ErrStruct.OpeErrInfo[0-1]:0x00C8 traceback10//
}

testcase SYS_CDCU_xiangfen_0086()
{
  TestDescription("香氛浓度调节(远控) Remote ON");
  teststep("warning","原始用例id为SYS-CDCU-香氛-0086");
  g_EM_LIN_Swc_LIN_Send("C4_FRS_CurrentIntensity 6 CH4"); // 测试步骤 TC_LINTest LIN Send C4_FRS_CurrentIntensity 6 CH4
  g_EM_Equipment_Swc_TC_4G_Time_Delay_Second("1"); // 测试步骤 TC_Sleep 1
  g_EM_SOAClient_Swc_SOA_CHECK_Prepare("Veh_SetSFSConRespStruct.Veh_SetSFSConNRC 0"); // 预期结果 TC_CANTest SOA check Veh_SetSFSConRespStruct.Veh_SetSFSConNRC 0
  g_EM_SOAClient_Swc_SOA_CHECK_Prepare("Veh_SFSService_ErrStruct.OpeNRC 0 traceback8"); // 预期结果 TC_CANTest SOA check Veh_SFSService_ErrStruct.OpeNRC 0 traceback8//
  g_EM_SOAClient_Swc_SOA_CHECK_Prepare("Veh_SFSService_ErrStruct.OpeErrInfo[0-1]:0x00C8 traceback10"); // 预期结果 TC_CANTest SOA check Veh_SFSService_ErrStruct.OpeErrInfo[0-1]:0x00C8 traceback10//
  g_EM_SOAClient_Swc_SOA_REQ("Veh_SetSFSConStruct.Veh_SetSFSCon:3&ServiceExecuteFeedbackFlag:2&UserID:0x01010001"); // 测试步骤 TC_CANTest SOA REQ Veh_SetSFSConStruct.Veh_SetSFSCon:3&ServiceExecuteFeedbackFlag:2&UserID:0x01010001//High
  g_EM_SOAClient_Swc_SOA_CHECK("Veh_SetSFSConRespStruct.Veh_SetSFSConNRC 0"); // 预期结果 TC_CANTest SOA check Veh_SetSFSConRespStruct.Veh_SetSFSConNRC 0
  g_EM_LIN_Swc_LIN_Check("C4_FRS_IntensityReq 6 CH4"); // 预期结果 TC_LINTest LIN Check C4_FRS_IntensityReq 6 CH4
  g_EM_SOAClient_Swc_SOA_CHECK("Veh_SFSService_ErrStruct.OpeNRC 0 traceback8"); // 预期结果 TC_CANTest SOA check Veh_SFSService_ErrStruct.OpeNRC 0 traceback8//
  g_EM_SOAClient_Swc_SOA_CHECK("Veh_SFSService_ErrStruct.OpeErrInfo[0-1]:0x00C8 traceback10"); // 预期结果 TC_CANTest SOA check Veh_SFSService_ErrStruct.OpeErrInfo[0-1]:0x00C8 traceback10//
}

testcase SYS_CDCU_xiangfen_0087()
{
  TestDescription("开启香氛(远控) Remote ON");
  teststep("warning","原始用例id为SYS-CDCU-香氛-0087");
  g_EM_LIN_Swc_LIN_Send("C4_FRS_CurrentIntensity 6 CH4"); // 测试步骤 TC_LINTest LIN Send C4_FRS_CurrentIntensity 6 CH4
  g_EM_Equipment_Swc_TC_4G_Time_Delay_Second("1"); // 测试步骤 TC_Sleep 1
  g_EM_SOAClient_Swc_SOA_CHECK_Prepare("Veh_TurnOnOffSFSRespStruct.Veh_TurnOnOffSFSNRC 0"); // 预期结果 TC_CANTest SOA check Veh_TurnOnOffSFSRespStruct.Veh_TurnOnOffSFSNRC 0
  g_EM_SOAClient_Swc_SOA_CHECK_Prepare("SOAEngineInterSignalStruct.SFSHVReq 0"); // 预期结果 TC_CANTest SOA check SOAEngineInterSignalStruct.SFSHVReq 0//请求上高压
  g_EM_SOAClient_Swc_SOA_CHECK_Prepare("Veh_SFSService_ErrStruct.OpeNRC 0 traceback8"); // 预期结果 TC_CANTest SOA check Veh_SFSService_ErrStruct.OpeNRC 0 traceback8//
  g_EM_SOAClient_Swc_SOA_CHECK_Prepare("Veh_SFSService_ErrStruct.OpeErrInfo[0-1]:0x00C8 traceback10"); // 预期结果 TC_CANTest SOA check Veh_SFSService_ErrStruct.OpeErrInfo[0-1]:0x00C8 traceback10//
  g_EM_SOAClient_Swc_SOA_REQ("Veh_TurnOnOffSFSStruct.Veh_TurnOnOffSFS:1&MemoryReq:1&ServiceExecuteFeedbackFlag:2&UserID:0x01010001&Time:0"); // 测试步骤 TC_CANTest SOA REQ Veh_TurnOnOffSFSStruct.Veh_TurnOnOffSFS:1&MemoryReq:1&ServiceExecuteFeedbackFlag:2&UserID:0x01010001&Time:0//High
  g_EM_SOAClient_Swc_SOA_CHECK("Veh_TurnOnOffSFSRespStruct.Veh_TurnOnOffSFSNRC 0"); // 预期结果 TC_CANTest SOA check Veh_TurnOnOffSFSRespStruct.Veh_TurnOnOffSFSNRC 0
  g_EM_SOAClient_Swc_SOA_CHECK("SOAEngineInterSignalStruct.SFSHVReq 0"); // 预期结果 TC_CANTest SOA check SOAEngineInterSignalStruct.SFSHVReq 0//请求上高压
  g_EM_LIN_Swc_LIN_Check("C4_FRS_IntensityReq 0 CH4"); // 预期结果 TC_LINTest LIN Check C4_FRS_IntensityReq 0 CH4
  g_EM_SOAClient_Swc_SOA_CHECK("Veh_SFSService_ErrStruct.OpeNRC 0 traceback8"); // 预期结果 TC_CANTest SOA check Veh_SFSService_ErrStruct.OpeNRC 0 traceback8//
  g_EM_SOAClient_Swc_SOA_CHECK("Veh_SFSService_ErrStruct.OpeErrInfo[0-1]:0x00C8 traceback10"); // 预期结果 TC_CANTest SOA check Veh_SFSService_ErrStruct.OpeErrInfo[0-1]:0x00C8 traceback10//
}

testcase SYS_CDCU_xiangfen_0088()
{
  TestDescription("开启香氛(远控) Remote ON");
  teststep("warning","原始用例id为SYS-CDCU-香氛-0088");
  g_EM_LIN_Swc_LIN_Send("C4_FRS_CurrentIntensity 6 CH4"); // 测试步骤 TC_LINTest LIN Send C4_FRS_CurrentIntensity 6 CH4
  g_EM_Equipment_Swc_TC_4G_Time_Delay_Second("1"); // 测试步骤 TC_Sleep 1
  g_EM_SOAClient_Swc_SOA_CHECK_Prepare("Veh_TurnOnOffSFSRespStruct.Veh_TurnOnOffSFSNRC 0"); // 预期结果 TC_CANTest SOA check Veh_TurnOnOffSFSRespStruct.Veh_TurnOnOffSFSNRC 0
  g_EM_SOAClient_Swc_SOA_CHECK_Prepare("SOAEngineInterSignalStruct.SFSHVReq 0"); // 预期结果 TC_CANTest SOA check SOAEngineInterSignalStruct.SFSHVReq 0//请求上高压
  g_EM_SOAClient_Swc_SOA_CHECK_Prepare("Veh_SFSService_ErrStruct.OpeNRC 0 traceback8"); // 预期结果 TC_CANTest SOA check Veh_SFSService_ErrStruct.OpeNRC 0 traceback8//
  g_EM_SOAClient_Swc_SOA_CHECK_Prepare("Veh_SFSService_ErrStruct.OpeErrInfo[0-1]:0x00C8 traceback10"); // 预期结果 TC_CANTest SOA check Veh_SFSService_ErrStruct.OpeErrInfo[0-1]:0x00C8 traceback10//
  g_EM_SOAClient_Swc_SOA_REQ("Veh_TurnOnOffSFSStruct.Veh_TurnOnOffSFS:1&MemoryReq:1&ServiceExecuteFeedbackFlag:2&UserID:0x01010001&Time:0xFFFF"); // 测试步骤 TC_CANTest SOA REQ Veh_TurnOnOffSFSStruct.Veh_TurnOnOffSFS:1&MemoryReq:1&ServiceExecuteFeedbackFlag:2&UserID:0x01010001&Time:0xFFFF//High
  g_EM_SOAClient_Swc_SOA_CHECK("Veh_TurnOnOffSFSRespStruct.Veh_TurnOnOffSFSNRC 0"); // 预期结果 TC_CANTest SOA check Veh_TurnOnOffSFSRespStruct.Veh_TurnOnOffSFSNRC 0
  g_EM_SOAClient_Swc_SOA_CHECK("SOAEngineInterSignalStruct.SFSHVReq 0"); // 预期结果 TC_CANTest SOA check SOAEngineInterSignalStruct.SFSHVReq 0//请求上高压
  g_EM_LIN_Swc_LIN_Check("C4_FRS_IntensityReq 0 CH4"); // 预期结果 TC_LINTest LIN Check C4_FRS_IntensityReq 0 CH4
  g_EM_SOAClient_Swc_SOA_CHECK("Veh_SFSService_ErrStruct.OpeNRC 0 traceback8"); // 预期结果 TC_CANTest SOA check Veh_SFSService_ErrStruct.OpeNRC 0 traceback8//
  g_EM_SOAClient_Swc_SOA_CHECK("Veh_SFSService_ErrStruct.OpeErrInfo[0-1]:0x00C8 traceback10"); // 预期结果 TC_CANTest SOA check Veh_SFSService_ErrStruct.OpeErrInfo[0-1]:0x00C8 traceback10//
}

testcase SYS_CDCU_xiangfen_0089()
{
  TestDescription("香氛浓度调节失败 Remote ON");
  teststep("warning","原始用例id为SYS-CDCU-香氛-0089");
  g_EM_LIN_Swc_LIN_Send("C4_FRS_CurrentIntensity 6 CH4"); // 测试步骤 TC_LINTest LIN Send C4_FRS_CurrentIntensity 6 CH4
  g_EM_Equipment_Swc_TC_4G_Time_Delay_Second("5"); // 测试步骤 TC_Sleep 5
  g_EM_SOAClient_Swc_SOA_CHECK_Prepare("Veh_SetSFSConRespStruct.Veh_SetSFSConNRC 0"); // 预期结果 TC_CANTest SOA check Veh_SetSFSConRespStruct.Veh_SetSFSConNRC 0
  g_EM_SOAClient_Swc_SOA_CHECK_Prepare("Veh_SFSService_ErrStruct.OpeNRC 0xFFFFFFFF traceback18"); // 预期结果 TC_CANTest SOA check Veh_SFSService_ErrStruct.OpeNRC 0xFFFFFFFF traceback18
  g_EM_SOAClient_Swc_SOA_CHECK_Prepare("Veh_SFSService_ErrStruct.OpeErrInfo[0-1]:0x01A4 traceback8"); // 预期结果 TC_CANTest SOA check Veh_SFSService_ErrStruct.OpeErrInfo[0-1]:0x01A4 traceback8//
  g_EM_SOAClient_Swc_SOA_REQ("Veh_SetSFSConStruct.Veh_SetSFSCon:1&ServiceExecuteFeedbackFlag:2&UserID:0x01010001"); // 测试步骤 TC_CANTest SOA REQ Veh_SetSFSConStruct.Veh_SetSFSCon:1&ServiceExecuteFeedbackFlag:2&UserID:0x01010001//Low
  g_EM_SOAClient_Swc_SOA_CHECK("Veh_SetSFSConRespStruct.Veh_SetSFSConNRC 0"); // 预期结果 TC_CANTest SOA check Veh_SetSFSConRespStruct.Veh_SetSFSConNRC 0
  g_EM_LIN_Swc_LIN_Check("C4_FRS_IntensityReq 3 CH4"); // 预期结果 TC_LINTest LIN Check C4_FRS_IntensityReq 3 CH4
  g_EM_Equipment_Swc_TC_4G_Time_Delay_Second("15"); // 测试步骤 TC_Sleep 15
  g_EM_SOAClient_Swc_SOA_CHECK("Veh_SFSService_ErrStruct.OpeNRC 0xFFFFFFFF traceback18"); // 预期结果 TC_CANTest SOA check Veh_SFSService_ErrStruct.OpeNRC 0xFFFFFFFF traceback18
  g_EM_SOAClient_Swc_SOA_CHECK("Veh_SFSService_ErrStruct.OpeErrInfo[0-1]:0x01A4 traceback8"); // 预期结果 TC_CANTest SOA check Veh_SFSService_ErrStruct.OpeErrInfo[0-1]:0x01A4 traceback8//
}

testcase SYS_CDCU_xiangfen_0090()
{
  TestDescription("香氛浓度调节失败 Remote ON");
  teststep("warning","原始用例id为SYS-CDCU-香氛-0090");
  g_CAN_Bus_Swc_Set("C_LDCU_SysSt.C_LDCU_EVSysReadySt 0"); // 测试步骤 TC_CANTest SET C_LDCU_SysSt.C_LDCU_EVSysReadySt 0//下高压
  g_EM_Equipment_Swc_TC_4G_Time_Delay_Second("2"); // 测试步骤 TC_Sleep 2
  g_EM_SOAClient_Swc_SOA_CHECK_Prepare("Veh_SFSService_ErrStruct.OpeNRC 4 traceback17"); // 预期结果 TC_CANTest SOA check Veh_SFSService_ErrStruct.OpeNRC 4 traceback17
  g_EM_SOAClient_Swc_SOA_CHECK_Prepare("Veh_SFSService_ErrStruct.OpeErrInfo[0-1]:0x6 traceback17"); // 预期结果 TC_CANTest SOA check Veh_SFSService_ErrStruct.OpeErrInfo[0-1]:0x6 traceback17
  g_EM_SOAClient_Swc_SOA_REQ("Veh_SetSFSConStruct.Veh_SetSFSCon:2&ServiceExecuteFeedbackFlag:2&UserID:0x01010001"); // 测试步骤 TC_CANTest SOA REQ Veh_SetSFSConStruct.Veh_SetSFSCon:2&ServiceExecuteFeedbackFlag:2&UserID:0x01010001//High
  g_EM_Equipment_Swc_TC_4G_Time_Delay_Second("15"); // 测试步骤 TC_Sleep 15
  g_EM_SOAClient_Swc_SOA_CHECK("Veh_SFSService_ErrStruct.OpeNRC 4 traceback17"); // 预期结果 TC_CANTest SOA check Veh_SFSService_ErrStruct.OpeNRC 4 traceback17
  g_EM_SOAClient_Swc_SOA_CHECK("Veh_SFSService_ErrStruct.OpeErrInfo[0-1]:0x6 traceback17"); // 预期结果 TC_CANTest SOA check Veh_SFSService_ErrStruct.OpeErrInfo[0-1]:0x6 traceback17
}

testcase SYS_CDCU_xiangfen_0091()
{
  TestDescription("香氛浓度调节---low 通道记忆1 当前通道浓度无效 Remote ON");
  teststep("warning","原始用例id为SYS-CDCU-香氛-0091");
  g_EM_Equipment_Swc_TC_IG("OFF"); // 测试步骤 TC_IG OFF
  g_CAN_Bus_Swc_Set("I_LDCU_BodySysSt1.I_LDCU_PowerMode 0"); // 测试步骤 TC_CANTest SET I_LDCU_BodySysSt1.I_LDCU_PowerMode 0
  g_EM_Equipment_Swc_TC_4G_Time_Delay_Second("1"); // 测试步骤 TC_Sleep 1
  g_EM_Equipment_Swc_TC_IG("ON"); // 测试步骤 TC_IG ON
  g_CAN_Bus_Swc_Set("I_LDCU_BodySysSt1.I_LDCU_PowerMode 2"); // 测试步骤 TC_CANTest SET I_LDCU_BodySysSt1.I_LDCU_PowerMode 2
  g_EM_LIN_Swc_LIN_Send("C4_FRS_active_container 0x1 CH4"); // 测试步骤 TC_LINTest LIN Send C4_FRS_active_container 0x1 CH4//ch3
  g_EM_Equipment_Swc_TC_4G_Time_Delay_Second("1"); // 测试步骤 TC_Sleep 1
  g_EM_SOAClient_Swc_SOA_CHECK_Prepare("Veh_SetSFSChanelRespStruct.Veh_SetSFSChanelNRC 0"); // 预期结果 TC_CANTest SOA check Veh_SetSFSChanelRespStruct.Veh_SetSFSChanelNRC 0
  g_EM_SOAClient_Swc_SOA_CHECK_Prepare("Veh_SFSService_ErrStruct.OpeNRC 0 traceback8"); // 预期结果 TC_CANTest SOA check Veh_SFSService_ErrStruct.OpeNRC 0 traceback8//
  g_EM_SOAClient_Swc_SOA_REQ("Veh_SetSFSChanelStruct.Veh_SetSFSChanel:1&ServiceExecuteFeedbackFlag:2&MemoryReq:1&UserID:0x01010001&Time:10"); // 测试步骤 TC_CANTest SOA REQ Veh_SetSFSChanelStruct.Veh_SetSFSChanel:1&ServiceExecuteFeedbackFlag:2&MemoryReq:1&UserID:0x01010001&Time:10//通道3
  g_EM_SOAClient_Swc_SOA_CHECK("Veh_SetSFSChanelRespStruct.Veh_SetSFSChanelNRC 0"); // 预期结果 TC_CANTest SOA check Veh_SetSFSChanelRespStruct.Veh_SetSFSChanelNRC 0
  g_CAN_Bus_Swc_Set("C_LDCU_SysSt.C_LDCU_EVSysReadySt 2"); // 测试步骤 TC_CANTest SET C_LDCU_SysSt.C_LDCU_EVSysReadySt 2//上高压
  g_EM_LIN_Swc_LIN_Check("C4_FRS_ChannelSelect 1 CH4"); // 预期结果 TC_LINTest LIN Check C4_FRS_ChannelSelect 1 CH4
  g_EM_SOAClient_Swc_SOA_CHECK("Veh_SFSService_ErrStruct.OpeNRC 0 traceback8"); // 预期结果 TC_CANTest SOA check Veh_SFSService_ErrStruct.OpeNRC 0 traceback8//
  g_EM_LIN_Swc_LIN_Send("C4_FRS_active_container 0x0 CH4"); // 测试步骤 TC_LINTest LIN Send C4_FRS_active_container 0x0 CH4//引擎转发香氛通道真实值
  g_EM_LIN_Swc_LIN_Send("C4_FRS_CurrentIntensity 0 CH4"); // 测试步骤 TC_LINTest LIN Send C4_FRS_CurrentIntensity 0 CH4//引擎转发香氛浓度真实值-closed
  g_EM_Equipment_Swc_TC_4G_Time_Delay_Second("1"); // 测试步骤 TC_Sleep 1
  g_EM_SOAClient_Swc_SOA_CHECK_Prepare("Veh_SetSFSConRespStruct.Veh_SetSFSConNRC 0"); // 预期结果 TC_CANTest SOA check Veh_SetSFSConRespStruct.Veh_SetSFSConNRC 0
  g_EM_SOAClient_Swc_SOA_CHECK_Prepare("Veh_SFSService_ErrStruct.OpeNRC 0 traceback8"); // 预期结果 TC_CANTest SOA check Veh_SFSService_ErrStruct.OpeNRC 0 traceback8//
  g_EM_SOAClient_Swc_SOA_REQ("Veh_SetSFSConStruct.Veh_SetSFSCon:1&ServiceExecuteFeedbackFlag:2&MemoryReq:1&UserID:0x01010001"); // 测试步骤 TC_CANTest SOA REQ Veh_SetSFSConStruct.Veh_SetSFSCon:1&ServiceExecuteFeedbackFlag:2&MemoryReq:1&UserID:0x01010001//Low
  g_EM_SOAClient_Swc_SOA_CHECK("Veh_SetSFSConRespStruct.Veh_SetSFSConNRC 0"); // 预期结果 TC_CANTest SOA check Veh_SetSFSConRespStruct.Veh_SetSFSConNRC 0
  g_EM_LIN_Swc_LIN_Check("C4_FRS_IntensityReq 3 CH4"); // 预期结果 TC_LINTest LIN Check C4_FRS_IntensityReq 3 CH4
  g_EM_LIN_Swc_LIN_Send("C4_FRS_CurrentIntensity 3 CH4"); // 测试步骤 TC_LINTest LIN Send C4_FRS_CurrentIntensity 3 CH4//引擎转发香氛通道真实值-closed
  g_EM_LIN_Swc_LIN_Check("C4_FRS_ChannelSelect 1 CH4"); // 预期结果 TC_LINTest LIN Check C4_FRS_ChannelSelect 1 CH4
  g_EM_LIN_Swc_LIN_Send("C4_FRS_active_container 0x1 CH4"); // 测试步骤 TC_LINTest LIN Send C4_FRS_active_container 0x1 CH4//ch3
  g_EM_SOAClient_Swc_SOA_CHECK("Veh_SFSService_ErrStruct.OpeNRC 0 traceback8"); // 预期结果 TC_CANTest SOA check Veh_SFSService_ErrStruct.OpeNRC 0 traceback8//
}

testcase SYS_CDCU_xiangfen_0092()
{
  TestDescription("香氛浓度调节---high 通道记忆1 当前通道浓度无效 Remote ON");
  teststep("warning","原始用例id为SYS-CDCU-香氛-0092");
  g_EM_LIN_Swc_LIN_Send("C4_FRS_active_container 0x0 CH4"); // 测试步骤 TC_LINTest LIN Send C4_FRS_active_container 0x0 CH4//引擎转发香氛通道真实值
  g_EM_LIN_Swc_LIN_Send("C4_FRS_CurrentIntensity 0 CH4"); // 测试步骤 TC_LINTest LIN Send C4_FRS_CurrentIntensity 0 CH4//引擎转发香氛浓度真实值-closed
  g_EM_Equipment_Swc_TC_4G_Time_Delay_Second("1"); // 测试步骤 TC_Sleep 1
  g_EM_SOAClient_Swc_SOA_CHECK_Prepare("Veh_SetSFSConRespStruct.Veh_SetSFSConNRC 0"); // 预期结果 TC_CANTest SOA check Veh_SetSFSConRespStruct.Veh_SetSFSConNRC 0
  g_EM_SOAClient_Swc_SOA_CHECK_Prepare("Veh_SFSService_ErrStruct.OpeNRC 0 traceback8"); // 预期结果 TC_CANTest SOA check Veh_SFSService_ErrStruct.OpeNRC 0 traceback8//
  g_EM_SOAClient_Swc_SOA_REQ("Veh_SetSFSConStruct.Veh_SetSFSCon:2&ServiceExecuteFeedbackFlag:2&MemoryReq:1&UserID:0x01010001"); // 测试步骤 TC_CANTest SOA REQ Veh_SetSFSConStruct.Veh_SetSFSCon:2&ServiceExecuteFeedbackFlag:2&MemoryReq:1&UserID:0x01010001//Low
  g_EM_SOAClient_Swc_SOA_CHECK("Veh_SetSFSConRespStruct.Veh_SetSFSConNRC 0"); // 预期结果 TC_CANTest SOA check Veh_SetSFSConRespStruct.Veh_SetSFSConNRC 0
  g_EM_LIN_Swc_LIN_Check("C4_FRS_IntensityReq 10 CH4"); // 预期结果 TC_LINTest LIN Check C4_FRS_IntensityReq 10 CH4
  g_EM_LIN_Swc_LIN_Send("C4_FRS_CurrentIntensity 10 CH4"); // 测试步骤 TC_LINTest LIN Send C4_FRS_CurrentIntensity 10 CH4//引擎转发香氛通道真实值-closed
  g_EM_LIN_Swc_LIN_Check("C4_FRS_ChannelSelect 1 CH4"); // 预期结果 TC_LINTest LIN Check C4_FRS_ChannelSelect 1 CH4
  g_EM_LIN_Swc_LIN_Send("C4_FRS_active_container 0x1 CH4"); // 测试步骤 TC_LINTest LIN Send C4_FRS_active_container 0x1 CH4//ch3
  g_EM_SOAClient_Swc_SOA_CHECK("Veh_SFSService_ErrStruct.OpeNRC 0 traceback8"); // 预期结果 TC_CANTest SOA check Veh_SFSService_ErrStruct.OpeNRC 0 traceback8//
}

testcase SYS_CDCU_xiangfen_0093()
{
  TestDescription("香氛浓度调节---mid 通道记忆1 当前通道浓度无效 Remote ON");
  teststep("warning","原始用例id为SYS-CDCU-香氛-0093");
  g_EM_LIN_Swc_LIN_Send("C4_FRS_active_container 0x0 CH4"); // 测试步骤 TC_LINTest LIN Send C4_FRS_active_container 0x0 CH4//引擎转发香氛通道真实值
  g_EM_LIN_Swc_LIN_Send("C4_FRS_CurrentIntensity 0 CH4"); // 测试步骤 TC_LINTest LIN Send C4_FRS_CurrentIntensity 0 CH4//引擎转发香氛浓度真实值-closed
  g_EM_Equipment_Swc_TC_4G_Time_Delay_Second("1"); // 测试步骤 TC_Sleep 1
  g_EM_SOAClient_Swc_SOA_CHECK_Prepare("Veh_SetSFSConRespStruct.Veh_SetSFSConNRC 0"); // 预期结果 TC_CANTest SOA check Veh_SetSFSConRespStruct.Veh_SetSFSConNRC 0
  g_EM_SOAClient_Swc_SOA_CHECK_Prepare("Veh_SFSService_ErrStruct.OpeNRC 0 traceback8"); // 预期结果 TC_CANTest SOA check Veh_SFSService_ErrStruct.OpeNRC 0 traceback8//
  g_EM_SOAClient_Swc_SOA_REQ("Veh_SetSFSConStruct.Veh_SetSFSCon:3&ServiceExecuteFeedbackFlag:2&MemoryReq:1&UserID:0x01010001"); // 测试步骤 TC_CANTest SOA REQ Veh_SetSFSConStruct.Veh_SetSFSCon:3&ServiceExecuteFeedbackFlag:2&MemoryReq:1&UserID:0x01010001//Low
  g_EM_SOAClient_Swc_SOA_CHECK("Veh_SetSFSConRespStruct.Veh_SetSFSConNRC 0"); // 预期结果 TC_CANTest SOA check Veh_SetSFSConRespStruct.Veh_SetSFSConNRC 0
  g_EM_LIN_Swc_LIN_Check("C4_FRS_IntensityReq 6 CH4"); // 预期结果 TC_LINTest LIN Check C4_FRS_IntensityReq 6 CH4
  g_EM_LIN_Swc_LIN_Send("C4_FRS_CurrentIntensity 6 CH4"); // 测试步骤 TC_LINTest LIN Send C4_FRS_CurrentIntensity 6 CH4//引擎转发香氛通道真实值-closed
  g_EM_LIN_Swc_LIN_Check("C4_FRS_ChannelSelect 1 CH4"); // 预期结果 TC_LINTest LIN Check C4_FRS_ChannelSelect 1 CH4
  g_EM_LIN_Swc_LIN_Send("C4_FRS_active_container 0x1 CH4"); // 测试步骤 TC_LINTest LIN Send C4_FRS_active_container 0x1 CH4//ch3
  g_EM_SOAClient_Swc_SOA_CHECK("Veh_SFSService_ErrStruct.OpeNRC 0 traceback8"); // 预期结果 TC_CANTest SOA check Veh_SFSService_ErrStruct.OpeNRC 0 traceback8//
}

testcase SYS_CDCU_xiangfen_0094()
{
  TestDescription("香氛浓度调节---low 通道记忆2 当前通道浓度无效 Remote ON");
  teststep("warning","原始用例id为SYS-CDCU-香氛-0094");
  g_EM_LIN_Swc_LIN_Send("C4_FRS_active_container 0x2 CH4"); // 测试步骤 TC_LINTest LIN Send C4_FRS_active_container 0x2 CH4//ch3
  g_EM_Equipment_Swc_TC_4G_Time_Delay_Second("1"); // 测试步骤 TC_Sleep 1
  g_EM_SOAClient_Swc_SOA_CHECK_Prepare("Veh_SetSFSChanelRespStruct.Veh_SetSFSChanelNRC 0"); // 预期结果 TC_CANTest SOA check Veh_SetSFSChanelRespStruct.Veh_SetSFSChanelNRC 0
  g_EM_SOAClient_Swc_SOA_CHECK_Prepare("Veh_SFSService_ErrStruct.OpeNRC 0 traceback8"); // 预期结果 TC_CANTest SOA check Veh_SFSService_ErrStruct.OpeNRC 0 traceback8//
  g_EM_SOAClient_Swc_SOA_REQ("Veh_SetSFSChanelStruct.Veh_SetSFSChanel:2&ServiceExecuteFeedbackFlag:2&MemoryReq:1&UserID:0x01010001&Time:10"); // 测试步骤 TC_CANTest SOA REQ Veh_SetSFSChanelStruct.Veh_SetSFSChanel:2&ServiceExecuteFeedbackFlag:2&MemoryReq:1&UserID:0x01010001&Time:10//通道3
  g_EM_SOAClient_Swc_SOA_CHECK("Veh_SetSFSChanelRespStruct.Veh_SetSFSChanelNRC 0"); // 预期结果 TC_CANTest SOA check Veh_SetSFSChanelRespStruct.Veh_SetSFSChanelNRC 0
  g_EM_LIN_Swc_LIN_Check("C4_FRS_ChannelSelect 2 CH4"); // 预期结果 TC_LINTest LIN Check C4_FRS_ChannelSelect 2 CH4
  g_EM_SOAClient_Swc_SOA_CHECK("Veh_SFSService_ErrStruct.OpeNRC 0 traceback8"); // 预期结果 TC_CANTest SOA check Veh_SFSService_ErrStruct.OpeNRC 0 traceback8//
  g_EM_LIN_Swc_LIN_Send("C4_FRS_active_container 0x0 CH4"); // 测试步骤 TC_LINTest LIN Send C4_FRS_active_container 0x0 CH4//引擎转发香氛通道真实值
  g_EM_LIN_Swc_LIN_Send("C4_FRS_CurrentIntensity 0 CH4"); // 测试步骤 TC_LINTest LIN Send C4_FRS_CurrentIntensity 0 CH4//引擎转发香氛浓度真实值-closed
  g_EM_Equipment_Swc_TC_4G_Time_Delay_Second("1"); // 测试步骤 TC_Sleep 1
  g_EM_SOAClient_Swc_SOA_CHECK_Prepare("Veh_SetSFSConRespStruct.Veh_SetSFSConNRC 0"); // 预期结果 TC_CANTest SOA check Veh_SetSFSConRespStruct.Veh_SetSFSConNRC 0
  g_EM_SOAClient_Swc_SOA_CHECK_Prepare("Veh_SFSService_ErrStruct.OpeNRC 0 traceback8"); // 预期结果 TC_CANTest SOA check Veh_SFSService_ErrStruct.OpeNRC 0 traceback8//
  g_EM_SOAClient_Swc_SOA_REQ("Veh_SetSFSConStruct.Veh_SetSFSCon:1&ServiceExecuteFeedbackFlag:2&MemoryReq:1&UserID:0x01010001"); // 测试步骤 TC_CANTest SOA REQ Veh_SetSFSConStruct.Veh_SetSFSCon:1&ServiceExecuteFeedbackFlag:2&MemoryReq:1&UserID:0x01010001//Low
  g_EM_SOAClient_Swc_SOA_CHECK("Veh_SetSFSConRespStruct.Veh_SetSFSConNRC 0"); // 预期结果 TC_CANTest SOA check Veh_SetSFSConRespStruct.Veh_SetSFSConNRC 0
  g_EM_LIN_Swc_LIN_Check("C4_FRS_IntensityReq 3 CH4"); // 预期结果 TC_LINTest LIN Check C4_FRS_IntensityReq 3 CH4
  g_EM_LIN_Swc_LIN_Send("C4_FRS_CurrentIntensity 3 CH4"); // 测试步骤 TC_LINTest LIN Send C4_FRS_CurrentIntensity 3 CH4//引擎转发香氛通道真实值-closed
  g_EM_LIN_Swc_LIN_Check("C4_FRS_ChannelSelect 2 CH4"); // 预期结果 TC_LINTest LIN Check C4_FRS_ChannelSelect 2 CH4
  g_EM_LIN_Swc_LIN_Send("C4_FRS_active_container 0x2 CH4"); // 测试步骤 TC_LINTest LIN Send C4_FRS_active_container 0x2 CH4//ch3
  g_EM_SOAClient_Swc_SOA_CHECK("Veh_SFSService_ErrStruct.OpeNRC 0 traceback8"); // 预期结果 TC_CANTest SOA check Veh_SFSService_ErrStruct.OpeNRC 0 traceback8//
}

testcase SYS_CDCU_xiangfen_0095()
{
  TestDescription("香氛浓度调节---high 通道记忆2 当前通道浓度无效 Remote ON");
  teststep("warning","原始用例id为SYS-CDCU-香氛-0095");
  g_EM_LIN_Swc_LIN_Send("C4_FRS_active_container 0x0 CH4"); // 测试步骤 TC_LINTest LIN Send C4_FRS_active_container 0x0 CH4//引擎转发香氛通道真实值
  g_EM_LIN_Swc_LIN_Send("C4_FRS_CurrentIntensity 0 CH4"); // 测试步骤 TC_LINTest LIN Send C4_FRS_CurrentIntensity 0 CH4//引擎转发香氛浓度真实值-closed
  g_EM_Equipment_Swc_TC_4G_Time_Delay_Second("1"); // 测试步骤 TC_Sleep 1
  g_EM_SOAClient_Swc_SOA_CHECK_Prepare("Veh_SetSFSConRespStruct.Veh_SetSFSConNRC 0"); // 预期结果 TC_CANTest SOA check Veh_SetSFSConRespStruct.Veh_SetSFSConNRC 0
  g_EM_SOAClient_Swc_SOA_CHECK_Prepare("Veh_SFSService_ErrStruct.OpeNRC 0 traceback8"); // 预期结果 TC_CANTest SOA check Veh_SFSService_ErrStruct.OpeNRC 0 traceback8//
  g_EM_SOAClient_Swc_SOA_REQ("Veh_SetSFSConStruct.Veh_SetSFSCon:2&ServiceExecuteFeedbackFlag:2&MemoryReq:1&UserID:0x01010001"); // 测试步骤 TC_CANTest SOA REQ Veh_SetSFSConStruct.Veh_SetSFSCon:2&ServiceExecuteFeedbackFlag:2&MemoryReq:1&UserID:0x01010001//Low
  g_EM_SOAClient_Swc_SOA_CHECK("Veh_SetSFSConRespStruct.Veh_SetSFSConNRC 0"); // 预期结果 TC_CANTest SOA check Veh_SetSFSConRespStruct.Veh_SetSFSConNRC 0
  g_EM_LIN_Swc_LIN_Check("C4_FRS_IntensityReq 10 CH4"); // 预期结果 TC_LINTest LIN Check C4_FRS_IntensityReq 10 CH4
  g_EM_LIN_Swc_LIN_Send("C4_FRS_CurrentIntensity 10 CH4"); // 测试步骤 TC_LINTest LIN Send C4_FRS_CurrentIntensity 10 CH4//引擎转发香氛通道真实值-closed
  g_EM_LIN_Swc_LIN_Check("C4_FRS_ChannelSelect 2 CH4"); // 预期结果 TC_LINTest LIN Check C4_FRS_ChannelSelect 2 CH4
  g_EM_LIN_Swc_LIN_Send("C4_FRS_active_container 0x2 CH4"); // 测试步骤 TC_LINTest LIN Send C4_FRS_active_container 0x2 CH4//ch3
  g_EM_SOAClient_Swc_SOA_CHECK("Veh_SFSService_ErrStruct.OpeNRC 0 traceback8"); // 预期结果 TC_CANTest SOA check Veh_SFSService_ErrStruct.OpeNRC 0 traceback8//
}

testcase SYS_CDCU_xiangfen_0096()
{
  TestDescription("香氛浓度调节---mid 通道记忆2 当前通道浓度无效 Remote ON");
  teststep("warning","原始用例id为SYS-CDCU-香氛-0096");
  g_EM_LIN_Swc_LIN_Send("C4_FRS_active_container 0x0 CH4"); // 测试步骤 TC_LINTest LIN Send C4_FRS_active_container 0x0 CH4//引擎转发香氛通道真实值
  g_EM_LIN_Swc_LIN_Send("C4_FRS_CurrentIntensity 0 CH4"); // 测试步骤 TC_LINTest LIN Send C4_FRS_CurrentIntensity 0 CH4//引擎转发香氛浓度真实值-closed
  g_EM_Equipment_Swc_TC_4G_Time_Delay_Second("1"); // 测试步骤 TC_Sleep 1
  g_EM_SOAClient_Swc_SOA_CHECK_Prepare("Veh_SetSFSConRespStruct.Veh_SetSFSConNRC 0"); // 预期结果 TC_CANTest SOA check Veh_SetSFSConRespStruct.Veh_SetSFSConNRC 0
  g_EM_SOAClient_Swc_SOA_CHECK_Prepare("Veh_SFSService_ErrStruct.OpeNRC 0 traceback8"); // 预期结果 TC_CANTest SOA check Veh_SFSService_ErrStruct.OpeNRC 0 traceback8//
  g_EM_SOAClient_Swc_SOA_REQ("Veh_SetSFSConStruct.Veh_SetSFSCon:3&ServiceExecuteFeedbackFlag:2&MemoryReq:1&UserID:0x01010001"); // 测试步骤 TC_CANTest SOA REQ Veh_SetSFSConStruct.Veh_SetSFSCon:3&ServiceExecuteFeedbackFlag:2&MemoryReq:1&UserID:0x01010001//Low
  g_EM_SOAClient_Swc_SOA_CHECK("Veh_SetSFSConRespStruct.Veh_SetSFSConNRC 0"); // 预期结果 TC_CANTest SOA check Veh_SetSFSConRespStruct.Veh_SetSFSConNRC 0
  g_EM_LIN_Swc_LIN_Check("C4_FRS_IntensityReq 6 CH4"); // 预期结果 TC_LINTest LIN Check C4_FRS_IntensityReq 6 CH4
  g_EM_LIN_Swc_LIN_Send("C4_FRS_CurrentIntensity 6 CH4"); // 测试步骤 TC_LINTest LIN Send C4_FRS_CurrentIntensity 6 CH4//引擎转发香氛通道真实值-closed
  g_EM_LIN_Swc_LIN_Check("C4_FRS_ChannelSelect 2 CH4"); // 预期结果 TC_LINTest LIN Check C4_FRS_ChannelSelect 2 CH4
  g_EM_LIN_Swc_LIN_Send("C4_FRS_active_container 0x2 CH4"); // 测试步骤 TC_LINTest LIN Send C4_FRS_active_container 0x2 CH4//ch3
  g_EM_SOAClient_Swc_SOA_CHECK("Veh_SFSService_ErrStruct.OpeNRC 0 traceback8"); // 预期结果 TC_CANTest SOA check Veh_SFSService_ErrStruct.OpeNRC 0 traceback8//
}

testcase SYS_CDCU_xiangfen_0097()
{
  TestDescription("香氛浓度调节---low 通道记忆3 当前通道浓度无效 Remote ON");
  teststep("warning","原始用例id为SYS-CDCU-香氛-0097");
  g_EM_LIN_Swc_LIN_Send("C4_FRS_active_container 0x3 CH4"); // 测试步骤 TC_LINTest LIN Send C4_FRS_active_container 0x3 CH4//ch3
  g_EM_Equipment_Swc_TC_4G_Time_Delay_Second("1"); // 测试步骤 TC_Sleep 1
  g_EM_SOAClient_Swc_SOA_CHECK_Prepare("Veh_SetSFSChanelRespStruct.Veh_SetSFSChanelNRC 0"); // 预期结果 TC_CANTest SOA check Veh_SetSFSChanelRespStruct.Veh_SetSFSChanelNRC 0
  g_EM_SOAClient_Swc_SOA_CHECK_Prepare("Veh_SFSService_ErrStruct.OpeNRC 0 traceback8"); // 预期结果 TC_CANTest SOA check Veh_SFSService_ErrStruct.OpeNRC 0 traceback8//
  g_EM_SOAClient_Swc_SOA_REQ("Veh_SetSFSChanelStruct.Veh_SetSFSChanel:3&ServiceExecuteFeedbackFlag:2&MemoryReq:1&UserID:0x01010001&Time:10"); // 测试步骤 TC_CANTest SOA REQ Veh_SetSFSChanelStruct.Veh_SetSFSChanel:3&ServiceExecuteFeedbackFlag:2&MemoryReq:1&UserID:0x01010001&Time:10//通道3
  g_EM_SOAClient_Swc_SOA_CHECK("Veh_SetSFSChanelRespStruct.Veh_SetSFSChanelNRC 0"); // 预期结果 TC_CANTest SOA check Veh_SetSFSChanelRespStruct.Veh_SetSFSChanelNRC 0
  g_EM_LIN_Swc_LIN_Check("C4_FRS_ChannelSelect 3 CH4"); // 预期结果 TC_LINTest LIN Check C4_FRS_ChannelSelect 3 CH4
  g_EM_SOAClient_Swc_SOA_CHECK("Veh_SFSService_ErrStruct.OpeNRC 0 traceback8"); // 预期结果 TC_CANTest SOA check Veh_SFSService_ErrStruct.OpeNRC 0 traceback8//
  g_EM_LIN_Swc_LIN_Send("C4_FRS_active_container 0x0 CH4"); // 测试步骤 TC_LINTest LIN Send C4_FRS_active_container 0x0 CH4//引擎转发香氛通道真实值
  g_EM_LIN_Swc_LIN_Send("C4_FRS_CurrentIntensity 0 CH4"); // 测试步骤 TC_LINTest LIN Send C4_FRS_CurrentIntensity 0 CH4//引擎转发香氛浓度真实值-closed
  g_EM_Equipment_Swc_TC_4G_Time_Delay_Second("1"); // 测试步骤 TC_Sleep 1
  g_EM_SOAClient_Swc_SOA_CHECK_Prepare("Veh_SetSFSConRespStruct.Veh_SetSFSConNRC 0"); // 预期结果 TC_CANTest SOA check Veh_SetSFSConRespStruct.Veh_SetSFSConNRC 0
  g_EM_SOAClient_Swc_SOA_CHECK_Prepare("Veh_SFSService_ErrStruct.OpeNRC 0 traceback8"); // 预期结果 TC_CANTest SOA check Veh_SFSService_ErrStruct.OpeNRC 0 traceback8//
  g_EM_SOAClient_Swc_SOA_REQ("Veh_SetSFSConStruct.Veh_SetSFSCon:1&ServiceExecuteFeedbackFlag:2&MemoryReq:1&UserID:0x01010001"); // 测试步骤 TC_CANTest SOA REQ Veh_SetSFSConStruct.Veh_SetSFSCon:1&ServiceExecuteFeedbackFlag:2&MemoryReq:1&UserID:0x01010001//Low
  g_EM_SOAClient_Swc_SOA_CHECK("Veh_SetSFSConRespStruct.Veh_SetSFSConNRC 0"); // 预期结果 TC_CANTest SOA check Veh_SetSFSConRespStruct.Veh_SetSFSConNRC 0
  g_EM_LIN_Swc_LIN_Check("C4_FRS_IntensityReq 3 CH4"); // 预期结果 TC_LINTest LIN Check C4_FRS_IntensityReq 3 CH4
  g_EM_LIN_Swc_LIN_Send("C4_FRS_CurrentIntensity 3 CH4"); // 测试步骤 TC_LINTest LIN Send C4_FRS_CurrentIntensity 3 CH4//引擎转发香氛通道真实值-closed
  g_EM_LIN_Swc_LIN_Check("C4_FRS_ChannelSelect 3 CH4"); // 预期结果 TC_LINTest LIN Check C4_FRS_ChannelSelect 3 CH4
  g_EM_LIN_Swc_LIN_Send("C4_FRS_active_container 0x3 CH4"); // 测试步骤 TC_LINTest LIN Send C4_FRS_active_container 0x3 CH4//ch3
  g_EM_SOAClient_Swc_SOA_CHECK("Veh_SFSService_ErrStruct.OpeNRC 0 traceback8"); // 预期结果 TC_CANTest SOA check Veh_SFSService_ErrStruct.OpeNRC 0 traceback8//
}

testcase SYS_CDCU_xiangfen_0098()
{
  TestDescription("香氛浓度调节---high 通道记忆3 当前通道浓度无效 Remote ON");
  teststep("warning","原始用例id为SYS-CDCU-香氛-0098");
  g_EM_LIN_Swc_LIN_Send("C4_FRS_active_container 0x0 CH4"); // 测试步骤 TC_LINTest LIN Send C4_FRS_active_container 0x0 CH4//引擎转发香氛通道真实值
  g_EM_LIN_Swc_LIN_Send("C4_FRS_CurrentIntensity 0 CH4"); // 测试步骤 TC_LINTest LIN Send C4_FRS_CurrentIntensity 0 CH4//引擎转发香氛浓度真实值-closed
  g_EM_Equipment_Swc_TC_4G_Time_Delay_Second("1"); // 测试步骤 TC_Sleep 1
  g_EM_SOAClient_Swc_SOA_CHECK_Prepare("Veh_SetSFSConRespStruct.Veh_SetSFSConNRC 0"); // 预期结果 TC_CANTest SOA check Veh_SetSFSConRespStruct.Veh_SetSFSConNRC 0
  g_EM_SOAClient_Swc_SOA_CHECK_Prepare("Veh_SFSService_ErrStruct.OpeNRC 0 traceback8"); // 预期结果 TC_CANTest SOA check Veh_SFSService_ErrStruct.OpeNRC 0 traceback8//
  g_EM_SOAClient_Swc_SOA_REQ("Veh_SetSFSConStruct.Veh_SetSFSCon:2&ServiceExecuteFeedbackFlag:2&MemoryReq:1&UserID:0x01010001"); // 测试步骤 TC_CANTest SOA REQ Veh_SetSFSConStruct.Veh_SetSFSCon:2&ServiceExecuteFeedbackFlag:2&MemoryReq:1&UserID:0x01010001//Low
  g_EM_SOAClient_Swc_SOA_CHECK("Veh_SetSFSConRespStruct.Veh_SetSFSConNRC 0"); // 预期结果 TC_CANTest SOA check Veh_SetSFSConRespStruct.Veh_SetSFSConNRC 0
  g_EM_LIN_Swc_LIN_Check("C4_FRS_IntensityReq 10 CH4"); // 预期结果 TC_LINTest LIN Check C4_FRS_IntensityReq 10 CH4
  g_EM_LIN_Swc_LIN_Send("C4_FRS_CurrentIntensity 10 CH4"); // 测试步骤 TC_LINTest LIN Send C4_FRS_CurrentIntensity 10 CH4//引擎转发香氛通道真实值-closed
  g_EM_LIN_Swc_LIN_Check("C4_FRS_ChannelSelect 3 CH4"); // 预期结果 TC_LINTest LIN Check C4_FRS_ChannelSelect 3 CH4
  g_EM_LIN_Swc_LIN_Send("C4_FRS_active_container 0x3 CH4"); // 测试步骤 TC_LINTest LIN Send C4_FRS_active_container 0x3 CH4//ch3
  g_EM_SOAClient_Swc_SOA_CHECK("Veh_SFSService_ErrStruct.OpeNRC 0 traceback8"); // 预期结果 TC_CANTest SOA check Veh_SFSService_ErrStruct.OpeNRC 0 traceback8//
}

testcase SYS_CDCU_xiangfen_0099()
{
  TestDescription("香氛浓度调节---mid 通道记忆3 当前通道浓度无效 Remote ON");
  teststep("warning","原始用例id为SYS-CDCU-香氛-0099");
  g_EM_LIN_Swc_LIN_Send("C4_FRS_active_container 0x0 CH4"); // 测试步骤 TC_LINTest LIN Send C4_FRS_active_container 0x0 CH4//引擎转发香氛通道真实值
  g_EM_LIN_Swc_LIN_Send("C4_FRS_CurrentIntensity 0 CH4"); // 测试步骤 TC_LINTest LIN Send C4_FRS_CurrentIntensity 0 CH4//引擎转发香氛浓度真实值-closed
  g_EM_Equipment_Swc_TC_4G_Time_Delay_Second("1"); // 测试步骤 TC_Sleep 1
  g_EM_SOAClient_Swc_SOA_CHECK_Prepare("Veh_SetSFSConRespStruct.Veh_SetSFSConNRC 0"); // 预期结果 TC_CANTest SOA check Veh_SetSFSConRespStruct.Veh_SetSFSConNRC 0
  g_EM_SOAClient_Swc_SOA_CHECK_Prepare("Veh_SFSService_ErrStruct.OpeNRC 0 traceback8"); // 预期结果 TC_CANTest SOA check Veh_SFSService_ErrStruct.OpeNRC 0 traceback8//
  g_EM_SOAClient_Swc_SOA_REQ("Veh_SetSFSConStruct.Veh_SetSFSCon:3&ServiceExecuteFeedbackFlag:2&MemoryReq:1&UserID:0x01010001"); // 测试步骤 TC_CANTest SOA REQ Veh_SetSFSConStruct.Veh_SetSFSCon:3&ServiceExecuteFeedbackFlag:2&MemoryReq:1&UserID:0x01010001//Low
  g_EM_SOAClient_Swc_SOA_CHECK("Veh_SetSFSConRespStruct.Veh_SetSFSConNRC 0"); // 预期结果 TC_CANTest SOA check Veh_SetSFSConRespStruct.Veh_SetSFSConNRC 0
  g_EM_LIN_Swc_LIN_Check("C4_FRS_IntensityReq 6 CH4"); // 预期结果 TC_LINTest LIN Check C4_FRS_IntensityReq 6 CH4
  g_EM_LIN_Swc_LIN_Send("C4_FRS_CurrentIntensity 6 CH4"); // 测试步骤 TC_LINTest LIN Send C4_FRS_CurrentIntensity 6 CH4//引擎转发香氛通道真实值-closed
  g_EM_LIN_Swc_LIN_Check("C4_FRS_ChannelSelect 3 CH4"); // 预期结果 TC_LINTest LIN Check C4_FRS_ChannelSelect 3 CH4
  g_EM_LIN_Swc_LIN_Send("C4_FRS_active_container 0x3 CH4"); // 测试步骤 TC_LINTest LIN Send C4_FRS_active_container 0x3 CH4//ch3
  g_EM_SOAClient_Swc_SOA_CHECK("Veh_SFSService_ErrStruct.OpeNRC 0 traceback8"); // 预期结果 TC_CANTest SOA check Veh_SFSService_ErrStruct.OpeNRC 0 traceback8//
}

testcase SYS_CDCU_xiangfen_0100()
{
  TestDescription("香氛浓度调节---low 通道记忆1 当前通道有效 浓度无效 Remote ON");
  teststep("warning","原始用例id为SYS-CDCU-香氛-0100");
  g_EM_LIN_Swc_LIN_Send("C4_FRS_active_container 0x1 CH4"); // 测试步骤 TC_LINTest LIN Send C4_FRS_active_container 0x1 CH4//ch3
  g_EM_Equipment_Swc_TC_4G_Time_Delay_Second("1"); // 测试步骤 TC_Sleep 1
  g_EM_SOAClient_Swc_SOA_CHECK_Prepare("Veh_SetSFSChanelRespStruct.Veh_SetSFSChanelNRC 0"); // 预期结果 TC_CANTest SOA check Veh_SetSFSChanelRespStruct.Veh_SetSFSChanelNRC 0
  g_EM_SOAClient_Swc_SOA_CHECK_Prepare("Veh_SFSService_ErrStruct.OpeNRC 0 traceback8"); // 预期结果 TC_CANTest SOA check Veh_SFSService_ErrStruct.OpeNRC 0 traceback8//
  g_EM_SOAClient_Swc_SOA_REQ("Veh_SetSFSChanelStruct.Veh_SetSFSChanel:1&ServiceExecuteFeedbackFlag:2&MemoryReq:1&UserID:0x01010001&Time:10"); // 测试步骤 TC_CANTest SOA REQ Veh_SetSFSChanelStruct.Veh_SetSFSChanel:1&ServiceExecuteFeedbackFlag:2&MemoryReq:1&UserID:0x01010001&Time:10//通道3
  g_EM_SOAClient_Swc_SOA_CHECK("Veh_SetSFSChanelRespStruct.Veh_SetSFSChanelNRC 0"); // 预期结果 TC_CANTest SOA check Veh_SetSFSChanelRespStruct.Veh_SetSFSChanelNRC 0
  g_EM_LIN_Swc_LIN_Check("C4_FRS_ChannelSelect 1 CH4"); // 预期结果 TC_LINTest LIN Check C4_FRS_ChannelSelect 1 CH4
  g_EM_SOAClient_Swc_SOA_CHECK("Veh_SFSService_ErrStruct.OpeNRC 0 traceback8"); // 预期结果 TC_CANTest SOA check Veh_SFSService_ErrStruct.OpeNRC 0 traceback8//
  g_EM_LIN_Swc_LIN_Send("C4_FRS_active_container 0x1 CH4"); // 测试步骤 TC_LINTest LIN Send C4_FRS_active_container 0x1 CH4//引擎转发香氛通道真实值
  g_EM_LIN_Swc_LIN_Send("C4_FRS_CurrentIntensity 0 CH4"); // 测试步骤 TC_LINTest LIN Send C4_FRS_CurrentIntensity 0 CH4//引擎转发香氛浓度真实值-closed
  g_EM_Equipment_Swc_TC_4G_Time_Delay_Second("1"); // 测试步骤 TC_Sleep 1
  g_EM_SOAClient_Swc_SOA_CHECK_Prepare("Veh_SetSFSConRespStruct.Veh_SetSFSConNRC 0"); // 预期结果 TC_CANTest SOA check Veh_SetSFSConRespStruct.Veh_SetSFSConNRC 0
  g_EM_SOAClient_Swc_SOA_CHECK_Prepare("Veh_SFSService_ErrStruct.OpeNRC 0 traceback8"); // 预期结果 TC_CANTest SOA check Veh_SFSService_ErrStruct.OpeNRC 0 traceback8//
  g_EM_SOAClient_Swc_SOA_REQ("Veh_SetSFSConStruct.Veh_SetSFSCon:1&ServiceExecuteFeedbackFlag:2&MemoryReq:1&UserID:0x01010001"); // 测试步骤 TC_CANTest SOA REQ Veh_SetSFSConStruct.Veh_SetSFSCon:1&ServiceExecuteFeedbackFlag:2&MemoryReq:1&UserID:0x01010001//Low
  g_EM_SOAClient_Swc_SOA_CHECK("Veh_SetSFSConRespStruct.Veh_SetSFSConNRC 0"); // 预期结果 TC_CANTest SOA check Veh_SetSFSConRespStruct.Veh_SetSFSConNRC 0
  g_EM_LIN_Swc_LIN_Check("C4_FRS_IntensityReq 3 CH4"); // 预期结果 TC_LINTest LIN Check C4_FRS_IntensityReq 3 CH4
  g_EM_LIN_Swc_LIN_Send("C4_FRS_CurrentIntensity 3 CH4"); // 测试步骤 TC_LINTest LIN Send C4_FRS_CurrentIntensity 3 CH4//引擎转发香氛通道真实值-closed
  g_EM_LIN_Swc_LIN_Check("C4_FRS_ChannelSelect 1 CH4"); // 预期结果 TC_LINTest LIN Check C4_FRS_ChannelSelect 1 CH4
  g_EM_LIN_Swc_LIN_Send("C4_FRS_active_container 0x1 CH4"); // 测试步骤 TC_LINTest LIN Send C4_FRS_active_container 0x1 CH4//ch3
  g_EM_SOAClient_Swc_SOA_CHECK("Veh_SFSService_ErrStruct.OpeNRC 0 traceback8"); // 预期结果 TC_CANTest SOA check Veh_SFSService_ErrStruct.OpeNRC 0 traceback8//
}

testcase SYS_CDCU_xiangfen_0101()
{
  TestDescription("香氛浓度调节---high 通道记忆1 当前通道有效浓度无效 Remote ON");
  teststep("warning","原始用例id为SYS-CDCU-香氛-0101");
  g_EM_LIN_Swc_LIN_Send("C4_FRS_active_container 0x1 CH4"); // 测试步骤 TC_LINTest LIN Send C4_FRS_active_container 0x1 CH4//引擎转发香氛通道真实值
  g_EM_LIN_Swc_LIN_Send("C4_FRS_CurrentIntensity 0 CH4"); // 测试步骤 TC_LINTest LIN Send C4_FRS_CurrentIntensity 0 CH4//引擎转发香氛浓度真实值-closed
  g_EM_Equipment_Swc_TC_4G_Time_Delay_Second("1"); // 测试步骤 TC_Sleep 1
  g_EM_SOAClient_Swc_SOA_CHECK_Prepare("Veh_SetSFSConRespStruct.Veh_SetSFSConNRC 0"); // 预期结果 TC_CANTest SOA check Veh_SetSFSConRespStruct.Veh_SetSFSConNRC 0
  g_EM_SOAClient_Swc_SOA_CHECK_Prepare("Veh_SFSService_ErrStruct.OpeNRC 0 traceback8"); // 预期结果 TC_CANTest SOA check Veh_SFSService_ErrStruct.OpeNRC 0 traceback8//
  g_EM_SOAClient_Swc_SOA_REQ("Veh_SetSFSConStruct.Veh_SetSFSCon:2&ServiceExecuteFeedbackFlag:2&MemoryReq:1&UserID:0x01010001"); // 测试步骤 TC_CANTest SOA REQ Veh_SetSFSConStruct.Veh_SetSFSCon:2&ServiceExecuteFeedbackFlag:2&MemoryReq:1&UserID:0x01010001//Low
  g_EM_SOAClient_Swc_SOA_CHECK("Veh_SetSFSConRespStruct.Veh_SetSFSConNRC 0"); // 预期结果 TC_CANTest SOA check Veh_SetSFSConRespStruct.Veh_SetSFSConNRC 0
  g_EM_LIN_Swc_LIN_Check("C4_FRS_IntensityReq 10 CH4"); // 预期结果 TC_LINTest LIN Check C4_FRS_IntensityReq 10 CH4
  g_EM_LIN_Swc_LIN_Send("C4_FRS_CurrentIntensity 10 CH4"); // 测试步骤 TC_LINTest LIN Send C4_FRS_CurrentIntensity 10 CH4//引擎转发香氛通道真实值-closed
  g_EM_LIN_Swc_LIN_Check("C4_FRS_ChannelSelect 1 CH4"); // 预期结果 TC_LINTest LIN Check C4_FRS_ChannelSelect 1 CH4
  g_EM_LIN_Swc_LIN_Send("C4_FRS_active_container 0x1 CH4"); // 测试步骤 TC_LINTest LIN Send C4_FRS_active_container 0x1 CH4//ch3
  g_EM_SOAClient_Swc_SOA_CHECK("Veh_SFSService_ErrStruct.OpeNRC 0 traceback8"); // 预期结果 TC_CANTest SOA check Veh_SFSService_ErrStruct.OpeNRC 0 traceback8//
}

testcase SYS_CDCU_xiangfen_0102()
{
  TestDescription("香氛浓度调节---mid 通道记忆1 当前通道有效浓度无效 Remote ON");
  teststep("warning","原始用例id为SYS-CDCU-香氛-0102");
  g_EM_LIN_Swc_LIN_Send("C4_FRS_active_container 0x1 CH4"); // 测试步骤 TC_LINTest LIN Send C4_FRS_active_container 0x1 CH4//引擎转发香氛通道真实值
  g_EM_LIN_Swc_LIN_Send("C4_FRS_CurrentIntensity 0 CH4"); // 测试步骤 TC_LINTest LIN Send C4_FRS_CurrentIntensity 0 CH4//引擎转发香氛浓度真实值-closed
  g_EM_Equipment_Swc_TC_4G_Time_Delay_Second("1"); // 测试步骤 TC_Sleep 1
  g_EM_SOAClient_Swc_SOA_CHECK_Prepare("Veh_SetSFSConRespStruct.Veh_SetSFSConNRC 0"); // 预期结果 TC_CANTest SOA check Veh_SetSFSConRespStruct.Veh_SetSFSConNRC 0
  g_EM_SOAClient_Swc_SOA_CHECK_Prepare("Veh_SFSService_ErrStruct.OpeNRC 0 traceback8"); // 预期结果 TC_CANTest SOA check Veh_SFSService_ErrStruct.OpeNRC 0 traceback8//
  g_EM_SOAClient_Swc_SOA_REQ("Veh_SetSFSConStruct.Veh_SetSFSCon:3&ServiceExecuteFeedbackFlag:2&MemoryReq:1&UserID:0x01010001"); // 测试步骤 TC_CANTest SOA REQ Veh_SetSFSConStruct.Veh_SetSFSCon:3&ServiceExecuteFeedbackFlag:2&MemoryReq:1&UserID:0x01010001//Low
  g_EM_SOAClient_Swc_SOA_CHECK("Veh_SetSFSConRespStruct.Veh_SetSFSConNRC 0"); // 预期结果 TC_CANTest SOA check Veh_SetSFSConRespStruct.Veh_SetSFSConNRC 0
  g_EM_LIN_Swc_LIN_Check("C4_FRS_IntensityReq 6 CH4"); // 预期结果 TC_LINTest LIN Check C4_FRS_IntensityReq 6 CH4
  g_EM_LIN_Swc_LIN_Send("C4_FRS_CurrentIntensity 6 CH4"); // 测试步骤 TC_LINTest LIN Send C4_FRS_CurrentIntensity 6 CH4//引擎转发香氛通道真实值-closed
  g_EM_LIN_Swc_LIN_Check("C4_FRS_ChannelSelect 1 CH4"); // 预期结果 TC_LINTest LIN Check C4_FRS_ChannelSelect 1 CH4
  g_EM_LIN_Swc_LIN_Send("C4_FRS_active_container 0x1 CH4"); // 测试步骤 TC_LINTest LIN Send C4_FRS_active_container 0x1 CH4//ch3
  g_EM_SOAClient_Swc_SOA_CHECK("Veh_SFSService_ErrStruct.OpeNRC 0 traceback8"); // 预期结果 TC_CANTest SOA check Veh_SFSService_ErrStruct.OpeNRC 0 traceback8//
}

testcase SYS_CDCU_xiangfen_0103()
{
  TestDescription("香氛浓度调节---low 通道记忆2 当前通道有效浓度无效 Remote ON");
  teststep("warning","原始用例id为SYS-CDCU-香氛-0103");
  g_EM_LIN_Swc_LIN_Send("C4_FRS_active_container 0x2 CH4"); // 测试步骤 TC_LINTest LIN Send C4_FRS_active_container 0x2 CH4//ch3
  g_EM_Equipment_Swc_TC_4G_Time_Delay_Second("1"); // 测试步骤 TC_Sleep 1
  g_EM_SOAClient_Swc_SOA_CHECK_Prepare("Veh_SetSFSChanelRespStruct.Veh_SetSFSChanelNRC 0"); // 预期结果 TC_CANTest SOA check Veh_SetSFSChanelRespStruct.Veh_SetSFSChanelNRC 0
  g_EM_SOAClient_Swc_SOA_CHECK_Prepare("Veh_SFSService_ErrStruct.OpeNRC 0 traceback8"); // 预期结果 TC_CANTest SOA check Veh_SFSService_ErrStruct.OpeNRC 0 traceback8//
  g_EM_SOAClient_Swc_SOA_REQ("Veh_SetSFSChanelStruct.Veh_SetSFSChanel:2&ServiceExecuteFeedbackFlag:2&MemoryReq:1&UserID:0x01010001&Time:10"); // 测试步骤 TC_CANTest SOA REQ Veh_SetSFSChanelStruct.Veh_SetSFSChanel:2&ServiceExecuteFeedbackFlag:2&MemoryReq:1&UserID:0x01010001&Time:10//通道3
  g_EM_SOAClient_Swc_SOA_CHECK("Veh_SetSFSChanelRespStruct.Veh_SetSFSChanelNRC 0"); // 预期结果 TC_CANTest SOA check Veh_SetSFSChanelRespStruct.Veh_SetSFSChanelNRC 0
  g_EM_LIN_Swc_LIN_Check("C4_FRS_ChannelSelect 2 CH4"); // 预期结果 TC_LINTest LIN Check C4_FRS_ChannelSelect 2 CH4
  g_EM_SOAClient_Swc_SOA_CHECK("Veh_SFSService_ErrStruct.OpeNRC 0 traceback8"); // 预期结果 TC_CANTest SOA check Veh_SFSService_ErrStruct.OpeNRC 0 traceback8//
  g_EM_LIN_Swc_LIN_Send("C4_FRS_active_container 0x2 CH4"); // 测试步骤 TC_LINTest LIN Send C4_FRS_active_container 0x2 CH4//引擎转发香氛通道真实值
  g_EM_LIN_Swc_LIN_Send("C4_FRS_CurrentIntensity 0 CH4"); // 测试步骤 TC_LINTest LIN Send C4_FRS_CurrentIntensity 0 CH4//引擎转发香氛浓度真实值-closed
  g_EM_Equipment_Swc_TC_4G_Time_Delay_Second("1"); // 测试步骤 TC_Sleep 1
  g_EM_SOAClient_Swc_SOA_CHECK_Prepare("Veh_SetSFSConRespStruct.Veh_SetSFSConNRC 0"); // 预期结果 TC_CANTest SOA check Veh_SetSFSConRespStruct.Veh_SetSFSConNRC 0
  g_EM_SOAClient_Swc_SOA_CHECK_Prepare("Veh_SFSService_ErrStruct.OpeNRC 0 traceback8"); // 预期结果 TC_CANTest SOA check Veh_SFSService_ErrStruct.OpeNRC 0 traceback8//
  g_EM_SOAClient_Swc_SOA_REQ("Veh_SetSFSConStruct.Veh_SetSFSCon:1&ServiceExecuteFeedbackFlag:2&MemoryReq:1&UserID:0x01010001"); // 测试步骤 TC_CANTest SOA REQ Veh_SetSFSConStruct.Veh_SetSFSCon:1&ServiceExecuteFeedbackFlag:2&MemoryReq:1&UserID:0x01010001//Low
  g_EM_SOAClient_Swc_SOA_CHECK("Veh_SetSFSConRespStruct.Veh_SetSFSConNRC 0"); // 预期结果 TC_CANTest SOA check Veh_SetSFSConRespStruct.Veh_SetSFSConNRC 0
  g_EM_LIN_Swc_LIN_Check("C4_FRS_IntensityReq 3 CH4"); // 预期结果 TC_LINTest LIN Check C4_FRS_IntensityReq 3 CH4
  g_EM_LIN_Swc_LIN_Send("C4_FRS_CurrentIntensity 3 CH4"); // 测试步骤 TC_LINTest LIN Send C4_FRS_CurrentIntensity 3 CH4//引擎转发香氛通道真实值-closed
  g_EM_LIN_Swc_LIN_Check("C4_FRS_ChannelSelect 2 CH4"); // 预期结果 TC_LINTest LIN Check C4_FRS_ChannelSelect 2 CH4
  g_EM_LIN_Swc_LIN_Send("C4_FRS_active_container 0x2 CH4"); // 测试步骤 TC_LINTest LIN Send C4_FRS_active_container 0x2 CH4//ch3
  g_EM_SOAClient_Swc_SOA_CHECK("Veh_SFSService_ErrStruct.OpeNRC 0 traceback8"); // 预期结果 TC_CANTest SOA check Veh_SFSService_ErrStruct.OpeNRC 0 traceback8//
}

testcase SYS_CDCU_xiangfen_0104()
{
  TestDescription("香氛浓度调节---high 通道记忆2 当前通道有效浓度无效 Remote ON");
  teststep("warning","原始用例id为SYS-CDCU-香氛-0104");
  g_EM_LIN_Swc_LIN_Send("C4_FRS_active_container 0x2 CH4"); // 测试步骤 TC_LINTest LIN Send C4_FRS_active_container 0x2 CH4//引擎转发香氛通道真实值
  g_EM_LIN_Swc_LIN_Send("C4_FRS_CurrentIntensity 0 CH4"); // 测试步骤 TC_LINTest LIN Send C4_FRS_CurrentIntensity 0 CH4//引擎转发香氛浓度真实值-closed
  g_EM_Equipment_Swc_TC_4G_Time_Delay_Second("1"); // 测试步骤 TC_Sleep 1
  g_EM_SOAClient_Swc_SOA_CHECK_Prepare("Veh_SetSFSConRespStruct.Veh_SetSFSConNRC 0"); // 预期结果 TC_CANTest SOA check Veh_SetSFSConRespStruct.Veh_SetSFSConNRC 0
  g_EM_SOAClient_Swc_SOA_CHECK_Prepare("Veh_SFSService_ErrStruct.OpeNRC 0 traceback8"); // 预期结果 TC_CANTest SOA check Veh_SFSService_ErrStruct.OpeNRC 0 traceback8//
  g_EM_SOAClient_Swc_SOA_REQ("Veh_SetSFSConStruct.Veh_SetSFSCon:2&ServiceExecuteFeedbackFlag:2&MemoryReq:1&UserID:0x01010001"); // 测试步骤 TC_CANTest SOA REQ Veh_SetSFSConStruct.Veh_SetSFSCon:2&ServiceExecuteFeedbackFlag:2&MemoryReq:1&UserID:0x01010001//Low
  g_EM_SOAClient_Swc_SOA_CHECK("Veh_SetSFSConRespStruct.Veh_SetSFSConNRC 0"); // 预期结果 TC_CANTest SOA check Veh_SetSFSConRespStruct.Veh_SetSFSConNRC 0
  g_EM_LIN_Swc_LIN_Check("C4_FRS_IntensityReq 10 CH4"); // 预期结果 TC_LINTest LIN Check C4_FRS_IntensityReq 10 CH4
  g_EM_LIN_Swc_LIN_Send("C4_FRS_CurrentIntensity 10 CH4"); // 测试步骤 TC_LINTest LIN Send C4_FRS_CurrentIntensity 10 CH4//引擎转发香氛通道真实值-closed
  g_EM_LIN_Swc_LIN_Check("C4_FRS_ChannelSelect 2 CH4"); // 预期结果 TC_LINTest LIN Check C4_FRS_ChannelSelect 2 CH4
  g_EM_LIN_Swc_LIN_Send("C4_FRS_active_container 0x2 CH4"); // 测试步骤 TC_LINTest LIN Send C4_FRS_active_container 0x2 CH4//ch3
  g_EM_SOAClient_Swc_SOA_CHECK("Veh_SFSService_ErrStruct.OpeNRC 0 traceback8"); // 预期结果 TC_CANTest SOA check Veh_SFSService_ErrStruct.OpeNRC 0 traceback8//
}

testcase SYS_CDCU_xiangfen_0105()
{
  TestDescription("香氛浓度调节---mid 通道记忆2 当前通道有效浓度无效 Remote ON");
  teststep("warning","原始用例id为SYS-CDCU-香氛-0105");
  g_EM_LIN_Swc_LIN_Send("C4_FRS_active_container 0x2 CH4"); // 测试步骤 TC_LINTest LIN Send C4_FRS_active_container 0x2 CH4//引擎转发香氛通道真实值
  g_EM_LIN_Swc_LIN_Send("C4_FRS_CurrentIntensity 0 CH4"); // 测试步骤 TC_LINTest LIN Send C4_FRS_CurrentIntensity 0 CH4//引擎转发香氛浓度真实值-closed
  g_EM_Equipment_Swc_TC_4G_Time_Delay_Second("1"); // 测试步骤 TC_Sleep 1
  g_EM_SOAClient_Swc_SOA_CHECK_Prepare("Veh_SetSFSConRespStruct.Veh_SetSFSConNRC 0"); // 预期结果 TC_CANTest SOA check Veh_SetSFSConRespStruct.Veh_SetSFSConNRC 0
  g_EM_SOAClient_Swc_SOA_CHECK_Prepare("Veh_SFSService_ErrStruct.OpeNRC 0 traceback8"); // 预期结果 TC_CANTest SOA check Veh_SFSService_ErrStruct.OpeNRC 0 traceback8//
  g_EM_SOAClient_Swc_SOA_REQ("Veh_SetSFSConStruct.Veh_SetSFSCon:3&ServiceExecuteFeedbackFlag:2&MemoryReq:1&UserID:0x01010001"); // 测试步骤 TC_CANTest SOA REQ Veh_SetSFSConStruct.Veh_SetSFSCon:3&ServiceExecuteFeedbackFlag:2&MemoryReq:1&UserID:0x01010001//Low
  g_EM_SOAClient_Swc_SOA_CHECK("Veh_SetSFSConRespStruct.Veh_SetSFSConNRC 0"); // 预期结果 TC_CANTest SOA check Veh_SetSFSConRespStruct.Veh_SetSFSConNRC 0
  g_EM_LIN_Swc_LIN_Check("C4_FRS_IntensityReq 6 CH4"); // 预期结果 TC_LINTest LIN Check C4_FRS_IntensityReq 6 CH4
  g_EM_LIN_Swc_LIN_Send("C4_FRS_CurrentIntensity 6 CH4"); // 测试步骤 TC_LINTest LIN Send C4_FRS_CurrentIntensity 6 CH4//引擎转发香氛通道真实值-closed
  g_EM_LIN_Swc_LIN_Check("C4_FRS_ChannelSelect 2 CH4"); // 预期结果 TC_LINTest LIN Check C4_FRS_ChannelSelect 2 CH4
  g_EM_LIN_Swc_LIN_Send("C4_FRS_active_container 0x2 CH4"); // 测试步骤 TC_LINTest LIN Send C4_FRS_active_container 0x2 CH4//ch3
  g_EM_SOAClient_Swc_SOA_CHECK("Veh_SFSService_ErrStruct.OpeNRC 0 traceback8"); // 预期结果 TC_CANTest SOA check Veh_SFSService_ErrStruct.OpeNRC 0 traceback8//
}

testcase SYS_CDCU_xiangfen_0106()
{
  TestDescription("香氛浓度调节---low 通道记忆3 当前通道有效浓度无效 Remote ON");
  teststep("warning","原始用例id为SYS-CDCU-香氛-0106");
  g_EM_LIN_Swc_LIN_Send("C4_FRS_active_container 0x3 CH4"); // 测试步骤 TC_LINTest LIN Send C4_FRS_active_container 0x3 CH4//ch3
  g_EM_Equipment_Swc_TC_4G_Time_Delay_Second("1"); // 测试步骤 TC_Sleep 1
  g_EM_SOAClient_Swc_SOA_CHECK_Prepare("Veh_SetSFSChanelRespStruct.Veh_SetSFSChanelNRC 0"); // 预期结果 TC_CANTest SOA check Veh_SetSFSChanelRespStruct.Veh_SetSFSChanelNRC 0
  g_EM_SOAClient_Swc_SOA_CHECK_Prepare("Veh_SFSService_ErrStruct.OpeNRC 0 traceback8"); // 预期结果 TC_CANTest SOA check Veh_SFSService_ErrStruct.OpeNRC 0 traceback8//
  g_EM_SOAClient_Swc_SOA_REQ("Veh_SetSFSChanelStruct.Veh_SetSFSChanel:3&ServiceExecuteFeedbackFlag:2&MemoryReq:1&UserID:0x01010001&Time:10"); // 测试步骤 TC_CANTest SOA REQ Veh_SetSFSChanelStruct.Veh_SetSFSChanel:3&ServiceExecuteFeedbackFlag:2&MemoryReq:1&UserID:0x01010001&Time:10//通道3
  g_EM_SOAClient_Swc_SOA_CHECK("Veh_SetSFSChanelRespStruct.Veh_SetSFSChanelNRC 0"); // 预期结果 TC_CANTest SOA check Veh_SetSFSChanelRespStruct.Veh_SetSFSChanelNRC 0
  g_EM_LIN_Swc_LIN_Check("C4_FRS_ChannelSelect 3 CH4"); // 预期结果 TC_LINTest LIN Check C4_FRS_ChannelSelect 3 CH4
  g_EM_SOAClient_Swc_SOA_CHECK("Veh_SFSService_ErrStruct.OpeNRC 0 traceback8"); // 预期结果 TC_CANTest SOA check Veh_SFSService_ErrStruct.OpeNRC 0 traceback8//
  g_EM_LIN_Swc_LIN_Send("C4_FRS_active_container 0x3 CH4"); // 测试步骤 TC_LINTest LIN Send C4_FRS_active_container 0x3 CH4//引擎转发香氛通道真实值
  g_EM_LIN_Swc_LIN_Send("C4_FRS_CurrentIntensity 0 CH4"); // 测试步骤 TC_LINTest LIN Send C4_FRS_CurrentIntensity 0 CH4//引擎转发香氛浓度真实值-closed
  g_EM_Equipment_Swc_TC_4G_Time_Delay_Second("1"); // 测试步骤 TC_Sleep 1
  g_EM_SOAClient_Swc_SOA_CHECK_Prepare("Veh_SetSFSConRespStruct.Veh_SetSFSConNRC 0"); // 预期结果 TC_CANTest SOA check Veh_SetSFSConRespStruct.Veh_SetSFSConNRC 0
  g_EM_SOAClient_Swc_SOA_CHECK_Prepare("Veh_SFSService_ErrStruct.OpeNRC 0 traceback8"); // 预期结果 TC_CANTest SOA check Veh_SFSService_ErrStruct.OpeNRC 0 traceback8//
  g_EM_SOAClient_Swc_SOA_REQ("Veh_SetSFSConStruct.Veh_SetSFSCon:1&ServiceExecuteFeedbackFlag:2&MemoryReq:1&UserID:0x01010001"); // 测试步骤 TC_CANTest SOA REQ Veh_SetSFSConStruct.Veh_SetSFSCon:1&ServiceExecuteFeedbackFlag:2&MemoryReq:1&UserID:0x01010001//Low
  g_EM_SOAClient_Swc_SOA_CHECK("Veh_SetSFSConRespStruct.Veh_SetSFSConNRC 0"); // 预期结果 TC_CANTest SOA check Veh_SetSFSConRespStruct.Veh_SetSFSConNRC 0
  g_EM_LIN_Swc_LIN_Check("C4_FRS_IntensityReq 3 CH4"); // 预期结果 TC_LINTest LIN Check C4_FRS_IntensityReq 3 CH4
  g_EM_LIN_Swc_LIN_Send("C4_FRS_CurrentIntensity 3 CH4"); // 测试步骤 TC_LINTest LIN Send C4_FRS_CurrentIntensity 3 CH4//引擎转发香氛通道真实值-closed
  g_EM_LIN_Swc_LIN_Check("C4_FRS_ChannelSelect 3 CH4"); // 预期结果 TC_LINTest LIN Check C4_FRS_ChannelSelect 3 CH4
  g_EM_LIN_Swc_LIN_Send("C4_FRS_active_container 0x3 CH4"); // 测试步骤 TC_LINTest LIN Send C4_FRS_active_container 0x3 CH4//ch3
  g_EM_SOAClient_Swc_SOA_CHECK("Veh_SFSService_ErrStruct.OpeNRC 0 traceback8"); // 预期结果 TC_CANTest SOA check Veh_SFSService_ErrStruct.OpeNRC 0 traceback8//
}

testcase SYS_CDCU_xiangfen_0107()
{
  TestDescription("香氛浓度调节---mid 通道记忆3 当前通道有效浓度无效 Remote ON");
  teststep("warning","原始用例id为SYS-CDCU-香氛-0107");
  g_EM_LIN_Swc_LIN_Send("C4_FRS_active_container 0x3 CH4"); // 测试步骤 TC_LINTest LIN Send C4_FRS_active_container 0x3 CH4//引擎转发香氛通道真实值
  g_EM_LIN_Swc_LIN_Send("C4_FRS_CurrentIntensity 0 CH4"); // 测试步骤 TC_LINTest LIN Send C4_FRS_CurrentIntensity 0 CH4//引擎转发香氛浓度真实值-closed
  g_EM_Equipment_Swc_TC_4G_Time_Delay_Second("1"); // 测试步骤 TC_Sleep 1
  g_EM_SOAClient_Swc_SOA_CHECK_Prepare("Veh_SetSFSConRespStruct.Veh_SetSFSConNRC 0"); // 预期结果 TC_CANTest SOA check Veh_SetSFSConRespStruct.Veh_SetSFSConNRC 0
  g_EM_SOAClient_Swc_SOA_CHECK_Prepare("Veh_SFSService_ErrStruct.OpeNRC 0 traceback8"); // 预期结果 TC_CANTest SOA check Veh_SFSService_ErrStruct.OpeNRC 0 traceback8//
  g_EM_SOAClient_Swc_SOA_REQ("Veh_SetSFSConStruct.Veh_SetSFSCon:3&ServiceExecuteFeedbackFlag:2&MemoryReq:1&UserID:0x01010001"); // 测试步骤 TC_CANTest SOA REQ Veh_SetSFSConStruct.Veh_SetSFSCon:3&ServiceExecuteFeedbackFlag:2&MemoryReq:1&UserID:0x01010001//Low
  g_EM_SOAClient_Swc_SOA_CHECK("Veh_SetSFSConRespStruct.Veh_SetSFSConNRC 0"); // 预期结果 TC_CANTest SOA check Veh_SetSFSConRespStruct.Veh_SetSFSConNRC 0
  g_EM_LIN_Swc_LIN_Check("C4_FRS_IntensityReq 6 CH4"); // 预期结果 TC_LINTest LIN Check C4_FRS_IntensityReq 6 CH4
  g_EM_LIN_Swc_LIN_Send("C4_FRS_CurrentIntensity 6 CH4"); // 测试步骤 TC_LINTest LIN Send C4_FRS_CurrentIntensity 6 CH4//引擎转发香氛通道真实值-closed
  g_EM_LIN_Swc_LIN_Check("C4_FRS_ChannelSelect 3 CH4"); // 预期结果 TC_LINTest LIN Check C4_FRS_ChannelSelect 3 CH4
  g_EM_LIN_Swc_LIN_Send("C4_FRS_active_container 0x3 CH4"); // 测试步骤 TC_LINTest LIN Send C4_FRS_active_container 0x3 CH4//ch3
  g_EM_SOAClient_Swc_SOA_CHECK("Veh_SFSService_ErrStruct.OpeNRC 0 traceback8"); // 预期结果 TC_CANTest SOA check Veh_SFSService_ErrStruct.OpeNRC 0 traceback8//
}

testcase SYS_CDCU_xiangfen_0108()
{
  TestDescription("香氛浓度调节---high 通道记忆3 当前通道有效浓度无效 Remote ON");
  teststep("warning","原始用例id为SYS-CDCU-香氛-0108");
  g_EM_LIN_Swc_LIN_Send("C4_FRS_active_container 0x3 CH4"); // 测试步骤 TC_LINTest LIN Send C4_FRS_active_container 0x3 CH4//引擎转发香氛通道真实值
  g_EM_LIN_Swc_LIN_Send("C4_FRS_CurrentIntensity 0 CH4"); // 测试步骤 TC_LINTest LIN Send C4_FRS_CurrentIntensity 0 CH4//引擎转发香氛浓度真实值-closed
  g_EM_Equipment_Swc_TC_4G_Time_Delay_Second("1"); // 测试步骤 TC_Sleep 1
  g_EM_SOAClient_Swc_SOA_CHECK_Prepare("Veh_SetSFSConRespStruct.Veh_SetSFSConNRC 0"); // 预期结果 TC_CANTest SOA check Veh_SetSFSConRespStruct.Veh_SetSFSConNRC 0
  g_EM_SOAClient_Swc_SOA_CHECK_Prepare("Veh_SFSService_ErrStruct.OpeNRC 0 traceback8"); // 预期结果 TC_CANTest SOA check Veh_SFSService_ErrStruct.OpeNRC 0 traceback8//
  g_EM_SOAClient_Swc_SOA_REQ("Veh_SetSFSConStruct.Veh_SetSFSCon:2&ServiceExecuteFeedbackFlag:2&MemoryReq:1&UserID:0x01010001"); // 测试步骤 TC_CANTest SOA REQ Veh_SetSFSConStruct.Veh_SetSFSCon:2&ServiceExecuteFeedbackFlag:2&MemoryReq:1&UserID:0x01010001//Low
  g_EM_SOAClient_Swc_SOA_CHECK("Veh_SetSFSConRespStruct.Veh_SetSFSConNRC 0"); // 预期结果 TC_CANTest SOA check Veh_SetSFSConRespStruct.Veh_SetSFSConNRC 0
  g_EM_LIN_Swc_LIN_Check("C4_FRS_IntensityReq 10 CH4"); // 预期结果 TC_LINTest LIN Check C4_FRS_IntensityReq 10 CH4
  g_EM_LIN_Swc_LIN_Send("C4_FRS_CurrentIntensity 10 CH4"); // 测试步骤 TC_LINTest LIN Send C4_FRS_CurrentIntensity 10 CH4//引擎转发香氛通道真实值-closed
  g_EM_LIN_Swc_LIN_Check("C4_FRS_ChannelSelect 3 CH4"); // 预期结果 TC_LINTest LIN Check C4_FRS_ChannelSelect 3 CH4
  g_EM_LIN_Swc_LIN_Send("C4_FRS_active_container 0x3 CH4"); // 测试步骤 TC_LINTest LIN Send C4_FRS_active_container 0x3 CH4//ch3
  g_EM_SOAClient_Swc_SOA_CHECK("Veh_SFSService_ErrStruct.OpeNRC 0 traceback8"); // 预期结果 TC_CANTest SOA check Veh_SFSService_ErrStruct.OpeNRC 0 traceback8//
}

testcase SYS_CDCU_xiangfen_0109()
{
  TestDescription("香氛开启 IG OFF");
  teststep("warning","原始用例id为SYS-CDCU-香氛-0109");
  g_EM_Equipment_Swc_TC_IG("OFF"); // 测试步骤 TC_IG OFF
  g_CAN_Bus_Swc_Set("I_LDCU_BodySysSt1.I_LDCU_PowerMode 0"); // 测试步骤 TC_CANTest SET I_LDCU_BodySysSt1.I_LDCU_PowerMode 0
  g_EM_SOAClient_Swc_SOA_REQ("Veh_SetSFSConStruct.Veh_SetSFSCon:2&ServiceExecuteFeedbackFlag:2&MemoryReq:1"); // 测试步骤 TC_CANTest SOA REQ Veh_SetSFSConStruct.Veh_SetSFSCon:2&ServiceExecuteFeedbackFlag:2&MemoryReq:1//High
  g_EM_Equipment_Swc_TC_4G_Time_Delay_Second("1"); // 测试步骤 TC_Sleep 1
  g_CAN_Bus_Swc_Set("I_LDCU_NM.I_LDCU_NMRepeatMsgReqBit 1"); // 测试步骤 TC_CANTest SET I_LDCU_NM.I_LDCU_NMRepeatMsgReqBit 1//网络唤醒维持帧
  g_EM_LIN_Swc_LIN_Send("C4_FRS_CurrentIntensity 10 CH4"); // 测试步骤 TC_LINTest LIN Send C4_FRS_CurrentIntensity 10 CH4
  g_EM_LIN_Swc_LIN_Send("C4_FRS_active_container 0x3 CH4"); // 测试步骤 TC_LINTest LIN Send C4_FRS_active_container 0x3 CH4
  g_CAN_Bus_Swc_Set("C_LDCU_SysSt.C_LDCU_EVSysReadySt 0"); // 测试步骤 TC_CANTest SET C_LDCU_SysSt.C_LDCU_EVSysReadySt 0//未高压
  g_EM_Equipment_Swc_TC_4G_Time_Delay_Second("1"); // 测试步骤 TC_Sleep 1
  g_EM_SOAClient_Swc_SOA_CHECK_Prepare("Veh_TurnOnOffSFSRespStruct.Veh_TurnOnOffSFSNRC 0"); // 预期结果 TC_CANTest SOA check Veh_TurnOnOffSFSRespStruct.Veh_TurnOnOffSFSNRC 0
  g_EM_SOAClient_Swc_SOA_CHECK_Prepare("Veh_SFSService_ErrStruct.OpeNRC 0 traceback8"); // 预期结果 TC_CANTest SOA check Veh_SFSService_ErrStruct.OpeNRC 0 traceback8//
  g_EM_SOAClient_Swc_SOA_REQ("Veh_TurnOnOffSFSStruct.Veh_TurnOnOffSFS:1&MemoryReq:1&ServiceExecuteFeedbackFlag:2&Time:1&UserID:0x01010001"); // 测试步骤 TC_CANTest SOA REQ Veh_TurnOnOffSFSStruct.Veh_TurnOnOffSFS:1&MemoryReq:1&ServiceExecuteFeedbackFlag:2&Time:1&UserID:0x01010001//ON
  g_EM_SOAClient_Swc_SOA_CHECK("Veh_TurnOnOffSFSRespStruct.Veh_TurnOnOffSFSNRC 0"); // 预期结果 TC_CANTest SOA check Veh_TurnOnOffSFSRespStruct.Veh_TurnOnOffSFSNRC 0
  gTC_CANTest_SOA_CheckReq_Prepare("HighVoltageCtrlStruct.HighVoltageCtrl 2"); // 预期结果 TC_CANTest SOA CheckReq HighVoltageCtrlStruct.HighVoltageCtrl 2//请求上高压
  g_CAN_Bus_Swc_Set("C_LDCU_SysSt.C_LDCU_EVSysReadySt 2"); // 测试步骤 TC_CANTest SET C_LDCU_SysSt.C_LDCU_EVSysReadySt 2//高压
  gTC_CANTest_SOA_CheckReq("HighVoltageCtrlStruct.HighVoltageCtrl 2"); // 预期结果 TC_CANTest SOA CheckReq HighVoltageCtrlStruct.HighVoltageCtrl 2//请求上高压
  g_EM_LIN_Swc_LIN_Check("C4_FRS_IntensityReq 10 CH4"); // 预期结果 TC_LINTest LIN Check C4_FRS_IntensityReq 10 CH4
  g_EM_LIN_Swc_LIN_Check("C4_FRS_ChannelSelect 3 CH4"); // 预期结果 TC_LINTest LIN Check C4_FRS_ChannelSelect 3 CH4
  g_EM_SOAClient_Swc_SOA_CHECK("Veh_SFSService_ErrStruct.OpeNRC 0 traceback8"); // 预期结果 TC_CANTest SOA check Veh_SFSService_ErrStruct.OpeNRC 0 traceback8//
}

testcase SYS_CDCU_xiangfen_0110()
{
  TestDescription("关闭 IG OFF");
  teststep("warning","原始用例id为SYS-CDCU-香氛-0110");
  g_EM_LIN_Swc_LIN_Send("C4_FRS_CurrentIntensity 0 CH4"); // 测试步骤 TC_LINTest LIN Send C4_FRS_CurrentIntensity 0 CH4//引擎转发香氛通道真实值-low
  g_EM_Equipment_Swc_TC_4G_Time_Delay_Second("1"); // 测试步骤 TC_Sleep 1
  g_EM_SOAClient_Swc_SOA_CHECK_Prepare("Veh_TurnOnOffSFSRespStruct.Veh_TurnOnOffSFSNRC 0"); // 预期结果 TC_CANTest SOA check Veh_TurnOnOffSFSRespStruct.Veh_TurnOnOffSFSNRC 0
  g_EM_SOAClient_Swc_SOA_CHECK_Prepare("Veh_SFSService_ErrStruct.OpeNRC 0 traceback8"); // 预期结果 TC_CANTest SOA check Veh_SFSService_ErrStruct.OpeNRC 0 traceback8//
  g_EM_SOAClient_Swc_SOA_REQ("Veh_TurnOnOffSFSStruct.Veh_TurnOnOffSFS:2&ServiceExecuteFeedbackFlag:2"); // 测试步骤 TC_CANTest SOA REQ Veh_TurnOnOffSFSStruct.Veh_TurnOnOffSFS:2&ServiceExecuteFeedbackFlag:2//OFF
  g_EM_SOAClient_Swc_SOA_CHECK("Veh_TurnOnOffSFSRespStruct.Veh_TurnOnOffSFSNRC 0"); // 预期结果 TC_CANTest SOA check Veh_TurnOnOffSFSRespStruct.Veh_TurnOnOffSFSNRC 0
  g_EM_LIN_Swc_LIN_Check("C4_FRS_IntensityReq 0 CH4"); // 预期结果 TC_LINTest LIN Check C4_FRS_IntensityReq 0 CH4
  g_EM_SOAClient_Swc_SOA_CHECK("Veh_SFSService_ErrStruct.OpeNRC 0 traceback8"); // 预期结果 TC_CANTest SOA check Veh_SFSService_ErrStruct.OpeNRC 0 traceback8//
}

testcase SYS_CDCU_xiangfen_0111()
{
  TestDescription("香氛开启(远控)15min释放 IG OFF");
  teststep("warning","原始用例id为SYS-CDCU-香氛-0111");
  g_EM_Equipment_Swc_TC_IG("ON"); // 测试步骤 TC_IG ON
  g_EM_Equipment_Swc_TC_4G_Time_Delay_Second("1"); // 测试步骤 TC_Sleep 1
  g_EM_Equipment_Swc_TC_IG("OFF"); // 测试步骤 TC_IG OFF
  g_CAN_Bus_Swc_Set("I_LDCU_BodySysSt1.I_LDCU_PowerMode 0"); // 测试步骤 TC_CANTest SET I_LDCU_BodySysSt1.I_LDCU_PowerMode 0
  g_EM_Equipment_Swc_TC_4G_Time_Delay_Second("1"); // 测试步骤 TC_Sleep 1
  g_CAN_Bus_Swc_Set("I_LDCU_NM.I_LDCU_NMRepeatMsgReqBit 1"); // 测试步骤 TC_CANTest SET I_LDCU_NM.I_LDCU_NMRepeatMsgReqBit 1//网络唤醒维持帧
  g_EM_LIN_Swc_LIN_Send("C4_FRS_CurrentIntensity 0 CH4"); // 测试步骤 TC_LINTest LIN Send C4_FRS_CurrentIntensity 0 CH4
  g_EM_LIN_Swc_LIN_Send("C4_FRS_active_container 0x3 CH4"); // 测试步骤 TC_LINTest LIN Send C4_FRS_active_container 0x3 CH4
  g_CAN_Bus_Swc_Set("C_LDCU_SysSt.C_LDCU_EVSysReadySt 0"); // 测试步骤 TC_CANTest SET C_LDCU_SysSt.C_LDCU_EVSysReadySt 0//未高压
  g_EM_SOAClient_Swc_SOA_CHECK_Prepare("Veh_SetSFSChanelRespStruct.Veh_SetSFSChanelNRC 0"); // 预期结果 TC_CANTest SOA check Veh_SetSFSChanelRespStruct.Veh_SetSFSChanelNRC 0
  gTC_CANTest_SOA_CheckReq_Prepare("HighVoltageCtrlStruct.HighVoltageCtrl 2"); // 预期结果 TC_CANTest SOA CheckReq HighVoltageCtrlStruct.HighVoltageCtrl 2//请求上高压
  g_EM_SOAClient_Swc_SOA_CHECK_Prepare("Veh_SFSService_ErrStruct.OpeNRC 0 traceback8"); // 预期结果 TC_CANTest SOA check Veh_SFSService_ErrStruct.OpeNRC 0 traceback8//
  g_EM_SOAClient_Swc_SOA_CHECK_Prepare("Veh_SFSService_ErrStruct.OpeErrInfo[0-1]:0x00C8 traceback10"); // 预期结果 TC_CANTest SOA check Veh_SFSService_ErrStruct.OpeErrInfo[0-1]:0x00C8 traceback10//
  g_EM_SOAClient_Swc_SOA_REQ("Veh_SetSFSChanelStruct.Veh_SetSFSChanel:3&ServiceExecuteFeedbackFlag:2&MemoryReq:1&UserID:0x01010001&Time:10"); // 测试步骤 TC_CANTest SOA REQ Veh_SetSFSChanelStruct.Veh_SetSFSChanel:3&ServiceExecuteFeedbackFlag:2&MemoryReq:1&UserID:0x01010001&Time:10//通道3
  g_EM_SOAClient_Swc_SOA_CHECK("Veh_SetSFSChanelRespStruct.Veh_SetSFSChanelNRC 0"); // 预期结果 TC_CANTest SOA check Veh_SetSFSChanelRespStruct.Veh_SetSFSChanelNRC 0
  gTC_CANTest_SOA_CheckReq("HighVoltageCtrlStruct.HighVoltageCtrl 2"); // 预期结果 TC_CANTest SOA CheckReq HighVoltageCtrlStruct.HighVoltageCtrl 2//请求上高压
  g_CAN_Bus_Swc_Set("C_LDCU_SysSt.C_LDCU_EVSysReadySt 2"); // 测试步骤 TC_CANTest SET C_LDCU_SysSt.C_LDCU_EVSysReadySt 2//未高压
  g_EM_LIN_Swc_LIN_Check("C4_FRS_IntensityReq 10 CH4"); // 预期结果 TC_LINTest LIN Check C4_FRS_IntensityReq 10 CH4
  g_EM_LIN_Swc_LIN_Check("C4_FRS_ChannelSelect 3 CH4"); // 预期结果 TC_LINTest LIN Check C4_FRS_ChannelSelect 3 CH4
  g_EM_SOAClient_Swc_SOA_CHECK("Veh_SFSService_ErrStruct.OpeNRC 0 traceback8"); // 预期结果 TC_CANTest SOA check Veh_SFSService_ErrStruct.OpeNRC 0 traceback8//
  g_EM_SOAClient_Swc_SOA_CHECK("Veh_SFSService_ErrStruct.OpeErrInfo[0-1]:0x00C8 traceback10"); // 预期结果 TC_CANTest SOA check Veh_SFSService_ErrStruct.OpeErrInfo[0-1]:0x00C8 traceback10//
  g_EM_Equipment_Swc_TC_4G_Time_Delay_Second("870"); // 测试步骤 TC_Sleep 870
  g_EM_LIN_Swc_LIN_Check("C4_FRS_IntensityReq 10 CH4"); // 预期结果 TC_LINTest LIN Check C4_FRS_IntensityReq 10 CH4
  g_EM_Equipment_Swc_TC_4G_Time_Delay_Second("50"); // 测试步骤 TC_Sleep 50
  g_EM_LIN_Swc_LIN_Check("C4_FRS_IntensityReq 0 CH4"); // 预期结果 TC_LINTest LIN Check C4_FRS_IntensityReq 0 CH4
}

testcase SYS_CDCU_xiangfen_0112()
{
  TestDescription("香氛开启(远控)15min释放 IG OFF");
  teststep("warning","原始用例id为SYS-CDCU-香氛-0112");
  g_EM_Equipment_Swc_TC_IG("ON"); // 测试步骤 TC_IG ON
  g_EM_Equipment_Swc_TC_4G_Time_Delay_Second("1"); // 测试步骤 TC_Sleep 1
  g_EM_Equipment_Swc_TC_IG("OFF"); // 测试步骤 TC_IG OFF
  g_CAN_Bus_Swc_Set("I_LDCU_BodySysSt1.I_LDCU_PowerMode 0"); // 测试步骤 TC_CANTest SET I_LDCU_BodySysSt1.I_LDCU_PowerMode 0
  g_EM_Equipment_Swc_TC_4G_Time_Delay_Second("1"); // 测试步骤 TC_Sleep 1
  g_CAN_Bus_Swc_Set("I_LDCU_NM.I_LDCU_NMRepeatMsgReqBit 1"); // 测试步骤 TC_CANTest SET I_LDCU_NM.I_LDCU_NMRepeatMsgReqBit 1//网络唤醒维持帧
  g_EM_LIN_Swc_LIN_Send("C4_FRS_CurrentIntensity 0 CH4"); // 测试步骤 TC_LINTest LIN Send C4_FRS_CurrentIntensity 0 CH4
  g_EM_LIN_Swc_LIN_Send("C4_FRS_active_container 0x3 CH4"); // 测试步骤 TC_LINTest LIN Send C4_FRS_active_container 0x3 CH4
  g_CAN_Bus_Swc_Set("C_LDCU_SysSt.C_LDCU_EVSysReadySt 0"); // 测试步骤 TC_CANTest SET C_LDCU_SysSt.C_LDCU_EVSysReadySt 0//未高压
  g_EM_SOAClient_Swc_SOA_CHECK_Prepare("Veh_SetSFSChanelRespStruct.Veh_SetSFSChanelNRC 0"); // 预期结果 TC_CANTest SOA check Veh_SetSFSChanelRespStruct.Veh_SetSFSChanelNRC 0
  gTC_CANTest_SOA_CheckReq_Prepare("HighVoltageCtrlStruct.HighVoltageCtrl 2"); // 预期结果 TC_CANTest SOA CheckReq HighVoltageCtrlStruct.HighVoltageCtrl 2//请求上高压
  g_EM_SOAClient_Swc_SOA_CHECK_Prepare("Veh_SFSService_ErrStruct.OpeNRC 0 traceback8"); // 预期结果 TC_CANTest SOA check Veh_SFSService_ErrStruct.OpeNRC 0 traceback8//
  g_EM_SOAClient_Swc_SOA_CHECK_Prepare("Veh_SFSService_ErrStruct.OpeErrInfo[0-1]:0x00C8 traceback10"); // 预期结果 TC_CANTest SOA check Veh_SFSService_ErrStruct.OpeErrInfo[0-1]:0x00C8 traceback10//
  g_EM_SOAClient_Swc_SOA_REQ("Veh_SetSFSChanelStruct.Veh_SetSFSChanel:3&ServiceExecuteFeedbackFlag:2&MemoryReq:1&UserID:0x01010001&Time:10"); // 测试步骤 TC_CANTest SOA REQ Veh_SetSFSChanelStruct.Veh_SetSFSChanel:3&ServiceExecuteFeedbackFlag:2&MemoryReq:1&UserID:0x01010001&Time:10//通道3
  g_EM_SOAClient_Swc_SOA_CHECK("Veh_SetSFSChanelRespStruct.Veh_SetSFSChanelNRC 0"); // 预期结果 TC_CANTest SOA check Veh_SetSFSChanelRespStruct.Veh_SetSFSChanelNRC 0
  gTC_CANTest_SOA_CheckReq("HighVoltageCtrlStruct.HighVoltageCtrl 2"); // 预期结果 TC_CANTest SOA CheckReq HighVoltageCtrlStruct.HighVoltageCtrl 2//请求上高压
  g_CAN_Bus_Swc_Set("C_LDCU_SysSt.C_LDCU_EVSysReadySt 2"); // 测试步骤 TC_CANTest SET C_LDCU_SysSt.C_LDCU_EVSysReadySt 2//未高压
  g_EM_LIN_Swc_LIN_Check("C4_FRS_IntensityReq 10 CH4"); // 预期结果 TC_LINTest LIN Check C4_FRS_IntensityReq 10 CH4
  g_EM_LIN_Swc_LIN_Check("C4_FRS_ChannelSelect 3 CH4"); // 预期结果 TC_LINTest LIN Check C4_FRS_ChannelSelect 3 CH4
  g_EM_SOAClient_Swc_SOA_CHECK("Veh_SFSService_ErrStruct.OpeNRC 0 traceback8"); // 预期结果 TC_CANTest SOA check Veh_SFSService_ErrStruct.OpeNRC 0 traceback8//
  g_EM_SOAClient_Swc_SOA_CHECK("Veh_SFSService_ErrStruct.OpeErrInfo[0-1]:0x00C8 traceback10"); // 预期结果 TC_CANTest SOA check Veh_SFSService_ErrStruct.OpeErrInfo[0-1]:0x00C8 traceback10//
  g_EM_Equipment_Swc_TC_4G_Time_Delay_Second("870"); // 测试步骤 TC_Sleep 870
  g_EM_LIN_Swc_LIN_Check("C4_FRS_IntensityReq 10 CH4"); // 预期结果 TC_LINTest LIN Check C4_FRS_IntensityReq 10 CH4
  g_EM_Equipment_Swc_TC_4G_Time_Delay_Second("50"); // 测试步骤 TC_Sleep 50
  g_EM_LIN_Swc_LIN_Check("C4_FRS_IntensityReq 0 CH4"); // 预期结果 TC_LINTest LIN Check C4_FRS_IntensityReq 0 CH4
}

testcase SYS_CDCU_xiangfen_0113()
{
  TestDescription("香氛开启失败(结果不对) IG OFF");
  teststep("warning","原始用例id为SYS-CDCU-香氛-0113");
  g_EM_LIN_Swc_LIN_Send("C4_FRS_CurrentIntensity 0 CH4"); // 测试步骤 TC_LINTest LIN Send C4_FRS_CurrentIntensity 0 CH4
  g_EM_Equipment_Swc_TC_4G_Time_Delay_Second("1"); // 测试步骤 TC_Sleep 1
  g_EM_SOAClient_Swc_SOA_CHECK_Prepare("Veh_TurnOnOffSFSRespStruct.Veh_TurnOnOffSFSNRC 0"); // 预期结果 TC_CANTest SOA check Veh_TurnOnOffSFSRespStruct.Veh_TurnOnOffSFSNRC 0
  g_EM_SOAClient_Swc_SOA_CHECK_Prepare("Veh_SFSService_ErrStruct.OpeNRC 0xFFFFFFFF traceback18"); // 预期结果 TC_CANTest SOA check Veh_SFSService_ErrStruct.OpeNRC 0xFFFFFFFF traceback18
  g_EM_SOAClient_Swc_SOA_CHECK_Prepare("Veh_SFSService_ErrStruct.OpeErrInfo[0-1]:0x285C traceback8"); // 预期结果 TC_CANTest SOA check Veh_SFSService_ErrStruct.OpeErrInfo[0-1]:0x285C traceback8//
  g_EM_SOAClient_Swc_SOA_REQ("Veh_TurnOnOffSFSStruct.Veh_TurnOnOffSFS:1&MemoryReq:1&ServiceExecuteFeedbackFlag:2&UserID:0x01010001&Time:1"); // 测试步骤 TC_CANTest SOA REQ Veh_TurnOnOffSFSStruct.Veh_TurnOnOffSFS:1&MemoryReq:1&ServiceExecuteFeedbackFlag:2&UserID:0x01010001&Time:1//ON
  g_EM_SOAClient_Swc_SOA_CHECK("Veh_TurnOnOffSFSRespStruct.Veh_TurnOnOffSFSNRC 0"); // 预期结果 TC_CANTest SOA check Veh_TurnOnOffSFSRespStruct.Veh_TurnOnOffSFSNRC 0
  g_EM_LIN_Swc_LIN_Check("C4_FRS_IntensityReq 10 CH4"); // 预期结果 TC_LINTest LIN Check C4_FRS_IntensityReq 10 CH4
  g_EM_Equipment_Swc_TC_4G_Time_Delay_Second("15"); // 测试步骤 TC_Sleep 15
  g_EM_SOAClient_Swc_SOA_CHECK("Veh_SFSService_ErrStruct.OpeNRC 0xFFFFFFFF traceback18"); // 预期结果 TC_CANTest SOA check Veh_SFSService_ErrStruct.OpeNRC 0xFFFFFFFF traceback18
  g_EM_SOAClient_Swc_SOA_CHECK("Veh_SFSService_ErrStruct.OpeErrInfo[0-1]:0x285C traceback8"); // 预期结果 TC_CANTest SOA check Veh_SFSService_ErrStruct.OpeErrInfo[0-1]:0x285C traceback8//
}

testcase SYS_CDCU_xiangfen_0114()
{
  TestDescription("香氛开启---失败 IG OFF");
  teststep("warning","原始用例id为SYS-CDCU-香氛-0114");
  g_EM_SOAClient_Swc_SOA_CHECK_Prepare("Veh_TurnOnOffSFSRespStruct.RespCode 0"); // 预期结果 TC_CANTest SOA check Veh_TurnOnOffSFSRespStruct.RespCode 0
  g_EM_SOAClient_Swc_SOA_CHECK_Prepare("Veh_SFSService_ErrStruct.OpeErrInfo[0-1]:0x01A4 traceback18"); // 预期结果 TC_CANTest SOA check Veh_SFSService_ErrStruct.OpeErrInfo[0-1]:0x01A4 traceback18
  g_EM_SOAClient_Swc_SOA_REQ("Veh_TurnOnOffSFSStruct.Veh_TurnOnOffSFS:1&ReqTimeOut:20&ServiceExecuteFeedbackFlag:2&UserID:0x01010001&Time:1"); // 测试步骤 TC_CANTest SOA REQ Veh_TurnOnOffSFSStruct.Veh_TurnOnOffSFS:1&ReqTimeOut:20&ServiceExecuteFeedbackFlag:2&UserID:0x01010001&Time:1//High
  g_EM_SOAClient_Swc_SOA_CHECK("Veh_TurnOnOffSFSRespStruct.RespCode 0"); // 预期结果 TC_CANTest SOA check Veh_TurnOnOffSFSRespStruct.RespCode 0
  g_EM_Equipment_Swc_TC_4G_Time_Delay_Second("16"); // 测试步骤 TC_Sleep 16
  g_EM_SOAClient_Swc_SOA_CHECK("Veh_SFSService_ErrStruct.OpeErrInfo[0-1]:0x01A4 traceback18"); // 预期结果 TC_CANTest SOA check Veh_SFSService_ErrStruct.OpeErrInfo[0-1]:0x01A4 traceback18
}

testcase SYS_CDCU_xiangfen_0115()
{
  TestDescription("香氛开启失败(异常下高压失败) IG OFF");
  teststep("warning","原始用例id为SYS-CDCU-香氛-0115");
  g_EM_Equipment_Swc_TC_IG("ON"); // 测试步骤 TC_IG ON
  g_EM_Equipment_Swc_TC_4G_Time_Delay_Second("1"); // 测试步骤 TC_Sleep 1
  g_EM_Equipment_Swc_TC_IG("OFF"); // 测试步骤 TC_IG OFF
  g_CAN_Bus_Swc_Set("I_LDCU_BodySysSt1.I_LDCU_PowerMode 0"); // 测试步骤 TC_CANTest SET I_LDCU_BodySysSt1.I_LDCU_PowerMode 0
  g_EM_Equipment_Swc_TC_4G_Time_Delay_Second("1"); // 测试步骤 TC_Sleep 1
  g_CAN_Bus_Swc_Set("I_LDCU_NM.I_LDCU_NMRepeatMsgReqBit 1"); // 测试步骤 TC_CANTest SET I_LDCU_NM.I_LDCU_NMRepeatMsgReqBit 1//网络唤醒维持帧
  g_CAN_Bus_Swc_Set("C_LDCU_SysSt.C_LDCU_EVSysReadySt 2"); // 测试步骤 TC_CANTest SET C_LDCU_SysSt.C_LDCU_EVSysReadySt 2//高压
  g_EM_LIN_Swc_LIN_Send("C4_FRS_CurrentIntensity 10 CH4"); // 测试步骤 TC_LINTest LIN Send C4_FRS_CurrentIntensity 10 CH4
  g_EM_LIN_Swc_LIN_Send("C4_FRS_active_container 0x3 CH4"); // 测试步骤 TC_LINTest LIN Send C4_FRS_active_container 0x3 CH4
  g_EM_Equipment_Swc_TC_4G_Time_Delay_Second("1"); // 测试步骤 TC_Sleep 1
  g_EM_SOAClient_Swc_SOA_CHECK_Prepare("Veh_TurnOnOffSFSRespStruct.Veh_TurnOnOffSFSNRC 0"); // 预期结果 TC_CANTest SOA check Veh_TurnOnOffSFSRespStruct.Veh_TurnOnOffSFSNRC 0
  g_EM_SOAClient_Swc_SOA_REQ("Veh_TurnOnOffSFSStruct.Veh_TurnOnOffSFS:1&MemoryReq:1&ServiceExecuteFeedbackFlag:2&UserID:0x01010001&Time:1"); // 测试步骤 TC_CANTest SOA REQ Veh_TurnOnOffSFSStruct.Veh_TurnOnOffSFS:1&MemoryReq:1&ServiceExecuteFeedbackFlag:2&UserID:0x01010001&Time:1//ON
  g_EM_SOAClient_Swc_SOA_CHECK("Veh_TurnOnOffSFSRespStruct.Veh_TurnOnOffSFSNRC 0"); // 预期结果 TC_CANTest SOA check Veh_TurnOnOffSFSRespStruct.Veh_TurnOnOffSFSNRC 0
  g_EM_LIN_Swc_LIN_Check("C4_FRS_IntensityReq 10 CH4"); // 预期结果 TC_LINTest LIN Check C4_FRS_IntensityReq 10 CH4
  g_CAN_Bus_Swc_Set("C_LDCU_SysSt.C_LDCU_EVSysReadySt 0"); // 测试步骤 TC_CANTest SET C_LDCU_SysSt.C_LDCU_EVSysReadySt 0//下高压
  g_EM_Equipment_Swc_TC_4G_Time_Delay_Second("5"); // 测试步骤 TC_Sleep 5
  g_EM_LIN_Swc_LIN_Check("C4_FRS_IntensityReq 0 CH4"); // 预期结果 TC_LINTest LIN Check C4_FRS_IntensityReq 0 CH4
}

testcase SYS_CDCU_xiangfen_0116()
{
  TestDescription("关闭 IG OFF");
  teststep("warning","原始用例id为SYS-CDCU-香氛-0116");
  g_EM_LIN_Swc_LIN_Send("C4_FRS_CurrentIntensity 0 CH4"); // 测试步骤 TC_LINTest LIN Send C4_FRS_CurrentIntensity 0 CH4//引擎转发香氛通道真实值-low
  g_EM_Equipment_Swc_TC_4G_Time_Delay_Second("1"); // 测试步骤 TC_Sleep 1
  g_EM_SOAClient_Swc_SOA_CHECK_Prepare("Veh_TurnOnOffSFSRespStruct.Veh_TurnOnOffSFSNRC 0"); // 预期结果 TC_CANTest SOA check Veh_TurnOnOffSFSRespStruct.Veh_TurnOnOffSFSNRC 0
  g_EM_SOAClient_Swc_SOA_CHECK_Prepare("Veh_SFSService_ErrStruct.OpeNRC 0 traceback8"); // 预期结果 TC_CANTest SOA check Veh_SFSService_ErrStruct.OpeNRC 0 traceback8//
  g_EM_SOAClient_Swc_SOA_REQ("Veh_TurnOnOffSFSStruct.Veh_TurnOnOffSFS:2&ServiceExecuteFeedbackFlag:2"); // 测试步骤 TC_CANTest SOA REQ Veh_TurnOnOffSFSStruct.Veh_TurnOnOffSFS:2&ServiceExecuteFeedbackFlag:2//OFF
  g_EM_SOAClient_Swc_SOA_CHECK("Veh_TurnOnOffSFSRespStruct.Veh_TurnOnOffSFSNRC 0"); // 预期结果 TC_CANTest SOA check Veh_TurnOnOffSFSRespStruct.Veh_TurnOnOffSFSNRC 0
  g_EM_LIN_Swc_LIN_Check("C4_FRS_IntensityReq 0 CH4"); // 预期结果 TC_LINTest LIN Check C4_FRS_IntensityReq 0 CH4
  g_EM_SOAClient_Swc_SOA_CHECK("Veh_SFSService_ErrStruct.OpeNRC 0 traceback8"); // 预期结果 TC_CANTest SOA check Veh_SFSService_ErrStruct.OpeNRC 0 traceback8//
}

testcase SYS_CDCU_xiangfen_0117()
{
  TestDescription("关闭(远控) IG OFF");
  teststep("warning","原始用例id为SYS-CDCU-香氛-0117");
  g_EM_LIN_Swc_LIN_Send("C4_FRS_CurrentIntensity 0 CH4"); // 测试步骤 TC_LINTest LIN Send C4_FRS_CurrentIntensity 0 CH4
  g_EM_Equipment_Swc_TC_4G_Time_Delay_Second("1"); // 测试步骤 TC_Sleep 1
  g_EM_SOAClient_Swc_SOA_CHECK_Prepare("Veh_TurnOnOffSFSRespStruct.Veh_TurnOnOffSFSNRC 0"); // 预期结果 TC_CANTest SOA check Veh_TurnOnOffSFSRespStruct.Veh_TurnOnOffSFSNRC 0
  g_EM_SOAClient_Swc_SOA_CHECK_Prepare("Veh_SFSService_ErrStruct.OpeNRC 0 traceback8"); // 预期结果 TC_CANTest SOA check Veh_SFSService_ErrStruct.OpeNRC 0 traceback8//
  g_EM_SOAClient_Swc_SOA_CHECK_Prepare("Veh_SFSService_ErrStruct.OpeErrInfo[0-1]:0x00C8 traceback10"); // 预期结果 TC_CANTest SOA check Veh_SFSService_ErrStruct.OpeErrInfo[0-1]:0x00C8 traceback10//
  g_EM_SOAClient_Swc_SOA_REQ("Veh_TurnOnOffSFSStruct.Veh_TurnOnOffSFS:2&ServiceExecuteFeedbackFlag:2&UserID:0x01010001&Time:1"); // 测试步骤 TC_CANTest SOA REQ Veh_TurnOnOffSFSStruct.Veh_TurnOnOffSFS:2&ServiceExecuteFeedbackFlag:2&UserID:0x01010001&Time:1//OFF
  g_EM_SOAClient_Swc_SOA_CHECK("Veh_TurnOnOffSFSRespStruct.Veh_TurnOnOffSFSNRC 0"); // 预期结果 TC_CANTest SOA check Veh_TurnOnOffSFSRespStruct.Veh_TurnOnOffSFSNRC 0
  g_EM_LIN_Swc_LIN_Check("C4_FRS_IntensityReq 0 CH4"); // 预期结果 TC_LINTest LIN Check C4_FRS_IntensityReq 0 CH4
  g_EM_SOAClient_Swc_SOA_CHECK("Veh_SFSService_ErrStruct.OpeNRC 0 traceback8"); // 预期结果 TC_CANTest SOA check Veh_SFSService_ErrStruct.OpeNRC 0 traceback8//
  g_EM_SOAClient_Swc_SOA_CHECK("Veh_SFSService_ErrStruct.OpeErrInfo[0-1]:0x00C8 traceback10"); // 预期结果 TC_CANTest SOA check Veh_SFSService_ErrStruct.OpeErrInfo[0-1]:0x00C8 traceback10//
}

testcase SYS_CDCU_xiangfen_0118()
{
  TestDescription("关闭(Time计时到) IG OFF");
  teststep("warning","原始用例id为SYS-CDCU-香氛-0118");
  g_EM_Equipment_Swc_TC_IG("ON"); // 测试步骤 TC_IG ON
  g_EM_Equipment_Swc_TC_4G_Time_Delay_Second("1"); // 测试步骤 TC_Sleep 1
  g_EM_Equipment_Swc_TC_IG("OFF"); // 测试步骤 TC_IG OFF
  g_CAN_Bus_Swc_Set("I_LDCU_BodySysSt1.I_LDCU_PowerMode 0"); // 测试步骤 TC_CANTest SET I_LDCU_BodySysSt1.I_LDCU_PowerMode 0
  g_EM_Equipment_Swc_TC_4G_Time_Delay_Second("1"); // 测试步骤 TC_Sleep 1
  g_CAN_Bus_Swc_Set("I_LDCU_NM.I_LDCU_NMRepeatMsgReqBit 1"); // 测试步骤 TC_CANTest SET I_LDCU_NM.I_LDCU_NMRepeatMsgReqBit 1//网络唤醒维持帧
  g_CAN_Bus_Swc_Set("C_LDCU_SysSt.C_LDCU_EVSysReadySt 2"); // 测试步骤 TC_CANTest SET C_LDCU_SysSt.C_LDCU_EVSysReadySt 2//高压
  g_EM_LIN_Swc_LIN_Send("C4_FRS_CurrentIntensity 10 CH4"); // 测试步骤 TC_LINTest LIN Send C4_FRS_CurrentIntensity 10 CH4
  g_EM_Equipment_Swc_TC_4G_Time_Delay_Second("1"); // 测试步骤 TC_Sleep 1
  g_EM_SOAClient_Swc_SOA_CHECK_Prepare("Veh_TurnOnOffSFSRespStruct.Veh_TurnOnOffSFSNRC 0"); // 预期结果 TC_CANTest SOA check Veh_TurnOnOffSFSRespStruct.Veh_TurnOnOffSFSNRC 0
  gTC_CANTest_SOA_CheckReq_Prepare("HighVoltageCtrlStruct.HighVoltageCtrl 2"); // 预期结果 TC_CANTest SOA CheckReq HighVoltageCtrlStruct.HighVoltageCtrl 2//请求上高压
  g_EM_SOAClient_Swc_SOA_REQ("Veh_TurnOnOffSFSStruct.Veh_TurnOnOffSFS:1&MemoryReq:1&ServiceExecuteFeedbackFlag:2&UserID:0x01010001&Time:1"); // 测试步骤 TC_CANTest SOA REQ Veh_TurnOnOffSFSStruct.Veh_TurnOnOffSFS:1&MemoryReq:1&ServiceExecuteFeedbackFlag:2&UserID:0x01010001&Time:1//ON
  g_EM_SOAClient_Swc_SOA_CHECK("Veh_TurnOnOffSFSRespStruct.Veh_TurnOnOffSFSNRC 0"); // 预期结果 TC_CANTest SOA check Veh_TurnOnOffSFSRespStruct.Veh_TurnOnOffSFSNRC 0
  gTC_CANTest_SOA_CheckReq("HighVoltageCtrlStruct.HighVoltageCtrl 2"); // 预期结果 TC_CANTest SOA CheckReq HighVoltageCtrlStruct.HighVoltageCtrl 2//请求上高压
  g_EM_LIN_Swc_LIN_Check("C4_FRS_IntensityReq 10 CH4"); // 预期结果 TC_LINTest LIN Check C4_FRS_IntensityReq 10 CH4
  g_EM_Equipment_Swc_TC_4G_Time_Delay_Second("61"); // 测试步骤 TC_Sleep 61
  g_EM_LIN_Swc_LIN_Check("C4_FRS_IntensityReq 0 CH4"); // 预期结果 TC_LINTest LIN Check C4_FRS_IntensityReq 0 CH4
}

testcase SYS_CDCU_xiangfen_0119()
{
  TestDescription("关闭失败 IG OFF");
  teststep("warning","原始用例id为SYS-CDCU-香氛-0119");
  g_EM_Equipment_Swc_TC_IG("ON"); // 测试步骤 TC_IG ON
  g_EM_Equipment_Swc_TC_4G_Time_Delay_Second("1"); // 测试步骤 TC_Sleep 1
  g_EM_Equipment_Swc_TC_IG("OFF"); // 测试步骤 TC_IG OFF
  g_EM_LIN_Swc_LIN_Send("C4_FRS_CurrentIntensity 10 CH4"); // 测试步骤 TC_LINTest LIN Send C4_FRS_CurrentIntensity 10 CH4
  g_EM_Equipment_Swc_TC_4G_Time_Delay_Second("1"); // 测试步骤 TC_Sleep 1
  g_EM_SOAClient_Swc_SOA_CHECK_Prepare("Veh_TurnOnOffSFSRespStruct.Veh_TurnOnOffSFSNRC 0"); // 预期结果 TC_CANTest SOA check Veh_TurnOnOffSFSRespStruct.Veh_TurnOnOffSFSNRC 0
  g_EM_SOAClient_Swc_SOA_CHECK_Prepare("Veh_SFSService_ErrStruct.OpeNRC 0xFFFFFFFF traceback18"); // 预期结果 TC_CANTest SOA check Veh_SFSService_ErrStruct.OpeNRC 0xFFFFFFFF traceback18
  g_EM_SOAClient_Swc_SOA_CHECK_Prepare("Veh_SFSService_ErrStruct.OpeErrInfo[0-1]:0x2867 traceback8"); // 预期结果 TC_CANTest SOA check Veh_SFSService_ErrStruct.OpeErrInfo[0-1]:0x2867 traceback8//
  g_EM_SOAClient_Swc_SOA_REQ("Veh_TurnOnOffSFSStruct.Veh_TurnOnOffSFS:2&ServiceExecuteFeedbackFlag:2&UserID:0x01010001&Time:1"); // 测试步骤 TC_CANTest SOA REQ Veh_TurnOnOffSFSStruct.Veh_TurnOnOffSFS:2&ServiceExecuteFeedbackFlag:2&UserID:0x01010001&Time:1//OFF
  g_EM_SOAClient_Swc_SOA_CHECK("Veh_TurnOnOffSFSRespStruct.Veh_TurnOnOffSFSNRC 0"); // 预期结果 TC_CANTest SOA check Veh_TurnOnOffSFSRespStruct.Veh_TurnOnOffSFSNRC 0
  g_EM_LIN_Swc_LIN_Check("C4_FRS_IntensityReq 0 CH4"); // 预期结果 TC_LINTest LIN Check C4_FRS_IntensityReq 0 CH4
  g_EM_Equipment_Swc_TC_4G_Time_Delay_Second("15"); // 测试步骤 TC_Sleep 15
  g_EM_SOAClient_Swc_SOA_CHECK("Veh_SFSService_ErrStruct.OpeNRC 0xFFFFFFFF traceback18"); // 预期结果 TC_CANTest SOA check Veh_SFSService_ErrStruct.OpeNRC 0xFFFFFFFF traceback18
  g_EM_SOAClient_Swc_SOA_CHECK("Veh_SFSService_ErrStruct.OpeErrInfo[0-1]:0x2867 traceback8"); // 预期结果 TC_CANTest SOA check Veh_SFSService_ErrStruct.OpeErrInfo[0-1]:0x2867 traceback8//
}

testcase SYS_CDCU_xiangfen_0120()
{
  TestDescription("香氛关闭---失败 IG OFF");
  teststep("warning","原始用例id为SYS-CDCU-香氛-0120");
  g_EM_SOAClient_Swc_SOA_CHECK_Prepare("Veh_TurnOnOffSFSRespStruct.RespCode 0"); // 预期结果 TC_CANTest SOA check Veh_TurnOnOffSFSRespStruct.RespCode 0
  g_EM_SOAClient_Swc_SOA_CHECK_Prepare("Veh_SFSService_ErrStruct.OpeErrInfo[0-1]:0x01A4 traceback18"); // 预期结果 TC_CANTest SOA check Veh_SFSService_ErrStruct.OpeErrInfo[0-1]:0x01A4 traceback18
  g_EM_SOAClient_Swc_SOA_REQ("Veh_TurnOnOffSFSStruct.Veh_TurnOnOffSFS:2&ReqTimeOut:20&ServiceExecuteFeedbackFlag:2&UserID:0x01010001&Time:1"); // 测试步骤 TC_CANTest SOA REQ Veh_TurnOnOffSFSStruct.Veh_TurnOnOffSFS:2&ReqTimeOut:20&ServiceExecuteFeedbackFlag:2&UserID:0x01010001&Time:1//OFF
  g_EM_SOAClient_Swc_SOA_CHECK("Veh_TurnOnOffSFSRespStruct.RespCode 0"); // 预期结果 TC_CANTest SOA check Veh_TurnOnOffSFSRespStruct.RespCode 0
  g_EM_Equipment_Swc_TC_4G_Time_Delay_Second("16"); // 测试步骤 TC_Sleep 16
  g_EM_SOAClient_Swc_SOA_CHECK("Veh_SFSService_ErrStruct.OpeErrInfo[0-1]:0x01A4 traceback18"); // 预期结果 TC_CANTest SOA check Veh_SFSService_ErrStruct.OpeErrInfo[0-1]:0x01A4 traceback18
}

testcase SYS_CDCU_xiangfen_0121()
{
  TestDescription("香氛通道选择 IG OFF");
  teststep("warning","原始用例id为SYS-CDCU-香氛-0121");
  g_EM_Equipment_Swc_TC_IG("ON"); // 测试步骤 TC_IG ON
  g_EM_Equipment_Swc_TC_4G_Time_Delay_Second("1"); // 测试步骤 TC_Sleep 1
  g_EM_Equipment_Swc_TC_IG("OFF"); // 测试步骤 TC_IG OFF
  g_EM_LIN_Swc_LIN_Send("C4_FRS_active_container 0x1 CH4"); // 测试步骤 TC_LINTest LIN Send C4_FRS_active_container 0x1 CH4//ch1
  g_EM_Equipment_Swc_TC_4G_Time_Delay_Second("1"); // 测试步骤 TC_Sleep 1
  g_EM_SOAClient_Swc_SOA_CHECK_Prepare("Veh_SetSFSChanelRespStruct.Veh_SetSFSChanelNRC 0"); // 预期结果 TC_CANTest SOA check Veh_SetSFSChanelRespStruct.Veh_SetSFSChanelNRC 0
  g_EM_SOAClient_Swc_SOA_CHECK_Prepare("Veh_SFSService_ErrStruct.OpeNRC 0 traceback8"); // 预期结果 TC_CANTest SOA check Veh_SFSService_ErrStruct.OpeNRC 0 traceback8//
  g_EM_SOAClient_Swc_SOA_REQ("Veh_SetSFSChanelStruct.Veh_SetSFSChanel:1&ServiceExecuteFeedbackFlag:2"); // 测试步骤 TC_CANTest SOA REQ Veh_SetSFSChanelStruct.Veh_SetSFSChanel:1&ServiceExecuteFeedbackFlag:2//通道1
  g_EM_SOAClient_Swc_SOA_CHECK("Veh_SetSFSChanelRespStruct.Veh_SetSFSChanelNRC 0"); // 预期结果 TC_CANTest SOA check Veh_SetSFSChanelRespStruct.Veh_SetSFSChanelNRC 0
  g_EM_LIN_Swc_LIN_Check("C4_FRS_ChannelSelect 1 CH4"); // 预期结果 TC_LINTest LIN Check C4_FRS_ChannelSelect 1 CH4
  g_EM_SOAClient_Swc_SOA_CHECK("Veh_SFSService_ErrStruct.OpeNRC 0 traceback8"); // 预期结果 TC_CANTest SOA check Veh_SFSService_ErrStruct.OpeNRC 0 traceback8//
}

testcase SYS_CDCU_xiangfen_0122()
{
  TestDescription("香氛通道选择 IG OFF");
  teststep("warning","原始用例id为SYS-CDCU-香氛-0122");
  g_EM_LIN_Swc_LIN_Send("C4_FRS_active_container 0x2 CH4"); // 测试步骤 TC_LINTest LIN Send C4_FRS_active_container 0x2 CH4//ch2
  g_EM_Equipment_Swc_TC_4G_Time_Delay_Second("1"); // 测试步骤 TC_Sleep 1
  g_EM_SOAClient_Swc_SOA_CHECK_Prepare("Veh_SetSFSChanelRespStruct.Veh_SetSFSChanelNRC 0"); // 预期结果 TC_CANTest SOA check Veh_SetSFSChanelRespStruct.Veh_SetSFSChanelNRC 0
  g_EM_SOAClient_Swc_SOA_CHECK_Prepare("Veh_SFSService_ErrStruct.OpeNRC 0 traceback8"); // 预期结果 TC_CANTest SOA check Veh_SFSService_ErrStruct.OpeNRC 0 traceback8//
  g_EM_SOAClient_Swc_SOA_REQ("Veh_SetSFSChanelStruct.Veh_SetSFSChanel:2&ServiceExecuteFeedbackFlag:2"); // 测试步骤 TC_CANTest SOA REQ Veh_SetSFSChanelStruct.Veh_SetSFSChanel:2&ServiceExecuteFeedbackFlag:2//通道2
  g_EM_SOAClient_Swc_SOA_CHECK("Veh_SetSFSChanelRespStruct.Veh_SetSFSChanelNRC 0"); // 预期结果 TC_CANTest SOA check Veh_SetSFSChanelRespStruct.Veh_SetSFSChanelNRC 0
  g_EM_LIN_Swc_LIN_Check("C4_FRS_ChannelSelect 2 CH4"); // 预期结果 TC_LINTest LIN Check C4_FRS_ChannelSelect 2 CH4
  g_EM_SOAClient_Swc_SOA_CHECK("Veh_SFSService_ErrStruct.OpeNRC 0 traceback8"); // 预期结果 TC_CANTest SOA check Veh_SFSService_ErrStruct.OpeNRC 0 traceback8//
}

testcase SYS_CDCU_xiangfen_0123()
{
  TestDescription("香氛通道选择 IG OFF");
  teststep("warning","原始用例id为SYS-CDCU-香氛-0123");
  g_EM_LIN_Swc_LIN_Send("C4_FRS_active_container 0x3 CH4"); // 测试步骤 TC_LINTest LIN Send C4_FRS_active_container 0x3 CH4//ch3
  g_EM_Equipment_Swc_TC_4G_Time_Delay_Second("1"); // 测试步骤 TC_Sleep 1
  g_EM_SOAClient_Swc_SOA_CHECK_Prepare("Veh_SetSFSChanelRespStruct.Veh_SetSFSChanelNRC 0"); // 预期结果 TC_CANTest SOA check Veh_SetSFSChanelRespStruct.Veh_SetSFSChanelNRC 0
  g_EM_SOAClient_Swc_SOA_CHECK_Prepare("Veh_SFSService_ErrStruct.OpeNRC 0 traceback8"); // 预期结果 TC_CANTest SOA check Veh_SFSService_ErrStruct.OpeNRC 0 traceback8//
  g_EM_SOAClient_Swc_SOA_REQ("Veh_SetSFSChanelStruct.Veh_SetSFSChanel:3&ServiceExecuteFeedbackFlag:2"); // 测试步骤 TC_CANTest SOA REQ Veh_SetSFSChanelStruct.Veh_SetSFSChanel:3&ServiceExecuteFeedbackFlag:2//通道3
  g_EM_SOAClient_Swc_SOA_CHECK("Veh_SetSFSChanelRespStruct.Veh_SetSFSChanelNRC 0"); // 预期结果 TC_CANTest SOA check Veh_SetSFSChanelRespStruct.Veh_SetSFSChanelNRC 0
  g_EM_LIN_Swc_LIN_Check("C4_FRS_ChannelSelect 3 CH4"); // 预期结果 TC_LINTest LIN Check C4_FRS_ChannelSelect 3 CH4
  g_EM_SOAClient_Swc_SOA_CHECK("Veh_SFSService_ErrStruct.OpeNRC 0 traceback8"); // 预期结果 TC_CANTest SOA check Veh_SFSService_ErrStruct.OpeNRC 0 traceback8//
}

testcase SYS_CDCU_xiangfen_0124()
{
  TestDescription("香氛通道选择(远控) IG OFF");
  teststep("warning","原始用例id为SYS-CDCU-香氛-0124");
  g_EM_LIN_Swc_LIN_Send("C4_FRS_active_container 0x1 CH4"); // 测试步骤 TC_LINTest LIN Send C4_FRS_active_container 0x1 CH4//ch1
  g_EM_Equipment_Swc_TC_4G_Time_Delay_Second("1"); // 测试步骤 TC_Sleep 1
  g_EM_SOAClient_Swc_SOA_CHECK_Prepare("Veh_SetSFSChanelRespStruct.Veh_SetSFSChanelNRC 0"); // 预期结果 TC_CANTest SOA check Veh_SetSFSChanelRespStruct.Veh_SetSFSChanelNRC 0
  g_EM_SOAClient_Swc_SOA_CHECK_Prepare("Veh_SFSService_ErrStruct.OpeNRC 0 traceback8"); // 预期结果 TC_CANTest SOA check Veh_SFSService_ErrStruct.OpeNRC 0 traceback8//
  g_EM_SOAClient_Swc_SOA_CHECK_Prepare("Veh_SFSService_ErrStruct.OpeErrInfo[0-1]:0x00C8 traceback10"); // 预期结果 TC_CANTest SOA check Veh_SFSService_ErrStruct.OpeErrInfo[0-1]:0x00C8 traceback10//
  g_EM_SOAClient_Swc_SOA_REQ("Veh_SetSFSChanelStruct.Veh_SetSFSChanel:1&ServiceExecuteFeedbackFlag:2&UserID:0x01010001&Time:1"); // 测试步骤 TC_CANTest SOA REQ Veh_SetSFSChanelStruct.Veh_SetSFSChanel:1&ServiceExecuteFeedbackFlag:2&UserID:0x01010001&Time:1//通道1
  g_EM_SOAClient_Swc_SOA_CHECK("Veh_SetSFSChanelRespStruct.Veh_SetSFSChanelNRC 0"); // 预期结果 TC_CANTest SOA check Veh_SetSFSChanelRespStruct.Veh_SetSFSChanelNRC 0
  g_EM_LIN_Swc_LIN_Check("C4_FRS_ChannelSelect 1 CH4"); // 预期结果 TC_LINTest LIN Check C4_FRS_ChannelSelect 1 CH4
  g_EM_SOAClient_Swc_SOA_CHECK("Veh_SFSService_ErrStruct.OpeNRC 0 traceback8"); // 预期结果 TC_CANTest SOA check Veh_SFSService_ErrStruct.OpeNRC 0 traceback8//
  g_EM_SOAClient_Swc_SOA_CHECK("Veh_SFSService_ErrStruct.OpeErrInfo[0-1]:0x00C8 traceback10"); // 预期结果 TC_CANTest SOA check Veh_SFSService_ErrStruct.OpeErrInfo[0-1]:0x00C8 traceback10//
}

testcase SYS_CDCU_xiangfen_0125()
{
  TestDescription("香氛通道选择(远控) IG OFF");
  teststep("warning","原始用例id为SYS-CDCU-香氛-0125");
  g_EM_LIN_Swc_LIN_Send("C4_FRS_active_container 0x2 CH4"); // 测试步骤 TC_LINTest LIN Send C4_FRS_active_container 0x2 CH4//ch2
  g_EM_Equipment_Swc_TC_4G_Time_Delay_Second("1"); // 测试步骤 TC_Sleep 1
  g_EM_SOAClient_Swc_SOA_CHECK_Prepare("Veh_SetSFSChanelRespStruct.Veh_SetSFSChanelNRC 0"); // 预期结果 TC_CANTest SOA check Veh_SetSFSChanelRespStruct.Veh_SetSFSChanelNRC 0
  g_EM_SOAClient_Swc_SOA_CHECK_Prepare("Veh_SFSService_ErrStruct.OpeNRC 0 traceback8"); // 预期结果 TC_CANTest SOA check Veh_SFSService_ErrStruct.OpeNRC 0 traceback8//
  g_EM_SOAClient_Swc_SOA_CHECK_Prepare("Veh_SFSService_ErrStruct.OpeErrInfo[0-1]:0x00C8 traceback10"); // 预期结果 TC_CANTest SOA check Veh_SFSService_ErrStruct.OpeErrInfo[0-1]:0x00C8 traceback10//
  g_EM_SOAClient_Swc_SOA_REQ("Veh_SetSFSChanelStruct.Veh_SetSFSChanel:2&ServiceExecuteFeedbackFlag:2&UserID:0x01010001&Time:1"); // 测试步骤 TC_CANTest SOA REQ Veh_SetSFSChanelStruct.Veh_SetSFSChanel:2&ServiceExecuteFeedbackFlag:2&UserID:0x01010001&Time:1//通道2
  g_EM_SOAClient_Swc_SOA_CHECK("Veh_SetSFSChanelRespStruct.Veh_SetSFSChanelNRC 0"); // 预期结果 TC_CANTest SOA check Veh_SetSFSChanelRespStruct.Veh_SetSFSChanelNRC 0
  g_EM_LIN_Swc_LIN_Check("C4_FRS_ChannelSelect 2 CH4"); // 预期结果 TC_LINTest LIN Check C4_FRS_ChannelSelect 2 CH4
  g_EM_SOAClient_Swc_SOA_CHECK("Veh_SFSService_ErrStruct.OpeNRC 0 traceback8"); // 预期结果 TC_CANTest SOA check Veh_SFSService_ErrStruct.OpeNRC 0 traceback8//
  g_EM_SOAClient_Swc_SOA_CHECK("Veh_SFSService_ErrStruct.OpeErrInfo[0-1]:0x00C8 traceback10"); // 预期结果 TC_CANTest SOA check Veh_SFSService_ErrStruct.OpeErrInfo[0-1]:0x00C8 traceback10//
}

testcase SYS_CDCU_xiangfen_0126()
{
  TestDescription("香氛通道选择(远控) IG OFF");
  teststep("warning","原始用例id为SYS-CDCU-香氛-0126");
  g_EM_LIN_Swc_LIN_Send("C4_FRS_active_container 0x3 CH4"); // 测试步骤 TC_LINTest LIN Send C4_FRS_active_container 0x3 CH4//ch3
  g_EM_Equipment_Swc_TC_4G_Time_Delay_Second("1"); // 测试步骤 TC_Sleep 1
  g_EM_SOAClient_Swc_SOA_CHECK_Prepare("Veh_SetSFSChanelRespStruct.Veh_SetSFSChanelNRC 0"); // 预期结果 TC_CANTest SOA check Veh_SetSFSChanelRespStruct.Veh_SetSFSChanelNRC 0
  g_EM_SOAClient_Swc_SOA_CHECK_Prepare("Veh_SFSService_ErrStruct.OpeNRC 0 traceback8"); // 预期结果 TC_CANTest SOA check Veh_SFSService_ErrStruct.OpeNRC 0 traceback8//
  g_EM_SOAClient_Swc_SOA_CHECK_Prepare("Veh_SFSService_ErrStruct.OpeErrInfo[0-1]:0x00C8 traceback10"); // 预期结果 TC_CANTest SOA check Veh_SFSService_ErrStruct.OpeErrInfo[0-1]:0x00C8 traceback10//
  g_EM_SOAClient_Swc_SOA_REQ("Veh_SetSFSChanelStruct.Veh_SetSFSChanel:3&ServiceExecuteFeedbackFlag:2&UserID:0x01010001&Time:1"); // 测试步骤 TC_CANTest SOA REQ Veh_SetSFSChanelStruct.Veh_SetSFSChanel:3&ServiceExecuteFeedbackFlag:2&UserID:0x01010001&Time:1//通道3
  g_EM_SOAClient_Swc_SOA_CHECK("Veh_SetSFSChanelRespStruct.Veh_SetSFSChanelNRC 0"); // 预期结果 TC_CANTest SOA check Veh_SetSFSChanelRespStruct.Veh_SetSFSChanelNRC 0
  g_EM_LIN_Swc_LIN_Check("C4_FRS_ChannelSelect 3 CH4"); // 预期结果 TC_LINTest LIN Check C4_FRS_ChannelSelect 3 CH4
  g_EM_SOAClient_Swc_SOA_CHECK("Veh_SFSService_ErrStruct.OpeNRC 0 traceback8"); // 预期结果 TC_CANTest SOA check Veh_SFSService_ErrStruct.OpeNRC 0 traceback8//
  g_EM_SOAClient_Swc_SOA_CHECK("Veh_SFSService_ErrStruct.OpeErrInfo[0-1]:0x00C8 traceback10"); // 预期结果 TC_CANTest SOA check Veh_SFSService_ErrStruct.OpeErrInfo[0-1]:0x00C8 traceback10//
}

testcase SYS_CDCU_xiangfen_0127()
{
  TestDescription("香氛通道选择失败 IG OFF");
  teststep("warning","原始用例id为SYS-CDCU-香氛-0127");
  g_EM_LIN_Swc_LIN_Send("C4_FRS_active_container 0x3 CH4"); // 测试步骤 TC_LINTest LIN Send C4_FRS_active_container 0x3 CH4//ch3
  g_EM_Equipment_Swc_TC_4G_Time_Delay_Second("1"); // 测试步骤 TC_Sleep 1
  g_EM_SOAClient_Swc_SOA_CHECK_Prepare("Veh_SetSFSChanelRespStruct.Veh_SetSFSChanelNRC 0"); // 预期结果 TC_CANTest SOA check Veh_SetSFSChanelRespStruct.Veh_SetSFSChanelNRC 0
  g_EM_SOAClient_Swc_SOA_CHECK_Prepare("Veh_SFSService_ErrStruct.OpeNRC 0xFFFFFFFF traceback18"); // 预期结果 TC_CANTest SOA check Veh_SFSService_ErrStruct.OpeNRC 0xFFFFFFFF traceback18
  g_EM_SOAClient_Swc_SOA_CHECK_Prepare("Veh_SFSService_ErrStruct.OpeErrInfo[0-1]:0x285C traceback8"); // 预期结果 TC_CANTest SOA check Veh_SFSService_ErrStruct.OpeErrInfo[0-1]:0x285C traceback8//
  g_EM_SOAClient_Swc_SOA_REQ("Veh_SetSFSChanelStruct.Veh_SetSFSChanel:1&ServiceExecuteFeedbackFlag:2&UserID:0x01010001&Time:1"); // 测试步骤 TC_CANTest SOA REQ Veh_SetSFSChanelStruct.Veh_SetSFSChanel:1&ServiceExecuteFeedbackFlag:2&UserID:0x01010001&Time:1//通道1
  g_EM_SOAClient_Swc_SOA_CHECK("Veh_SetSFSChanelRespStruct.Veh_SetSFSChanelNRC 0"); // 预期结果 TC_CANTest SOA check Veh_SetSFSChanelRespStruct.Veh_SetSFSChanelNRC 0
  g_EM_LIN_Swc_LIN_Check("C4_FRS_ChannelSelect 1 CH4"); // 预期结果 TC_LINTest LIN Check C4_FRS_ChannelSelect 1 CH4
  g_EM_Equipment_Swc_TC_4G_Time_Delay_Second("15"); // 测试步骤 TC_Sleep 15
  g_EM_SOAClient_Swc_SOA_CHECK("Veh_SFSService_ErrStruct.OpeNRC 0xFFFFFFFF traceback18"); // 预期结果 TC_CANTest SOA check Veh_SFSService_ErrStruct.OpeNRC 0xFFFFFFFF traceback18
  g_EM_SOAClient_Swc_SOA_CHECK("Veh_SFSService_ErrStruct.OpeErrInfo[0-1]:0x285C traceback8"); // 预期结果 TC_CANTest SOA check Veh_SFSService_ErrStruct.OpeErrInfo[0-1]:0x285C traceback8//
}

testcase SYS_CDCU_xiangfen_0128()
{
  TestDescription("香氛通道选择失败 IG OFF");
  teststep("warning","原始用例id为SYS-CDCU-香氛-0128");
  g_EM_SOAClient_Swc_SOA_CHECK_Prepare("Veh_SFSService_ErrStruct.OpeNRC 162 traceback8"); // 预期结果 TC_CANTest SOA check Veh_SFSService_ErrStruct.OpeNRC 162 traceback8
  g_EM_SOAClient_Swc_SOA_CHECK_Prepare("Veh_SFSService_ErrStruct.OpeErrInfo[0-1]:0x01A4 traceback10"); // 预期结果 TC_CANTest SOA check Veh_SFSService_ErrStruct.OpeErrInfo[0-1]:0x01A4 traceback10
  g_EM_SOAClient_Swc_SOA_REQ("Veh_SetSFSChanelStruct.Veh_SetSFSChanel:3&ReqTimeOut:20&ServiceExecuteFeedbackFlag:2&UserID:0x01010001&Time:1"); // 测试步骤 TC_CANTest SOA REQ Veh_SetSFSChanelStruct.Veh_SetSFSChanel:3&ReqTimeOut:20&ServiceExecuteFeedbackFlag:2&UserID:0x01010001&Time:1//通道3
  g_EM_SOAClient_Swc_SOA_CHECK("Veh_SFSService_ErrStruct.OpeNRC 162 traceback8"); // 预期结果 TC_CANTest SOA check Veh_SFSService_ErrStruct.OpeNRC 162 traceback8
  g_EM_Equipment_Swc_TC_4G_Time_Delay_Second("2"); // 测试步骤 TC_Sleep 2
  g_EM_SOAClient_Swc_SOA_CHECK("Veh_SFSService_ErrStruct.OpeErrInfo[0-1]:0x01A4 traceback10"); // 预期结果 TC_CANTest SOA check Veh_SFSService_ErrStruct.OpeErrInfo[0-1]:0x01A4 traceback10
}

testcase SYS_CDCU_xiangfen_0129()
{
  TestDescription("香氛通道选择失败 IG OFF");
  teststep("warning","原始用例id为SYS-CDCU-香氛-0129");
  g_CAN_Bus_Swc_Set("C_LDCU_SysSt.C_LDCU_EVSysReadySt 0"); // 测试步骤 TC_CANTest SET C_LDCU_SysSt.C_LDCU_EVSysReadySt 0//下高压
  g_EM_Equipment_Swc_TC_4G_Time_Delay_Second("2"); // 测试步骤 TC_Sleep 2
  g_EM_SOAClient_Swc_SOA_CHECK_Prepare("Veh_SFSService_ErrStruct.OpeNRC 4 traceback17"); // 预期结果 TC_CANTest SOA check Veh_SFSService_ErrStruct.OpeNRC 4 traceback17
  g_EM_SOAClient_Swc_SOA_CHECK_Prepare("Veh_SFSService_ErrStruct.OpeErrInfo[0-1]:0x6 traceback18"); // 预期结果 TC_CANTest SOA check Veh_SFSService_ErrStruct.OpeErrInfo[0-1]:0x6 traceback18
  g_EM_SOAClient_Swc_SOA_REQ("Veh_SetSFSChanelStruct.Veh_SetSFSChanel:3&ServiceExecuteFeedbackFlag:2&UserID:0x01010001&Time:1"); // 测试步骤 TC_CANTest SOA REQ Veh_SetSFSChanelStruct.Veh_SetSFSChanel:3&ServiceExecuteFeedbackFlag:2&UserID:0x01010001&Time:1//通道3
  g_EM_Equipment_Swc_TC_4G_Time_Delay_Second("15"); // 测试步骤 TC_Sleep 15
  g_EM_SOAClient_Swc_SOA_CHECK("Veh_SFSService_ErrStruct.OpeNRC 4 traceback17"); // 预期结果 TC_CANTest SOA check Veh_SFSService_ErrStruct.OpeNRC 4 traceback17
  g_EM_SOAClient_Swc_SOA_CHECK("Veh_SFSService_ErrStruct.OpeErrInfo[0-1]:0x6 traceback18"); // 预期结果 TC_CANTest SOA check Veh_SFSService_ErrStruct.OpeErrInfo[0-1]:0x6 traceback18
}

testcase SYS_CDCU_xiangfen_0130()
{
  TestDescription("香氛通道选择(当前active通道0)浓度记忆10通道选择3 IG OFF");
  teststep("warning","原始用例id为SYS-CDCU-香氛-0130");
  g_EM_Equipment_Swc_TC_IG("ON"); // 测试步骤 TC_IG ON
  g_EM_Equipment_Swc_TC_4G_Time_Delay_Second("1"); // 测试步骤 TC_Sleep 1
  g_EM_Equipment_Swc_TC_IG("OFF"); // 测试步骤 TC_IG OFF
  g_CAN_Bus_Swc_Set("I_LDCU_BodySysSt1.I_LDCU_PowerMode 0"); // 测试步骤 TC_CANTest SET I_LDCU_BodySysSt1.I_LDCU_PowerMode 0
  g_EM_Equipment_Swc_TC_4G_Time_Delay_Second("1"); // 测试步骤 TC_Sleep 1
  g_CAN_Bus_Swc_Set("I_LDCU_NM.I_LDCU_NMRepeatMsgReqBit 1"); // 测试步骤 TC_CANTest SET I_LDCU_NM.I_LDCU_NMRepeatMsgReqBit 1//网络唤醒维持帧
  g_CAN_Bus_Swc_Set("C_LDCU_SysSt.C_LDCU_EVSysReadySt 2"); // 测试步骤 TC_CANTest SET C_LDCU_SysSt.C_LDCU_EVSysReadySt 2//高压
  g_EM_LIN_Swc_LIN_Send("C4_FRS_CurrentIntensity 10 CH4"); // 测试步骤 TC_LINTest LIN Send C4_FRS_CurrentIntensity 10 CH4
  g_EM_Equipment_Swc_TC_4G_Time_Delay_Second("1"); // 测试步骤 TC_Sleep 1
  g_EM_SOAClient_Swc_SOA_CHECK_Prepare("Veh_SetSFSConRespStruct.Veh_SetSFSConNRC 0"); // 预期结果 TC_CANTest SOA check Veh_SetSFSConRespStruct.Veh_SetSFSConNRC 0
  g_EM_SOAClient_Swc_SOA_CHECK_Prepare("Veh_SFSService_ErrStruct.OpeNRC 0 traceback8"); // 预期结果 TC_CANTest SOA check Veh_SFSService_ErrStruct.OpeNRC 0 traceback8//
  g_EM_SOAClient_Swc_SOA_REQ("Veh_SetSFSConStruct.Veh_SetSFSCon:2&ServiceExecuteFeedbackFlag:2&MemoryReq:1&UserID:0x01010001"); // 测试步骤 TC_CANTest SOA REQ Veh_SetSFSConStruct.Veh_SetSFSCon:2&ServiceExecuteFeedbackFlag:2&MemoryReq:1&UserID:0x01010001//High
  g_EM_SOAClient_Swc_SOA_CHECK("Veh_SetSFSConRespStruct.Veh_SetSFSConNRC 0"); // 预期结果 TC_CANTest SOA check Veh_SetSFSConRespStruct.Veh_SetSFSConNRC 0
  g_EM_LIN_Swc_LIN_Check("C4_FRS_IntensityReq 10 CH4"); // 预期结果 TC_LINTest LIN Check C4_FRS_IntensityReq 10 CH4
  g_EM_SOAClient_Swc_SOA_CHECK("Veh_SFSService_ErrStruct.OpeNRC 0 traceback8"); // 预期结果 TC_CANTest SOA check Veh_SFSService_ErrStruct.OpeNRC 0 traceback8//
  g_EM_LIN_Swc_LIN_Send("C4_FRS_active_container 0x0 CH4"); // 测试步骤 TC_LINTest LIN Send C4_FRS_active_container 0x0 CH4//ch3
  g_EM_LIN_Swc_LIN_Send("C4_FRS_CurrentIntensity 0 CH4"); // 测试步骤 TC_LINTest LIN Send C4_FRS_CurrentIntensity 0 CH4//引擎转发香氛通道真实值-closed
  g_EM_Equipment_Swc_TC_4G_Time_Delay_Second("1"); // 测试步骤 TC_Sleep 1
  g_EM_SOAClient_Swc_SOA_CHECK_Prepare("Veh_SetSFSChanelRespStruct.Veh_SetSFSChanelNRC 0"); // 预期结果 TC_CANTest SOA check Veh_SetSFSChanelRespStruct.Veh_SetSFSChanelNRC 0
  g_EM_SOAClient_Swc_SOA_CHECK_Prepare("Veh_SFSService_ErrStruct.OpeNRC 0 traceback8"); // 预期结果 TC_CANTest SOA check Veh_SFSService_ErrStruct.OpeNRC 0 traceback8//
  g_EM_SOAClient_Swc_SOA_REQ("Veh_SetSFSChanelStruct.Veh_SetSFSChanel:3&ServiceExecuteFeedbackFlag:2&MemoryReq:1&UserID:0x01010001&Time:10"); // 测试步骤 TC_CANTest SOA REQ Veh_SetSFSChanelStruct.Veh_SetSFSChanel:3&ServiceExecuteFeedbackFlag:2&MemoryReq:1&UserID:0x01010001&Time:10//通道3
  g_EM_SOAClient_Swc_SOA_CHECK("Veh_SetSFSChanelRespStruct.Veh_SetSFSChanelNRC 0"); // 预期结果 TC_CANTest SOA check Veh_SetSFSChanelRespStruct.Veh_SetSFSChanelNRC 0
  g_EM_LIN_Swc_LIN_Check("C4_FRS_ChannelSelect 3 CH4"); // 预期结果 TC_LINTest LIN Check C4_FRS_ChannelSelect 3 CH4
  g_EM_LIN_Swc_LIN_Send("C4_FRS_active_container 0x3 CH4"); // 测试步骤 TC_LINTest LIN Send C4_FRS_active_container 0x3 CH4//ch3
  g_EM_LIN_Swc_LIN_Check("C4_FRS_IntensityReq 10 CH4"); // 预期结果 TC_LINTest LIN Check C4_FRS_IntensityReq 10 CH4
  g_EM_LIN_Swc_LIN_Send("C4_FRS_CurrentIntensity 10 CH4"); // 测试步骤 TC_LINTest LIN Send C4_FRS_CurrentIntensity 10 CH4//引擎转发香氛通道真实值-10
  g_EM_SOAClient_Swc_SOA_CHECK("Veh_SFSService_ErrStruct.OpeNRC 0 traceback8"); // 预期结果 TC_CANTest SOA check Veh_SFSService_ErrStruct.OpeNRC 0 traceback8//
}

testcase SYS_CDCU_xiangfen_0131()
{
  TestDescription("香氛通道选择(当前active通道0)浓度记忆10通道选择2 IG OFF");
  teststep("warning","原始用例id为SYS-CDCU-香氛-0131");
  g_EM_LIN_Swc_LIN_Send("C4_FRS_active_container 0x0 CH4"); // 测试步骤 TC_LINTest LIN Send C4_FRS_active_container 0x0 CH4//ch3
  g_EM_LIN_Swc_LIN_Send("C4_FRS_CurrentIntensity 0 CH4"); // 测试步骤 TC_LINTest LIN Send C4_FRS_CurrentIntensity 0 CH4//引擎转发香氛通道真实值-closed
  g_EM_Equipment_Swc_TC_4G_Time_Delay_Second("1"); // 测试步骤 TC_Sleep 1
  g_EM_SOAClient_Swc_SOA_CHECK_Prepare("Veh_SetSFSChanelRespStruct.Veh_SetSFSChanelNRC 0"); // 预期结果 TC_CANTest SOA check Veh_SetSFSChanelRespStruct.Veh_SetSFSChanelNRC 0
  g_EM_SOAClient_Swc_SOA_CHECK_Prepare("Veh_SFSService_ErrStruct.OpeNRC 0 traceback8"); // 预期结果 TC_CANTest SOA check Veh_SFSService_ErrStruct.OpeNRC 0 traceback8//
  g_EM_SOAClient_Swc_SOA_REQ("Veh_SetSFSChanelStruct.Veh_SetSFSChanel:2&ServiceExecuteFeedbackFlag:2&MemoryReq:1&UserID:0x01010001&Time:10"); // 测试步骤 TC_CANTest SOA REQ Veh_SetSFSChanelStruct.Veh_SetSFSChanel:2&ServiceExecuteFeedbackFlag:2&MemoryReq:1&UserID:0x01010001&Time:10//通道3
  g_EM_SOAClient_Swc_SOA_CHECK("Veh_SetSFSChanelRespStruct.Veh_SetSFSChanelNRC 0"); // 预期结果 TC_CANTest SOA check Veh_SetSFSChanelRespStruct.Veh_SetSFSChanelNRC 0
  g_EM_LIN_Swc_LIN_Check("C4_FRS_ChannelSelect 2 CH4"); // 预期结果 TC_LINTest LIN Check C4_FRS_ChannelSelect 2 CH4
  g_EM_LIN_Swc_LIN_Send("C4_FRS_active_container 0x2 CH4"); // 测试步骤 TC_LINTest LIN Send C4_FRS_active_container 0x2 CH4//ch3
  g_EM_LIN_Swc_LIN_Check("C4_FRS_IntensityReq 10 CH4"); // 预期结果 TC_LINTest LIN Check C4_FRS_IntensityReq 10 CH4
  g_EM_LIN_Swc_LIN_Send("C4_FRS_CurrentIntensity 10 CH4"); // 测试步骤 TC_LINTest LIN Send C4_FRS_CurrentIntensity 10 CH4//引擎转发香氛通道真实值-10
  g_EM_SOAClient_Swc_SOA_CHECK("Veh_SFSService_ErrStruct.OpeNRC 0 traceback8"); // 预期结果 TC_CANTest SOA check Veh_SFSService_ErrStruct.OpeNRC 0 traceback8//
}

testcase SYS_CDCU_xiangfen_0132()
{
  TestDescription("香氛通道选择(当前active通道0)浓度记忆10通道选择1 IG OFF");
  teststep("warning","原始用例id为SYS-CDCU-香氛-0132");
  g_EM_LIN_Swc_LIN_Send("C4_FRS_active_container 0x0 CH4"); // 测试步骤 TC_LINTest LIN Send C4_FRS_active_container 0x0 CH4//ch3
  g_EM_LIN_Swc_LIN_Send("C4_FRS_CurrentIntensity 0 CH4"); // 测试步骤 TC_LINTest LIN Send C4_FRS_CurrentIntensity 0 CH4//引擎转发香氛通道真实值-closed
  g_EM_Equipment_Swc_TC_4G_Time_Delay_Second("1"); // 测试步骤 TC_Sleep 1
  g_EM_SOAClient_Swc_SOA_CHECK_Prepare("Veh_SetSFSChanelRespStruct.Veh_SetSFSChanelNRC 0"); // 预期结果 TC_CANTest SOA check Veh_SetSFSChanelRespStruct.Veh_SetSFSChanelNRC 0
  g_EM_SOAClient_Swc_SOA_CHECK_Prepare("Veh_SFSService_ErrStruct.OpeNRC 0 traceback8"); // 预期结果 TC_CANTest SOA check Veh_SFSService_ErrStruct.OpeNRC 0 traceback8//
  g_EM_SOAClient_Swc_SOA_REQ("Veh_SetSFSChanelStruct.Veh_SetSFSChanel:1&ServiceExecuteFeedbackFlag:2&MemoryReq:1&UserID:0x01010001&Time:10"); // 测试步骤 TC_CANTest SOA REQ Veh_SetSFSChanelStruct.Veh_SetSFSChanel:1&ServiceExecuteFeedbackFlag:2&MemoryReq:1&UserID:0x01010001&Time:10//通道3
  g_EM_SOAClient_Swc_SOA_CHECK("Veh_SetSFSChanelRespStruct.Veh_SetSFSChanelNRC 0"); // 预期结果 TC_CANTest SOA check Veh_SetSFSChanelRespStruct.Veh_SetSFSChanelNRC 0
  g_EM_LIN_Swc_LIN_Check("C4_FRS_ChannelSelect 1 CH4"); // 预期结果 TC_LINTest LIN Check C4_FRS_ChannelSelect 1 CH4
  g_EM_LIN_Swc_LIN_Send("C4_FRS_active_container 0x1 CH4"); // 测试步骤 TC_LINTest LIN Send C4_FRS_active_container 0x1 CH4//ch3
  g_EM_LIN_Swc_LIN_Check("C4_FRS_IntensityReq 10 CH4"); // 预期结果 TC_LINTest LIN Check C4_FRS_IntensityReq 10 CH4
  g_EM_LIN_Swc_LIN_Send("C4_FRS_CurrentIntensity 10 CH4"); // 测试步骤 TC_LINTest LIN Send C4_FRS_CurrentIntensity 10 CH4//引擎转发香氛通道真实值-10
  g_EM_SOAClient_Swc_SOA_CHECK("Veh_SFSService_ErrStruct.OpeNRC 0 traceback8"); // 预期结果 TC_CANTest SOA check Veh_SFSService_ErrStruct.OpeNRC 0 traceback8//
}

testcase SYS_CDCU_xiangfen_0133()
{
  TestDescription("香氛通道选择(当前active通道0)浓度记忆3 IG OFF");
  teststep("warning","原始用例id为SYS-CDCU-香氛-0133");
  g_EM_LIN_Swc_LIN_Send("C4_FRS_CurrentIntensity 3 CH4"); // 测试步骤 TC_LINTest LIN Send C4_FRS_CurrentIntensity 3 CH4
  g_EM_Equipment_Swc_TC_4G_Time_Delay_Second("1"); // 测试步骤 TC_Sleep 1
  g_EM_SOAClient_Swc_SOA_CHECK_Prepare("Veh_SetSFSConRespStruct.Veh_SetSFSConNRC 0"); // 预期结果 TC_CANTest SOA check Veh_SetSFSConRespStruct.Veh_SetSFSConNRC 0
  g_EM_SOAClient_Swc_SOA_CHECK_Prepare("Veh_SFSService_ErrStruct.OpeNRC 0 traceback8"); // 预期结果 TC_CANTest SOA check Veh_SFSService_ErrStruct.OpeNRC 0 traceback8//
  g_EM_SOAClient_Swc_SOA_REQ("Veh_SetSFSConStruct.Veh_SetSFSCon:1&ServiceExecuteFeedbackFlag:2&MemoryReq:1&UserID:0x01010001"); // 测试步骤 TC_CANTest SOA REQ Veh_SetSFSConStruct.Veh_SetSFSCon:1&ServiceExecuteFeedbackFlag:2&MemoryReq:1&UserID:0x01010001//High
  g_EM_SOAClient_Swc_SOA_CHECK("Veh_SetSFSConRespStruct.Veh_SetSFSConNRC 0"); // 预期结果 TC_CANTest SOA check Veh_SetSFSConRespStruct.Veh_SetSFSConNRC 0
  g_EM_LIN_Swc_LIN_Check("C4_FRS_IntensityReq 3 CH4"); // 预期结果 TC_LINTest LIN Check C4_FRS_IntensityReq 3 CH4
  g_EM_SOAClient_Swc_SOA_CHECK("Veh_SFSService_ErrStruct.OpeNRC 0 traceback8"); // 预期结果 TC_CANTest SOA check Veh_SFSService_ErrStruct.OpeNRC 0 traceback8//
  g_EM_LIN_Swc_LIN_Send("C4_FRS_active_container 0x0 CH4"); // 测试步骤 TC_LINTest LIN Send C4_FRS_active_container 0x0 CH4//ch3
  g_EM_LIN_Swc_LIN_Send("C4_FRS_CurrentIntensity 0 CH4"); // 测试步骤 TC_LINTest LIN Send C4_FRS_CurrentIntensity 0 CH4//引擎转发香氛通道真实值-closed
  g_EM_Equipment_Swc_TC_4G_Time_Delay_Second("1"); // 测试步骤 TC_Sleep 1
  g_EM_SOAClient_Swc_SOA_CHECK_Prepare("Veh_SetSFSChanelRespStruct.Veh_SetSFSChanelNRC 0"); // 预期结果 TC_CANTest SOA check Veh_SetSFSChanelRespStruct.Veh_SetSFSChanelNRC 0
  g_EM_SOAClient_Swc_SOA_CHECK_Prepare("Veh_SFSService_ErrStruct.OpeNRC 0 traceback8"); // 预期结果 TC_CANTest SOA check Veh_SFSService_ErrStruct.OpeNRC 0 traceback8//
  g_EM_SOAClient_Swc_SOA_REQ("Veh_SetSFSChanelStruct.Veh_SetSFSChanel:3&ServiceExecuteFeedbackFlag:2&MemoryReq:1&UserID:0x01010001&Time:10"); // 测试步骤 TC_CANTest SOA REQ Veh_SetSFSChanelStruct.Veh_SetSFSChanel:3&ServiceExecuteFeedbackFlag:2&MemoryReq:1&UserID:0x01010001&Time:10//通道3
  g_EM_SOAClient_Swc_SOA_CHECK("Veh_SetSFSChanelRespStruct.Veh_SetSFSChanelNRC 0"); // 预期结果 TC_CANTest SOA check Veh_SetSFSChanelRespStruct.Veh_SetSFSChanelNRC 0
  g_EM_LIN_Swc_LIN_Check("C4_FRS_ChannelSelect 3 CH4"); // 预期结果 TC_LINTest LIN Check C4_FRS_ChannelSelect 3 CH4
  g_EM_LIN_Swc_LIN_Send("C4_FRS_active_container 0x3 CH4"); // 测试步骤 TC_LINTest LIN Send C4_FRS_active_container 0x3 CH4//ch3
  g_EM_LIN_Swc_LIN_Check("C4_FRS_IntensityReq 3 CH4"); // 预期结果 TC_LINTest LIN Check C4_FRS_IntensityReq 3 CH4
  g_EM_LIN_Swc_LIN_Send("C4_FRS_CurrentIntensity 3 CH4"); // 测试步骤 TC_LINTest LIN Send C4_FRS_CurrentIntensity 3 CH4//引擎转发香氛通道真实值-3
  g_EM_SOAClient_Swc_SOA_CHECK("Veh_SFSService_ErrStruct.OpeNRC 0 traceback8"); // 预期结果 TC_CANTest SOA check Veh_SFSService_ErrStruct.OpeNRC 0 traceback8//
}

testcase SYS_CDCU_xiangfen_0134()
{
  TestDescription("香氛通道选择(当前active通道0)浓度记忆3通道选择2 IG OFF");
  teststep("warning","原始用例id为SYS-CDCU-香氛-0134");
  g_EM_LIN_Swc_LIN_Send("C4_FRS_active_container 0x0 CH4"); // 测试步骤 TC_LINTest LIN Send C4_FRS_active_container 0x0 CH4//ch3
  g_EM_LIN_Swc_LIN_Send("C4_FRS_CurrentIntensity 0 CH4"); // 测试步骤 TC_LINTest LIN Send C4_FRS_CurrentIntensity 0 CH4//引擎转发香氛通道真实值-closed
  g_EM_Equipment_Swc_TC_4G_Time_Delay_Second("1"); // 测试步骤 TC_Sleep 1
  g_EM_SOAClient_Swc_SOA_CHECK_Prepare("Veh_SetSFSChanelRespStruct.Veh_SetSFSChanelNRC 0"); // 预期结果 TC_CANTest SOA check Veh_SetSFSChanelRespStruct.Veh_SetSFSChanelNRC 0
  g_EM_SOAClient_Swc_SOA_CHECK_Prepare("Veh_SFSService_ErrStruct.OpeNRC 0 traceback8"); // 预期结果 TC_CANTest SOA check Veh_SFSService_ErrStruct.OpeNRC 0 traceback8//
  g_EM_SOAClient_Swc_SOA_REQ("Veh_SetSFSChanelStruct.Veh_SetSFSChanel:2&ServiceExecuteFeedbackFlag:2&MemoryReq:1&UserID:0x01010001&Time:10"); // 测试步骤 TC_CANTest SOA REQ Veh_SetSFSChanelStruct.Veh_SetSFSChanel:2&ServiceExecuteFeedbackFlag:2&MemoryReq:1&UserID:0x01010001&Time:10//通道3
  g_EM_SOAClient_Swc_SOA_CHECK("Veh_SetSFSChanelRespStruct.Veh_SetSFSChanelNRC 0"); // 预期结果 TC_CANTest SOA check Veh_SetSFSChanelRespStruct.Veh_SetSFSChanelNRC 0
  g_EM_LIN_Swc_LIN_Check("C4_FRS_ChannelSelect 2 CH4"); // 预期结果 TC_LINTest LIN Check C4_FRS_ChannelSelect 2 CH4
  g_EM_LIN_Swc_LIN_Send("C4_FRS_active_container 0x2 CH4"); // 测试步骤 TC_LINTest LIN Send C4_FRS_active_container 0x2 CH4//ch3
  g_EM_LIN_Swc_LIN_Check("C4_FRS_IntensityReq 3 CH4"); // 预期结果 TC_LINTest LIN Check C4_FRS_IntensityReq 3 CH4
  g_EM_LIN_Swc_LIN_Send("C4_FRS_CurrentIntensity 3 CH4"); // 测试步骤 TC_LINTest LIN Send C4_FRS_CurrentIntensity 3 CH4//引擎转发香氛通道真实值-3
  g_EM_SOAClient_Swc_SOA_CHECK("Veh_SFSService_ErrStruct.OpeNRC 0 traceback8"); // 预期结果 TC_CANTest SOA check Veh_SFSService_ErrStruct.OpeNRC 0 traceback8//
}

testcase SYS_CDCU_xiangfen_0135()
{
  TestDescription("香氛通道选择(当前active通道0)浓度记忆3通道选择1 IG OFF");
  teststep("warning","原始用例id为SYS-CDCU-香氛-0135");
  g_EM_LIN_Swc_LIN_Send("C4_FRS_active_container 0x0 CH4"); // 测试步骤 TC_LINTest LIN Send C4_FRS_active_container 0x0 CH4//ch3
  g_EM_LIN_Swc_LIN_Send("C4_FRS_CurrentIntensity 0 CH4"); // 测试步骤 TC_LINTest LIN Send C4_FRS_CurrentIntensity 0 CH4//引擎转发香氛通道真实值-closed
  g_EM_Equipment_Swc_TC_4G_Time_Delay_Second("1"); // 测试步骤 TC_Sleep 1
  g_EM_SOAClient_Swc_SOA_CHECK_Prepare("Veh_SetSFSChanelRespStruct.Veh_SetSFSChanelNRC 0"); // 预期结果 TC_CANTest SOA check Veh_SetSFSChanelRespStruct.Veh_SetSFSChanelNRC 0
  g_EM_SOAClient_Swc_SOA_CHECK_Prepare("Veh_SFSService_ErrStruct.OpeNRC 0 traceback8"); // 预期结果 TC_CANTest SOA check Veh_SFSService_ErrStruct.OpeNRC 0 traceback8//
  g_EM_SOAClient_Swc_SOA_REQ("Veh_SetSFSChanelStruct.Veh_SetSFSChanel:1&ServiceExecuteFeedbackFlag:2&MemoryReq:1&UserID:0x01010001&Time:10"); // 测试步骤 TC_CANTest SOA REQ Veh_SetSFSChanelStruct.Veh_SetSFSChanel:1&ServiceExecuteFeedbackFlag:2&MemoryReq:1&UserID:0x01010001&Time:10//通道3
  g_EM_SOAClient_Swc_SOA_CHECK("Veh_SetSFSChanelRespStruct.Veh_SetSFSChanelNRC 0"); // 预期结果 TC_CANTest SOA check Veh_SetSFSChanelRespStruct.Veh_SetSFSChanelNRC 0
  g_EM_LIN_Swc_LIN_Check("C4_FRS_ChannelSelect 1 CH4"); // 预期结果 TC_LINTest LIN Check C4_FRS_ChannelSelect 1 CH4
  g_EM_LIN_Swc_LIN_Send("C4_FRS_active_container 0x1 CH4"); // 测试步骤 TC_LINTest LIN Send C4_FRS_active_container 0x1 CH4//ch3
  g_EM_LIN_Swc_LIN_Check("C4_FRS_IntensityReq 3 CH4"); // 预期结果 TC_LINTest LIN Check C4_FRS_IntensityReq 3 CH4
  g_EM_LIN_Swc_LIN_Send("C4_FRS_CurrentIntensity 3 CH4"); // 测试步骤 TC_LINTest LIN Send C4_FRS_CurrentIntensity 3 CH4//引擎转发香氛通道真实值-3
  g_EM_SOAClient_Swc_SOA_CHECK("Veh_SFSService_ErrStruct.OpeNRC 0 traceback8"); // 预期结果 TC_CANTest SOA check Veh_SFSService_ErrStruct.OpeNRC 0 traceback8//
}

testcase SYS_CDCU_xiangfen_0136()
{
  TestDescription("香氛通道选择(当前active通道0)浓度记忆6 IG OFF");
  teststep("warning","原始用例id为SYS-CDCU-香氛-0136");
  g_EM_LIN_Swc_LIN_Send("C4_FRS_CurrentIntensity 3 CH4"); // 测试步骤 TC_LINTest LIN Send C4_FRS_CurrentIntensity 3 CH4
  g_EM_Equipment_Swc_TC_4G_Time_Delay_Second("1"); // 测试步骤 TC_Sleep 1
  g_EM_SOAClient_Swc_SOA_CHECK_Prepare("Veh_SetSFSConRespStruct.Veh_SetSFSConNRC 0"); // 预期结果 TC_CANTest SOA check Veh_SetSFSConRespStruct.Veh_SetSFSConNRC 0
  g_EM_SOAClient_Swc_SOA_CHECK_Prepare("Veh_SFSService_ErrStruct.OpeNRC 0 traceback8"); // 预期结果 TC_CANTest SOA check Veh_SFSService_ErrStruct.OpeNRC 0 traceback8//
  g_EM_SOAClient_Swc_SOA_REQ("Veh_SetSFSConStruct.Veh_SetSFSCon:3&ServiceExecuteFeedbackFlag:2&MemoryReq:1&UserID:0x01010001"); // 测试步骤 TC_CANTest SOA REQ Veh_SetSFSConStruct.Veh_SetSFSCon:3&ServiceExecuteFeedbackFlag:2&MemoryReq:1&UserID:0x01010001//High
  g_EM_SOAClient_Swc_SOA_CHECK("Veh_SetSFSConRespStruct.Veh_SetSFSConNRC 0"); // 预期结果 TC_CANTest SOA check Veh_SetSFSConRespStruct.Veh_SetSFSConNRC 0
  g_EM_LIN_Swc_LIN_Check("C4_FRS_IntensityReq 6 CH4"); // 预期结果 TC_LINTest LIN Check C4_FRS_IntensityReq 6 CH4
  g_EM_SOAClient_Swc_SOA_CHECK("Veh_SFSService_ErrStruct.OpeNRC 0 traceback8"); // 预期结果 TC_CANTest SOA check Veh_SFSService_ErrStruct.OpeNRC 0 traceback8//
  g_EM_LIN_Swc_LIN_Send("C4_FRS_active_container 0x0 CH4"); // 测试步骤 TC_LINTest LIN Send C4_FRS_active_container 0x0 CH4//ch3
  g_EM_LIN_Swc_LIN_Send("C4_FRS_CurrentIntensity 0 CH4"); // 测试步骤 TC_LINTest LIN Send C4_FRS_CurrentIntensity 0 CH4//引擎转发香氛通道真实值-closed
  g_EM_Equipment_Swc_TC_4G_Time_Delay_Second("1"); // 测试步骤 TC_Sleep 1
  g_EM_SOAClient_Swc_SOA_CHECK_Prepare("Veh_SetSFSChanelRespStruct.Veh_SetSFSChanelNRC 0"); // 预期结果 TC_CANTest SOA check Veh_SetSFSChanelRespStruct.Veh_SetSFSChanelNRC 0
  g_EM_SOAClient_Swc_SOA_CHECK_Prepare("Veh_SFSService_ErrStruct.OpeNRC 0 traceback8"); // 预期结果 TC_CANTest SOA check Veh_SFSService_ErrStruct.OpeNRC 0 traceback8//
  g_EM_SOAClient_Swc_SOA_REQ("Veh_SetSFSChanelStruct.Veh_SetSFSChanel:3&ServiceExecuteFeedbackFlag:2&MemoryReq:1&UserID:0x01010001&Time:10"); // 测试步骤 TC_CANTest SOA REQ Veh_SetSFSChanelStruct.Veh_SetSFSChanel:3&ServiceExecuteFeedbackFlag:2&MemoryReq:1&UserID:0x01010001&Time:10//通道3
  g_EM_SOAClient_Swc_SOA_CHECK("Veh_SetSFSChanelRespStruct.Veh_SetSFSChanelNRC 0"); // 预期结果 TC_CANTest SOA check Veh_SetSFSChanelRespStruct.Veh_SetSFSChanelNRC 0
  g_EM_LIN_Swc_LIN_Check("C4_FRS_ChannelSelect 3 CH4"); // 预期结果 TC_LINTest LIN Check C4_FRS_ChannelSelect 3 CH4
  g_EM_LIN_Swc_LIN_Send("C4_FRS_active_container 0x3 CH4"); // 测试步骤 TC_LINTest LIN Send C4_FRS_active_container 0x3 CH4//ch3
  g_EM_LIN_Swc_LIN_Check("C4_FRS_IntensityReq 6 CH4"); // 预期结果 TC_LINTest LIN Check C4_FRS_IntensityReq 6 CH4
  g_EM_LIN_Swc_LIN_Send("C4_FRS_CurrentIntensity 6 CH4"); // 测试步骤 TC_LINTest LIN Send C4_FRS_CurrentIntensity 6 CH4//引擎转发香氛通道真实值-3
  g_EM_SOAClient_Swc_SOA_CHECK("Veh_SFSService_ErrStruct.OpeNRC 0 traceback8"); // 预期结果 TC_CANTest SOA check Veh_SFSService_ErrStruct.OpeNRC 0 traceback8//
}

testcase SYS_CDCU_xiangfen_0137()
{
  TestDescription("香氛通道选择(当前active通道0)浓度记忆6通道选择2 IG OFF");
  teststep("warning","原始用例id为SYS-CDCU-香氛-0137");
  g_EM_LIN_Swc_LIN_Send("C4_FRS_active_container 0x0 CH4"); // 测试步骤 TC_LINTest LIN Send C4_FRS_active_container 0x0 CH4//ch3
  g_EM_LIN_Swc_LIN_Send("C4_FRS_CurrentIntensity 0 CH4"); // 测试步骤 TC_LINTest LIN Send C4_FRS_CurrentIntensity 0 CH4//引擎转发香氛通道真实值-closed
  g_EM_Equipment_Swc_TC_4G_Time_Delay_Second("1"); // 测试步骤 TC_Sleep 1
  g_EM_SOAClient_Swc_SOA_CHECK_Prepare("Veh_SetSFSChanelRespStruct.Veh_SetSFSChanelNRC 0"); // 预期结果 TC_CANTest SOA check Veh_SetSFSChanelRespStruct.Veh_SetSFSChanelNRC 0
  g_EM_SOAClient_Swc_SOA_CHECK_Prepare("Veh_SFSService_ErrStruct.OpeNRC 0 traceback8"); // 预期结果 TC_CANTest SOA check Veh_SFSService_ErrStruct.OpeNRC 0 traceback8//
  g_EM_SOAClient_Swc_SOA_REQ("Veh_SetSFSChanelStruct.Veh_SetSFSChanel:2&ServiceExecuteFeedbackFlag:2&MemoryReq:1&UserID:0x01010001&Time:10"); // 测试步骤 TC_CANTest SOA REQ Veh_SetSFSChanelStruct.Veh_SetSFSChanel:2&ServiceExecuteFeedbackFlag:2&MemoryReq:1&UserID:0x01010001&Time:10//通道3
  g_EM_SOAClient_Swc_SOA_CHECK("Veh_SetSFSChanelRespStruct.Veh_SetSFSChanelNRC 0"); // 预期结果 TC_CANTest SOA check Veh_SetSFSChanelRespStruct.Veh_SetSFSChanelNRC 0
  g_EM_LIN_Swc_LIN_Check("C4_FRS_ChannelSelect 2 CH4"); // 预期结果 TC_LINTest LIN Check C4_FRS_ChannelSelect 2 CH4
  g_EM_LIN_Swc_LIN_Send("C4_FRS_active_container 0x2 CH4"); // 测试步骤 TC_LINTest LIN Send C4_FRS_active_container 0x2 CH4//ch3
  g_EM_LIN_Swc_LIN_Check("C4_FRS_IntensityReq 6 CH4"); // 预期结果 TC_LINTest LIN Check C4_FRS_IntensityReq 6 CH4
  g_EM_LIN_Swc_LIN_Send("C4_FRS_CurrentIntensity 6 CH4"); // 测试步骤 TC_LINTest LIN Send C4_FRS_CurrentIntensity 6 CH4//引擎转发香氛通道真实值-3
  g_EM_SOAClient_Swc_SOA_CHECK("Veh_SFSService_ErrStruct.OpeNRC 0 traceback8"); // 预期结果 TC_CANTest SOA check Veh_SFSService_ErrStruct.OpeNRC 0 traceback8//
}

testcase SYS_CDCU_xiangfen_0138()
{
  TestDescription("香氛通道选择(当前active通道0)浓度记忆6通道选择1 IG OFF");
  teststep("warning","原始用例id为SYS-CDCU-香氛-0138");
  g_EM_LIN_Swc_LIN_Send("C4_FRS_active_container 0x0 CH4"); // 测试步骤 TC_LINTest LIN Send C4_FRS_active_container 0x0 CH4//ch3
  g_EM_LIN_Swc_LIN_Send("C4_FRS_CurrentIntensity 0 CH4"); // 测试步骤 TC_LINTest LIN Send C4_FRS_CurrentIntensity 0 CH4//引擎转发香氛通道真实值-closed
  g_EM_Equipment_Swc_TC_4G_Time_Delay_Second("1"); // 测试步骤 TC_Sleep 1
  g_EM_SOAClient_Swc_SOA_CHECK_Prepare("Veh_SetSFSChanelRespStruct.Veh_SetSFSChanelNRC 0"); // 预期结果 TC_CANTest SOA check Veh_SetSFSChanelRespStruct.Veh_SetSFSChanelNRC 0
  g_EM_SOAClient_Swc_SOA_CHECK_Prepare("Veh_SFSService_ErrStruct.OpeNRC 0 traceback8"); // 预期结果 TC_CANTest SOA check Veh_SFSService_ErrStruct.OpeNRC 0 traceback8//
  g_EM_SOAClient_Swc_SOA_REQ("Veh_SetSFSChanelStruct.Veh_SetSFSChanel:1&ServiceExecuteFeedbackFlag:2&MemoryReq:1&UserID:0x01010001&Time:10"); // 测试步骤 TC_CANTest SOA REQ Veh_SetSFSChanelStruct.Veh_SetSFSChanel:1&ServiceExecuteFeedbackFlag:2&MemoryReq:1&UserID:0x01010001&Time:10//通道3
  g_EM_SOAClient_Swc_SOA_CHECK("Veh_SetSFSChanelRespStruct.Veh_SetSFSChanelNRC 0"); // 预期结果 TC_CANTest SOA check Veh_SetSFSChanelRespStruct.Veh_SetSFSChanelNRC 0
  g_EM_LIN_Swc_LIN_Check("C4_FRS_ChannelSelect 1 CH4"); // 预期结果 TC_LINTest LIN Check C4_FRS_ChannelSelect 1 CH4
  g_EM_LIN_Swc_LIN_Send("C4_FRS_active_container 0x1 CH4"); // 测试步骤 TC_LINTest LIN Send C4_FRS_active_container 0x1 CH4//ch3
  g_EM_LIN_Swc_LIN_Check("C4_FRS_IntensityReq 6 CH4"); // 预期结果 TC_LINTest LIN Check C4_FRS_IntensityReq 6 CH4
  g_EM_LIN_Swc_LIN_Send("C4_FRS_CurrentIntensity 6 CH4"); // 测试步骤 TC_LINTest LIN Send C4_FRS_CurrentIntensity 6 CH4//引擎转发香氛通道真实值-3
  g_EM_SOAClient_Swc_SOA_CHECK("Veh_SFSService_ErrStruct.OpeNRC 0 traceback8"); // 预期结果 TC_CANTest SOA check Veh_SFSService_ErrStruct.OpeNRC 0 traceback8//
}

testcase SYS_CDCU_xiangfen_0139()
{
  TestDescription("香氛浓度调节 IG OFF");
  teststep("warning","原始用例id为SYS-CDCU-香氛-0139");
  g_CAN_Bus_Swc_Set("C_LDCU_SysSt.C_LDCU_EVSysReadySt 2"); // 测试步骤 TC_CANTest SET C_LDCU_SysSt.C_LDCU_EVSysReadySt 2//上高压
  g_EM_LIN_Swc_LIN_Send("C4_FRS_CurrentIntensity 3 CH4"); // 测试步骤 TC_LINTest LIN Send C4_FRS_CurrentIntensity 3 CH4
  g_EM_Equipment_Swc_TC_4G_Time_Delay_Second("1"); // 测试步骤 TC_Sleep 1
  g_EM_SOAClient_Swc_SOA_CHECK_Prepare("Veh_SetSFSConRespStruct.Veh_SetSFSConNRC 0"); // 预期结果 TC_CANTest SOA check Veh_SetSFSConRespStruct.Veh_SetSFSConNRC 0
  g_EM_SOAClient_Swc_SOA_CHECK_Prepare("Veh_SFSService_ErrStruct.OpeNRC 0 traceback8"); // 预期结果 TC_CANTest SOA check Veh_SFSService_ErrStruct.OpeNRC 0 traceback8//
  g_EM_SOAClient_Swc_SOA_REQ("Veh_SetSFSConStruct.Veh_SetSFSCon:1&ServiceExecuteFeedbackFlag:2"); // 测试步骤 TC_CANTest SOA REQ Veh_SetSFSConStruct.Veh_SetSFSCon:1&ServiceExecuteFeedbackFlag:2//Low
  g_EM_SOAClient_Swc_SOA_CHECK("Veh_SetSFSConRespStruct.Veh_SetSFSConNRC 0"); // 预期结果 TC_CANTest SOA check Veh_SetSFSConRespStruct.Veh_SetSFSConNRC 0
  g_EM_LIN_Swc_LIN_Check("C4_FRS_IntensityReq 3 CH4"); // 预期结果 TC_LINTest LIN Check C4_FRS_IntensityReq 3 CH4
  g_EM_SOAClient_Swc_SOA_CHECK("Veh_SFSService_ErrStruct.OpeNRC 0 traceback8"); // 预期结果 TC_CANTest SOA check Veh_SFSService_ErrStruct.OpeNRC 0 traceback8//
}

testcase SYS_CDCU_xiangfen_0140()
{
  TestDescription("香氛浓度调节 IG OFF");
  teststep("warning","原始用例id为SYS-CDCU-香氛-0140");
  g_EM_LIN_Swc_LIN_Send("C4_FRS_CurrentIntensity 10 CH4"); // 测试步骤 TC_LINTest LIN Send C4_FRS_CurrentIntensity 10 CH4
  g_EM_Equipment_Swc_TC_4G_Time_Delay_Second("1"); // 测试步骤 TC_Sleep 1
  g_EM_SOAClient_Swc_SOA_CHECK_Prepare("Veh_SetSFSConRespStruct.Veh_SetSFSConNRC 0"); // 预期结果 TC_CANTest SOA check Veh_SetSFSConRespStruct.Veh_SetSFSConNRC 0
  g_EM_SOAClient_Swc_SOA_CHECK_Prepare("Veh_SFSService_ErrStruct.OpeNRC 0 traceback8"); // 预期结果 TC_CANTest SOA check Veh_SFSService_ErrStruct.OpeNRC 0 traceback8//
  g_EM_SOAClient_Swc_SOA_REQ("Veh_SetSFSConStruct.Veh_SetSFSCon:2&ServiceExecuteFeedbackFlag:2"); // 测试步骤 TC_CANTest SOA REQ Veh_SetSFSConStruct.Veh_SetSFSCon:2&ServiceExecuteFeedbackFlag:2//High
  g_EM_SOAClient_Swc_SOA_CHECK("Veh_SetSFSConRespStruct.Veh_SetSFSConNRC 0"); // 预期结果 TC_CANTest SOA check Veh_SetSFSConRespStruct.Veh_SetSFSConNRC 0
  g_EM_LIN_Swc_LIN_Check("C4_FRS_IntensityReq 10 CH4"); // 预期结果 TC_LINTest LIN Check C4_FRS_IntensityReq 10 CH4
  g_EM_SOAClient_Swc_SOA_CHECK("Veh_SFSService_ErrStruct.OpeNRC 0 traceback8"); // 预期结果 TC_CANTest SOA check Veh_SFSService_ErrStruct.OpeNRC 0 traceback8//
}

testcase SYS_CDCU_xiangfen_0141()
{
  TestDescription("香氛浓度调节 IG OFF");
  teststep("warning","原始用例id为SYS-CDCU-香氛-0141");
  g_EM_LIN_Swc_LIN_Send("C4_FRS_CurrentIntensity 6 CH4"); // 测试步骤 TC_LINTest LIN Send C4_FRS_CurrentIntensity 6 CH4
  g_EM_Equipment_Swc_TC_4G_Time_Delay_Second("1"); // 测试步骤 TC_Sleep 1
  g_EM_SOAClient_Swc_SOA_CHECK_Prepare("Veh_SetSFSConRespStruct.Veh_SetSFSConNRC 0"); // 预期结果 TC_CANTest SOA check Veh_SetSFSConRespStruct.Veh_SetSFSConNRC 0
  g_EM_SOAClient_Swc_SOA_CHECK_Prepare("Veh_SFSService_ErrStruct.OpeNRC 0 traceback8"); // 预期结果 TC_CANTest SOA check Veh_SFSService_ErrStruct.OpeNRC 0 traceback8//
  g_EM_SOAClient_Swc_SOA_REQ("Veh_SetSFSConStruct.Veh_SetSFSCon:3&ServiceExecuteFeedbackFlag:2"); // 测试步骤 TC_CANTest SOA REQ Veh_SetSFSConStruct.Veh_SetSFSCon:3&ServiceExecuteFeedbackFlag:2//High
  g_EM_SOAClient_Swc_SOA_CHECK("Veh_SetSFSConRespStruct.Veh_SetSFSConNRC 0"); // 预期结果 TC_CANTest SOA check Veh_SetSFSConRespStruct.Veh_SetSFSConNRC 0
  g_EM_LIN_Swc_LIN_Check("C4_FRS_IntensityReq 6 CH4"); // 预期结果 TC_LINTest LIN Check C4_FRS_IntensityReq 6 CH4
  g_EM_SOAClient_Swc_SOA_CHECK("Veh_SFSService_ErrStruct.OpeNRC 0 traceback8"); // 预期结果 TC_CANTest SOA check Veh_SFSService_ErrStruct.OpeNRC 0 traceback8//
}

testcase SYS_CDCU_xiangfen_0142()
{
  TestDescription("香氛浓度调节(远控) IG OFF");
  teststep("warning","原始用例id为SYS-CDCU-香氛-0142");
  g_EM_LIN_Swc_LIN_Send("C4_FRS_CurrentIntensity 3 CH4"); // 测试步骤 TC_LINTest LIN Send C4_FRS_CurrentIntensity 3 CH4
  g_EM_Equipment_Swc_TC_4G_Time_Delay_Second("1"); // 测试步骤 TC_Sleep 1
  g_EM_SOAClient_Swc_SOA_CHECK_Prepare("Veh_SetSFSConRespStruct.Veh_SetSFSConNRC 0"); // 预期结果 TC_CANTest SOA check Veh_SetSFSConRespStruct.Veh_SetSFSConNRC 0
  g_EM_SOAClient_Swc_SOA_CHECK_Prepare("Veh_SFSService_ErrStruct.OpeNRC 0 traceback8"); // 预期结果 TC_CANTest SOA check Veh_SFSService_ErrStruct.OpeNRC 0 traceback8//
  g_EM_SOAClient_Swc_SOA_CHECK_Prepare("Veh_SFSService_ErrStruct.OpeErrInfo[0-1]:0x00C8 traceback10"); // 预期结果 TC_CANTest SOA check Veh_SFSService_ErrStruct.OpeErrInfo[0-1]:0x00C8 traceback10//
  g_EM_SOAClient_Swc_SOA_REQ("Veh_SetSFSConStruct.Veh_SetSFSCon:1&ServiceExecuteFeedbackFlag:2&UserID:0x01010001"); // 测试步骤 TC_CANTest SOA REQ Veh_SetSFSConStruct.Veh_SetSFSCon:1&ServiceExecuteFeedbackFlag:2&UserID:0x01010001//Low
  g_EM_SOAClient_Swc_SOA_CHECK("Veh_SetSFSConRespStruct.Veh_SetSFSConNRC 0"); // 预期结果 TC_CANTest SOA check Veh_SetSFSConRespStruct.Veh_SetSFSConNRC 0
  g_EM_LIN_Swc_LIN_Check("C4_FRS_IntensityReq 3 CH4"); // 预期结果 TC_LINTest LIN Check C4_FRS_IntensityReq 3 CH4
  g_EM_SOAClient_Swc_SOA_CHECK("Veh_SFSService_ErrStruct.OpeNRC 0 traceback8"); // 预期结果 TC_CANTest SOA check Veh_SFSService_ErrStruct.OpeNRC 0 traceback8//
  g_EM_SOAClient_Swc_SOA_CHECK("Veh_SFSService_ErrStruct.OpeErrInfo[0-1]:0x00C8 traceback10"); // 预期结果 TC_CANTest SOA check Veh_SFSService_ErrStruct.OpeErrInfo[0-1]:0x00C8 traceback10//
}

testcase SYS_CDCU_xiangfen_0143()
{
  TestDescription("香氛浓度调节(远控) IG OFF");
  teststep("warning","原始用例id为SYS-CDCU-香氛-0143");
  g_EM_LIN_Swc_LIN_Send("C4_FRS_CurrentIntensity 10 CH4"); // 测试步骤 TC_LINTest LIN Send C4_FRS_CurrentIntensity 10 CH4
  g_EM_Equipment_Swc_TC_4G_Time_Delay_Second("1"); // 测试步骤 TC_Sleep 1
  g_EM_SOAClient_Swc_SOA_CHECK_Prepare("Veh_SetSFSConRespStruct.Veh_SetSFSConNRC 0"); // 预期结果 TC_CANTest SOA check Veh_SetSFSConRespStruct.Veh_SetSFSConNRC 0
  g_EM_SOAClient_Swc_SOA_CHECK_Prepare("Veh_SFSService_ErrStruct.OpeNRC 0 traceback8"); // 预期结果 TC_CANTest SOA check Veh_SFSService_ErrStruct.OpeNRC 0 traceback8//
  g_EM_SOAClient_Swc_SOA_CHECK_Prepare("Veh_SFSService_ErrStruct.OpeErrInfo[0-1]:0x00C8 traceback10"); // 预期结果 TC_CANTest SOA check Veh_SFSService_ErrStruct.OpeErrInfo[0-1]:0x00C8 traceback10//
  g_EM_SOAClient_Swc_SOA_REQ("Veh_SetSFSConStruct.Veh_SetSFSCon:2&ServiceExecuteFeedbackFlag:2&UserID:0x01010001"); // 测试步骤 TC_CANTest SOA REQ Veh_SetSFSConStruct.Veh_SetSFSCon:2&ServiceExecuteFeedbackFlag:2&UserID:0x01010001//High
  g_EM_SOAClient_Swc_SOA_CHECK("Veh_SetSFSConRespStruct.Veh_SetSFSConNRC 0"); // 预期结果 TC_CANTest SOA check Veh_SetSFSConRespStruct.Veh_SetSFSConNRC 0
  g_EM_LIN_Swc_LIN_Check("C4_FRS_IntensityReq 10 CH4"); // 预期结果 TC_LINTest LIN Check C4_FRS_IntensityReq 10 CH4
  g_EM_SOAClient_Swc_SOA_CHECK("Veh_SFSService_ErrStruct.OpeNRC 0 traceback8"); // 预期结果 TC_CANTest SOA check Veh_SFSService_ErrStruct.OpeNRC 0 traceback8//
  g_EM_SOAClient_Swc_SOA_CHECK("Veh_SFSService_ErrStruct.OpeErrInfo[0-1]:0x00C8 traceback10"); // 预期结果 TC_CANTest SOA check Veh_SFSService_ErrStruct.OpeErrInfo[0-1]:0x00C8 traceback10//
}

testcase SYS_CDCU_xiangfen_0144()
{
  TestDescription("香氛浓度调节(远控) IG OFF");
  teststep("warning","原始用例id为SYS-CDCU-香氛-0144");
  g_EM_LIN_Swc_LIN_Send("C4_FRS_CurrentIntensity 6 CH4"); // 测试步骤 TC_LINTest LIN Send C4_FRS_CurrentIntensity 6 CH4
  g_EM_Equipment_Swc_TC_4G_Time_Delay_Second("1"); // 测试步骤 TC_Sleep 1
  g_EM_SOAClient_Swc_SOA_CHECK_Prepare("Veh_SetSFSConRespStruct.Veh_SetSFSConNRC 0"); // 预期结果 TC_CANTest SOA check Veh_SetSFSConRespStruct.Veh_SetSFSConNRC 0
  g_EM_SOAClient_Swc_SOA_CHECK_Prepare("Veh_SFSService_ErrStruct.OpeNRC 0 traceback8"); // 预期结果 TC_CANTest SOA check Veh_SFSService_ErrStruct.OpeNRC 0 traceback8//
  g_EM_SOAClient_Swc_SOA_CHECK_Prepare("Veh_SFSService_ErrStruct.OpeErrInfo[0-1]:0x00C8 traceback10"); // 预期结果 TC_CANTest SOA check Veh_SFSService_ErrStruct.OpeErrInfo[0-1]:0x00C8 traceback10//
  g_EM_SOAClient_Swc_SOA_REQ("Veh_SetSFSConStruct.Veh_SetSFSCon:3&ServiceExecuteFeedbackFlag:2&UserID:0x01010001"); // 测试步骤 TC_CANTest SOA REQ Veh_SetSFSConStruct.Veh_SetSFSCon:3&ServiceExecuteFeedbackFlag:2&UserID:0x01010001//High
  g_EM_SOAClient_Swc_SOA_CHECK("Veh_SetSFSConRespStruct.Veh_SetSFSConNRC 0"); // 预期结果 TC_CANTest SOA check Veh_SetSFSConRespStruct.Veh_SetSFSConNRC 0
  g_EM_LIN_Swc_LIN_Check("C4_FRS_IntensityReq 6 CH4"); // 预期结果 TC_LINTest LIN Check C4_FRS_IntensityReq 6 CH4
  g_EM_SOAClient_Swc_SOA_CHECK("Veh_SFSService_ErrStruct.OpeNRC 0 traceback8"); // 预期结果 TC_CANTest SOA check Veh_SFSService_ErrStruct.OpeNRC 0 traceback8//
  g_EM_SOAClient_Swc_SOA_CHECK("Veh_SFSService_ErrStruct.OpeErrInfo[0-1]:0x00C8 traceback10"); // 预期结果 TC_CANTest SOA check Veh_SFSService_ErrStruct.OpeErrInfo[0-1]:0x00C8 traceback10//
}

testcase SYS_CDCU_xiangfen_0145()
{
  TestDescription("香氛浓度调节失败 IG OFF");
  teststep("warning","原始用例id为SYS-CDCU-香氛-0145");
  g_EM_LIN_Swc_LIN_Send("C4_FRS_CurrentIntensity 6 CH4"); // 测试步骤 TC_LINTest LIN Send C4_FRS_CurrentIntensity 6 CH4
  g_EM_Equipment_Swc_TC_4G_Time_Delay_Second("2"); // 测试步骤 TC_Sleep 2
  g_EM_SOAClient_Swc_SOA_CHECK_Prepare("Veh_SetSFSConRespStruct.Veh_SetSFSConNRC 0"); // 预期结果 TC_CANTest SOA check Veh_SetSFSConRespStruct.Veh_SetSFSConNRC 0
  g_EM_SOAClient_Swc_SOA_CHECK_Prepare("Veh_SFSService_ErrStruct.OpeNRC 0xFFFFFFFF traceback18"); // 预期结果 TC_CANTest SOA check Veh_SFSService_ErrStruct.OpeNRC 0xFFFFFFFF traceback18
  g_EM_SOAClient_Swc_SOA_CHECK_Prepare("Veh_SFSService_ErrStruct.OpeErrInfo[0-1]:0x01A4 traceback8"); // 预期结果 TC_CANTest SOA check Veh_SFSService_ErrStruct.OpeErrInfo[0-1]:0x01A4 traceback8//
  g_EM_SOAClient_Swc_SOA_REQ("Veh_SetSFSConStruct.Veh_SetSFSCon:1&ServiceExecuteFeedbackFlag:2&UserID:0x01010001"); // 测试步骤 TC_CANTest SOA REQ Veh_SetSFSConStruct.Veh_SetSFSCon:1&ServiceExecuteFeedbackFlag:2&UserID:0x01010001//Low
  g_EM_SOAClient_Swc_SOA_CHECK("Veh_SetSFSConRespStruct.Veh_SetSFSConNRC 0"); // 预期结果 TC_CANTest SOA check Veh_SetSFSConRespStruct.Veh_SetSFSConNRC 0
  g_EM_LIN_Swc_LIN_Check("C4_FRS_IntensityReq 3 CH4"); // 预期结果 TC_LINTest LIN Check C4_FRS_IntensityReq 3 CH4
  g_EM_Equipment_Swc_TC_4G_Time_Delay_Second("15"); // 测试步骤 TC_Sleep 15
  g_EM_SOAClient_Swc_SOA_CHECK("Veh_SFSService_ErrStruct.OpeNRC 0xFFFFFFFF traceback18"); // 预期结果 TC_CANTest SOA check Veh_SFSService_ErrStruct.OpeNRC 0xFFFFFFFF traceback18
  g_EM_SOAClient_Swc_SOA_CHECK("Veh_SFSService_ErrStruct.OpeErrInfo[0-1]:0x01A4 traceback8"); // 预期结果 TC_CANTest SOA check Veh_SFSService_ErrStruct.OpeErrInfo[0-1]:0x01A4 traceback8//
}

testcase SYS_CDCU_xiangfen_0146()
{
  TestDescription("香氛浓度调节失败 IG OFF");
  teststep("warning","原始用例id为SYS-CDCU-香氛-0146");
  g_CAN_Bus_Swc_Set("C_LDCU_SysSt.C_LDCU_EVSysReadySt 0"); // 测试步骤 TC_CANTest SET C_LDCU_SysSt.C_LDCU_EVSysReadySt 0//下高压
  g_EM_Equipment_Swc_TC_4G_Time_Delay_Second("2"); // 测试步骤 TC_Sleep 2
  g_EM_SOAClient_Swc_SOA_CHECK_Prepare("Veh_SFSService_ErrStruct.OpeNRC 4 traceback17"); // 预期结果 TC_CANTest SOA check Veh_SFSService_ErrStruct.OpeNRC 4 traceback17
  g_EM_SOAClient_Swc_SOA_CHECK_Prepare("Veh_SFSService_ErrStruct.OpeErrInfo[0-1]:0x6 traceback18"); // 预期结果 TC_CANTest SOA check Veh_SFSService_ErrStruct.OpeErrInfo[0-1]:0x6 traceback18
  g_EM_SOAClient_Swc_SOA_REQ("Veh_SetSFSConStruct.Veh_SetSFSCon:2&ServiceExecuteFeedbackFlag:2&UserID:0x01010001"); // 测试步骤 TC_CANTest SOA REQ Veh_SetSFSConStruct.Veh_SetSFSCon:2&ServiceExecuteFeedbackFlag:2&UserID:0x01010001//High
  g_EM_Equipment_Swc_TC_4G_Time_Delay_Second("15"); // 测试步骤 TC_Sleep 15
  g_EM_SOAClient_Swc_SOA_CHECK("Veh_SFSService_ErrStruct.OpeNRC 4 traceback17"); // 预期结果 TC_CANTest SOA check Veh_SFSService_ErrStruct.OpeNRC 4 traceback17
  g_EM_SOAClient_Swc_SOA_CHECK("Veh_SFSService_ErrStruct.OpeErrInfo[0-1]:0x6 traceback18"); // 预期结果 TC_CANTest SOA check Veh_SFSService_ErrStruct.OpeErrInfo[0-1]:0x6 traceback18
}

testcase SYS_CDCU_xiangfen_0147()
{
  TestDescription("香氛浓度调节---low 通道记忆1 当前通道浓度无效 IG OFF");
  teststep("warning","原始用例id为SYS-CDCU-香氛-0147");
  g_EM_Equipment_Swc_TC_IG("ON"); // 测试步骤 TC_IG ON
  g_EM_Equipment_Swc_TC_4G_Time_Delay_Second("1"); // 测试步骤 TC_Sleep 1
  g_EM_Equipment_Swc_TC_IG("OFF"); // 测试步骤 TC_IG OFF
  g_CAN_Bus_Swc_Set("I_LDCU_BodySysSt1.I_LDCU_PowerMode 0"); // 测试步骤 TC_CANTest SET I_LDCU_BodySysSt1.I_LDCU_PowerMode 0
  g_EM_Equipment_Swc_TC_4G_Time_Delay_Second("1"); // 测试步骤 TC_Sleep 1
  g_CAN_Bus_Swc_Set("I_LDCU_NM.I_LDCU_NMRepeatMsgReqBit 1"); // 测试步骤 TC_CANTest SET I_LDCU_NM.I_LDCU_NMRepeatMsgReqBit 1//网络唤醒维持帧
  g_CAN_Bus_Swc_Set("C_LDCU_SysSt.C_LDCU_EVSysReadySt 2"); // 测试步骤 TC_CANTest SET C_LDCU_SysSt.C_LDCU_EVSysReadySt 2//高压
  g_EM_LIN_Swc_LIN_Send("C4_FRS_active_container 0x1 CH4"); // 测试步骤 TC_LINTest LIN Send C4_FRS_active_container 0x1 CH4//ch3
  g_EM_Equipment_Swc_TC_4G_Time_Delay_Second("1"); // 测试步骤 TC_Sleep 1
  g_EM_SOAClient_Swc_SOA_CHECK_Prepare("Veh_SetSFSChanelRespStruct.Veh_SetSFSChanelNRC 0"); // 预期结果 TC_CANTest SOA check Veh_SetSFSChanelRespStruct.Veh_SetSFSChanelNRC 0
  g_EM_SOAClient_Swc_SOA_CHECK_Prepare("Veh_SFSService_ErrStruct.OpeNRC 0 traceback8"); // 预期结果 TC_CANTest SOA check Veh_SFSService_ErrStruct.OpeNRC 0 traceback8//
  g_EM_SOAClient_Swc_SOA_REQ("Veh_SetSFSChanelStruct.Veh_SetSFSChanel:1&ServiceExecuteFeedbackFlag:2&MemoryReq:1"); // 测试步骤 TC_CANTest SOA REQ Veh_SetSFSChanelStruct.Veh_SetSFSChanel:1&ServiceExecuteFeedbackFlag:2&MemoryReq:1//通道3
  g_EM_SOAClient_Swc_SOA_CHECK("Veh_SetSFSChanelRespStruct.Veh_SetSFSChanelNRC 0"); // 预期结果 TC_CANTest SOA check Veh_SetSFSChanelRespStruct.Veh_SetSFSChanelNRC 0
  g_EM_LIN_Swc_LIN_Check("C4_FRS_ChannelSelect 1 CH4"); // 预期结果 TC_LINTest LIN Check C4_FRS_ChannelSelect 1 CH4
  g_EM_SOAClient_Swc_SOA_CHECK("Veh_SFSService_ErrStruct.OpeNRC 0 traceback8"); // 预期结果 TC_CANTest SOA check Veh_SFSService_ErrStruct.OpeNRC 0 traceback8//
  g_EM_LIN_Swc_LIN_Send("C4_FRS_active_container 0x0 CH4"); // 测试步骤 TC_LINTest LIN Send C4_FRS_active_container 0x0 CH4//引擎转发香氛通道真实值
  g_EM_LIN_Swc_LIN_Send("C4_FRS_CurrentIntensity 0 CH4"); // 测试步骤 TC_LINTest LIN Send C4_FRS_CurrentIntensity 0 CH4//引擎转发香氛浓度真实值-closed
  g_EM_Equipment_Swc_TC_4G_Time_Delay_Second("1"); // 测试步骤 TC_Sleep 1
  g_EM_SOAClient_Swc_SOA_CHECK_Prepare("Veh_SetSFSConRespStruct.Veh_SetSFSConNRC 0"); // 预期结果 TC_CANTest SOA check Veh_SetSFSConRespStruct.Veh_SetSFSConNRC 0
  g_EM_SOAClient_Swc_SOA_CHECK_Prepare("Veh_SFSService_ErrStruct.OpeNRC 0 traceback8"); // 预期结果 TC_CANTest SOA check Veh_SFSService_ErrStruct.OpeNRC 0 traceback8//
  g_EM_SOAClient_Swc_SOA_REQ("Veh_SetSFSConStruct.Veh_SetSFSCon:1&ServiceExecuteFeedbackFlag:2&MemoryReq:1"); // 测试步骤 TC_CANTest SOA REQ Veh_SetSFSConStruct.Veh_SetSFSCon:1&ServiceExecuteFeedbackFlag:2&MemoryReq:1//Low
  g_EM_SOAClient_Swc_SOA_CHECK("Veh_SetSFSConRespStruct.Veh_SetSFSConNRC 0"); // 预期结果 TC_CANTest SOA check Veh_SetSFSConRespStruct.Veh_SetSFSConNRC 0
  g_EM_LIN_Swc_LIN_Check("C4_FRS_IntensityReq 3 CH4"); // 预期结果 TC_LINTest LIN Check C4_FRS_IntensityReq 3 CH4
  g_EM_LIN_Swc_LIN_Send("C4_FRS_CurrentIntensity 3 CH4"); // 测试步骤 TC_LINTest LIN Send C4_FRS_CurrentIntensity 3 CH4//引擎转发香氛通道真实值-closed
  g_EM_LIN_Swc_LIN_Check("C4_FRS_ChannelSelect 1 CH4"); // 预期结果 TC_LINTest LIN Check C4_FRS_ChannelSelect 1 CH4
  g_EM_LIN_Swc_LIN_Send("C4_FRS_active_container 0x1 CH4"); // 测试步骤 TC_LINTest LIN Send C4_FRS_active_container 0x1 CH4//ch3
  g_EM_SOAClient_Swc_SOA_CHECK("Veh_SFSService_ErrStruct.OpeNRC 0 traceback8"); // 预期结果 TC_CANTest SOA check Veh_SFSService_ErrStruct.OpeNRC 0 traceback8//
}

testcase SYS_CDCU_xiangfen_0148()
{
  TestDescription("香氛浓度调节---high 通道记忆1 当前通道浓度无效 IG OFF");
  teststep("warning","原始用例id为SYS-CDCU-香氛-0148");
  g_EM_LIN_Swc_LIN_Send("C4_FRS_active_container 0x0 CH4"); // 测试步骤 TC_LINTest LIN Send C4_FRS_active_container 0x0 CH4//引擎转发香氛通道真实值
  g_EM_LIN_Swc_LIN_Send("C4_FRS_CurrentIntensity 0 CH4"); // 测试步骤 TC_LINTest LIN Send C4_FRS_CurrentIntensity 0 CH4//引擎转发香氛浓度真实值-closed
  g_EM_Equipment_Swc_TC_4G_Time_Delay_Second("1"); // 测试步骤 TC_Sleep 1
  g_EM_SOAClient_Swc_SOA_CHECK_Prepare("Veh_SetSFSConRespStruct.Veh_SetSFSConNRC 0"); // 预期结果 TC_CANTest SOA check Veh_SetSFSConRespStruct.Veh_SetSFSConNRC 0
  g_EM_SOAClient_Swc_SOA_CHECK_Prepare("Veh_SFSService_ErrStruct.OpeNRC 0 traceback8"); // 预期结果 TC_CANTest SOA check Veh_SFSService_ErrStruct.OpeNRC 0 traceback8//
  g_EM_SOAClient_Swc_SOA_REQ("Veh_SetSFSConStruct.Veh_SetSFSCon:2&ServiceExecuteFeedbackFlag:2&MemoryReq:1"); // 测试步骤 TC_CANTest SOA REQ Veh_SetSFSConStruct.Veh_SetSFSCon:2&ServiceExecuteFeedbackFlag:2&MemoryReq:1//Low
  g_EM_SOAClient_Swc_SOA_CHECK("Veh_SetSFSConRespStruct.Veh_SetSFSConNRC 0"); // 预期结果 TC_CANTest SOA check Veh_SetSFSConRespStruct.Veh_SetSFSConNRC 0
  g_EM_LIN_Swc_LIN_Check("C4_FRS_IntensityReq 10 CH4"); // 预期结果 TC_LINTest LIN Check C4_FRS_IntensityReq 10 CH4
  g_EM_LIN_Swc_LIN_Send("C4_FRS_CurrentIntensity 10 CH4"); // 测试步骤 TC_LINTest LIN Send C4_FRS_CurrentIntensity 10 CH4//引擎转发香氛通道真实值-closed
  g_EM_LIN_Swc_LIN_Check("C4_FRS_ChannelSelect 1 CH4"); // 预期结果 TC_LINTest LIN Check C4_FRS_ChannelSelect 1 CH4
  g_EM_LIN_Swc_LIN_Send("C4_FRS_active_container 0x1 CH4"); // 测试步骤 TC_LINTest LIN Send C4_FRS_active_container 0x1 CH4//ch3
  g_EM_SOAClient_Swc_SOA_CHECK("Veh_SFSService_ErrStruct.OpeNRC 0 traceback8"); // 预期结果 TC_CANTest SOA check Veh_SFSService_ErrStruct.OpeNRC 0 traceback8//
}

testcase SYS_CDCU_xiangfen_0149()
{
  TestDescription("香氛浓度调节---mid 通道记忆1 当前通道浓度无效 IG OFF");
  teststep("warning","原始用例id为SYS-CDCU-香氛-0149");
  g_EM_LIN_Swc_LIN_Send("C4_FRS_active_container 0x0 CH4"); // 测试步骤 TC_LINTest LIN Send C4_FRS_active_container 0x0 CH4//引擎转发香氛通道真实值
  g_EM_LIN_Swc_LIN_Send("C4_FRS_CurrentIntensity 0 CH4"); // 测试步骤 TC_LINTest LIN Send C4_FRS_CurrentIntensity 0 CH4//引擎转发香氛浓度真实值-closed
  g_EM_Equipment_Swc_TC_4G_Time_Delay_Second("1"); // 测试步骤 TC_Sleep 1
  g_EM_SOAClient_Swc_SOA_CHECK_Prepare("Veh_SetSFSConRespStruct.Veh_SetSFSConNRC 0"); // 预期结果 TC_CANTest SOA check Veh_SetSFSConRespStruct.Veh_SetSFSConNRC 0
  g_EM_SOAClient_Swc_SOA_CHECK_Prepare("Veh_SFSService_ErrStruct.OpeNRC 0 traceback8"); // 预期结果 TC_CANTest SOA check Veh_SFSService_ErrStruct.OpeNRC 0 traceback8//
  g_EM_SOAClient_Swc_SOA_REQ("Veh_SetSFSConStruct.Veh_SetSFSCon:3&ServiceExecuteFeedbackFlag:2&MemoryReq:1"); // 测试步骤 TC_CANTest SOA REQ Veh_SetSFSConStruct.Veh_SetSFSCon:3&ServiceExecuteFeedbackFlag:2&MemoryReq:1//Low
  g_EM_SOAClient_Swc_SOA_CHECK("Veh_SetSFSConRespStruct.Veh_SetSFSConNRC 0"); // 预期结果 TC_CANTest SOA check Veh_SetSFSConRespStruct.Veh_SetSFSConNRC 0
  g_EM_LIN_Swc_LIN_Check("C4_FRS_IntensityReq 6 CH4"); // 预期结果 TC_LINTest LIN Check C4_FRS_IntensityReq 6 CH4
  g_EM_LIN_Swc_LIN_Send("C4_FRS_CurrentIntensity 6 CH4"); // 测试步骤 TC_LINTest LIN Send C4_FRS_CurrentIntensity 6 CH4//引擎转发香氛通道真实值-closed
  g_EM_LIN_Swc_LIN_Check("C4_FRS_ChannelSelect 1 CH4"); // 预期结果 TC_LINTest LIN Check C4_FRS_ChannelSelect 1 CH4
  g_EM_LIN_Swc_LIN_Send("C4_FRS_active_container 0x1 CH4"); // 测试步骤 TC_LINTest LIN Send C4_FRS_active_container 0x1 CH4//ch3
  g_EM_SOAClient_Swc_SOA_CHECK("Veh_SFSService_ErrStruct.OpeNRC 0 traceback8"); // 预期结果 TC_CANTest SOA check Veh_SFSService_ErrStruct.OpeNRC 0 traceback8//
}

testcase SYS_CDCU_xiangfen_0150()
{
  TestDescription("香氛浓度调节---low 通道记忆2 当前通道浓度无效 IG OFF");
  teststep("warning","原始用例id为SYS-CDCU-香氛-0150");
  g_EM_LIN_Swc_LIN_Send("C4_FRS_active_container 0x2 CH4"); // 测试步骤 TC_LINTest LIN Send C4_FRS_active_container 0x2 CH4//ch3
  g_EM_Equipment_Swc_TC_4G_Time_Delay_Second("1"); // 测试步骤 TC_Sleep 1
  g_EM_SOAClient_Swc_SOA_CHECK_Prepare("Veh_SetSFSChanelRespStruct.Veh_SetSFSChanelNRC 0"); // 预期结果 TC_CANTest SOA check Veh_SetSFSChanelRespStruct.Veh_SetSFSChanelNRC 0
  g_EM_SOAClient_Swc_SOA_CHECK_Prepare("Veh_SFSService_ErrStruct.OpeNRC 0 traceback8"); // 预期结果 TC_CANTest SOA check Veh_SFSService_ErrStruct.OpeNRC 0 traceback8//
  g_EM_SOAClient_Swc_SOA_REQ("Veh_SetSFSChanelStruct.Veh_SetSFSChanel:2&ServiceExecuteFeedbackFlag:2&MemoryReq:1"); // 测试步骤 TC_CANTest SOA REQ Veh_SetSFSChanelStruct.Veh_SetSFSChanel:2&ServiceExecuteFeedbackFlag:2&MemoryReq:1//通道3
  g_EM_SOAClient_Swc_SOA_CHECK("Veh_SetSFSChanelRespStruct.Veh_SetSFSChanelNRC 0"); // 预期结果 TC_CANTest SOA check Veh_SetSFSChanelRespStruct.Veh_SetSFSChanelNRC 0
  g_EM_LIN_Swc_LIN_Check("C4_FRS_ChannelSelect 2 CH4"); // 预期结果 TC_LINTest LIN Check C4_FRS_ChannelSelect 2 CH4
  g_EM_SOAClient_Swc_SOA_CHECK("Veh_SFSService_ErrStruct.OpeNRC 0 traceback8"); // 预期结果 TC_CANTest SOA check Veh_SFSService_ErrStruct.OpeNRC 0 traceback8//
  g_EM_LIN_Swc_LIN_Send("C4_FRS_active_container 0x0 CH4"); // 测试步骤 TC_LINTest LIN Send C4_FRS_active_container 0x0 CH4//引擎转发香氛通道真实值
  g_EM_LIN_Swc_LIN_Send("C4_FRS_CurrentIntensity 0 CH4"); // 测试步骤 TC_LINTest LIN Send C4_FRS_CurrentIntensity 0 CH4//引擎转发香氛浓度真实值-closed
  g_EM_Equipment_Swc_TC_4G_Time_Delay_Second("1"); // 测试步骤 TC_Sleep 1
  g_EM_SOAClient_Swc_SOA_CHECK_Prepare("Veh_SetSFSConRespStruct.Veh_SetSFSConNRC 0"); // 预期结果 TC_CANTest SOA check Veh_SetSFSConRespStruct.Veh_SetSFSConNRC 0
  g_EM_SOAClient_Swc_SOA_CHECK_Prepare("Veh_SFSService_ErrStruct.OpeNRC 0 traceback8"); // 预期结果 TC_CANTest SOA check Veh_SFSService_ErrStruct.OpeNRC 0 traceback8//
  g_EM_SOAClient_Swc_SOA_REQ("Veh_SetSFSConStruct.Veh_SetSFSCon:1&ServiceExecuteFeedbackFlag:2&MemoryReq:1"); // 测试步骤 TC_CANTest SOA REQ Veh_SetSFSConStruct.Veh_SetSFSCon:1&ServiceExecuteFeedbackFlag:2&MemoryReq:1//Low
  g_EM_SOAClient_Swc_SOA_CHECK("Veh_SetSFSConRespStruct.Veh_SetSFSConNRC 0"); // 预期结果 TC_CANTest SOA check Veh_SetSFSConRespStruct.Veh_SetSFSConNRC 0
  g_EM_LIN_Swc_LIN_Check("C4_FRS_IntensityReq 3 CH4"); // 预期结果 TC_LINTest LIN Check C4_FRS_IntensityReq 3 CH4
  g_EM_LIN_Swc_LIN_Send("C4_FRS_CurrentIntensity 3 CH4"); // 测试步骤 TC_LINTest LIN Send C4_FRS_CurrentIntensity 3 CH4//引擎转发香氛通道真实值-closed
  g_EM_LIN_Swc_LIN_Check("C4_FRS_ChannelSelect 2 CH4"); // 预期结果 TC_LINTest LIN Check C4_FRS_ChannelSelect 2 CH4
  g_EM_LIN_Swc_LIN_Send("C4_FRS_active_container 0x2 CH4"); // 测试步骤 TC_LINTest LIN Send C4_FRS_active_container 0x2 CH4//ch3
  g_EM_SOAClient_Swc_SOA_CHECK("Veh_SFSService_ErrStruct.OpeNRC 0 traceback8"); // 预期结果 TC_CANTest SOA check Veh_SFSService_ErrStruct.OpeNRC 0 traceback8//
}

testcase SYS_CDCU_xiangfen_0151()
{
  TestDescription("香氛浓度调节---high 通道记忆2 当前通道浓度无效 IG OFF");
  teststep("warning","原始用例id为SYS-CDCU-香氛-0151");
  g_EM_LIN_Swc_LIN_Send("C4_FRS_active_container 0x0 CH4"); // 测试步骤 TC_LINTest LIN Send C4_FRS_active_container 0x0 CH4//引擎转发香氛通道真实值
  g_EM_LIN_Swc_LIN_Send("C4_FRS_CurrentIntensity 0 CH4"); // 测试步骤 TC_LINTest LIN Send C4_FRS_CurrentIntensity 0 CH4//引擎转发香氛浓度真实值-closed
  g_EM_Equipment_Swc_TC_4G_Time_Delay_Second("1"); // 测试步骤 TC_Sleep 1
  g_EM_SOAClient_Swc_SOA_CHECK_Prepare("Veh_SetSFSConRespStruct.Veh_SetSFSConNRC 0"); // 预期结果 TC_CANTest SOA check Veh_SetSFSConRespStruct.Veh_SetSFSConNRC 0
  g_EM_SOAClient_Swc_SOA_CHECK_Prepare("Veh_SFSService_ErrStruct.OpeNRC 0 traceback8"); // 预期结果 TC_CANTest SOA check Veh_SFSService_ErrStruct.OpeNRC 0 traceback8//
  g_EM_SOAClient_Swc_SOA_REQ("Veh_SetSFSConStruct.Veh_SetSFSCon:2&ServiceExecuteFeedbackFlag:2&MemoryReq:1"); // 测试步骤 TC_CANTest SOA REQ Veh_SetSFSConStruct.Veh_SetSFSCon:2&ServiceExecuteFeedbackFlag:2&MemoryReq:1//Low
  g_EM_SOAClient_Swc_SOA_CHECK("Veh_SetSFSConRespStruct.Veh_SetSFSConNRC 0"); // 预期结果 TC_CANTest SOA check Veh_SetSFSConRespStruct.Veh_SetSFSConNRC 0
  g_EM_LIN_Swc_LIN_Check("C4_FRS_IntensityReq 10 CH4"); // 预期结果 TC_LINTest LIN Check C4_FRS_IntensityReq 10 CH4
  g_EM_LIN_Swc_LIN_Send("C4_FRS_CurrentIntensity 10 CH4"); // 测试步骤 TC_LINTest LIN Send C4_FRS_CurrentIntensity 10 CH4//引擎转发香氛通道真实值-closed
  g_EM_LIN_Swc_LIN_Check("C4_FRS_ChannelSelect 2 CH4"); // 预期结果 TC_LINTest LIN Check C4_FRS_ChannelSelect 2 CH4
  g_EM_LIN_Swc_LIN_Send("C4_FRS_active_container 0x2 CH4"); // 测试步骤 TC_LINTest LIN Send C4_FRS_active_container 0x2 CH4//ch3
  g_EM_SOAClient_Swc_SOA_CHECK("Veh_SFSService_ErrStruct.OpeNRC 0 traceback8"); // 预期结果 TC_CANTest SOA check Veh_SFSService_ErrStruct.OpeNRC 0 traceback8//
}

testcase SYS_CDCU_xiangfen_0152()
{
  TestDescription("香氛浓度调节---mid 通道记忆2 当前通道浓度无效 IG OFF");
  teststep("warning","原始用例id为SYS-CDCU-香氛-0152");
  g_EM_LIN_Swc_LIN_Send("C4_FRS_active_container 0x0 CH4"); // 测试步骤 TC_LINTest LIN Send C4_FRS_active_container 0x0 CH4//引擎转发香氛通道真实值
  g_EM_LIN_Swc_LIN_Send("C4_FRS_CurrentIntensity 0 CH4"); // 测试步骤 TC_LINTest LIN Send C4_FRS_CurrentIntensity 0 CH4//引擎转发香氛浓度真实值-closed
  g_EM_Equipment_Swc_TC_4G_Time_Delay_Second("1"); // 测试步骤 TC_Sleep 1
  g_EM_SOAClient_Swc_SOA_CHECK_Prepare("Veh_SetSFSConRespStruct.Veh_SetSFSConNRC 0"); // 预期结果 TC_CANTest SOA check Veh_SetSFSConRespStruct.Veh_SetSFSConNRC 0
  g_EM_SOAClient_Swc_SOA_CHECK_Prepare("Veh_SFSService_ErrStruct.OpeNRC 0 traceback8"); // 预期结果 TC_CANTest SOA check Veh_SFSService_ErrStruct.OpeNRC 0 traceback8//
  g_EM_SOAClient_Swc_SOA_REQ("Veh_SetSFSConStruct.Veh_SetSFSCon:3&ServiceExecuteFeedbackFlag:2&MemoryReq:1"); // 测试步骤 TC_CANTest SOA REQ Veh_SetSFSConStruct.Veh_SetSFSCon:3&ServiceExecuteFeedbackFlag:2&MemoryReq:1//Low
  g_EM_SOAClient_Swc_SOA_CHECK("Veh_SetSFSConRespStruct.Veh_SetSFSConNRC 0"); // 预期结果 TC_CANTest SOA check Veh_SetSFSConRespStruct.Veh_SetSFSConNRC 0
  g_EM_LIN_Swc_LIN_Check("C4_FRS_IntensityReq 6 CH4"); // 预期结果 TC_LINTest LIN Check C4_FRS_IntensityReq 6 CH4
  g_EM_LIN_Swc_LIN_Send("C4_FRS_CurrentIntensity 6 CH4"); // 测试步骤 TC_LINTest LIN Send C4_FRS_CurrentIntensity 6 CH4//引擎转发香氛通道真实值-closed
  g_EM_LIN_Swc_LIN_Check("C4_FRS_ChannelSelect 2 CH4"); // 预期结果 TC_LINTest LIN Check C4_FRS_ChannelSelect 2 CH4
  g_EM_LIN_Swc_LIN_Send("C4_FRS_active_container 0x2 CH4"); // 测试步骤 TC_LINTest LIN Send C4_FRS_active_container 0x2 CH4//ch3
  g_EM_SOAClient_Swc_SOA_CHECK("Veh_SFSService_ErrStruct.OpeNRC 0 traceback8"); // 预期结果 TC_CANTest SOA check Veh_SFSService_ErrStruct.OpeNRC 0 traceback8//
}

testcase SYS_CDCU_xiangfen_0153()
{
  TestDescription("香氛浓度调节---low 通道记忆3 当前通道浓度无效 IG OFF");
  teststep("warning","原始用例id为SYS-CDCU-香氛-0153");
  g_EM_LIN_Swc_LIN_Send("C4_FRS_active_container 0x3 CH4"); // 测试步骤 TC_LINTest LIN Send C4_FRS_active_container 0x3 CH4//ch3
  g_EM_Equipment_Swc_TC_4G_Time_Delay_Second("1"); // 测试步骤 TC_Sleep 1
  g_EM_SOAClient_Swc_SOA_CHECK_Prepare("Veh_SetSFSChanelRespStruct.Veh_SetSFSChanelNRC 0"); // 预期结果 TC_CANTest SOA check Veh_SetSFSChanelRespStruct.Veh_SetSFSChanelNRC 0
  g_EM_SOAClient_Swc_SOA_CHECK_Prepare("Veh_SFSService_ErrStruct.OpeNRC 0 traceback8"); // 预期结果 TC_CANTest SOA check Veh_SFSService_ErrStruct.OpeNRC 0 traceback8//
  g_EM_SOAClient_Swc_SOA_REQ("Veh_SetSFSChanelStruct.Veh_SetSFSChanel:3&ServiceExecuteFeedbackFlag:2&MemoryReq:1"); // 测试步骤 TC_CANTest SOA REQ Veh_SetSFSChanelStruct.Veh_SetSFSChanel:3&ServiceExecuteFeedbackFlag:2&MemoryReq:1//通道3
  g_EM_SOAClient_Swc_SOA_CHECK("Veh_SetSFSChanelRespStruct.Veh_SetSFSChanelNRC 0"); // 预期结果 TC_CANTest SOA check Veh_SetSFSChanelRespStruct.Veh_SetSFSChanelNRC 0
  g_EM_LIN_Swc_LIN_Check("C4_FRS_ChannelSelect 3 CH4"); // 预期结果 TC_LINTest LIN Check C4_FRS_ChannelSelect 3 CH4
  g_EM_SOAClient_Swc_SOA_CHECK("Veh_SFSService_ErrStruct.OpeNRC 0 traceback8"); // 预期结果 TC_CANTest SOA check Veh_SFSService_ErrStruct.OpeNRC 0 traceback8//
  g_EM_LIN_Swc_LIN_Send("C4_FRS_active_container 0x0 CH4"); // 测试步骤 TC_LINTest LIN Send C4_FRS_active_container 0x0 CH4//引擎转发香氛通道真实值
  g_EM_LIN_Swc_LIN_Send("C4_FRS_CurrentIntensity 0 CH4"); // 测试步骤 TC_LINTest LIN Send C4_FRS_CurrentIntensity 0 CH4//引擎转发香氛浓度真实值-closed
  g_EM_Equipment_Swc_TC_4G_Time_Delay_Second("1"); // 测试步骤 TC_Sleep 1
  g_EM_SOAClient_Swc_SOA_CHECK_Prepare("Veh_SetSFSConRespStruct.Veh_SetSFSConNRC 0"); // 预期结果 TC_CANTest SOA check Veh_SetSFSConRespStruct.Veh_SetSFSConNRC 0
  g_EM_SOAClient_Swc_SOA_CHECK_Prepare("Veh_SFSService_ErrStruct.OpeNRC 0 traceback8"); // 预期结果 TC_CANTest SOA check Veh_SFSService_ErrStruct.OpeNRC 0 traceback8//
  g_EM_SOAClient_Swc_SOA_REQ("Veh_SetSFSConStruct.Veh_SetSFSCon:1&ServiceExecuteFeedbackFlag:2&MemoryReq:1"); // 测试步骤 TC_CANTest SOA REQ Veh_SetSFSConStruct.Veh_SetSFSCon:1&ServiceExecuteFeedbackFlag:2&MemoryReq:1//Low
  g_EM_SOAClient_Swc_SOA_CHECK("Veh_SetSFSConRespStruct.Veh_SetSFSConNRC 0"); // 预期结果 TC_CANTest SOA check Veh_SetSFSConRespStruct.Veh_SetSFSConNRC 0
  g_EM_LIN_Swc_LIN_Check("C4_FRS_IntensityReq 3 CH4"); // 预期结果 TC_LINTest LIN Check C4_FRS_IntensityReq 3 CH4
  g_EM_LIN_Swc_LIN_Send("C4_FRS_CurrentIntensity 3 CH4"); // 测试步骤 TC_LINTest LIN Send C4_FRS_CurrentIntensity 3 CH4//引擎转发香氛通道真实值-closed
  g_EM_LIN_Swc_LIN_Check("C4_FRS_ChannelSelect 3 CH4"); // 预期结果 TC_LINTest LIN Check C4_FRS_ChannelSelect 3 CH4
  g_EM_LIN_Swc_LIN_Send("C4_FRS_active_container 0x3 CH4"); // 测试步骤 TC_LINTest LIN Send C4_FRS_active_container 0x3 CH4//ch3
  g_EM_SOAClient_Swc_SOA_CHECK("Veh_SFSService_ErrStruct.OpeNRC 0 traceback8"); // 预期结果 TC_CANTest SOA check Veh_SFSService_ErrStruct.OpeNRC 0 traceback8//
}

testcase SYS_CDCU_xiangfen_0154()
{
  TestDescription("香氛浓度调节---high 通道记忆3 当前通道浓度无效 IG OFF");
  teststep("warning","原始用例id为SYS-CDCU-香氛-0154");
  g_EM_LIN_Swc_LIN_Send("C4_FRS_active_container 0x0 CH4"); // 测试步骤 TC_LINTest LIN Send C4_FRS_active_container 0x0 CH4//引擎转发香氛通道真实值
  g_EM_LIN_Swc_LIN_Send("C4_FRS_CurrentIntensity 0 CH4"); // 测试步骤 TC_LINTest LIN Send C4_FRS_CurrentIntensity 0 CH4//引擎转发香氛浓度真实值-closed
  g_EM_Equipment_Swc_TC_4G_Time_Delay_Second("1"); // 测试步骤 TC_Sleep 1
  g_EM_SOAClient_Swc_SOA_CHECK_Prepare("Veh_SetSFSConRespStruct.Veh_SetSFSConNRC 0"); // 预期结果 TC_CANTest SOA check Veh_SetSFSConRespStruct.Veh_SetSFSConNRC 0
  g_EM_SOAClient_Swc_SOA_CHECK_Prepare("Veh_SFSService_ErrStruct.OpeNRC 0 traceback8"); // 预期结果 TC_CANTest SOA check Veh_SFSService_ErrStruct.OpeNRC 0 traceback8//
  g_EM_SOAClient_Swc_SOA_REQ("Veh_SetSFSConStruct.Veh_SetSFSCon:2&ServiceExecuteFeedbackFlag:2&MemoryReq:1"); // 测试步骤 TC_CANTest SOA REQ Veh_SetSFSConStruct.Veh_SetSFSCon:2&ServiceExecuteFeedbackFlag:2&MemoryReq:1//Low
  g_EM_SOAClient_Swc_SOA_CHECK("Veh_SetSFSConRespStruct.Veh_SetSFSConNRC 0"); // 预期结果 TC_CANTest SOA check Veh_SetSFSConRespStruct.Veh_SetSFSConNRC 0
  g_EM_LIN_Swc_LIN_Check("C4_FRS_IntensityReq 10 CH4"); // 预期结果 TC_LINTest LIN Check C4_FRS_IntensityReq 10 CH4
  g_EM_LIN_Swc_LIN_Send("C4_FRS_CurrentIntensity 10 CH4"); // 测试步骤 TC_LINTest LIN Send C4_FRS_CurrentIntensity 10 CH4//引擎转发香氛通道真实值-closed
  g_EM_LIN_Swc_LIN_Check("C4_FRS_ChannelSelect 3 CH4"); // 预期结果 TC_LINTest LIN Check C4_FRS_ChannelSelect 3 CH4
  g_EM_LIN_Swc_LIN_Send("C4_FRS_active_container 0x3 CH4"); // 测试步骤 TC_LINTest LIN Send C4_FRS_active_container 0x3 CH4//ch3
  g_EM_SOAClient_Swc_SOA_CHECK("Veh_SFSService_ErrStruct.OpeNRC 0 traceback8"); // 预期结果 TC_CANTest SOA check Veh_SFSService_ErrStruct.OpeNRC 0 traceback8//
}

testcase SYS_CDCU_xiangfen_0155()
{
  TestDescription("香氛浓度调节---mid 通道记忆3 当前通道浓度无效 IG OFF");
  teststep("warning","原始用例id为SYS-CDCU-香氛-0155");
  g_EM_LIN_Swc_LIN_Send("C4_FRS_active_container 0x0 CH4"); // 测试步骤 TC_LINTest LIN Send C4_FRS_active_container 0x0 CH4//引擎转发香氛通道真实值
  g_EM_LIN_Swc_LIN_Send("C4_FRS_CurrentIntensity 0 CH4"); // 测试步骤 TC_LINTest LIN Send C4_FRS_CurrentIntensity 0 CH4//引擎转发香氛浓度真实值-closed
  g_EM_Equipment_Swc_TC_4G_Time_Delay_Second("1"); // 测试步骤 TC_Sleep 1
  g_EM_SOAClient_Swc_SOA_CHECK_Prepare("Veh_SetSFSConRespStruct.Veh_SetSFSConNRC 0"); // 预期结果 TC_CANTest SOA check Veh_SetSFSConRespStruct.Veh_SetSFSConNRC 0
  g_EM_SOAClient_Swc_SOA_CHECK_Prepare("Veh_SFSService_ErrStruct.OpeNRC 0 traceback8"); // 预期结果 TC_CANTest SOA check Veh_SFSService_ErrStruct.OpeNRC 0 traceback8//
  g_EM_SOAClient_Swc_SOA_REQ("Veh_SetSFSConStruct.Veh_SetSFSCon:3&ServiceExecuteFeedbackFlag:2&MemoryReq:1"); // 测试步骤 TC_CANTest SOA REQ Veh_SetSFSConStruct.Veh_SetSFSCon:3&ServiceExecuteFeedbackFlag:2&MemoryReq:1//Low
  g_EM_SOAClient_Swc_SOA_CHECK("Veh_SetSFSConRespStruct.Veh_SetSFSConNRC 0"); // 预期结果 TC_CANTest SOA check Veh_SetSFSConRespStruct.Veh_SetSFSConNRC 0
  g_EM_LIN_Swc_LIN_Check("C4_FRS_IntensityReq 6 CH4"); // 预期结果 TC_LINTest LIN Check C4_FRS_IntensityReq 6 CH4
  g_EM_LIN_Swc_LIN_Send("C4_FRS_CurrentIntensity 6 CH4"); // 测试步骤 TC_LINTest LIN Send C4_FRS_CurrentIntensity 6 CH4//引擎转发香氛通道真实值-closed
  g_EM_LIN_Swc_LIN_Check("C4_FRS_ChannelSelect 3 CH4"); // 预期结果 TC_LINTest LIN Check C4_FRS_ChannelSelect 3 CH4
  g_EM_LIN_Swc_LIN_Send("C4_FRS_active_container 0x3 CH4"); // 测试步骤 TC_LINTest LIN Send C4_FRS_active_container 0x3 CH4//ch3
  g_EM_SOAClient_Swc_SOA_CHECK("Veh_SFSService_ErrStruct.OpeNRC 0 traceback8"); // 预期结果 TC_CANTest SOA check Veh_SFSService_ErrStruct.OpeNRC 0 traceback8//
}

testcase SYS_CDCU_xiangfen_0156()
{
  TestDescription("香氛浓度调节---low 通道记忆1 当前通道有效 浓度无效 IG OFF");
  teststep("warning","原始用例id为SYS-CDCU-香氛-0156");
  g_EM_LIN_Swc_LIN_Send("C4_FRS_active_container 0x1 CH4"); // 测试步骤 TC_LINTest LIN Send C4_FRS_active_container 0x1 CH4//ch3
  g_EM_Equipment_Swc_TC_4G_Time_Delay_Second("1"); // 测试步骤 TC_Sleep 1
  g_EM_SOAClient_Swc_SOA_CHECK_Prepare("Veh_SetSFSChanelRespStruct.Veh_SetSFSChanelNRC 0"); // 预期结果 TC_CANTest SOA check Veh_SetSFSChanelRespStruct.Veh_SetSFSChanelNRC 0
  g_EM_SOAClient_Swc_SOA_CHECK_Prepare("Veh_SFSService_ErrStruct.OpeNRC 0 traceback8"); // 预期结果 TC_CANTest SOA check Veh_SFSService_ErrStruct.OpeNRC 0 traceback8//
  g_EM_SOAClient_Swc_SOA_REQ("Veh_SetSFSChanelStruct.Veh_SetSFSChanel:1&ServiceExecuteFeedbackFlag:2&MemoryReq:1"); // 测试步骤 TC_CANTest SOA REQ Veh_SetSFSChanelStruct.Veh_SetSFSChanel:1&ServiceExecuteFeedbackFlag:2&MemoryReq:1//通道3
  g_EM_SOAClient_Swc_SOA_CHECK("Veh_SetSFSChanelRespStruct.Veh_SetSFSChanelNRC 0"); // 预期结果 TC_CANTest SOA check Veh_SetSFSChanelRespStruct.Veh_SetSFSChanelNRC 0
  g_EM_LIN_Swc_LIN_Check("C4_FRS_ChannelSelect 1 CH4"); // 预期结果 TC_LINTest LIN Check C4_FRS_ChannelSelect 1 CH4
  g_EM_SOAClient_Swc_SOA_CHECK("Veh_SFSService_ErrStruct.OpeNRC 0 traceback8"); // 预期结果 TC_CANTest SOA check Veh_SFSService_ErrStruct.OpeNRC 0 traceback8//
  g_EM_LIN_Swc_LIN_Send("C4_FRS_active_container 0x1 CH4"); // 测试步骤 TC_LINTest LIN Send C4_FRS_active_container 0x1 CH4//引擎转发香氛通道真实值
  g_EM_LIN_Swc_LIN_Send("C4_FRS_CurrentIntensity 0 CH4"); // 测试步骤 TC_LINTest LIN Send C4_FRS_CurrentIntensity 0 CH4//引擎转发香氛浓度真实值-closed
  g_EM_Equipment_Swc_TC_4G_Time_Delay_Second("1"); // 测试步骤 TC_Sleep 1
  g_EM_SOAClient_Swc_SOA_CHECK_Prepare("Veh_SetSFSConRespStruct.Veh_SetSFSConNRC 0"); // 预期结果 TC_CANTest SOA check Veh_SetSFSConRespStruct.Veh_SetSFSConNRC 0
  g_EM_SOAClient_Swc_SOA_CHECK_Prepare("Veh_SFSService_ErrStruct.OpeNRC 0 traceback8"); // 预期结果 TC_CANTest SOA check Veh_SFSService_ErrStruct.OpeNRC 0 traceback8//
  g_EM_SOAClient_Swc_SOA_REQ("Veh_SetSFSConStruct.Veh_SetSFSCon:1&ServiceExecuteFeedbackFlag:2&MemoryReq:1"); // 测试步骤 TC_CANTest SOA REQ Veh_SetSFSConStruct.Veh_SetSFSCon:1&ServiceExecuteFeedbackFlag:2&MemoryReq:1//Low
  g_EM_SOAClient_Swc_SOA_CHECK("Veh_SetSFSConRespStruct.Veh_SetSFSConNRC 0"); // 预期结果 TC_CANTest SOA check Veh_SetSFSConRespStruct.Veh_SetSFSConNRC 0
  g_EM_LIN_Swc_LIN_Check("C4_FRS_IntensityReq 3 CH4"); // 预期结果 TC_LINTest LIN Check C4_FRS_IntensityReq 3 CH4
  g_EM_LIN_Swc_LIN_Send("C4_FRS_CurrentIntensity 3 CH4"); // 测试步骤 TC_LINTest LIN Send C4_FRS_CurrentIntensity 3 CH4//引擎转发香氛通道真实值-closed
  g_EM_LIN_Swc_LIN_Check("C4_FRS_ChannelSelect 1 CH4"); // 预期结果 TC_LINTest LIN Check C4_FRS_ChannelSelect 1 CH4
  g_EM_LIN_Swc_LIN_Send("C4_FRS_active_container 0x1 CH4"); // 测试步骤 TC_LINTest LIN Send C4_FRS_active_container 0x1 CH4//ch3
  g_EM_SOAClient_Swc_SOA_CHECK("Veh_SFSService_ErrStruct.OpeNRC 0 traceback8"); // 预期结果 TC_CANTest SOA check Veh_SFSService_ErrStruct.OpeNRC 0 traceback8//
}

testcase SYS_CDCU_xiangfen_0157()
{
  TestDescription("香氛浓度调节---high 通道记忆1 当前通道有效浓度无效 IG OFF");
  teststep("warning","原始用例id为SYS-CDCU-香氛-0157");
  g_EM_LIN_Swc_LIN_Send("C4_FRS_active_container 0x1 CH4"); // 测试步骤 TC_LINTest LIN Send C4_FRS_active_container 0x1 CH4//引擎转发香氛通道真实值
  g_EM_LIN_Swc_LIN_Send("C4_FRS_CurrentIntensity 0 CH4"); // 测试步骤 TC_LINTest LIN Send C4_FRS_CurrentIntensity 0 CH4//引擎转发香氛浓度真实值-closed
  g_EM_Equipment_Swc_TC_4G_Time_Delay_Second("1"); // 测试步骤 TC_Sleep 1
  g_EM_SOAClient_Swc_SOA_CHECK_Prepare("Veh_SetSFSConRespStruct.Veh_SetSFSConNRC 0"); // 预期结果 TC_CANTest SOA check Veh_SetSFSConRespStruct.Veh_SetSFSConNRC 0
  g_EM_SOAClient_Swc_SOA_CHECK_Prepare("Veh_SFSService_ErrStruct.OpeNRC 0 traceback8"); // 预期结果 TC_CANTest SOA check Veh_SFSService_ErrStruct.OpeNRC 0 traceback8//
  g_EM_SOAClient_Swc_SOA_REQ("Veh_SetSFSConStruct.Veh_SetSFSCon:2&ServiceExecuteFeedbackFlag:2&MemoryReq:1"); // 测试步骤 TC_CANTest SOA REQ Veh_SetSFSConStruct.Veh_SetSFSCon:2&ServiceExecuteFeedbackFlag:2&MemoryReq:1//Low
  g_EM_SOAClient_Swc_SOA_CHECK("Veh_SetSFSConRespStruct.Veh_SetSFSConNRC 0"); // 预期结果 TC_CANTest SOA check Veh_SetSFSConRespStruct.Veh_SetSFSConNRC 0
  g_EM_LIN_Swc_LIN_Check("C4_FRS_IntensityReq 10 CH4"); // 预期结果 TC_LINTest LIN Check C4_FRS_IntensityReq 10 CH4
  g_EM_LIN_Swc_LIN_Send("C4_FRS_CurrentIntensity 10 CH4"); // 测试步骤 TC_LINTest LIN Send C4_FRS_CurrentIntensity 10 CH4//引擎转发香氛通道真实值-closed
  g_EM_LIN_Swc_LIN_Check("C4_FRS_ChannelSelect 1 CH4"); // 预期结果 TC_LINTest LIN Check C4_FRS_ChannelSelect 1 CH4
  g_EM_LIN_Swc_LIN_Send("C4_FRS_active_container 0x1 CH4"); // 测试步骤 TC_LINTest LIN Send C4_FRS_active_container 0x1 CH4//ch3
  g_EM_SOAClient_Swc_SOA_CHECK("Veh_SFSService_ErrStruct.OpeNRC 0 traceback8"); // 预期结果 TC_CANTest SOA check Veh_SFSService_ErrStruct.OpeNRC 0 traceback8//
}

testcase SYS_CDCU_xiangfen_0158()
{
  TestDescription("香氛浓度调节---mid 通道记忆1 当前通道有效浓度无效 IG OFF");
  teststep("warning","原始用例id为SYS-CDCU-香氛-0158");
  g_EM_LIN_Swc_LIN_Send("C4_FRS_active_container 0x1 CH4"); // 测试步骤 TC_LINTest LIN Send C4_FRS_active_container 0x1 CH4//引擎转发香氛通道真实值
  g_EM_LIN_Swc_LIN_Send("C4_FRS_CurrentIntensity 0 CH4"); // 测试步骤 TC_LINTest LIN Send C4_FRS_CurrentIntensity 0 CH4//引擎转发香氛浓度真实值-closed
  g_EM_Equipment_Swc_TC_4G_Time_Delay_Second("1"); // 测试步骤 TC_Sleep 1
  g_EM_SOAClient_Swc_SOA_CHECK_Prepare("Veh_SetSFSConRespStruct.Veh_SetSFSConNRC 0"); // 预期结果 TC_CANTest SOA check Veh_SetSFSConRespStruct.Veh_SetSFSConNRC 0
  g_EM_SOAClient_Swc_SOA_CHECK_Prepare("Veh_SFSService_ErrStruct.OpeNRC 0 traceback8"); // 预期结果 TC_CANTest SOA check Veh_SFSService_ErrStruct.OpeNRC 0 traceback8//
  g_EM_SOAClient_Swc_SOA_REQ("Veh_SetSFSConStruct.Veh_SetSFSCon:3&ServiceExecuteFeedbackFlag:2&MemoryReq:1"); // 测试步骤 TC_CANTest SOA REQ Veh_SetSFSConStruct.Veh_SetSFSCon:3&ServiceExecuteFeedbackFlag:2&MemoryReq:1//Low
  g_EM_SOAClient_Swc_SOA_CHECK("Veh_SetSFSConRespStruct.Veh_SetSFSConNRC 0"); // 预期结果 TC_CANTest SOA check Veh_SetSFSConRespStruct.Veh_SetSFSConNRC 0
  g_EM_LIN_Swc_LIN_Check("C4_FRS_IntensityReq 6 CH4"); // 预期结果 TC_LINTest LIN Check C4_FRS_IntensityReq 6 CH4
  g_EM_LIN_Swc_LIN_Send("C4_FRS_CurrentIntensity 6 CH4"); // 测试步骤 TC_LINTest LIN Send C4_FRS_CurrentIntensity 6 CH4//引擎转发香氛通道真实值-closed
  g_EM_LIN_Swc_LIN_Check("C4_FRS_ChannelSelect 1 CH4"); // 预期结果 TC_LINTest LIN Check C4_FRS_ChannelSelect 1 CH4
  g_EM_LIN_Swc_LIN_Send("C4_FRS_active_container 0x1 CH4"); // 测试步骤 TC_LINTest LIN Send C4_FRS_active_container 0x1 CH4//ch3
  g_EM_SOAClient_Swc_SOA_CHECK("Veh_SFSService_ErrStruct.OpeNRC 0 traceback8"); // 预期结果 TC_CANTest SOA check Veh_SFSService_ErrStruct.OpeNRC 0 traceback8//
}

testcase SYS_CDCU_xiangfen_0159()
{
  TestDescription("香氛浓度调节---low 通道记忆2 当前通道有效浓度无效 IG OFF");
  teststep("warning","原始用例id为SYS-CDCU-香氛-0159");
  g_EM_LIN_Swc_LIN_Send("C4_FRS_active_container 0x2 CH4"); // 测试步骤 TC_LINTest LIN Send C4_FRS_active_container 0x2 CH4//ch3
  g_EM_Equipment_Swc_TC_4G_Time_Delay_Second("1"); // 测试步骤 TC_Sleep 1
  g_EM_SOAClient_Swc_SOA_CHECK_Prepare("Veh_SetSFSChanelRespStruct.Veh_SetSFSChanelNRC 0"); // 预期结果 TC_CANTest SOA check Veh_SetSFSChanelRespStruct.Veh_SetSFSChanelNRC 0
  g_EM_SOAClient_Swc_SOA_CHECK_Prepare("Veh_SFSService_ErrStruct.OpeNRC 0 traceback8"); // 预期结果 TC_CANTest SOA check Veh_SFSService_ErrStruct.OpeNRC 0 traceback8//
  g_EM_SOAClient_Swc_SOA_REQ("Veh_SetSFSChanelStruct.Veh_SetSFSChanel:2&ServiceExecuteFeedbackFlag:2&MemoryReq:1"); // 测试步骤 TC_CANTest SOA REQ Veh_SetSFSChanelStruct.Veh_SetSFSChanel:2&ServiceExecuteFeedbackFlag:2&MemoryReq:1//通道3
  g_EM_SOAClient_Swc_SOA_CHECK("Veh_SetSFSChanelRespStruct.Veh_SetSFSChanelNRC 0"); // 预期结果 TC_CANTest SOA check Veh_SetSFSChanelRespStruct.Veh_SetSFSChanelNRC 0
  g_EM_LIN_Swc_LIN_Check("C4_FRS_ChannelSelect 2 CH4"); // 预期结果 TC_LINTest LIN Check C4_FRS_ChannelSelect 2 CH4
  g_EM_SOAClient_Swc_SOA_CHECK("Veh_SFSService_ErrStruct.OpeNRC 0 traceback8"); // 预期结果 TC_CANTest SOA check Veh_SFSService_ErrStruct.OpeNRC 0 traceback8//
  g_EM_LIN_Swc_LIN_Send("C4_FRS_active_container 0x2 CH4"); // 测试步骤 TC_LINTest LIN Send C4_FRS_active_container 0x2 CH4//引擎转发香氛通道真实值
  g_EM_LIN_Swc_LIN_Send("C4_FRS_CurrentIntensity 0 CH4"); // 测试步骤 TC_LINTest LIN Send C4_FRS_CurrentIntensity 0 CH4//引擎转发香氛浓度真实值-closed
  g_EM_Equipment_Swc_TC_4G_Time_Delay_Second("1"); // 测试步骤 TC_Sleep 1
  g_EM_SOAClient_Swc_SOA_CHECK_Prepare("Veh_SetSFSConRespStruct.Veh_SetSFSConNRC 0"); // 预期结果 TC_CANTest SOA check Veh_SetSFSConRespStruct.Veh_SetSFSConNRC 0
  g_EM_SOAClient_Swc_SOA_CHECK_Prepare("Veh_SFSService_ErrStruct.OpeNRC 0 traceback8"); // 预期结果 TC_CANTest SOA check Veh_SFSService_ErrStruct.OpeNRC 0 traceback8//
  g_EM_SOAClient_Swc_SOA_REQ("Veh_SetSFSConStruct.Veh_SetSFSCon:1&ServiceExecuteFeedbackFlag:2&MemoryReq:1"); // 测试步骤 TC_CANTest SOA REQ Veh_SetSFSConStruct.Veh_SetSFSCon:1&ServiceExecuteFeedbackFlag:2&MemoryReq:1//Low
  g_EM_SOAClient_Swc_SOA_CHECK("Veh_SetSFSConRespStruct.Veh_SetSFSConNRC 0"); // 预期结果 TC_CANTest SOA check Veh_SetSFSConRespStruct.Veh_SetSFSConNRC 0
  g_EM_LIN_Swc_LIN_Check("C4_FRS_IntensityReq 3 CH4"); // 预期结果 TC_LINTest LIN Check C4_FRS_IntensityReq 3 CH4
  g_EM_LIN_Swc_LIN_Send("C4_FRS_CurrentIntensity 3 CH4"); // 测试步骤 TC_LINTest LIN Send C4_FRS_CurrentIntensity 3 CH4//引擎转发香氛通道真实值-closed
  g_EM_LIN_Swc_LIN_Check("C4_FRS_ChannelSelect 2 CH4"); // 预期结果 TC_LINTest LIN Check C4_FRS_ChannelSelect 2 CH4
  g_EM_LIN_Swc_LIN_Send("C4_FRS_active_container 0x2 CH4"); // 测试步骤 TC_LINTest LIN Send C4_FRS_active_container 0x2 CH4//ch3
  g_EM_SOAClient_Swc_SOA_CHECK("Veh_SFSService_ErrStruct.OpeNRC 0 traceback8"); // 预期结果 TC_CANTest SOA check Veh_SFSService_ErrStruct.OpeNRC 0 traceback8//
}

testcase SYS_CDCU_xiangfen_0160()
{
  TestDescription("香氛浓度调节---high 通道记忆2 当前通道有效浓度无效 IG OFF");
  teststep("warning","原始用例id为SYS-CDCU-香氛-0160");
  g_EM_LIN_Swc_LIN_Send("C4_FRS_active_container 0x2 CH4"); // 测试步骤 TC_LINTest LIN Send C4_FRS_active_container 0x2 CH4//引擎转发香氛通道真实值
  g_EM_LIN_Swc_LIN_Send("C4_FRS_CurrentIntensity 0 CH4"); // 测试步骤 TC_LINTest LIN Send C4_FRS_CurrentIntensity 0 CH4//引擎转发香氛浓度真实值-closed
  g_EM_Equipment_Swc_TC_4G_Time_Delay_Second("1"); // 测试步骤 TC_Sleep 1
  g_EM_SOAClient_Swc_SOA_CHECK_Prepare("Veh_SetSFSConRespStruct.Veh_SetSFSConNRC 0"); // 预期结果 TC_CANTest SOA check Veh_SetSFSConRespStruct.Veh_SetSFSConNRC 0
  g_EM_SOAClient_Swc_SOA_CHECK_Prepare("Veh_SFSService_ErrStruct.OpeNRC 0 traceback8"); // 预期结果 TC_CANTest SOA check Veh_SFSService_ErrStruct.OpeNRC 0 traceback8//
  g_EM_SOAClient_Swc_SOA_REQ("Veh_SetSFSConStruct.Veh_SetSFSCon:2&ServiceExecuteFeedbackFlag:2&MemoryReq:1"); // 测试步骤 TC_CANTest SOA REQ Veh_SetSFSConStruct.Veh_SetSFSCon:2&ServiceExecuteFeedbackFlag:2&MemoryReq:1//Low
  g_EM_SOAClient_Swc_SOA_CHECK("Veh_SetSFSConRespStruct.Veh_SetSFSConNRC 0"); // 预期结果 TC_CANTest SOA check Veh_SetSFSConRespStruct.Veh_SetSFSConNRC 0
  g_EM_LIN_Swc_LIN_Check("C4_FRS_IntensityReq 10 CH4"); // 预期结果 TC_LINTest LIN Check C4_FRS_IntensityReq 10 CH4
  g_EM_LIN_Swc_LIN_Send("C4_FRS_CurrentIntensity 10 CH4"); // 测试步骤 TC_LINTest LIN Send C4_FRS_CurrentIntensity 10 CH4//引擎转发香氛通道真实值-closed
  g_EM_LIN_Swc_LIN_Check("C4_FRS_ChannelSelect 2 CH4"); // 预期结果 TC_LINTest LIN Check C4_FRS_ChannelSelect 2 CH4
  g_EM_LIN_Swc_LIN_Send("C4_FRS_active_container 0x2 CH4"); // 测试步骤 TC_LINTest LIN Send C4_FRS_active_container 0x2 CH4//ch3
  g_EM_SOAClient_Swc_SOA_CHECK("Veh_SFSService_ErrStruct.OpeNRC 0 traceback8"); // 预期结果 TC_CANTest SOA check Veh_SFSService_ErrStruct.OpeNRC 0 traceback8//
}

testcase SYS_CDCU_xiangfen_0161()
{
  TestDescription("香氛浓度调节---mid 通道记忆2 当前通道有效浓度无效 IG OFF");
  teststep("warning","原始用例id为SYS-CDCU-香氛-0161");
  g_EM_LIN_Swc_LIN_Send("C4_FRS_active_container 0x2 CH4"); // 测试步骤 TC_LINTest LIN Send C4_FRS_active_container 0x2 CH4//引擎转发香氛通道真实值
  g_EM_LIN_Swc_LIN_Send("C4_FRS_CurrentIntensity 0 CH4"); // 测试步骤 TC_LINTest LIN Send C4_FRS_CurrentIntensity 0 CH4//引擎转发香氛浓度真实值-closed
  g_EM_Equipment_Swc_TC_4G_Time_Delay_Second("1"); // 测试步骤 TC_Sleep 1
  g_EM_SOAClient_Swc_SOA_CHECK_Prepare("Veh_SetSFSConRespStruct.Veh_SetSFSConNRC 0"); // 预期结果 TC_CANTest SOA check Veh_SetSFSConRespStruct.Veh_SetSFSConNRC 0
  g_EM_SOAClient_Swc_SOA_CHECK_Prepare("Veh_SFSService_ErrStruct.OpeNRC 0 traceback8"); // 预期结果 TC_CANTest SOA check Veh_SFSService_ErrStruct.OpeNRC 0 traceback8//
  g_EM_SOAClient_Swc_SOA_REQ("Veh_SetSFSConStruct.Veh_SetSFSCon:3&ServiceExecuteFeedbackFlag:2&MemoryReq:1"); // 测试步骤 TC_CANTest SOA REQ Veh_SetSFSConStruct.Veh_SetSFSCon:3&ServiceExecuteFeedbackFlag:2&MemoryReq:1//Low
  g_EM_SOAClient_Swc_SOA_CHECK("Veh_SetSFSConRespStruct.Veh_SetSFSConNRC 0"); // 预期结果 TC_CANTest SOA check Veh_SetSFSConRespStruct.Veh_SetSFSConNRC 0
  g_EM_LIN_Swc_LIN_Check("C4_FRS_IntensityReq 6 CH4"); // 预期结果 TC_LINTest LIN Check C4_FRS_IntensityReq 6 CH4
  g_EM_LIN_Swc_LIN_Send("C4_FRS_CurrentIntensity 6 CH4"); // 测试步骤 TC_LINTest LIN Send C4_FRS_CurrentIntensity 6 CH4//引擎转发香氛通道真实值-closed
  g_EM_LIN_Swc_LIN_Check("C4_FRS_ChannelSelect 2 CH4"); // 预期结果 TC_LINTest LIN Check C4_FRS_ChannelSelect 2 CH4
  g_EM_LIN_Swc_LIN_Send("C4_FRS_active_container 0x2 CH4"); // 测试步骤 TC_LINTest LIN Send C4_FRS_active_container 0x2 CH4//ch3
  g_EM_SOAClient_Swc_SOA_CHECK("Veh_SFSService_ErrStruct.OpeNRC 0 traceback8"); // 预期结果 TC_CANTest SOA check Veh_SFSService_ErrStruct.OpeNRC 0 traceback8//
}

testcase SYS_CDCU_xiangfen_0162()
{
  TestDescription("香氛浓度调节---low 通道记忆3 当前通道有效浓度无效 IG OFF");
  teststep("warning","原始用例id为SYS-CDCU-香氛-0162");
  g_EM_LIN_Swc_LIN_Send("C4_FRS_active_container 0x3 CH4"); // 测试步骤 TC_LINTest LIN Send C4_FRS_active_container 0x3 CH4//ch3
  g_EM_Equipment_Swc_TC_4G_Time_Delay_Second("1"); // 测试步骤 TC_Sleep 1
  g_EM_SOAClient_Swc_SOA_CHECK_Prepare("Veh_SetSFSChanelRespStruct.Veh_SetSFSChanelNRC 0"); // 预期结果 TC_CANTest SOA check Veh_SetSFSChanelRespStruct.Veh_SetSFSChanelNRC 0
  g_EM_SOAClient_Swc_SOA_CHECK_Prepare("Veh_SFSService_ErrStruct.OpeNRC 0 traceback8"); // 预期结果 TC_CANTest SOA check Veh_SFSService_ErrStruct.OpeNRC 0 traceback8//
  g_EM_SOAClient_Swc_SOA_REQ("Veh_SetSFSChanelStruct.Veh_SetSFSChanel:3&ServiceExecuteFeedbackFlag:2&MemoryReq:1"); // 测试步骤 TC_CANTest SOA REQ Veh_SetSFSChanelStruct.Veh_SetSFSChanel:3&ServiceExecuteFeedbackFlag:2&MemoryReq:1//通道3
  g_EM_SOAClient_Swc_SOA_CHECK("Veh_SetSFSChanelRespStruct.Veh_SetSFSChanelNRC 0"); // 预期结果 TC_CANTest SOA check Veh_SetSFSChanelRespStruct.Veh_SetSFSChanelNRC 0
  g_EM_LIN_Swc_LIN_Check("C4_FRS_ChannelSelect 3 CH4"); // 预期结果 TC_LINTest LIN Check C4_FRS_ChannelSelect 3 CH4
  g_EM_SOAClient_Swc_SOA_CHECK("Veh_SFSService_ErrStruct.OpeNRC 0 traceback8"); // 预期结果 TC_CANTest SOA check Veh_SFSService_ErrStruct.OpeNRC 0 traceback8//
  g_EM_LIN_Swc_LIN_Send("C4_FRS_active_container 0x3 CH4"); // 测试步骤 TC_LINTest LIN Send C4_FRS_active_container 0x3 CH4//引擎转发香氛通道真实值
  g_EM_LIN_Swc_LIN_Send("C4_FRS_CurrentIntensity 0 CH4"); // 测试步骤 TC_LINTest LIN Send C4_FRS_CurrentIntensity 0 CH4//引擎转发香氛浓度真实值-closed
  g_EM_Equipment_Swc_TC_4G_Time_Delay_Second("1"); // 测试步骤 TC_Sleep 1
  g_EM_SOAClient_Swc_SOA_CHECK_Prepare("Veh_SetSFSConRespStruct.Veh_SetSFSConNRC 0"); // 预期结果 TC_CANTest SOA check Veh_SetSFSConRespStruct.Veh_SetSFSConNRC 0
  g_EM_SOAClient_Swc_SOA_CHECK_Prepare("Veh_SFSService_ErrStruct.OpeNRC 0 traceback8"); // 预期结果 TC_CANTest SOA check Veh_SFSService_ErrStruct.OpeNRC 0 traceback8//
  g_EM_SOAClient_Swc_SOA_REQ("Veh_SetSFSConStruct.Veh_SetSFSCon:1&ServiceExecuteFeedbackFlag:2&MemoryReq:1"); // 测试步骤 TC_CANTest SOA REQ Veh_SetSFSConStruct.Veh_SetSFSCon:1&ServiceExecuteFeedbackFlag:2&MemoryReq:1//Low
  g_EM_SOAClient_Swc_SOA_CHECK("Veh_SetSFSConRespStruct.Veh_SetSFSConNRC 0"); // 预期结果 TC_CANTest SOA check Veh_SetSFSConRespStruct.Veh_SetSFSConNRC 0
  g_EM_LIN_Swc_LIN_Check("C4_FRS_IntensityReq 3 CH4"); // 预期结果 TC_LINTest LIN Check C4_FRS_IntensityReq 3 CH4
  g_EM_LIN_Swc_LIN_Send("C4_FRS_CurrentIntensity 3 CH4"); // 测试步骤 TC_LINTest LIN Send C4_FRS_CurrentIntensity 3 CH4//引擎转发香氛通道真实值-closed
  g_EM_LIN_Swc_LIN_Check("C4_FRS_ChannelSelect 3 CH4"); // 预期结果 TC_LINTest LIN Check C4_FRS_ChannelSelect 3 CH4
  g_EM_LIN_Swc_LIN_Send("C4_FRS_active_container 0x3 CH4"); // 测试步骤 TC_LINTest LIN Send C4_FRS_active_container 0x3 CH4//ch3
  g_EM_SOAClient_Swc_SOA_CHECK("Veh_SFSService_ErrStruct.OpeNRC 0 traceback8"); // 预期结果 TC_CANTest SOA check Veh_SFSService_ErrStruct.OpeNRC 0 traceback8//
}

testcase SYS_CDCU_xiangfen_0163()
{
  TestDescription("香氛浓度调节---mid 通道记忆3 当前通道有效浓度无效 IG OFF");
  teststep("warning","原始用例id为SYS-CDCU-香氛-0163");
  g_EM_LIN_Swc_LIN_Send("C4_FRS_active_container 0x3 CH4"); // 测试步骤 TC_LINTest LIN Send C4_FRS_active_container 0x3 CH4//引擎转发香氛通道真实值
  g_EM_LIN_Swc_LIN_Send("C4_FRS_CurrentIntensity 0 CH4"); // 测试步骤 TC_LINTest LIN Send C4_FRS_CurrentIntensity 0 CH4//引擎转发香氛浓度真实值-closed
  g_EM_Equipment_Swc_TC_4G_Time_Delay_Second("1"); // 测试步骤 TC_Sleep 1
  g_EM_SOAClient_Swc_SOA_CHECK_Prepare("Veh_SetSFSConRespStruct.Veh_SetSFSConNRC 0"); // 预期结果 TC_CANTest SOA check Veh_SetSFSConRespStruct.Veh_SetSFSConNRC 0
  g_EM_SOAClient_Swc_SOA_CHECK_Prepare("Veh_SFSService_ErrStruct.OpeNRC 0 traceback8"); // 预期结果 TC_CANTest SOA check Veh_SFSService_ErrStruct.OpeNRC 0 traceback8//
  g_EM_SOAClient_Swc_SOA_REQ("Veh_SetSFSConStruct.Veh_SetSFSCon:3&ServiceExecuteFeedbackFlag:2&MemoryReq:1"); // 测试步骤 TC_CANTest SOA REQ Veh_SetSFSConStruct.Veh_SetSFSCon:3&ServiceExecuteFeedbackFlag:2&MemoryReq:1//Low
  g_EM_SOAClient_Swc_SOA_CHECK("Veh_SetSFSConRespStruct.Veh_SetSFSConNRC 0"); // 预期结果 TC_CANTest SOA check Veh_SetSFSConRespStruct.Veh_SetSFSConNRC 0
  g_EM_LIN_Swc_LIN_Check("C4_FRS_IntensityReq 6 CH4"); // 预期结果 TC_LINTest LIN Check C4_FRS_IntensityReq 6 CH4
  g_EM_LIN_Swc_LIN_Send("C4_FRS_CurrentIntensity 6 CH4"); // 测试步骤 TC_LINTest LIN Send C4_FRS_CurrentIntensity 6 CH4//引擎转发香氛通道真实值-closed
  g_EM_LIN_Swc_LIN_Check("C4_FRS_ChannelSelect 3 CH4"); // 预期结果 TC_LINTest LIN Check C4_FRS_ChannelSelect 3 CH4
  g_EM_LIN_Swc_LIN_Send("C4_FRS_active_container 0x3 CH4"); // 测试步骤 TC_LINTest LIN Send C4_FRS_active_container 0x3 CH4//ch3
  g_EM_SOAClient_Swc_SOA_CHECK("Veh_SFSService_ErrStruct.OpeNRC 0 traceback8"); // 预期结果 TC_CANTest SOA check Veh_SFSService_ErrStruct.OpeNRC 0 traceback8//
}

testcase SYS_CDCU_xiangfen_0164()
{
  TestDescription("香氛浓度调节---high 通道记忆3 当前通道有效浓度无效 IG OFF");
  teststep("warning","原始用例id为SYS-CDCU-香氛-0164");
  g_EM_LIN_Swc_LIN_Send("C4_FRS_active_container 0x3 CH4"); // 测试步骤 TC_LINTest LIN Send C4_FRS_active_container 0x3 CH4//引擎转发香氛通道真实值
  g_EM_LIN_Swc_LIN_Send("C4_FRS_CurrentIntensity 0 CH4"); // 测试步骤 TC_LINTest LIN Send C4_FRS_CurrentIntensity 0 CH4//引擎转发香氛浓度真实值-closed
  g_EM_Equipment_Swc_TC_4G_Time_Delay_Second("1"); // 测试步骤 TC_Sleep 1
  g_EM_SOAClient_Swc_SOA_CHECK_Prepare("Veh_SetSFSConRespStruct.Veh_SetSFSConNRC 0"); // 预期结果 TC_CANTest SOA check Veh_SetSFSConRespStruct.Veh_SetSFSConNRC 0
  g_EM_SOAClient_Swc_SOA_CHECK_Prepare("Veh_SFSService_ErrStruct.OpeNRC 0 traceback8"); // 预期结果 TC_CANTest SOA check Veh_SFSService_ErrStruct.OpeNRC 0 traceback8//
  g_EM_SOAClient_Swc_SOA_REQ("Veh_SetSFSConStruct.Veh_SetSFSCon:2&ServiceExecuteFeedbackFlag:2&MemoryReq:1"); // 测试步骤 TC_CANTest SOA REQ Veh_SetSFSConStruct.Veh_SetSFSCon:2&ServiceExecuteFeedbackFlag:2&MemoryReq:1//Low
  g_EM_SOAClient_Swc_SOA_CHECK("Veh_SetSFSConRespStruct.Veh_SetSFSConNRC 0"); // 预期结果 TC_CANTest SOA check Veh_SetSFSConRespStruct.Veh_SetSFSConNRC 0
  g_EM_LIN_Swc_LIN_Check("C4_FRS_IntensityReq 10 CH4"); // 预期结果 TC_LINTest LIN Check C4_FRS_IntensityReq 10 CH4
  g_EM_LIN_Swc_LIN_Send("C4_FRS_CurrentIntensity 10 CH4"); // 测试步骤 TC_LINTest LIN Send C4_FRS_CurrentIntensity 10 CH4//引擎转发香氛通道真实值-closed
  g_EM_LIN_Swc_LIN_Check("C4_FRS_ChannelSelect 3 CH4"); // 预期结果 TC_LINTest LIN Check C4_FRS_ChannelSelect 3 CH4
  g_EM_LIN_Swc_LIN_Send("C4_FRS_active_container 0x3 CH4"); // 测试步骤 TC_LINTest LIN Send C4_FRS_active_container 0x3 CH4//ch3
  g_EM_SOAClient_Swc_SOA_CHECK("Veh_SFSService_ErrStruct.OpeNRC 0 traceback8"); // 预期结果 TC_CANTest SOA check Veh_SFSService_ErrStruct.OpeNRC 0 traceback8//
}

testcase SYS_CDCU_xiangfen_0165()
{
  TestDescription("上电后香氛默认值-状态为非init Local on");
  teststep("warning","原始用例id为SYS-CDCU-香氛-0165");
  g_EM_Equipment_Swc_TC_IG("ON"); // 测试步骤 TC_IG ON
  g_EM_LIN_Swc_LIN_Send("C4_FRS_CurrentIntensity 3 CH4"); // 测试步骤 TC_LINTest LIN Send C4_FRS_CurrentIntensity 3 CH4
  g_EM_LIN_Swc_LIN_Send("C4_FRS_active_container 1 CH4"); // 测试步骤 TC_LINTest LIN Send C4_FRS_active_container 1 CH4
  g_EM_LIN_Swc_LIN_Send("C4_FRS_FragranceID_Container_1 1 CH4"); // 测试步骤 TC_LINTest LIN Send C4_FRS_FragranceID_Container_1 1 CH4
  g_EM_LIN_Swc_LIN_Send("C4_FRS_FragranceID_Container_2 1 CH4"); // 测试步骤 TC_LINTest LIN Send C4_FRS_FragranceID_Container_2 1 CH4
  g_EM_LIN_Swc_LIN_Send("C4_FRS_FragranceID_Container_3 1 CH4"); // 测试步骤 TC_LINTest LIN Send C4_FRS_FragranceID_Container_3 1 CH4
  g_EM_Equipment_Swc_TC_PW("OFF"); // 测试步骤 TC_PW OFF
  g_EM_Equipment_Swc_TC_4G_Time_Delay_Second("1"); // 测试步骤 TC_Sleep 1
  g_EM_Equipment_Swc_TC_PW("ON"); // 测试步骤 TC_PW ON
  g_EM_Equipment_Swc_TC_4G_Time_Delay_Second("2"); // 测试步骤 TC_Sleep 2
  g_EM_SOAClient_Swc_SOA_SubPeriod("SFSSt 1"); // 测试步骤 TC_CANTest SOA SubPeriod SFSSt 1
  g_EM_LIN_Swc_LIN_Disable("0x35 CH4"); // 测试步骤 TC_LINTest LIN Disable 0x35 CH4
  g_EM_SOAClient_Swc_SOA_CHECK_Prepare("SFSStStruct.SFS_Ch1_Type 0x81"); // 预期结果 TC_CANTest SOA check SFSStStruct.SFS_Ch1_Type 0x81
  g_EM_SOAClient_Swc_SOA_CHECK_Prepare("SFSStStruct.SFS_Ch2_Type 0x81"); // 预期结果 TC_CANTest SOA check SFSStStruct.SFS_Ch2_Type 0x81
  g_EM_SOAClient_Swc_SOA_CHECK_Prepare("SFSStStruct.SFS_Ch3_Type 0x81"); // 预期结果 TC_CANTest SOA check SFSStStruct.SFS_Ch3_Type 0x81
  g_CAN_Bus_Swc_Set("I_LDCU_BodySysSt1.I_LDCU_PowerMode 1"); // 测试步骤 TC_CANTest SET I_LDCU_BodySysSt1.I_LDCU_PowerMode 1
  g_EM_SOAClient_Swc_SOA_CHECK("SFSStStruct.SFS_Ch1_Type 0x81"); // 预期结果 TC_CANTest SOA check SFSStStruct.SFS_Ch1_Type 0x81
  g_EM_SOAClient_Swc_SOA_CHECK("SFSStStruct.SFS_Ch2_Type 0x81"); // 预期结果 TC_CANTest SOA check SFSStStruct.SFS_Ch2_Type 0x81
  g_EM_SOAClient_Swc_SOA_CHECK("SFSStStruct.SFS_Ch3_Type 0x81"); // 预期结果 TC_CANTest SOA check SFSStStruct.SFS_Ch3_Type 0x81
}

testcase SYS_CDCU_xiangfen_0166()
{
  TestDescription("香氛浓度调节记忆 IG ON");
  teststep("warning","原始用例id为SYS-CDCU-香氛-0166");
  g_EM_Equipment_Swc_TC_IG("ON"); // 测试步骤 TC_IG ON
  g_CAN_Bus_Swc_Set("I_LDCU_BodySysSt1.I_LDCU_PowerMode 1"); // 测试步骤 TC_CANTest SET I_LDCU_BodySysSt1.I_LDCU_PowerMode 1
  g_CAN_Bus_Swc_Set("C_LDCU_SysSt.C_LDCU_EVSysReadySt 2"); // 测试步骤 TC_CANTest SET C_LDCU_SysSt.C_LDCU_EVSysReadySt 2//上高压
  g_EM_LIN_Swc_LIN_Send("C4_FRS_CurrentIntensity 3 CH4"); // 测试步骤 TC_LINTest LIN Send C4_FRS_CurrentIntensity 3 CH4
  g_EM_Equipment_Swc_TC_4G_Time_Delay_Second("1"); // 测试步骤 TC_Sleep 1
  g_EM_SOAClient_Swc_SOA_CHECK_Prepare("Veh_SetSFSConRespStruct.Veh_SetSFSConNRC 0"); // 预期结果 TC_CANTest SOA check Veh_SetSFSConRespStruct.Veh_SetSFSConNRC 0
  g_EM_SOAClient_Swc_SOA_CHECK_Prepare("Veh_SFSService_ErrStruct.OpeNRC 0 traceback8"); // 预期结果 TC_CANTest SOA check Veh_SFSService_ErrStruct.OpeNRC 0 traceback8//
  g_EM_SOAClient_Swc_SOA_REQ("Veh_SetSFSConStruct.Veh_SetSFSCon:1&MemoryReq:1&ServiceExecuteFeedbackFlag:2"); // 测试步骤 TC_CANTest SOA REQ Veh_SetSFSConStruct.Veh_SetSFSCon:1&MemoryReq:1&ServiceExecuteFeedbackFlag:2//Low
  g_EM_SOAClient_Swc_SOA_CHECK("Veh_SetSFSConRespStruct.Veh_SetSFSConNRC 0"); // 预期结果 TC_CANTest SOA check Veh_SetSFSConRespStruct.Veh_SetSFSConNRC 0
  g_EM_LIN_Swc_LIN_Check("C4_FRS_IntensityReq 3 CH4"); // 预期结果 TC_LINTest LIN Check C4_FRS_IntensityReq 3 CH4
  g_EM_SOAClient_Swc_SOA_CHECK("Veh_SFSService_ErrStruct.OpeNRC 0 traceback8"); // 预期结果 TC_CANTest SOA check Veh_SFSService_ErrStruct.OpeNRC 0 traceback8//
  g_EM_Equipment_Swc_TC_IG("OFF"); // 测试步骤 TC_IG OFF
  g_EM_Equipment_Swc_TC_4G_Time_Delay_Second("5"); // 测试步骤 TC_Sleep 5
  g_EM_Equipment_Swc_TC_PW("OFF"); // 测试步骤 TC_PW OFF
  g_EM_Equipment_Swc_TC_4G_Time_Delay_Second("5"); // 测试步骤 TC_Sleep 5
  g_EM_Equipment_Swc_TC_PW("ON"); // 测试步骤 TC_PW ON
  g_EM_Equipment_Swc_TC_4G_Time_Delay_Second("5"); // 测试步骤 TC_Sleep 5
  g_EM_Equipment_Swc_TC_IG("ON"); // 测试步骤 TC_IG ON
  g_EM_Equipment_Swc_TC_4G_Time_Delay_Second("5"); // 测试步骤 TC_Sleep 5
  g_EM_LIN_Swc_LIN_Check("C4_FRS_IntensityReq 3 CH4"); // 预期结果 TC_LINTest LIN Check C4_FRS_IntensityReq 3 CH4
}

testcase SYS_CDCU_xiangfen_0167()
{
  TestDescription("香氛通道调节记忆 IG ON");
  teststep("warning","原始用例id为SYS-CDCU-香氛-0167");
  g_EM_Equipment_Swc_TC_IG("ON"); // 测试步骤 TC_IG ON
  g_CAN_Bus_Swc_Set("I_LDCU_BodySysSt1.I_LDCU_PowerMode 1"); // 测试步骤 TC_CANTest SET I_LDCU_BodySysSt1.I_LDCU_PowerMode 1
  g_CAN_Bus_Swc_Set("C_LDCU_SysSt.C_LDCU_EVSysReadySt 2"); // 测试步骤 TC_CANTest SET C_LDCU_SysSt.C_LDCU_EVSysReadySt 2//上高压
  g_EM_LIN_Swc_LIN_Send("C4_FRS_active_container 0x3 CH4"); // 测试步骤 TC_LINTest LIN Send C4_FRS_active_container 0x3 CH4//ch1
  g_EM_Equipment_Swc_TC_4G_Time_Delay_Second("1"); // 测试步骤 TC_Sleep 1
  g_EM_SOAClient_Swc_SOA_CHECK_Prepare("Veh_SetSFSChanelRespStruct.Veh_SetSFSChanelNRC 0"); // 预期结果 TC_CANTest SOA check Veh_SetSFSChanelRespStruct.Veh_SetSFSChanelNRC 0
  g_EM_SOAClient_Swc_SOA_CHECK_Prepare("Veh_SFSService_ErrStruct.OpeNRC 0 traceback8"); // 预期结果 TC_CANTest SOA check Veh_SFSService_ErrStruct.OpeNRC 0 traceback8//
  g_EM_SOAClient_Swc_SOA_REQ("Veh_SetSFSChanelStruct.Veh_SetSFSChanel:3&MemoryReq:1&ServiceExecuteFeedbackFlag:2"); // 测试步骤 TC_CANTest SOA REQ Veh_SetSFSChanelStruct.Veh_SetSFSChanel:3&MemoryReq:1&ServiceExecuteFeedbackFlag:2//通道1
  g_EM_SOAClient_Swc_SOA_CHECK("Veh_SetSFSChanelRespStruct.Veh_SetSFSChanelNRC 0"); // 预期结果 TC_CANTest SOA check Veh_SetSFSChanelRespStruct.Veh_SetSFSChanelNRC 0
  g_EM_LIN_Swc_LIN_Check("C4_FRS_ChannelSelect 3 CH4"); // 预期结果 TC_LINTest LIN Check C4_FRS_ChannelSelect 3 CH4
  g_EM_SOAClient_Swc_SOA_CHECK("Veh_SFSService_ErrStruct.OpeNRC 0 traceback8"); // 预期结果 TC_CANTest SOA check Veh_SFSService_ErrStruct.OpeNRC 0 traceback8//
  g_EM_Equipment_Swc_TC_IG("OFF"); // 测试步骤 TC_IG OFF
  g_EM_Equipment_Swc_TC_4G_Time_Delay_Second("5"); // 测试步骤 TC_Sleep 5
  g_EM_Equipment_Swc_TC_PW("OFF"); // 测试步骤 TC_PW OFF
  g_EM_Equipment_Swc_TC_4G_Time_Delay_Second("5"); // 测试步骤 TC_Sleep 5
  g_EM_Equipment_Swc_TC_PW("ON"); // 测试步骤 TC_PW ON
  g_EM_Equipment_Swc_TC_4G_Time_Delay_Second("5"); // 测试步骤 TC_Sleep 5
  g_EM_Equipment_Swc_TC_IG("ON"); // 测试步骤 TC_IG ON
  g_EM_Equipment_Swc_TC_4G_Time_Delay_Second("5"); // 测试步骤 TC_Sleep 5
  g_EM_LIN_Swc_LIN_Check("C4_FRS_ChannelSelect 3 CH4"); // 预期结果 TC_LINTest LIN Check C4_FRS_ChannelSelect 3 CH4
}

testcase SYS_CDCU_xiangfen_0168()
{
  TestDescription("香氛浓度记忆，拔插香氛通道1浓度中 IG ON");
  teststep("warning","原始用例id为SYS-CDCU-香氛-0168");
  g_CAN_Bus_Swc_Set("I_LDCU_BodySysSt1.I_LDCU_PowerMode 1"); // 测试步骤 TC_CANTest SET I_LDCU_BodySysSt1.I_LDCU_PowerMode 1
  g_CAN_Bus_Swc_Set("C_LDCU_SysSt.C_LDCU_EVSysReadySt 2"); // 测试步骤 TC_CANTest SET C_LDCU_SysSt.C_LDCU_EVSysReadySt 2//上高压
  g_EM_LIN_Swc_LIN_Send("C4_FRS_active_container 0x1 CH4"); // 测试步骤 TC_LINTest LIN Send C4_FRS_active_container 0x1 CH4//ch1
  g_EM_LIN_Swc_LIN_Send("C4_FRS_CurrentIntensity 6 CH4"); // 测试步骤 TC_LINTest LIN Send C4_FRS_CurrentIntensity 6 CH4
  g_EM_SOAClient_Swc_SOA_CHECK_Prepare("Veh_SetSFSChanelRespStruct.Veh_SetSFSChanelNRC 0"); // 预期结果 TC_CANTest SOA check Veh_SetSFSChanelRespStruct.Veh_SetSFSChanelNRC 0
  g_EM_SOAClient_Swc_SOA_CHECK_Prepare("Veh_SFSService_ErrStruct.OpeNRC 0 traceback8"); // 预期结果 TC_CANTest SOA check Veh_SFSService_ErrStruct.OpeNRC 0 traceback8//
  g_EM_SOAClient_Swc_SOA_REQ("Veh_SetSFSChanelStruct.Veh_SetSFSChanel:1&MemoryReq:1&ServiceExecuteFeedbackFlag:2"); // 测试步骤 TC_CANTest SOA REQ Veh_SetSFSChanelStruct.Veh_SetSFSChanel:1&MemoryReq:1&ServiceExecuteFeedbackFlag:2//通道1
  g_EM_SOAClient_Swc_SOA_CHECK("Veh_SetSFSChanelRespStruct.Veh_SetSFSChanelNRC 0"); // 预期结果 TC_CANTest SOA check Veh_SetSFSChanelRespStruct.Veh_SetSFSChanelNRC 0
  g_EM_LIN_Swc_LIN_Check("C4_FRS_ChannelSelect 1 CH4"); // 预期结果 TC_LINTest LIN Check C4_FRS_ChannelSelect 1 CH4
  g_EM_SOAClient_Swc_SOA_CHECK("Veh_SFSService_ErrStruct.OpeNRC 0 traceback8"); // 预期结果 TC_CANTest SOA check Veh_SFSService_ErrStruct.OpeNRC 0 traceback8//
  g_EM_SOAClient_Swc_SOA_CHECK_Prepare("Veh_SetSFSConRespStruct.Veh_SetSFSConNRC 0"); // 预期结果 TC_CANTest SOA check Veh_SetSFSConRespStruct.Veh_SetSFSConNRC 0
  g_EM_SOAClient_Swc_SOA_CHECK_Prepare("Veh_SFSService_ErrStruct.OpeNRC 0 traceback8"); // 预期结果 TC_CANTest SOA check Veh_SFSService_ErrStruct.OpeNRC 0 traceback8//
  g_EM_SOAClient_Swc_SOA_REQ("Veh_SetSFSConStruct.Veh_SetSFSCon:3&MemoryReq:1&ServiceExecuteFeedbackFlag:2"); // 测试步骤 TC_CANTest SOA REQ Veh_SetSFSConStruct.Veh_SetSFSCon:3&MemoryReq:1&ServiceExecuteFeedbackFlag:2//Low
  g_EM_SOAClient_Swc_SOA_CHECK("Veh_SetSFSConRespStruct.Veh_SetSFSConNRC 0"); // 预期结果 TC_CANTest SOA check Veh_SetSFSConRespStruct.Veh_SetSFSConNRC 0
  g_EM_LIN_Swc_LIN_Check("C4_FRS_IntensityReq 6 CH4"); // 预期结果 TC_LINTest LIN Check C4_FRS_IntensityReq 6 CH4
  g_EM_SOAClient_Swc_SOA_CHECK("Veh_SFSService_ErrStruct.OpeNRC 0 traceback8"); // 预期结果 TC_CANTest SOA check Veh_SFSService_ErrStruct.OpeNRC 0 traceback8//
  g_EM_LIN_Swc_LIN_Send("C4_FRS_FragranceID_Container_1 0 CH4"); // 测试步骤 TC_LINTest LIN Send C4_FRS_FragranceID_Container_1 0 CH4
  g_EM_LIN_Swc_LIN_Check("C4_FRS_IntensityReq 6 CH4"); // 预期结果 TC_LINTest LIN Check C4_FRS_IntensityReq 6 CH4
  g_EM_Equipment_Swc_TC_4G_Time_Delay_Second("11"); // 测试步骤 TC_Sleep 11//故障延迟10s
  g_EM_LIN_Swc_LIN_Check("C4_FRS_IntensityReq 0 CH4"); // 预期结果 TC_LINTest LIN Check C4_FRS_IntensityReq 0 CH4
  g_EM_LIN_Swc_LIN_Send("C4_FRS_FragranceID_Container_1 1 CH4"); // 测试步骤 TC_LINTest LIN Send C4_FRS_FragranceID_Container_1 1 CH4
  g_EM_SOAClient_Swc_SOA_CHECK_Prepare("Veh_TurnOnOffSFSRespStruct.Veh_TurnOnOffSFSNRC 0"); // 预期结果 TC_CANTest SOA check Veh_TurnOnOffSFSRespStruct.Veh_TurnOnOffSFSNRC 0
  g_EM_SOAClient_Swc_SOA_CHECK_Prepare("Veh_SFSService_ErrStruct.OpeNRC 0 traceback8"); // 预期结果 TC_CANTest SOA check Veh_SFSService_ErrStruct.OpeNRC 0 traceback8//
  g_EM_SOAClient_Swc_SOA_REQ("Veh_TurnOnOffSFSStruct.Veh_TurnOnOffSFS:1&ServiceExecuteFeedbackFlag:2"); // 测试步骤 TC_CANTest SOA REQ Veh_TurnOnOffSFSStruct.Veh_TurnOnOffSFS:1&ServiceExecuteFeedbackFlag:2//ON
  g_EM_SOAClient_Swc_SOA_CHECK("Veh_TurnOnOffSFSRespStruct.Veh_TurnOnOffSFSNRC 0"); // 预期结果 TC_CANTest SOA check Veh_TurnOnOffSFSRespStruct.Veh_TurnOnOffSFSNRC 0
  g_EM_LIN_Swc_LIN_Check("C4_FRS_IntensityReq 6 CH4"); // 预期结果 TC_LINTest LIN Check C4_FRS_IntensityReq 6 CH4
  g_EM_SOAClient_Swc_SOA_CHECK("Veh_SFSService_ErrStruct.OpeNRC 0 traceback8"); // 预期结果 TC_CANTest SOA check Veh_SFSService_ErrStruct.OpeNRC 0 traceback8//
}

testcase SYS_CDCU_xiangfen_0169()
{
  TestDescription("香氛浓度记忆，拔插香氛通道1浓度低 IG ON");
  teststep("warning","原始用例id为SYS-CDCU-香氛-0169");
  g_CAN_Bus_Swc_Set("I_LDCU_BodySysSt1.I_LDCU_PowerMode 1"); // 测试步骤 TC_CANTest SET I_LDCU_BodySysSt1.I_LDCU_PowerMode 1
  g_CAN_Bus_Swc_Set("C_LDCU_SysSt.C_LDCU_EVSysReadySt 2"); // 测试步骤 TC_CANTest SET C_LDCU_SysSt.C_LDCU_EVSysReadySt 2//上高压
  g_EM_LIN_Swc_LIN_Send("C4_FRS_active_container 0x1 CH4"); // 测试步骤 TC_LINTest LIN Send C4_FRS_active_container 0x1 CH4//ch1
  g_EM_LIN_Swc_LIN_Send("C4_FRS_CurrentIntensity 3 CH4"); // 测试步骤 TC_LINTest LIN Send C4_FRS_CurrentIntensity 3 CH4
  g_EM_SOAClient_Swc_SOA_CHECK_Prepare("Veh_SetSFSChanelRespStruct.Veh_SetSFSChanelNRC 0"); // 预期结果 TC_CANTest SOA check Veh_SetSFSChanelRespStruct.Veh_SetSFSChanelNRC 0
  g_EM_SOAClient_Swc_SOA_CHECK_Prepare("Veh_SFSService_ErrStruct.OpeNRC 0 traceback8"); // 预期结果 TC_CANTest SOA check Veh_SFSService_ErrStruct.OpeNRC 0 traceback8//
  g_EM_SOAClient_Swc_SOA_REQ("Veh_SetSFSChanelStruct.Veh_SetSFSChanel:1&MemoryReq:1&ServiceExecuteFeedbackFlag:2"); // 测试步骤 TC_CANTest SOA REQ Veh_SetSFSChanelStruct.Veh_SetSFSChanel:1&MemoryReq:1&ServiceExecuteFeedbackFlag:2//通道1
  g_EM_SOAClient_Swc_SOA_CHECK("Veh_SetSFSChanelRespStruct.Veh_SetSFSChanelNRC 0"); // 预期结果 TC_CANTest SOA check Veh_SetSFSChanelRespStruct.Veh_SetSFSChanelNRC 0
  g_EM_LIN_Swc_LIN_Check("C4_FRS_ChannelSelect 1 CH4"); // 预期结果 TC_LINTest LIN Check C4_FRS_ChannelSelect 1 CH4
  g_EM_SOAClient_Swc_SOA_CHECK("Veh_SFSService_ErrStruct.OpeNRC 0 traceback8"); // 预期结果 TC_CANTest SOA check Veh_SFSService_ErrStruct.OpeNRC 0 traceback8//
  g_EM_SOAClient_Swc_SOA_CHECK_Prepare("Veh_SetSFSConRespStruct.Veh_SetSFSConNRC 0"); // 预期结果 TC_CANTest SOA check Veh_SetSFSConRespStruct.Veh_SetSFSConNRC 0
  g_EM_SOAClient_Swc_SOA_CHECK_Prepare("Veh_SFSService_ErrStruct.OpeNRC 0 traceback8"); // 预期结果 TC_CANTest SOA check Veh_SFSService_ErrStruct.OpeNRC 0 traceback8//
  g_EM_SOAClient_Swc_SOA_REQ("Veh_SetSFSConStruct.Veh_SetSFSCon:1&MemoryReq:1&ServiceExecuteFeedbackFlag:2"); // 测试步骤 TC_CANTest SOA REQ Veh_SetSFSConStruct.Veh_SetSFSCon:1&MemoryReq:1&ServiceExecuteFeedbackFlag:2//Low
  g_EM_SOAClient_Swc_SOA_CHECK("Veh_SetSFSConRespStruct.Veh_SetSFSConNRC 0"); // 预期结果 TC_CANTest SOA check Veh_SetSFSConRespStruct.Veh_SetSFSConNRC 0
  g_EM_LIN_Swc_LIN_Check("C4_FRS_IntensityReq 3 CH4"); // 预期结果 TC_LINTest LIN Check C4_FRS_IntensityReq 3 CH4
  g_EM_SOAClient_Swc_SOA_CHECK("Veh_SFSService_ErrStruct.OpeNRC 0 traceback8"); // 预期结果 TC_CANTest SOA check Veh_SFSService_ErrStruct.OpeNRC 0 traceback8//
  g_EM_LIN_Swc_LIN_Send("C4_FRS_FragranceID_Container_1 0 CH4"); // 测试步骤 TC_LINTest LIN Send C4_FRS_FragranceID_Container_1 0 CH4
  g_EM_LIN_Swc_LIN_Check("C4_FRS_IntensityReq 3 CH4"); // 预期结果 TC_LINTest LIN Check C4_FRS_IntensityReq 3 CH4
  g_EM_Equipment_Swc_TC_4G_Time_Delay_Second("11"); // 测试步骤 TC_Sleep 11//故障延迟10s
  g_EM_LIN_Swc_LIN_Check("C4_FRS_IntensityReq 0 CH4"); // 预期结果 TC_LINTest LIN Check C4_FRS_IntensityReq 0 CH4
  g_EM_LIN_Swc_LIN_Send("C4_FRS_FragranceID_Container_1 1 CH4"); // 测试步骤 TC_LINTest LIN Send C4_FRS_FragranceID_Container_1 1 CH4
  g_EM_SOAClient_Swc_SOA_CHECK_Prepare("Veh_TurnOnOffSFSRespStruct.Veh_TurnOnOffSFSNRC 0"); // 预期结果 TC_CANTest SOA check Veh_TurnOnOffSFSRespStruct.Veh_TurnOnOffSFSNRC 0
  g_EM_SOAClient_Swc_SOA_CHECK_Prepare("Veh_SFSService_ErrStruct.OpeNRC 0 traceback8"); // 预期结果 TC_CANTest SOA check Veh_SFSService_ErrStruct.OpeNRC 0 traceback8//
  g_EM_SOAClient_Swc_SOA_REQ("Veh_TurnOnOffSFSStruct.Veh_TurnOnOffSFS:1&ServiceExecuteFeedbackFlag:2"); // 测试步骤 TC_CANTest SOA REQ Veh_TurnOnOffSFSStruct.Veh_TurnOnOffSFS:1&ServiceExecuteFeedbackFlag:2//ON
  g_EM_SOAClient_Swc_SOA_CHECK("Veh_TurnOnOffSFSRespStruct.Veh_TurnOnOffSFSNRC 0"); // 预期结果 TC_CANTest SOA check Veh_TurnOnOffSFSRespStruct.Veh_TurnOnOffSFSNRC 0
  g_EM_LIN_Swc_LIN_Check("C4_FRS_IntensityReq 3 CH4"); // 预期结果 TC_LINTest LIN Check C4_FRS_IntensityReq 3 CH4
  g_EM_SOAClient_Swc_SOA_CHECK("Veh_SFSService_ErrStruct.OpeNRC 0 traceback8"); // 预期结果 TC_CANTest SOA check Veh_SFSService_ErrStruct.OpeNRC 0 traceback8//
}

testcase SYS_CDCU_xiangfen_0170()
{
  TestDescription("香氛浓度记忆，拔插香氛通道1浓度高 IG ON");
  teststep("warning","原始用例id为SYS-CDCU-香氛-0170");
  g_CAN_Bus_Swc_Set("I_LDCU_BodySysSt1.I_LDCU_PowerMode 1"); // 测试步骤 TC_CANTest SET I_LDCU_BodySysSt1.I_LDCU_PowerMode 1
  g_CAN_Bus_Swc_Set("C_LDCU_SysSt.C_LDCU_EVSysReadySt 2"); // 测试步骤 TC_CANTest SET C_LDCU_SysSt.C_LDCU_EVSysReadySt 2//上高压
  g_EM_LIN_Swc_LIN_Send("C4_FRS_active_container 0x1 CH4"); // 测试步骤 TC_LINTest LIN Send C4_FRS_active_container 0x1 CH4//ch1
  g_EM_LIN_Swc_LIN_Send("C4_FRS_CurrentIntensity 10 CH4"); // 测试步骤 TC_LINTest LIN Send C4_FRS_CurrentIntensity 10 CH4
  g_EM_SOAClient_Swc_SOA_CHECK_Prepare("Veh_SetSFSChanelRespStruct.Veh_SetSFSChanelNRC 0"); // 预期结果 TC_CANTest SOA check Veh_SetSFSChanelRespStruct.Veh_SetSFSChanelNRC 0
  g_EM_SOAClient_Swc_SOA_CHECK_Prepare("Veh_SFSService_ErrStruct.OpeNRC 0 traceback8"); // 预期结果 TC_CANTest SOA check Veh_SFSService_ErrStruct.OpeNRC 0 traceback8//
  g_EM_SOAClient_Swc_SOA_REQ("Veh_SetSFSChanelStruct.Veh_SetSFSChanel:1&MemoryReq:1&ServiceExecuteFeedbackFlag:2"); // 测试步骤 TC_CANTest SOA REQ Veh_SetSFSChanelStruct.Veh_SetSFSChanel:1&MemoryReq:1&ServiceExecuteFeedbackFlag:2//通道1
  g_EM_SOAClient_Swc_SOA_CHECK("Veh_SetSFSChanelRespStruct.Veh_SetSFSChanelNRC 0"); // 预期结果 TC_CANTest SOA check Veh_SetSFSChanelRespStruct.Veh_SetSFSChanelNRC 0
  g_EM_LIN_Swc_LIN_Check("C4_FRS_ChannelSelect 1 CH4"); // 预期结果 TC_LINTest LIN Check C4_FRS_ChannelSelect 1 CH4
  g_EM_SOAClient_Swc_SOA_CHECK("Veh_SFSService_ErrStruct.OpeNRC 0 traceback8"); // 预期结果 TC_CANTest SOA check Veh_SFSService_ErrStruct.OpeNRC 0 traceback8//
  g_EM_SOAClient_Swc_SOA_CHECK_Prepare("Veh_SetSFSConRespStruct.Veh_SetSFSConNRC 0"); // 预期结果 TC_CANTest SOA check Veh_SetSFSConRespStruct.Veh_SetSFSConNRC 0
  g_EM_SOAClient_Swc_SOA_CHECK_Prepare("Veh_SFSService_ErrStruct.OpeNRC 0 traceback8"); // 预期结果 TC_CANTest SOA check Veh_SFSService_ErrStruct.OpeNRC 0 traceback8//
  g_EM_SOAClient_Swc_SOA_REQ("Veh_SetSFSConStruct.Veh_SetSFSCon:2&MemoryReq:1&ServiceExecuteFeedbackFlag:2"); // 测试步骤 TC_CANTest SOA REQ Veh_SetSFSConStruct.Veh_SetSFSCon:2&MemoryReq:1&ServiceExecuteFeedbackFlag:2//Low
  g_EM_SOAClient_Swc_SOA_CHECK("Veh_SetSFSConRespStruct.Veh_SetSFSConNRC 0"); // 预期结果 TC_CANTest SOA check Veh_SetSFSConRespStruct.Veh_SetSFSConNRC 0
  g_EM_LIN_Swc_LIN_Check("C4_FRS_IntensityReq 10 CH4"); // 预期结果 TC_LINTest LIN Check C4_FRS_IntensityReq 10 CH4
  g_EM_SOAClient_Swc_SOA_CHECK("Veh_SFSService_ErrStruct.OpeNRC 0 traceback8"); // 预期结果 TC_CANTest SOA check Veh_SFSService_ErrStruct.OpeNRC 0 traceback8//
  g_EM_LIN_Swc_LIN_Send("C4_FRS_FragranceID_Container_1 0 CH4"); // 测试步骤 TC_LINTest LIN Send C4_FRS_FragranceID_Container_1 0 CH4
  g_EM_LIN_Swc_LIN_Check("C4_FRS_IntensityReq 10 CH4"); // 预期结果 TC_LINTest LIN Check C4_FRS_IntensityReq 10 CH4
  g_EM_Equipment_Swc_TC_4G_Time_Delay_Second("11"); // 测试步骤 TC_Sleep 11//故障延迟10s
  g_EM_LIN_Swc_LIN_Check("C4_FRS_IntensityReq 0 CH4"); // 预期结果 TC_LINTest LIN Check C4_FRS_IntensityReq 0 CH4
  g_EM_LIN_Swc_LIN_Send("C4_FRS_FragranceID_Container_1 1 CH4"); // 测试步骤 TC_LINTest LIN Send C4_FRS_FragranceID_Container_1 1 CH4
  g_EM_SOAClient_Swc_SOA_CHECK_Prepare("Veh_TurnOnOffSFSRespStruct.Veh_TurnOnOffSFSNRC 0"); // 预期结果 TC_CANTest SOA check Veh_TurnOnOffSFSRespStruct.Veh_TurnOnOffSFSNRC 0
  g_EM_SOAClient_Swc_SOA_CHECK_Prepare("Veh_SFSService_ErrStruct.OpeNRC 0 traceback8"); // 预期结果 TC_CANTest SOA check Veh_SFSService_ErrStruct.OpeNRC 0 traceback8//
  g_EM_SOAClient_Swc_SOA_REQ("Veh_TurnOnOffSFSStruct.Veh_TurnOnOffSFS:1&ServiceExecuteFeedbackFlag:2"); // 测试步骤 TC_CANTest SOA REQ Veh_TurnOnOffSFSStruct.Veh_TurnOnOffSFS:1&ServiceExecuteFeedbackFlag:2//ON
  g_EM_SOAClient_Swc_SOA_CHECK("Veh_TurnOnOffSFSRespStruct.Veh_TurnOnOffSFSNRC 0"); // 预期结果 TC_CANTest SOA check Veh_TurnOnOffSFSRespStruct.Veh_TurnOnOffSFSNRC 0
  g_EM_LIN_Swc_LIN_Check("C4_FRS_IntensityReq 10 CH4"); // 预期结果 TC_LINTest LIN Check C4_FRS_IntensityReq 10 CH4
  g_EM_SOAClient_Swc_SOA_CHECK("Veh_SFSService_ErrStruct.OpeNRC 0 traceback8"); // 预期结果 TC_CANTest SOA check Veh_SFSService_ErrStruct.OpeNRC 0 traceback8//
}

testcase SYS_CDCU_xiangfen_0171()
{
  TestDescription("香氛浓度记忆，拔插香氛通道2浓度中 IG ON");
  teststep("warning","原始用例id为SYS-CDCU-香氛-0171");
  g_CAN_Bus_Swc_Set("I_LDCU_BodySysSt1.I_LDCU_PowerMode 1"); // 测试步骤 TC_CANTest SET I_LDCU_BodySysSt1.I_LDCU_PowerMode 1
  g_CAN_Bus_Swc_Set("C_LDCU_SysSt.C_LDCU_EVSysReadySt 2"); // 测试步骤 TC_CANTest SET C_LDCU_SysSt.C_LDCU_EVSysReadySt 2//上高压
  g_EM_LIN_Swc_LIN_Send("C4_FRS_active_container 0x2 CH4"); // 测试步骤 TC_LINTest LIN Send C4_FRS_active_container 0x2 CH4//ch1
  g_EM_LIN_Swc_LIN_Send("C4_FRS_CurrentIntensity 6 CH4"); // 测试步骤 TC_LINTest LIN Send C4_FRS_CurrentIntensity 6 CH4
  g_EM_SOAClient_Swc_SOA_CHECK_Prepare("Veh_SetSFSChanelRespStruct.Veh_SetSFSChanelNRC 0"); // 预期结果 TC_CANTest SOA check Veh_SetSFSChanelRespStruct.Veh_SetSFSChanelNRC 0
  g_EM_SOAClient_Swc_SOA_CHECK_Prepare("Veh_SFSService_ErrStruct.OpeNRC 0 traceback8"); // 预期结果 TC_CANTest SOA check Veh_SFSService_ErrStruct.OpeNRC 0 traceback8//
  g_EM_SOAClient_Swc_SOA_REQ("Veh_SetSFSChanelStruct.Veh_SetSFSChanel:2&MemoryReq:1&ServiceExecuteFeedbackFlag:2"); // 测试步骤 TC_CANTest SOA REQ Veh_SetSFSChanelStruct.Veh_SetSFSChanel:2&MemoryReq:1&ServiceExecuteFeedbackFlag:2//通道1
  g_EM_SOAClient_Swc_SOA_CHECK("Veh_SetSFSChanelRespStruct.Veh_SetSFSChanelNRC 0"); // 预期结果 TC_CANTest SOA check Veh_SetSFSChanelRespStruct.Veh_SetSFSChanelNRC 0
  g_EM_LIN_Swc_LIN_Check("C4_FRS_ChannelSelect 2 CH4"); // 预期结果 TC_LINTest LIN Check C4_FRS_ChannelSelect 2 CH4
  g_EM_SOAClient_Swc_SOA_CHECK("Veh_SFSService_ErrStruct.OpeNRC 0 traceback8"); // 预期结果 TC_CANTest SOA check Veh_SFSService_ErrStruct.OpeNRC 0 traceback8//
  g_EM_SOAClient_Swc_SOA_CHECK_Prepare("Veh_SetSFSConRespStruct.Veh_SetSFSConNRC 0"); // 预期结果 TC_CANTest SOA check Veh_SetSFSConRespStruct.Veh_SetSFSConNRC 0
  g_EM_SOAClient_Swc_SOA_CHECK_Prepare("Veh_SFSService_ErrStruct.OpeNRC 0 traceback8"); // 预期结果 TC_CANTest SOA check Veh_SFSService_ErrStruct.OpeNRC 0 traceback8//
  g_EM_SOAClient_Swc_SOA_REQ("Veh_SetSFSConStruct.Veh_SetSFSCon:3&MemoryReq:1&ServiceExecuteFeedbackFlag:2"); // 测试步骤 TC_CANTest SOA REQ Veh_SetSFSConStruct.Veh_SetSFSCon:3&MemoryReq:1&ServiceExecuteFeedbackFlag:2//Low
  g_EM_SOAClient_Swc_SOA_CHECK("Veh_SetSFSConRespStruct.Veh_SetSFSConNRC 0"); // 预期结果 TC_CANTest SOA check Veh_SetSFSConRespStruct.Veh_SetSFSConNRC 0
  g_EM_LIN_Swc_LIN_Check("C4_FRS_IntensityReq 6 CH4"); // 预期结果 TC_LINTest LIN Check C4_FRS_IntensityReq 6 CH4
  g_EM_SOAClient_Swc_SOA_CHECK("Veh_SFSService_ErrStruct.OpeNRC 0 traceback8"); // 预期结果 TC_CANTest SOA check Veh_SFSService_ErrStruct.OpeNRC 0 traceback8//
  g_EM_LIN_Swc_LIN_Send("C4_FRS_FragranceID_Container_2 0 CH4"); // 测试步骤 TC_LINTest LIN Send C4_FRS_FragranceID_Container_2 0 CH4
  g_EM_LIN_Swc_LIN_Check("C4_FRS_IntensityReq 6 CH4"); // 预期结果 TC_LINTest LIN Check C4_FRS_IntensityReq 6 CH4
  g_EM_Equipment_Swc_TC_4G_Time_Delay_Second("11"); // 测试步骤 TC_Sleep 11//故障延迟10s
  g_EM_LIN_Swc_LIN_Check("C4_FRS_IntensityReq 0 CH4"); // 预期结果 TC_LINTest LIN Check C4_FRS_IntensityReq 0 CH4
  g_EM_LIN_Swc_LIN_Send("C4_FRS_FragranceID_Container_2 1 CH4"); // 测试步骤 TC_LINTest LIN Send C4_FRS_FragranceID_Container_2 1 CH4
  g_EM_SOAClient_Swc_SOA_CHECK_Prepare("Veh_TurnOnOffSFSRespStruct.Veh_TurnOnOffSFSNRC 0"); // 预期结果 TC_CANTest SOA check Veh_TurnOnOffSFSRespStruct.Veh_TurnOnOffSFSNRC 0
  g_EM_SOAClient_Swc_SOA_CHECK_Prepare("Veh_SFSService_ErrStruct.OpeNRC 0 traceback8"); // 预期结果 TC_CANTest SOA check Veh_SFSService_ErrStruct.OpeNRC 0 traceback8//
  g_EM_SOAClient_Swc_SOA_REQ("Veh_TurnOnOffSFSStruct.Veh_TurnOnOffSFS:1&ServiceExecuteFeedbackFlag:2"); // 测试步骤 TC_CANTest SOA REQ Veh_TurnOnOffSFSStruct.Veh_TurnOnOffSFS:1&ServiceExecuteFeedbackFlag:2//ON
  g_EM_SOAClient_Swc_SOA_CHECK("Veh_TurnOnOffSFSRespStruct.Veh_TurnOnOffSFSNRC 0"); // 预期结果 TC_CANTest SOA check Veh_TurnOnOffSFSRespStruct.Veh_TurnOnOffSFSNRC 0
  g_EM_LIN_Swc_LIN_Check("C4_FRS_IntensityReq 6 CH4"); // 预期结果 TC_LINTest LIN Check C4_FRS_IntensityReq 6 CH4
  g_EM_SOAClient_Swc_SOA_CHECK("Veh_SFSService_ErrStruct.OpeNRC 0 traceback8"); // 预期结果 TC_CANTest SOA check Veh_SFSService_ErrStruct.OpeNRC 0 traceback8//
}

testcase SYS_CDCU_xiangfen_0172()
{
  TestDescription("香氛浓度记忆，拔插香氛通道2浓度低 IG ON");
  teststep("warning","原始用例id为SYS-CDCU-香氛-0172");
  g_CAN_Bus_Swc_Set("I_LDCU_BodySysSt1.I_LDCU_PowerMode 1"); // 测试步骤 TC_CANTest SET I_LDCU_BodySysSt1.I_LDCU_PowerMode 1
  g_CAN_Bus_Swc_Set("C_LDCU_SysSt.C_LDCU_EVSysReadySt 2"); // 测试步骤 TC_CANTest SET C_LDCU_SysSt.C_LDCU_EVSysReadySt 2//上高压
  g_EM_LIN_Swc_LIN_Send("C4_FRS_active_container 0x2 CH4"); // 测试步骤 TC_LINTest LIN Send C4_FRS_active_container 0x2 CH4//ch1
  g_EM_LIN_Swc_LIN_Send("C4_FRS_CurrentIntensity 3 CH4"); // 测试步骤 TC_LINTest LIN Send C4_FRS_CurrentIntensity 3 CH4
  g_EM_SOAClient_Swc_SOA_CHECK_Prepare("Veh_SetSFSChanelRespStruct.Veh_SetSFSChanelNRC 0"); // 预期结果 TC_CANTest SOA check Veh_SetSFSChanelRespStruct.Veh_SetSFSChanelNRC 0
  g_EM_SOAClient_Swc_SOA_CHECK_Prepare("Veh_SFSService_ErrStruct.OpeNRC 0 traceback8"); // 预期结果 TC_CANTest SOA check Veh_SFSService_ErrStruct.OpeNRC 0 traceback8//
  g_EM_SOAClient_Swc_SOA_REQ("Veh_SetSFSChanelStruct.Veh_SetSFSChanel:2&MemoryReq:1&ServiceExecuteFeedbackFlag:2"); // 测试步骤 TC_CANTest SOA REQ Veh_SetSFSChanelStruct.Veh_SetSFSChanel:2&MemoryReq:1&ServiceExecuteFeedbackFlag:2//通道1
  g_EM_SOAClient_Swc_SOA_CHECK("Veh_SetSFSChanelRespStruct.Veh_SetSFSChanelNRC 0"); // 预期结果 TC_CANTest SOA check Veh_SetSFSChanelRespStruct.Veh_SetSFSChanelNRC 0
  g_EM_LIN_Swc_LIN_Check("C4_FRS_ChannelSelect 2 CH4"); // 预期结果 TC_LINTest LIN Check C4_FRS_ChannelSelect 2 CH4
  g_EM_SOAClient_Swc_SOA_CHECK("Veh_SFSService_ErrStruct.OpeNRC 0 traceback8"); // 预期结果 TC_CANTest SOA check Veh_SFSService_ErrStruct.OpeNRC 0 traceback8//
  g_EM_SOAClient_Swc_SOA_CHECK_Prepare("Veh_SetSFSConRespStruct.Veh_SetSFSConNRC 0"); // 预期结果 TC_CANTest SOA check Veh_SetSFSConRespStruct.Veh_SetSFSConNRC 0
  g_EM_SOAClient_Swc_SOA_CHECK_Prepare("Veh_SFSService_ErrStruct.OpeNRC 0 traceback8"); // 预期结果 TC_CANTest SOA check Veh_SFSService_ErrStruct.OpeNRC 0 traceback8//
  g_EM_SOAClient_Swc_SOA_REQ("Veh_SetSFSConStruct.Veh_SetSFSCon:1&MemoryReq:1&ServiceExecuteFeedbackFlag:2"); // 测试步骤 TC_CANTest SOA REQ Veh_SetSFSConStruct.Veh_SetSFSCon:1&MemoryReq:1&ServiceExecuteFeedbackFlag:2//Low
  g_EM_SOAClient_Swc_SOA_CHECK("Veh_SetSFSConRespStruct.Veh_SetSFSConNRC 0"); // 预期结果 TC_CANTest SOA check Veh_SetSFSConRespStruct.Veh_SetSFSConNRC 0
  g_EM_LIN_Swc_LIN_Check("C4_FRS_IntensityReq 3 CH4"); // 预期结果 TC_LINTest LIN Check C4_FRS_IntensityReq 3 CH4
  g_EM_SOAClient_Swc_SOA_CHECK("Veh_SFSService_ErrStruct.OpeNRC 0 traceback8"); // 预期结果 TC_CANTest SOA check Veh_SFSService_ErrStruct.OpeNRC 0 traceback8//
  g_EM_LIN_Swc_LIN_Send("C4_FRS_FragranceID_Container_2 0 CH4"); // 测试步骤 TC_LINTest LIN Send C4_FRS_FragranceID_Container_2 0 CH4
  g_EM_LIN_Swc_LIN_Check("C4_FRS_IntensityReq 3 CH4"); // 预期结果 TC_LINTest LIN Check C4_FRS_IntensityReq 3 CH4
  g_EM_Equipment_Swc_TC_4G_Time_Delay_Second("11"); // 测试步骤 TC_Sleep 11//故障延迟10s
  g_EM_LIN_Swc_LIN_Check("C4_FRS_IntensityReq 0 CH4"); // 预期结果 TC_LINTest LIN Check C4_FRS_IntensityReq 0 CH4
  g_EM_LIN_Swc_LIN_Send("C4_FRS_FragranceID_Container_2 1 CH4"); // 测试步骤 TC_LINTest LIN Send C4_FRS_FragranceID_Container_2 1 CH4
  g_EM_SOAClient_Swc_SOA_CHECK_Prepare("Veh_TurnOnOffSFSRespStruct.Veh_TurnOnOffSFSNRC 0"); // 预期结果 TC_CANTest SOA check Veh_TurnOnOffSFSRespStruct.Veh_TurnOnOffSFSNRC 0
  g_EM_SOAClient_Swc_SOA_CHECK_Prepare("Veh_SFSService_ErrStruct.OpeNRC 0 traceback8"); // 预期结果 TC_CANTest SOA check Veh_SFSService_ErrStruct.OpeNRC 0 traceback8//
  g_EM_SOAClient_Swc_SOA_REQ("Veh_TurnOnOffSFSStruct.Veh_TurnOnOffSFS:1&ServiceExecuteFeedbackFlag:2"); // 测试步骤 TC_CANTest SOA REQ Veh_TurnOnOffSFSStruct.Veh_TurnOnOffSFS:1&ServiceExecuteFeedbackFlag:2//ON
  g_EM_SOAClient_Swc_SOA_CHECK("Veh_TurnOnOffSFSRespStruct.Veh_TurnOnOffSFSNRC 0"); // 预期结果 TC_CANTest SOA check Veh_TurnOnOffSFSRespStruct.Veh_TurnOnOffSFSNRC 0
  g_EM_LIN_Swc_LIN_Check("C4_FRS_IntensityReq 3 CH4"); // 预期结果 TC_LINTest LIN Check C4_FRS_IntensityReq 3 CH4
  g_EM_SOAClient_Swc_SOA_CHECK("Veh_SFSService_ErrStruct.OpeNRC 0 traceback8"); // 预期结果 TC_CANTest SOA check Veh_SFSService_ErrStruct.OpeNRC 0 traceback8//
}

testcase SYS_CDCU_xiangfen_0173()
{
  TestDescription("香氛浓度记忆，拔插香氛通道2浓度高 IG ON");
  teststep("warning","原始用例id为SYS-CDCU-香氛-0173");
  g_CAN_Bus_Swc_Set("I_LDCU_BodySysSt1.I_LDCU_PowerMode 1"); // 测试步骤 TC_CANTest SET I_LDCU_BodySysSt1.I_LDCU_PowerMode 1
  g_CAN_Bus_Swc_Set("C_LDCU_SysSt.C_LDCU_EVSysReadySt 2"); // 测试步骤 TC_CANTest SET C_LDCU_SysSt.C_LDCU_EVSysReadySt 2//上高压
  g_EM_LIN_Swc_LIN_Send("C4_FRS_active_container 0x2 CH4"); // 测试步骤 TC_LINTest LIN Send C4_FRS_active_container 0x2 CH4//ch1
  g_EM_LIN_Swc_LIN_Send("C4_FRS_CurrentIntensity 10 CH4"); // 测试步骤 TC_LINTest LIN Send C4_FRS_CurrentIntensity 10 CH4
  g_EM_SOAClient_Swc_SOA_CHECK_Prepare("Veh_SetSFSChanelRespStruct.Veh_SetSFSChanelNRC 0"); // 预期结果 TC_CANTest SOA check Veh_SetSFSChanelRespStruct.Veh_SetSFSChanelNRC 0
  g_EM_SOAClient_Swc_SOA_CHECK_Prepare("Veh_SFSService_ErrStruct.OpeNRC 0 traceback8"); // 预期结果 TC_CANTest SOA check Veh_SFSService_ErrStruct.OpeNRC 0 traceback8//
  g_EM_SOAClient_Swc_SOA_REQ("Veh_SetSFSChanelStruct.Veh_SetSFSChanel:2&MemoryReq:1&ServiceExecuteFeedbackFlag:2"); // 测试步骤 TC_CANTest SOA REQ Veh_SetSFSChanelStruct.Veh_SetSFSChanel:2&MemoryReq:1&ServiceExecuteFeedbackFlag:2//通道1
  g_EM_SOAClient_Swc_SOA_CHECK("Veh_SetSFSChanelRespStruct.Veh_SetSFSChanelNRC 0"); // 预期结果 TC_CANTest SOA check Veh_SetSFSChanelRespStruct.Veh_SetSFSChanelNRC 0
  g_EM_LIN_Swc_LIN_Check("C4_FRS_ChannelSelect 2 CH4"); // 预期结果 TC_LINTest LIN Check C4_FRS_ChannelSelect 2 CH4
  g_EM_SOAClient_Swc_SOA_CHECK("Veh_SFSService_ErrStruct.OpeNRC 0 traceback8"); // 预期结果 TC_CANTest SOA check Veh_SFSService_ErrStruct.OpeNRC 0 traceback8//
  g_EM_SOAClient_Swc_SOA_CHECK_Prepare("Veh_SetSFSConRespStruct.Veh_SetSFSConNRC 0"); // 预期结果 TC_CANTest SOA check Veh_SetSFSConRespStruct.Veh_SetSFSConNRC 0
  g_EM_SOAClient_Swc_SOA_CHECK_Prepare("Veh_SFSService_ErrStruct.OpeNRC 0 traceback8"); // 预期结果 TC_CANTest SOA check Veh_SFSService_ErrStruct.OpeNRC 0 traceback8//
  g_EM_SOAClient_Swc_SOA_REQ("Veh_SetSFSConStruct.Veh_SetSFSCon:2&MemoryReq:1&ServiceExecuteFeedbackFlag:2"); // 测试步骤 TC_CANTest SOA REQ Veh_SetSFSConStruct.Veh_SetSFSCon:2&MemoryReq:1&ServiceExecuteFeedbackFlag:2//Low
  g_EM_SOAClient_Swc_SOA_CHECK("Veh_SetSFSConRespStruct.Veh_SetSFSConNRC 0"); // 预期结果 TC_CANTest SOA check Veh_SetSFSConRespStruct.Veh_SetSFSConNRC 0
  g_EM_LIN_Swc_LIN_Check("C4_FRS_IntensityReq 10 CH4"); // 预期结果 TC_LINTest LIN Check C4_FRS_IntensityReq 10 CH4
  g_EM_SOAClient_Swc_SOA_CHECK("Veh_SFSService_ErrStruct.OpeNRC 0 traceback8"); // 预期结果 TC_CANTest SOA check Veh_SFSService_ErrStruct.OpeNRC 0 traceback8//
  g_EM_LIN_Swc_LIN_Send("C4_FRS_FragranceID_Container_2 0 CH4"); // 测试步骤 TC_LINTest LIN Send C4_FRS_FragranceID_Container_2 0 CH4
  g_EM_LIN_Swc_LIN_Check("C4_FRS_IntensityReq 10 CH4"); // 预期结果 TC_LINTest LIN Check C4_FRS_IntensityReq 10 CH4
  g_EM_Equipment_Swc_TC_4G_Time_Delay_Second("11"); // 测试步骤 TC_Sleep 11//故障延迟10s
  g_EM_LIN_Swc_LIN_Check("C4_FRS_IntensityReq 0 CH4"); // 预期结果 TC_LINTest LIN Check C4_FRS_IntensityReq 0 CH4
  g_EM_LIN_Swc_LIN_Send("C4_FRS_FragranceID_Container_2 1 CH4"); // 测试步骤 TC_LINTest LIN Send C4_FRS_FragranceID_Container_2 1 CH4
  g_EM_SOAClient_Swc_SOA_CHECK_Prepare("Veh_TurnOnOffSFSRespStruct.Veh_TurnOnOffSFSNRC 0"); // 预期结果 TC_CANTest SOA check Veh_TurnOnOffSFSRespStruct.Veh_TurnOnOffSFSNRC 0
  g_EM_SOAClient_Swc_SOA_CHECK_Prepare("Veh_SFSService_ErrStruct.OpeNRC 0 traceback8"); // 预期结果 TC_CANTest SOA check Veh_SFSService_ErrStruct.OpeNRC 0 traceback8//
  g_EM_SOAClient_Swc_SOA_REQ("Veh_TurnOnOffSFSStruct.Veh_TurnOnOffSFS:1&ServiceExecuteFeedbackFlag:2"); // 测试步骤 TC_CANTest SOA REQ Veh_TurnOnOffSFSStruct.Veh_TurnOnOffSFS:1&ServiceExecuteFeedbackFlag:2//ON
  g_EM_SOAClient_Swc_SOA_CHECK("Veh_TurnOnOffSFSRespStruct.Veh_TurnOnOffSFSNRC 0"); // 预期结果 TC_CANTest SOA check Veh_TurnOnOffSFSRespStruct.Veh_TurnOnOffSFSNRC 0
  g_EM_LIN_Swc_LIN_Check("C4_FRS_IntensityReq 10 CH4"); // 预期结果 TC_LINTest LIN Check C4_FRS_IntensityReq 10 CH4
  g_EM_SOAClient_Swc_SOA_CHECK("Veh_SFSService_ErrStruct.OpeNRC 0 traceback8"); // 预期结果 TC_CANTest SOA check Veh_SFSService_ErrStruct.OpeNRC 0 traceback8//
}

testcase SYS_CDCU_xiangfen_0174()
{
  TestDescription("香氛浓度记忆，拔插香氛通道3浓度中 IG ON");
  teststep("warning","原始用例id为SYS-CDCU-香氛-0174");
  g_CAN_Bus_Swc_Set("I_LDCU_BodySysSt1.I_LDCU_PowerMode 1"); // 测试步骤 TC_CANTest SET I_LDCU_BodySysSt1.I_LDCU_PowerMode 1
  g_CAN_Bus_Swc_Set("C_LDCU_SysSt.C_LDCU_EVSysReadySt 2"); // 测试步骤 TC_CANTest SET C_LDCU_SysSt.C_LDCU_EVSysReadySt 2//上高压
  g_EM_LIN_Swc_LIN_Send("C4_FRS_active_container 0x3 CH4"); // 测试步骤 TC_LINTest LIN Send C4_FRS_active_container 0x3 CH4//ch1
  g_EM_LIN_Swc_LIN_Send("C4_FRS_CurrentIntensity 6 CH4"); // 测试步骤 TC_LINTest LIN Send C4_FRS_CurrentIntensity 6 CH4
  g_EM_SOAClient_Swc_SOA_CHECK_Prepare("Veh_SetSFSChanelRespStruct.Veh_SetSFSChanelNRC 0"); // 预期结果 TC_CANTest SOA check Veh_SetSFSChanelRespStruct.Veh_SetSFSChanelNRC 0
  g_EM_SOAClient_Swc_SOA_CHECK_Prepare("Veh_SFSService_ErrStruct.OpeNRC 0 traceback8"); // 预期结果 TC_CANTest SOA check Veh_SFSService_ErrStruct.OpeNRC 0 traceback8//
  g_EM_SOAClient_Swc_SOA_REQ("Veh_SetSFSChanelStruct.Veh_SetSFSChanel:3&MemoryReq:1&ServiceExecuteFeedbackFlag:2"); // 测试步骤 TC_CANTest SOA REQ Veh_SetSFSChanelStruct.Veh_SetSFSChanel:3&MemoryReq:1&ServiceExecuteFeedbackFlag:2//通道1
  g_EM_SOAClient_Swc_SOA_CHECK("Veh_SetSFSChanelRespStruct.Veh_SetSFSChanelNRC 0"); // 预期结果 TC_CANTest SOA check Veh_SetSFSChanelRespStruct.Veh_SetSFSChanelNRC 0
  g_EM_LIN_Swc_LIN_Check("C4_FRS_ChannelSelect 3 CH4"); // 预期结果 TC_LINTest LIN Check C4_FRS_ChannelSelect 3 CH4
  g_EM_SOAClient_Swc_SOA_CHECK("Veh_SFSService_ErrStruct.OpeNRC 0 traceback8"); // 预期结果 TC_CANTest SOA check Veh_SFSService_ErrStruct.OpeNRC 0 traceback8//
  g_EM_SOAClient_Swc_SOA_CHECK_Prepare("Veh_SetSFSConRespStruct.Veh_SetSFSConNRC 0"); // 预期结果 TC_CANTest SOA check Veh_SetSFSConRespStruct.Veh_SetSFSConNRC 0
  g_EM_SOAClient_Swc_SOA_CHECK_Prepare("Veh_SFSService_ErrStruct.OpeNRC 0 traceback8"); // 预期结果 TC_CANTest SOA check Veh_SFSService_ErrStruct.OpeNRC 0 traceback8//
  g_EM_SOAClient_Swc_SOA_REQ("Veh_SetSFSConStruct.Veh_SetSFSCon:3&MemoryReq:1&ServiceExecuteFeedbackFlag:2"); // 测试步骤 TC_CANTest SOA REQ Veh_SetSFSConStruct.Veh_SetSFSCon:3&MemoryReq:1&ServiceExecuteFeedbackFlag:2//Low
  g_EM_SOAClient_Swc_SOA_CHECK("Veh_SetSFSConRespStruct.Veh_SetSFSConNRC 0"); // 预期结果 TC_CANTest SOA check Veh_SetSFSConRespStruct.Veh_SetSFSConNRC 0
  g_EM_LIN_Swc_LIN_Check("C4_FRS_IntensityReq 6 CH4"); // 预期结果 TC_LINTest LIN Check C4_FRS_IntensityReq 6 CH4
  g_EM_SOAClient_Swc_SOA_CHECK("Veh_SFSService_ErrStruct.OpeNRC 0 traceback8"); // 预期结果 TC_CANTest SOA check Veh_SFSService_ErrStruct.OpeNRC 0 traceback8//
  g_EM_LIN_Swc_LIN_Send("C4_FRS_FragranceID_Container_3 0 CH4"); // 测试步骤 TC_LINTest LIN Send C4_FRS_FragranceID_Container_3 0 CH4
  g_EM_LIN_Swc_LIN_Check("C4_FRS_IntensityReq 6 CH4"); // 预期结果 TC_LINTest LIN Check C4_FRS_IntensityReq 6 CH4
  g_EM_Equipment_Swc_TC_4G_Time_Delay_Second("11"); // 测试步骤 TC_Sleep 11//故障延迟10s
  g_EM_LIN_Swc_LIN_Check("C4_FRS_IntensityReq 0 CH4"); // 预期结果 TC_LINTest LIN Check C4_FRS_IntensityReq 0 CH4
  g_EM_LIN_Swc_LIN_Send("C4_FRS_FragranceID_Container_3 1 CH4"); // 测试步骤 TC_LINTest LIN Send C4_FRS_FragranceID_Container_3 1 CH4
  g_EM_SOAClient_Swc_SOA_CHECK_Prepare("Veh_TurnOnOffSFSRespStruct.Veh_TurnOnOffSFSNRC 0"); // 预期结果 TC_CANTest SOA check Veh_TurnOnOffSFSRespStruct.Veh_TurnOnOffSFSNRC 0
  g_EM_SOAClient_Swc_SOA_CHECK_Prepare("Veh_SFSService_ErrStruct.OpeNRC 0 traceback8"); // 预期结果 TC_CANTest SOA check Veh_SFSService_ErrStruct.OpeNRC 0 traceback8//
  g_EM_SOAClient_Swc_SOA_REQ("Veh_TurnOnOffSFSStruct.Veh_TurnOnOffSFS:1&ServiceExecuteFeedbackFlag:2"); // 测试步骤 TC_CANTest SOA REQ Veh_TurnOnOffSFSStruct.Veh_TurnOnOffSFS:1&ServiceExecuteFeedbackFlag:2//ON
  g_EM_SOAClient_Swc_SOA_CHECK("Veh_TurnOnOffSFSRespStruct.Veh_TurnOnOffSFSNRC 0"); // 预期结果 TC_CANTest SOA check Veh_TurnOnOffSFSRespStruct.Veh_TurnOnOffSFSNRC 0
  g_EM_LIN_Swc_LIN_Check("C4_FRS_IntensityReq 6 CH4"); // 预期结果 TC_LINTest LIN Check C4_FRS_IntensityReq 6 CH4
  g_EM_SOAClient_Swc_SOA_CHECK("Veh_SFSService_ErrStruct.OpeNRC 0 traceback8"); // 预期结果 TC_CANTest SOA check Veh_SFSService_ErrStruct.OpeNRC 0 traceback8//
}

testcase SYS_CDCU_xiangfen_0175()
{
  TestDescription("香氛浓度记忆，拔插香氛通道3浓度低 IG ON");
  teststep("warning","原始用例id为SYS-CDCU-香氛-0175");
  g_CAN_Bus_Swc_Set("I_LDCU_BodySysSt1.I_LDCU_PowerMode 1"); // 测试步骤 TC_CANTest SET I_LDCU_BodySysSt1.I_LDCU_PowerMode 1
  g_CAN_Bus_Swc_Set("C_LDCU_SysSt.C_LDCU_EVSysReadySt 2"); // 测试步骤 TC_CANTest SET C_LDCU_SysSt.C_LDCU_EVSysReadySt 2//上高压
  g_EM_LIN_Swc_LIN_Send("C4_FRS_active_container 0x3 CH4"); // 测试步骤 TC_LINTest LIN Send C4_FRS_active_container 0x3 CH4//ch1
  g_EM_LIN_Swc_LIN_Send("C4_FRS_CurrentIntensity 3 CH4"); // 测试步骤 TC_LINTest LIN Send C4_FRS_CurrentIntensity 3 CH4
  g_EM_SOAClient_Swc_SOA_CHECK_Prepare("Veh_SetSFSChanelRespStruct.Veh_SetSFSChanelNRC 0"); // 预期结果 TC_CANTest SOA check Veh_SetSFSChanelRespStruct.Veh_SetSFSChanelNRC 0
  g_EM_SOAClient_Swc_SOA_CHECK_Prepare("Veh_SFSService_ErrStruct.OpeNRC 0 traceback8"); // 预期结果 TC_CANTest SOA check Veh_SFSService_ErrStruct.OpeNRC 0 traceback8//
  g_EM_SOAClient_Swc_SOA_REQ("Veh_SetSFSChanelStruct.Veh_SetSFSChanel:3&MemoryReq:1&ServiceExecuteFeedbackFlag:2"); // 测试步骤 TC_CANTest SOA REQ Veh_SetSFSChanelStruct.Veh_SetSFSChanel:3&MemoryReq:1&ServiceExecuteFeedbackFlag:2//通道1
  g_EM_SOAClient_Swc_SOA_CHECK("Veh_SetSFSChanelRespStruct.Veh_SetSFSChanelNRC 0"); // 预期结果 TC_CANTest SOA check Veh_SetSFSChanelRespStruct.Veh_SetSFSChanelNRC 0
  g_EM_LIN_Swc_LIN_Check("C4_FRS_ChannelSelect 3 CH4"); // 预期结果 TC_LINTest LIN Check C4_FRS_ChannelSelect 3 CH4
  g_EM_SOAClient_Swc_SOA_CHECK("Veh_SFSService_ErrStruct.OpeNRC 0 traceback8"); // 预期结果 TC_CANTest SOA check Veh_SFSService_ErrStruct.OpeNRC 0 traceback8//
  g_EM_SOAClient_Swc_SOA_CHECK_Prepare("Veh_SetSFSConRespStruct.Veh_SetSFSConNRC 0"); // 预期结果 TC_CANTest SOA check Veh_SetSFSConRespStruct.Veh_SetSFSConNRC 0
  g_EM_SOAClient_Swc_SOA_CHECK_Prepare("Veh_SFSService_ErrStruct.OpeNRC 0 traceback8"); // 预期结果 TC_CANTest SOA check Veh_SFSService_ErrStruct.OpeNRC 0 traceback8//
  g_EM_SOAClient_Swc_SOA_REQ("Veh_SetSFSConStruct.Veh_SetSFSCon:1&MemoryReq:1&ServiceExecuteFeedbackFlag:2"); // 测试步骤 TC_CANTest SOA REQ Veh_SetSFSConStruct.Veh_SetSFSCon:1&MemoryReq:1&ServiceExecuteFeedbackFlag:2//Low
  g_EM_SOAClient_Swc_SOA_CHECK("Veh_SetSFSConRespStruct.Veh_SetSFSConNRC 0"); // 预期结果 TC_CANTest SOA check Veh_SetSFSConRespStruct.Veh_SetSFSConNRC 0
  g_EM_LIN_Swc_LIN_Check("C4_FRS_IntensityReq 3 CH4"); // 预期结果 TC_LINTest LIN Check C4_FRS_IntensityReq 3 CH4
  g_EM_SOAClient_Swc_SOA_CHECK("Veh_SFSService_ErrStruct.OpeNRC 0 traceback8"); // 预期结果 TC_CANTest SOA check Veh_SFSService_ErrStruct.OpeNRC 0 traceback8//
  g_EM_LIN_Swc_LIN_Send("C4_FRS_FragranceID_Container_3 0 CH4"); // 测试步骤 TC_LINTest LIN Send C4_FRS_FragranceID_Container_3 0 CH4
  g_EM_LIN_Swc_LIN_Check("C4_FRS_IntensityReq 3 CH4"); // 预期结果 TC_LINTest LIN Check C4_FRS_IntensityReq 3 CH4
  g_EM_Equipment_Swc_TC_4G_Time_Delay_Second("11"); // 测试步骤 TC_Sleep 11//故障延迟10s
  g_EM_LIN_Swc_LIN_Check("C4_FRS_IntensityReq 0 CH4"); // 预期结果 TC_LINTest LIN Check C4_FRS_IntensityReq 0 CH4
  g_EM_LIN_Swc_LIN_Send("C4_FRS_FragranceID_Container_3 1 CH4"); // 测试步骤 TC_LINTest LIN Send C4_FRS_FragranceID_Container_3 1 CH4
  g_EM_SOAClient_Swc_SOA_CHECK_Prepare("Veh_TurnOnOffSFSRespStruct.Veh_TurnOnOffSFSNRC 0"); // 预期结果 TC_CANTest SOA check Veh_TurnOnOffSFSRespStruct.Veh_TurnOnOffSFSNRC 0
  g_EM_SOAClient_Swc_SOA_CHECK_Prepare("Veh_SFSService_ErrStruct.OpeNRC 0 traceback8"); // 预期结果 TC_CANTest SOA check Veh_SFSService_ErrStruct.OpeNRC 0 traceback8//
  g_EM_SOAClient_Swc_SOA_REQ("Veh_TurnOnOffSFSStruct.Veh_TurnOnOffSFS:1&ServiceExecuteFeedbackFlag:2"); // 测试步骤 TC_CANTest SOA REQ Veh_TurnOnOffSFSStruct.Veh_TurnOnOffSFS:1&ServiceExecuteFeedbackFlag:2//ON
  g_EM_SOAClient_Swc_SOA_CHECK("Veh_TurnOnOffSFSRespStruct.Veh_TurnOnOffSFSNRC 0"); // 预期结果 TC_CANTest SOA check Veh_TurnOnOffSFSRespStruct.Veh_TurnOnOffSFSNRC 0
  g_EM_LIN_Swc_LIN_Check("C4_FRS_IntensityReq 3 CH4"); // 预期结果 TC_LINTest LIN Check C4_FRS_IntensityReq 3 CH4
  g_EM_SOAClient_Swc_SOA_CHECK("Veh_SFSService_ErrStruct.OpeNRC 0 traceback8"); // 预期结果 TC_CANTest SOA check Veh_SFSService_ErrStruct.OpeNRC 0 traceback8//
}

testcase SYS_CDCU_xiangfen_0176()
{
  TestDescription("香氛浓度记忆，拔插香氛通道3浓度高 IG ON");
  teststep("warning","原始用例id为SYS-CDCU-香氛-0176");
  g_CAN_Bus_Swc_Set("I_LDCU_BodySysSt1.I_LDCU_PowerMode 1"); // 测试步骤 TC_CANTest SET I_LDCU_BodySysSt1.I_LDCU_PowerMode 1
  g_CAN_Bus_Swc_Set("C_LDCU_SysSt.C_LDCU_EVSysReadySt 2"); // 测试步骤 TC_CANTest SET C_LDCU_SysSt.C_LDCU_EVSysReadySt 2//上高压
  g_EM_LIN_Swc_LIN_Send("C4_FRS_active_container 0x3 CH4"); // 测试步骤 TC_LINTest LIN Send C4_FRS_active_container 0x3 CH4//ch1
  g_EM_LIN_Swc_LIN_Send("C4_FRS_CurrentIntensity 10 CH4"); // 测试步骤 TC_LINTest LIN Send C4_FRS_CurrentIntensity 10 CH4
  g_EM_SOAClient_Swc_SOA_CHECK_Prepare("Veh_SetSFSChanelRespStruct.Veh_SetSFSChanelNRC 0"); // 预期结果 TC_CANTest SOA check Veh_SetSFSChanelRespStruct.Veh_SetSFSChanelNRC 0
  g_EM_SOAClient_Swc_SOA_CHECK_Prepare("Veh_SFSService_ErrStruct.OpeNRC 0 traceback8"); // 预期结果 TC_CANTest SOA check Veh_SFSService_ErrStruct.OpeNRC 0 traceback8//
  g_EM_SOAClient_Swc_SOA_REQ("Veh_SetSFSChanelStruct.Veh_SetSFSChanel:3&MemoryReq:1&ServiceExecuteFeedbackFlag:2"); // 测试步骤 TC_CANTest SOA REQ Veh_SetSFSChanelStruct.Veh_SetSFSChanel:3&MemoryReq:1&ServiceExecuteFeedbackFlag:2//通道1
  g_EM_SOAClient_Swc_SOA_CHECK("Veh_SetSFSChanelRespStruct.Veh_SetSFSChanelNRC 0"); // 预期结果 TC_CANTest SOA check Veh_SetSFSChanelRespStruct.Veh_SetSFSChanelNRC 0
  g_EM_LIN_Swc_LIN_Check("C4_FRS_ChannelSelect 3 CH4"); // 预期结果 TC_LINTest LIN Check C4_FRS_ChannelSelect 3 CH4
  g_EM_SOAClient_Swc_SOA_CHECK("Veh_SFSService_ErrStruct.OpeNRC 0 traceback8"); // 预期结果 TC_CANTest SOA check Veh_SFSService_ErrStruct.OpeNRC 0 traceback8//
  g_EM_SOAClient_Swc_SOA_CHECK_Prepare("Veh_SetSFSConRespStruct.Veh_SetSFSConNRC 0"); // 预期结果 TC_CANTest SOA check Veh_SetSFSConRespStruct.Veh_SetSFSConNRC 0
  g_EM_SOAClient_Swc_SOA_CHECK_Prepare("Veh_SFSService_ErrStruct.OpeNRC 0 traceback8"); // 预期结果 TC_CANTest SOA check Veh_SFSService_ErrStruct.OpeNRC 0 traceback8//
  g_EM_SOAClient_Swc_SOA_REQ("Veh_SetSFSConStruct.Veh_SetSFSCon:2&MemoryReq:1&ServiceExecuteFeedbackFlag:2"); // 测试步骤 TC_CANTest SOA REQ Veh_SetSFSConStruct.Veh_SetSFSCon:2&MemoryReq:1&ServiceExecuteFeedbackFlag:2//Low
  g_EM_SOAClient_Swc_SOA_CHECK("Veh_SetSFSConRespStruct.Veh_SetSFSConNRC 0"); // 预期结果 TC_CANTest SOA check Veh_SetSFSConRespStruct.Veh_SetSFSConNRC 0
  g_EM_LIN_Swc_LIN_Check("C4_FRS_IntensityReq 10 CH4"); // 预期结果 TC_LINTest LIN Check C4_FRS_IntensityReq 10 CH4
  g_EM_SOAClient_Swc_SOA_CHECK("Veh_SFSService_ErrStruct.OpeNRC 0 traceback8"); // 预期结果 TC_CANTest SOA check Veh_SFSService_ErrStruct.OpeNRC 0 traceback8//
  g_EM_LIN_Swc_LIN_Send("C4_FRS_FragranceID_Container_3 0 CH4"); // 测试步骤 TC_LINTest LIN Send C4_FRS_FragranceID_Container_3 0 CH4
  g_EM_LIN_Swc_LIN_Check("C4_FRS_IntensityReq 10 CH4"); // 预期结果 TC_LINTest LIN Check C4_FRS_IntensityReq 10 CH4
  g_EM_Equipment_Swc_TC_4G_Time_Delay_Second("11"); // 测试步骤 TC_Sleep 11//故障延迟10s
  g_EM_LIN_Swc_LIN_Check("C4_FRS_IntensityReq 0 CH4"); // 预期结果 TC_LINTest LIN Check C4_FRS_IntensityReq 0 CH4
  g_EM_LIN_Swc_LIN_Send("C4_FRS_FragranceID_Container_3 1 CH4"); // 测试步骤 TC_LINTest LIN Send C4_FRS_FragranceID_Container_3 1 CH4
  g_EM_SOAClient_Swc_SOA_CHECK_Prepare("Veh_TurnOnOffSFSRespStruct.Veh_TurnOnOffSFSNRC 0"); // 预期结果 TC_CANTest SOA check Veh_TurnOnOffSFSRespStruct.Veh_TurnOnOffSFSNRC 0
  g_EM_SOAClient_Swc_SOA_CHECK_Prepare("Veh_SFSService_ErrStruct.OpeNRC 0 traceback8"); // 预期结果 TC_CANTest SOA check Veh_SFSService_ErrStruct.OpeNRC 0 traceback8//
  g_EM_SOAClient_Swc_SOA_REQ("Veh_TurnOnOffSFSStruct.Veh_TurnOnOffSFS:1&ServiceExecuteFeedbackFlag:2"); // 测试步骤 TC_CANTest SOA REQ Veh_TurnOnOffSFSStruct.Veh_TurnOnOffSFS:1&ServiceExecuteFeedbackFlag:2//ON
  g_EM_SOAClient_Swc_SOA_CHECK("Veh_TurnOnOffSFSRespStruct.Veh_TurnOnOffSFSNRC 0"); // 预期结果 TC_CANTest SOA check Veh_TurnOnOffSFSRespStruct.Veh_TurnOnOffSFSNRC 0
  g_EM_LIN_Swc_LIN_Check("C4_FRS_IntensityReq 10 CH4"); // 预期结果 TC_LINTest LIN Check C4_FRS_IntensityReq 10 CH4
  g_EM_SOAClient_Swc_SOA_CHECK("Veh_SFSService_ErrStruct.OpeNRC 0 traceback8"); // 预期结果 TC_CANTest SOA check Veh_SFSService_ErrStruct.OpeNRC 0 traceback8//
}

testcase SYS_CDCU_xiangfen_0177()
{
  TestDescription("香氛通道状态上传 Local on");
  teststep("warning","原始用例id为SYS-CDCU-香氛-0177");
  g_EM_SOAClient_Swc_SOA_CHECK_Prepare("SFSStStruct.SFS_Ch_St 2"); // 预期结果 TC_CANTest SOA check SFSStStruct.SFS_Ch_St 2
  g_EM_LIN_Swc_LIN_Send("C4_FRS_active_container 0x2 CH4"); // 测试步骤 TC_LINTest LIN Send C4_FRS_active_container 0x2 CH4
  g_EM_SOAClient_Swc_SOA_CHECK("SFSStStruct.SFS_Ch_St 2"); // 预期结果 TC_CANTest SOA check SFSStStruct.SFS_Ch_St 2
}

testcase SYS_CDCU_xiangfen_0178()
{
  TestDescription("香氛通道状态上传 Local on");
  teststep("warning","原始用例id为SYS-CDCU-香氛-0178");
  g_EM_SOAClient_Swc_SOA_CHECK_Prepare("SFSStStruct.SFS_Ch_St 3"); // 预期结果 TC_CANTest SOA check SFSStStruct.SFS_Ch_St 3
  g_EM_LIN_Swc_LIN_Send("C4_FRS_active_container 0x3 CH4"); // 测试步骤 TC_LINTest LIN Send C4_FRS_active_container 0x3 CH4
  g_EM_SOAClient_Swc_SOA_CHECK("SFSStStruct.SFS_Ch_St 3"); // 预期结果 TC_CANTest SOA check SFSStStruct.SFS_Ch_St 3
}

testcase SYS_CDCU_xiangfen_0179()
{
  TestDescription("香氛通道状态上传 Local on");
  teststep("warning","原始用例id为SYS-CDCU-香氛-0179");
  g_EM_SOAClient_Swc_SOA_CHECK_Prepare("SFSStStruct.SFS_Ch_St 0"); // 预期结果 TC_CANTest SOA check SFSStStruct.SFS_Ch_St 0
  g_EM_LIN_Swc_LIN_Send("C4_FRS_active_container 0x0 CH4"); // 测试步骤 TC_LINTest LIN Send C4_FRS_active_container 0x0 CH4
  g_EM_SOAClient_Swc_SOA_CHECK("SFSStStruct.SFS_Ch_St 0"); // 预期结果 TC_CANTest SOA check SFSStStruct.SFS_Ch_St 0
}

testcase SYS_CDCU_xiangfen_0180()
{
  TestDescription("香氛通道状态上传 Local on");
  teststep("warning","原始用例id为SYS-CDCU-香氛-0180");
  g_EM_SOAClient_Swc_SOA_CHECK_Prepare("SFSStStruct.SFS_Ch_St 1"); // 预期结果 TC_CANTest SOA check SFSStStruct.SFS_Ch_St 1
  g_EM_LIN_Swc_LIN_Send("C4_FRS_active_container 0x1 CH4"); // 测试步骤 TC_LINTest LIN Send C4_FRS_active_container 0x1 CH4
  g_EM_SOAClient_Swc_SOA_CHECK("SFSStStruct.SFS_Ch_St 1"); // 预期结果 TC_CANTest SOA check SFSStStruct.SFS_Ch_St 1
}

testcase SYS_CDCU_xiangfen_0181()
{
  TestDescription("香氛浓度状态和工作状态上传 Local on");
  teststep("warning","原始用例id为SYS-CDCU-香氛-0181");
  g_EM_SOAClient_Swc_SOA_CHECK_Prepare("SFSStStruct.SFS_Con_St 0"); // 预期结果 TC_CANTest SOA check SFSStStruct.SFS_Con_St 0
  g_EM_SOAClient_Swc_SOA_CHECK_Prepare("SFSStStruct.SFS_Sw_St 0"); // 预期结果 TC_CANTest SOA check SFSStStruct.SFS_Sw_St 0
  g_EM_LIN_Swc_LIN_Send("C4_FRS_CurrentIntensity 14 CH4"); // 测试步骤 TC_LINTest LIN Send C4_FRS_CurrentIntensity 14 CH4
  g_EM_SOAClient_Swc_SOA_CHECK("SFSStStruct.SFS_Con_St 0"); // 预期结果 TC_CANTest SOA check SFSStStruct.SFS_Con_St 0
  g_EM_SOAClient_Swc_SOA_CHECK("SFSStStruct.SFS_Sw_St 0"); // 预期结果 TC_CANTest SOA check SFSStStruct.SFS_Sw_St 0
}

testcase SYS_CDCU_xiangfen_0182()
{
  TestDescription("香氛浓度状态和工作状态上传 Local on");
  teststep("warning","原始用例id为SYS-CDCU-香氛-0182");
  g_EM_SOAClient_Swc_SOA_CHECK_Prepare("SFSStStruct.SFS_Con_St 3"); // 预期结果 TC_CANTest SOA check SFSStStruct.SFS_Con_St 3
  g_EM_SOAClient_Swc_SOA_CHECK_Prepare("SFSStStruct.SFS_Sw_St 1"); // 预期结果 TC_CANTest SOA check SFSStStruct.SFS_Sw_St 1
  g_EM_LIN_Swc_LIN_Send("C4_FRS_CurrentIntensity 0x6 CH4"); // 测试步骤 TC_LINTest LIN Send C4_FRS_CurrentIntensity 0x6 CH4//Mid
  g_EM_SOAClient_Swc_SOA_CHECK("SFSStStruct.SFS_Con_St 3"); // 预期结果 TC_CANTest SOA check SFSStStruct.SFS_Con_St 3
  g_EM_SOAClient_Swc_SOA_CHECK("SFSStStruct.SFS_Sw_St 1"); // 预期结果 TC_CANTest SOA check SFSStStruct.SFS_Sw_St 1
}

testcase SYS_CDCU_xiangfen_0183()
{
  TestDescription("香氛浓度状态和工作状态上传 Local on");
  teststep("warning","原始用例id为SYS-CDCU-香氛-0183");
  g_EM_SOAClient_Swc_SOA_CHECK_Prepare("SFSStStruct.SFS_Con_St 0"); // 预期结果 TC_CANTest SOA check SFSStStruct.SFS_Con_St 0
  g_EM_SOAClient_Swc_SOA_CHECK_Prepare("SFSStStruct.SFS_Sw_St 0"); // 预期结果 TC_CANTest SOA check SFSStStruct.SFS_Sw_St 0
  g_EM_LIN_Swc_LIN_Send("C4_FRS_CurrentIntensity 15 CH4"); // 测试步骤 TC_LINTest LIN Send C4_FRS_CurrentIntensity 15 CH4
  g_EM_SOAClient_Swc_SOA_CHECK("SFSStStruct.SFS_Con_St 0"); // 预期结果 TC_CANTest SOA check SFSStStruct.SFS_Con_St 0
  g_EM_SOAClient_Swc_SOA_CHECK("SFSStStruct.SFS_Sw_St 0"); // 预期结果 TC_CANTest SOA check SFSStStruct.SFS_Sw_St 0
}

testcase SYS_CDCU_xiangfen_0184()
{
  TestDescription("香氛浓度状态和工作状态上传 Local on");
  teststep("warning","原始用例id为SYS-CDCU-香氛-0184");
  g_EM_SOAClient_Swc_SOA_CHECK_Prepare("SFSStStruct.SFS_Con_St 2"); // 预期结果 TC_CANTest SOA check SFSStStruct.SFS_Con_St 2
  g_EM_SOAClient_Swc_SOA_CHECK_Prepare("SFSStStruct.SFS_Sw_St 1"); // 预期结果 TC_CANTest SOA check SFSStStruct.SFS_Sw_St 1
  g_EM_LIN_Swc_LIN_Send("C4_FRS_CurrentIntensity 10 CH4"); // 测试步骤 TC_LINTest LIN Send C4_FRS_CurrentIntensity 10 CH4//High
  g_EM_SOAClient_Swc_SOA_CHECK("SFSStStruct.SFS_Con_St 2"); // 预期结果 TC_CANTest SOA check SFSStStruct.SFS_Con_St 2
  g_EM_SOAClient_Swc_SOA_CHECK("SFSStStruct.SFS_Sw_St 1"); // 预期结果 TC_CANTest SOA check SFSStStruct.SFS_Sw_St 1
}

testcase SYS_CDCU_xiangfen_0185()
{
  TestDescription("香氛浓度状态和工作状态上传 Local on");
  teststep("warning","原始用例id为SYS-CDCU-香氛-0185");
  g_EM_SOAClient_Swc_SOA_CHECK_Prepare("SFSStStruct.SFS_Con_St 0"); // 预期结果 TC_CANTest SOA check SFSStStruct.SFS_Con_St 0
  g_EM_SOAClient_Swc_SOA_CHECK_Prepare("SFSStStruct.SFS_Sw_St 0"); // 预期结果 TC_CANTest SOA check SFSStStruct.SFS_Sw_St 0
  g_EM_LIN_Swc_LIN_Send("C4_FRS_CurrentIntensity 0 CH4"); // 测试步骤 TC_LINTest LIN Send C4_FRS_CurrentIntensity 0 CH4
  g_EM_SOAClient_Swc_SOA_CHECK("SFSStStruct.SFS_Con_St 0"); // 预期结果 TC_CANTest SOA check SFSStStruct.SFS_Con_St 0
  g_EM_SOAClient_Swc_SOA_CHECK("SFSStStruct.SFS_Sw_St 0"); // 预期结果 TC_CANTest SOA check SFSStStruct.SFS_Sw_St 0
}

testcase SYS_CDCU_xiangfen_0186()
{
  TestDescription("香氛浓度状态和工作状态上传 Local on");
  teststep("warning","原始用例id为SYS-CDCU-香氛-0186");
  g_EM_SOAClient_Swc_SOA_CHECK_Prepare("SFSStStruct.SFS_Con_St 1"); // 预期结果 TC_CANTest SOA check SFSStStruct.SFS_Con_St 1
  g_EM_SOAClient_Swc_SOA_CHECK_Prepare("SFSStStruct.SFS_Sw_St 1"); // 预期结果 TC_CANTest SOA check SFSStStruct.SFS_Sw_St 1
  g_EM_LIN_Swc_LIN_Send("C4_FRS_CurrentIntensity 0x3 CH4"); // 测试步骤 TC_LINTest LIN Send C4_FRS_CurrentIntensity 0x3 CH4//Low
  g_EM_SOAClient_Swc_SOA_CHECK("SFSStStruct.SFS_Con_St 1"); // 预期结果 TC_CANTest SOA check SFSStStruct.SFS_Con_St 1
  g_EM_SOAClient_Swc_SOA_CHECK("SFSStStruct.SFS_Sw_St 1"); // 预期结果 TC_CANTest SOA check SFSStStruct.SFS_Sw_St 1
}

testcase SYS_CDCU_xiangfen_0187()
{
  TestDescription("香氛工作状态上传 Local on");
  teststep("warning","原始用例id为SYS-CDCU-香氛-0187");
  g_EM_SOAClient_Swc_SOA_CHECK_Prepare("SFSStStruct.SFS_Ch1_Type 0x80"); // 预期结果 TC_CANTest SOA check SFSStStruct.SFS_Ch1_Type 0x80
  g_EM_LIN_Swc_LIN_Send("C4_FRS_FragranceID_Container_1 0 CH4"); // 测试步骤 TC_LINTest LIN Send C4_FRS_FragranceID_Container_1 0 CH4
  g_EM_SOAClient_Swc_SOA_CHECK("SFSStStruct.SFS_Ch1_Type 0x80"); // 预期结果 TC_CANTest SOA check SFSStStruct.SFS_Ch1_Type 0x80
}

testcase SYS_CDCU_xiangfen_0188()
{
  TestDescription("香氛工作状态上传 Local on");
  teststep("warning","原始用例id为SYS-CDCU-香氛-0188");
  g_EM_SOAClient_Swc_SOA_CHECK_Prepare("SFSStStruct.SFS_Ch1_Type 0x89"); // 预期结果 TC_CANTest SOA check SFSStStruct.SFS_Ch1_Type 0x89
  g_EM_LIN_Swc_LIN_Send("C4_FRS_FragranceID_Container_1 9 CH4"); // 测试步骤 TC_LINTest LIN Send C4_FRS_FragranceID_Container_1 9 CH4
  g_EM_SOAClient_Swc_SOA_CHECK("SFSStStruct.SFS_Ch1_Type 0x89"); // 预期结果 TC_CANTest SOA check SFSStStruct.SFS_Ch1_Type 0x89
}

testcase SYS_CDCU_xiangfen_0189()
{
  TestDescription("香氛工作状态上传 Local on");
  teststep("warning","原始用例id为SYS-CDCU-香氛-0189");
  g_EM_SOAClient_Swc_SOA_CHECK_Prepare("SFSStStruct.SFS_Ch1_Type 0xBF"); // 预期结果 TC_CANTest SOA check SFSStStruct.SFS_Ch1_Type 0xBF
  g_EM_LIN_Swc_LIN_Send("C4_FRS_FragranceID_Container_1 0x3F CH4"); // 测试步骤 TC_LINTest LIN Send C4_FRS_FragranceID_Container_1 0x3F CH4
  g_EM_SOAClient_Swc_SOA_CHECK("SFSStStruct.SFS_Ch1_Type 0xBF"); // 预期结果 TC_CANTest SOA check SFSStStruct.SFS_Ch1_Type 0xBF
}

testcase SYS_CDCU_xiangfen_0190()
{
  TestDescription("香氛工作状态上传 Local on");
  teststep("warning","原始用例id为SYS-CDCU-香氛-0190");
  g_EM_SOAClient_Swc_SOA_CHECK_Prepare("SFSStStruct.SFS_Ch2_Type 0x80"); // 预期结果 TC_CANTest SOA check SFSStStruct.SFS_Ch2_Type 0x80
  g_EM_LIN_Swc_LIN_Send("C4_FRS_FragranceID_Container_2 0 CH4"); // 测试步骤 TC_LINTest LIN Send C4_FRS_FragranceID_Container_2 0 CH4
  g_EM_SOAClient_Swc_SOA_CHECK("SFSStStruct.SFS_Ch2_Type 0x80"); // 预期结果 TC_CANTest SOA check SFSStStruct.SFS_Ch2_Type 0x80
}

testcase SYS_CDCU_xiangfen_0191()
{
  TestDescription("香氛工作状态上传 Local on");
  teststep("warning","原始用例id为SYS-CDCU-香氛-0191");
  g_EM_SOAClient_Swc_SOA_CHECK_Prepare("SFSStStruct.SFS_Ch2_Type 0x89"); // 预期结果 TC_CANTest SOA check SFSStStruct.SFS_Ch2_Type 0x89
  g_EM_LIN_Swc_LIN_Send("C4_FRS_FragranceID_Container_2 9 CH4"); // 测试步骤 TC_LINTest LIN Send C4_FRS_FragranceID_Container_2 9 CH4
  g_EM_SOAClient_Swc_SOA_CHECK("SFSStStruct.SFS_Ch2_Type 0x89"); // 预期结果 TC_CANTest SOA check SFSStStruct.SFS_Ch2_Type 0x89
}

testcase SYS_CDCU_xiangfen_0192()
{
  TestDescription("香氛工作状态上传 Local on");
  teststep("warning","原始用例id为SYS-CDCU-香氛-0192");
  g_EM_SOAClient_Swc_SOA_CHECK_Prepare("SFSStStruct.SFS_Ch2_Type 0xBF"); // 预期结果 TC_CANTest SOA check SFSStStruct.SFS_Ch2_Type 0xBF
  g_EM_LIN_Swc_LIN_Send("C4_FRS_FragranceID_Container_2 0x3F CH4"); // 测试步骤 TC_LINTest LIN Send C4_FRS_FragranceID_Container_2 0x3F CH4
  g_EM_SOAClient_Swc_SOA_CHECK("SFSStStruct.SFS_Ch2_Type 0xBF"); // 预期结果 TC_CANTest SOA check SFSStStruct.SFS_Ch2_Type 0xBF
}

testcase SYS_CDCU_xiangfen_0193()
{
  TestDescription("香氛工作状态上传 Local on");
  teststep("warning","原始用例id为SYS-CDCU-香氛-0193");
  g_EM_SOAClient_Swc_SOA_CHECK_Prepare("SFSStStruct.SFS_Ch3_Type 0x80"); // 预期结果 TC_CANTest SOA check SFSStStruct.SFS_Ch3_Type 0x80
  g_EM_LIN_Swc_LIN_Send("C4_FRS_FragranceID_Container_3 0 CH4"); // 测试步骤 TC_LINTest LIN Send C4_FRS_FragranceID_Container_3 0 CH4
  g_EM_SOAClient_Swc_SOA_CHECK("SFSStStruct.SFS_Ch3_Type 0x80"); // 预期结果 TC_CANTest SOA check SFSStStruct.SFS_Ch3_Type 0x80
}

testcase SYS_CDCU_xiangfen_0194()
{
  TestDescription("香氛工作状态上传 Local on");
  teststep("warning","原始用例id为SYS-CDCU-香氛-0194");
  g_EM_SOAClient_Swc_SOA_CHECK_Prepare("SFSStStruct.SFS_Ch3_Type 0x89"); // 预期结果 TC_CANTest SOA check SFSStStruct.SFS_Ch3_Type 0x89
  g_EM_LIN_Swc_LIN_Send("C4_FRS_FragranceID_Container_3 9 CH4"); // 测试步骤 TC_LINTest LIN Send C4_FRS_FragranceID_Container_3 9 CH4
  g_EM_SOAClient_Swc_SOA_CHECK("SFSStStruct.SFS_Ch3_Type 0x89"); // 预期结果 TC_CANTest SOA check SFSStStruct.SFS_Ch3_Type 0x89
}

testcase SYS_CDCU_xiangfen_0195()
{
  TestDescription("香氛工作状态上传 Local on");
  teststep("warning","原始用例id为SYS-CDCU-香氛-0195");
  g_EM_SOAClient_Swc_SOA_CHECK_Prepare("SFSStStruct.SFS_Ch3_Type 0xBF"); // 预期结果 TC_CANTest SOA check SFSStStruct.SFS_Ch3_Type 0xBF
  g_EM_LIN_Swc_LIN_Send("C4_FRS_FragranceID_Container_3 0x3F CH4"); // 测试步骤 TC_LINTest LIN Send C4_FRS_FragranceID_Container_3 0x3F CH4
  g_EM_SOAClient_Swc_SOA_CHECK("SFSStStruct.SFS_Ch3_Type 0xBF"); // 预期结果 TC_CANTest SOA check SFSStStruct.SFS_Ch3_Type 0xBF
}

testcase SYS_CDCU_xiangfen_0196()
{
  TestDescription("香氛工作状态上传 Local on");
  teststep("warning","原始用例id为SYS-CDCU-香氛-0196");
  g_EM_SOAClient_Swc_SOA_CHECK_Prepare("SFSStStruct.SFS_WorkSt 1"); // 预期结果 TC_CANTest SOA check SFSStStruct.SFS_WorkSt 1
  g_EM_LIN_Swc_LIN_Send("C4_FRS_Status 0x1 CH4"); // 测试步骤 TC_LINTest LIN Send C4_FRS_Status 0x1 CH4
  g_EM_SOAClient_Swc_SOA_CHECK("SFSStStruct.SFS_WorkSt 1"); // 预期结果 TC_CANTest SOA check SFSStStruct.SFS_WorkSt 1
}

testcase SYS_CDCU_xiangfen_0197()
{
  TestDescription("香氛工作状态上传 Local on");
  teststep("warning","原始用例id为SYS-CDCU-香氛-0197");
  g_EM_SOAClient_Swc_SOA_CHECK_Prepare("SFSStStruct.SFS_WorkSt 0"); // 预期结果 TC_CANTest SOA check SFSStStruct.SFS_WorkSt 0
  g_EM_LIN_Swc_LIN_Send("C4_FRS_Status 0x0 CH4"); // 测试步骤 TC_LINTest LIN Send C4_FRS_Status 0x0 CH4
  g_EM_SOAClient_Swc_SOA_CHECK("SFSStStruct.SFS_WorkSt 0"); // 预期结果 TC_CANTest SOA check SFSStStruct.SFS_WorkSt 0
}

testcase SYS_CDCU_xiangfen_0198()
{
  TestDescription("香氛风扇错误上传 Local on");
  teststep("warning","原始用例id为SYS-CDCU-香氛-0198");
  g_EM_SOAClient_Swc_SOA_CHECK_Prepare("SFSStStruct.SFS_Fan_Err 1"); // 预期结果 TC_CANTest SOA check SFSStStruct.SFS_Fan_Err 1
  g_EM_LIN_Swc_LIN_Send("C4_FRS_Fan_status 0x1 CH4"); // 测试步骤 TC_LINTest LIN Send C4_FRS_Fan_status 0x1 CH4
  g_EM_SOAClient_Swc_SOA_CHECK("SFSStStruct.SFS_Fan_Err 1"); // 预期结果 TC_CANTest SOA check SFSStStruct.SFS_Fan_Err 1
}

testcase SYS_CDCU_xiangfen_0199()
{
  TestDescription("香氛风扇错误上传 Local on");
  teststep("warning","原始用例id为SYS-CDCU-香氛-0199");
  g_EM_SOAClient_Swc_SOA_CHECK_Prepare("SFSStStruct.SFS_Fan_Err 0"); // 预期结果 TC_CANTest SOA check SFSStStruct.SFS_Fan_Err 0
  g_EM_LIN_Swc_LIN_Send("C4_FRS_Fan_status 0x0 CH4"); // 测试步骤 TC_LINTest LIN Send C4_FRS_Fan_status 0x0 CH4
  g_EM_SOAClient_Swc_SOA_CHECK("SFSStStruct.SFS_Fan_Err 0"); // 预期结果 TC_CANTest SOA check SFSStStruct.SFS_Fan_Err 0
}

testcase SYS_CDCU_xiangfen_0200()
{
  TestDescription("香氛电机错误上传 Local on");
  teststep("warning","原始用例id为SYS-CDCU-香氛-0200");
  g_EM_SOAClient_Swc_SOA_CHECK_Prepare("SFSStStruct.SFS_Mot_Err 1"); // 预期结果 TC_CANTest SOA check SFSStStruct.SFS_Mot_Err 1
  g_EM_LIN_Swc_LIN_Send("C4_FRS_Stepper_Status 0x1 CH4"); // 测试步骤 TC_LINTest LIN Send C4_FRS_Stepper_Status 0x1 CH4
  g_EM_SOAClient_Swc_SOA_CHECK("SFSStStruct.SFS_Mot_Err 1"); // 预期结果 TC_CANTest SOA check SFSStStruct.SFS_Mot_Err 1
}

testcase SYS_CDCU_xiangfen_0201()
{
  TestDescription("香氛电机错误上传 Local on");
  teststep("warning","原始用例id为SYS-CDCU-香氛-0201");
  g_EM_SOAClient_Swc_SOA_CHECK_Prepare("SFSStStruct.SFS_Mot_Err 0"); // 预期结果 TC_CANTest SOA check SFSStStruct.SFS_Mot_Err 0
  g_EM_LIN_Swc_LIN_Send("C4_FRS_Stepper_Status 0x0 CH4"); // 测试步骤 TC_LINTest LIN Send C4_FRS_Stepper_Status 0x0 CH4
  g_EM_SOAClient_Swc_SOA_CHECK("SFSStStruct.SFS_Mot_Err 0"); // 预期结果 TC_CANTest SOA check SFSStStruct.SFS_Mot_Err 0
}

testcase SYS_CDCU_xiangfen_0202()
{
  TestDescription("香氛过电压错误上传 Local on");
  teststep("warning","原始用例id为SYS-CDCU-香氛-0202");
  g_EM_SOAClient_Swc_SOA_CHECK_Prepare("SFSStStruct.SFS_OvrVolt_Err 1"); // 预期结果 TC_CANTest SOA check SFSStStruct.SFS_OvrVolt_Err 1
  g_EM_LIN_Swc_LIN_Send("C4_FRS_Status_UBatt 0x2 CH4"); // 测试步骤 TC_LINTest LIN Send C4_FRS_Status_UBatt 0x2 CH4
  g_EM_SOAClient_Swc_SOA_CHECK("SFSStStruct.SFS_OvrVolt_Err 1"); // 预期结果 TC_CANTest SOA check SFSStStruct.SFS_OvrVolt_Err 1
}

testcase SYS_CDCU_xiangfen_0203()
{
  TestDescription("香氛过电压错误上传 Local on");
  teststep("warning","原始用例id为SYS-CDCU-香氛-0203");
  g_EM_SOAClient_Swc_SOA_CHECK_Prepare("SFSStStruct.SFS_OvrVolt_Err 0"); // 预期结果 TC_CANTest SOA check SFSStStruct.SFS_OvrVolt_Err 0
  g_EM_LIN_Swc_LIN_Send("C4_FRS_Status_UBatt 0x0 CH4"); // 测试步骤 TC_LINTest LIN Send C4_FRS_Status_UBatt 0x0 CH4
  g_EM_SOAClient_Swc_SOA_CHECK("SFSStStruct.SFS_OvrVolt_Err 0"); // 预期结果 TC_CANTest SOA check SFSStStruct.SFS_OvrVolt_Err 0
}

testcase SYS_CDCU_xiangfen_0204()
{
  TestDescription("香氛欠电压错误上传 Local on");
  teststep("warning","原始用例id为SYS-CDCU-香氛-0204");
  g_EM_SOAClient_Swc_SOA_CHECK_Prepare("SFSStStruct.SFS_UndVolt_Err 1"); // 预期结果 TC_CANTest SOA check SFSStStruct.SFS_UndVolt_Err 1
  g_EM_LIN_Swc_LIN_Send("C4_FRS_Status_UBatt 0x1 CH4"); // 测试步骤 TC_LINTest LIN Send C4_FRS_Status_UBatt 0x1 CH4
  g_EM_SOAClient_Swc_SOA_CHECK("SFSStStruct.SFS_UndVolt_Err 1"); // 预期结果 TC_CANTest SOA check SFSStStruct.SFS_UndVolt_Err 1
}

testcase SYS_CDCU_xiangfen_0205()
{
  TestDescription("香氛欠电压错误上传 Local on");
  teststep("warning","原始用例id为SYS-CDCU-香氛-0205");
  g_EM_SOAClient_Swc_SOA_CHECK_Prepare("SFSStStruct.SFS_UndVolt_Err 0"); // 预期结果 TC_CANTest SOA check SFSStStruct.SFS_UndVolt_Err 0
  g_EM_LIN_Swc_LIN_Send("C4_FRS_Status_UBatt 0x0 CH4"); // 测试步骤 TC_LINTest LIN Send C4_FRS_Status_UBatt 0x0 CH4
  g_EM_SOAClient_Swc_SOA_CHECK("SFSStStruct.SFS_UndVolt_Err 0"); // 预期结果 TC_CANTest SOA check SFSStStruct.SFS_UndVolt_Err 0
}

testcase SYS_CDCU_xiangfen_0206()
{
  TestDescription("香氛lin通信异常响应错误上传 Local on");
  teststep("warning","原始用例id为SYS-CDCU-香氛-0206");
  g_EM_SOAClient_Swc_SOA_CHECK_Prepare("SFSStStruct.SFS_LIN_Err 1"); // 预期结果 TC_CANTest SOA check SFSStStruct.SFS_LIN_Err 1
  g_EM_LIN_Swc_LIN_Send("C4_FRS_ResponseError 0x1 CH4"); // 测试步骤 TC_LINTest LIN Send C4_FRS_ResponseError 0x1 CH4
  g_EM_SOAClient_Swc_SOA_CHECK("SFSStStruct.SFS_LIN_Err 1"); // 预期结果 TC_CANTest SOA check SFSStStruct.SFS_LIN_Err 1
}

testcase SYS_CDCU_xiangfen_0207()
{
  TestDescription("香氛lin通信异常响应错误上传 Local on");
  teststep("warning","原始用例id为SYS-CDCU-香氛-0207");
  g_EM_SOAClient_Swc_SOA_CHECK_Prepare("SFSStStruct.SFS_LIN_Err 0"); // 预期结果 TC_CANTest SOA check SFSStStruct.SFS_LIN_Err 0
  g_EM_LIN_Swc_LIN_Send("C4_FRS_ResponseError 0x0 CH4"); // 测试步骤 TC_LINTest LIN Send C4_FRS_ResponseError 0x0 CH4
  g_EM_SOAClient_Swc_SOA_CHECK("SFSStStruct.SFS_LIN_Err 0"); // 预期结果 TC_CANTest SOA check SFSStStruct.SFS_LIN_Err 0
}

testcase SYS_CDCU_xiangfen_0208()
{
  TestDescription("香氛通道1余量信息 Local on");
  teststep("warning","原始用例id为SYS-CDCU-香氛-0208");
  g_EM_SOAClient_Swc_SOA_CHECK_Prepare("SFSStStruct.SFS_Ch1_Lev_St 0"); // 预期结果 TC_CANTest SOA check SFSStStruct.SFS_Ch1_Lev_St 0
  g_EM_LIN_Swc_LIN_Send("C4_FRS_Level_Container_1 0 CH4"); // 测试步骤 TC_LINTest LIN Send C4_FRS_Level_Container_1 0 CH4
  g_EM_SOAClient_Swc_SOA_CHECK("SFSStStruct.SFS_Ch1_Lev_St 0"); // 预期结果 TC_CANTest SOA check SFSStStruct.SFS_Ch1_Lev_St 0
  g_EM_SOAClient_Swc_SOA_CHECK_Prepare("SFSStStruct.SFS_Ch1_Lev_St 10"); // 预期结果 TC_CANTest SOA check SFSStStruct.SFS_Ch1_Lev_St 10
  g_EM_LIN_Swc_LIN_Send("C4_FRS_Level_Container_1 10 CH4"); // 测试步骤 TC_LINTest LIN Send C4_FRS_Level_Container_1 10 CH4
  g_EM_SOAClient_Swc_SOA_CHECK("SFSStStruct.SFS_Ch1_Lev_St 10"); // 预期结果 TC_CANTest SOA check SFSStStruct.SFS_Ch1_Lev_St 10
  g_EM_SOAClient_Swc_SOA_CHECK_Prepare("SFSStStruct.SFS_Ch1_Lev_St 20"); // 预期结果 TC_CANTest SOA check SFSStStruct.SFS_Ch1_Lev_St 20
  g_EM_LIN_Swc_LIN_Send("C4_FRS_Level_Container_1 20 CH4"); // 测试步骤 TC_LINTest LIN Send C4_FRS_Level_Container_1 20 CH4
  g_EM_SOAClient_Swc_SOA_CHECK("SFSStStruct.SFS_Ch1_Lev_St 20"); // 预期结果 TC_CANTest SOA check SFSStStruct.SFS_Ch1_Lev_St 20
  g_EM_SOAClient_Swc_SOA_CHECK_Prepare("SFSStStruct.SFS_Ch1_Lev_St 30"); // 预期结果 TC_CANTest SOA check SFSStStruct.SFS_Ch1_Lev_St 30
  g_EM_LIN_Swc_LIN_Send("C4_FRS_Level_Container_1 30 CH4"); // 测试步骤 TC_LINTest LIN Send C4_FRS_Level_Container_1 30 CH4
  g_EM_SOAClient_Swc_SOA_CHECK("SFSStStruct.SFS_Ch1_Lev_St 30"); // 预期结果 TC_CANTest SOA check SFSStStruct.SFS_Ch1_Lev_St 30
  g_EM_SOAClient_Swc_SOA_CHECK_Prepare("SFSStStruct.SFS_Ch1_Lev_St 40"); // 预期结果 TC_CANTest SOA check SFSStStruct.SFS_Ch1_Lev_St 40
  g_EM_LIN_Swc_LIN_Send("C4_FRS_Level_Container_1 40 CH4"); // 测试步骤 TC_LINTest LIN Send C4_FRS_Level_Container_1 40 CH4
  g_EM_SOAClient_Swc_SOA_CHECK("SFSStStruct.SFS_Ch1_Lev_St 40"); // 预期结果 TC_CANTest SOA check SFSStStruct.SFS_Ch1_Lev_St 40
  g_EM_SOAClient_Swc_SOA_CHECK_Prepare("SFSStStruct.SFS_Ch1_Lev_St 50"); // 预期结果 TC_CANTest SOA check SFSStStruct.SFS_Ch1_Lev_St 50
  g_EM_LIN_Swc_LIN_Send("C4_FRS_Level_Container_1 50 CH4"); // 测试步骤 TC_LINTest LIN Send C4_FRS_Level_Container_1 50 CH4
  g_EM_SOAClient_Swc_SOA_CHECK("SFSStStruct.SFS_Ch1_Lev_St 50"); // 预期结果 TC_CANTest SOA check SFSStStruct.SFS_Ch1_Lev_St 50
  g_EM_SOAClient_Swc_SOA_CHECK_Prepare("SFSStStruct.SFS_Ch1_Lev_St 60"); // 预期结果 TC_CANTest SOA check SFSStStruct.SFS_Ch1_Lev_St 60
  g_EM_LIN_Swc_LIN_Send("C4_FRS_Level_Container_1 60 CH4"); // 测试步骤 TC_LINTest LIN Send C4_FRS_Level_Container_1 60 CH4
  g_EM_SOAClient_Swc_SOA_CHECK("SFSStStruct.SFS_Ch1_Lev_St 60"); // 预期结果 TC_CANTest SOA check SFSStStruct.SFS_Ch1_Lev_St 60
  g_EM_SOAClient_Swc_SOA_CHECK_Prepare("SFSStStruct.SFS_Ch1_Lev_St 70"); // 预期结果 TC_CANTest SOA check SFSStStruct.SFS_Ch1_Lev_St 70
  g_EM_LIN_Swc_LIN_Send("C4_FRS_Level_Container_1 70 CH4"); // 测试步骤 TC_LINTest LIN Send C4_FRS_Level_Container_1 70 CH4
  g_EM_SOAClient_Swc_SOA_CHECK("SFSStStruct.SFS_Ch1_Lev_St 70"); // 预期结果 TC_CANTest SOA check SFSStStruct.SFS_Ch1_Lev_St 70
  g_EM_SOAClient_Swc_SOA_CHECK_Prepare("SFSStStruct.SFS_Ch1_Lev_St 80"); // 预期结果 TC_CANTest SOA check SFSStStruct.SFS_Ch1_Lev_St 80
  g_EM_LIN_Swc_LIN_Send("C4_FRS_Level_Container_1 80 CH4"); // 测试步骤 TC_LINTest LIN Send C4_FRS_Level_Container_1 80 CH4
  g_EM_SOAClient_Swc_SOA_CHECK("SFSStStruct.SFS_Ch1_Lev_St 80"); // 预期结果 TC_CANTest SOA check SFSStStruct.SFS_Ch1_Lev_St 80
  g_EM_SOAClient_Swc_SOA_CHECK_Prepare("SFSStStruct.SFS_Ch1_Lev_St 90"); // 预期结果 TC_CANTest SOA check SFSStStruct.SFS_Ch1_Lev_St 90
  g_EM_LIN_Swc_LIN_Send("C4_FRS_Level_Container_1 90 CH4"); // 测试步骤 TC_LINTest LIN Send C4_FRS_Level_Container_1 90 CH4
  g_EM_SOAClient_Swc_SOA_CHECK("SFSStStruct.SFS_Ch1_Lev_St 90"); // 预期结果 TC_CANTest SOA check SFSStStruct.SFS_Ch1_Lev_St 90
  g_EM_SOAClient_Swc_SOA_CHECK_Prepare("SFSStStruct.SFS_Ch1_Lev_St 100"); // 预期结果 TC_CANTest SOA check SFSStStruct.SFS_Ch1_Lev_St 100
  g_EM_LIN_Swc_LIN_Send("C4_FRS_Level_Container_1 100 CH4"); // 测试步骤 TC_LINTest LIN Send C4_FRS_Level_Container_1 100 CH4
  g_EM_SOAClient_Swc_SOA_CHECK("SFSStStruct.SFS_Ch1_Lev_St 100"); // 预期结果 TC_CANTest SOA check SFSStStruct.SFS_Ch1_Lev_St 100
  g_EM_SOAClient_Swc_SOA_CHECK_Prepare("SFSStStruct.SFS_Ch1_Lev_St 125"); // 预期结果 TC_CANTest SOA check SFSStStruct.SFS_Ch1_Lev_St 125
  g_EM_LIN_Swc_LIN_Send("C4_FRS_Level_Container_1 125 CH4"); // 测试步骤 TC_LINTest LIN Send C4_FRS_Level_Container_1 125 CH4
  g_EM_SOAClient_Swc_SOA_CHECK("SFSStStruct.SFS_Ch1_Lev_St 125"); // 预期结果 TC_CANTest SOA check SFSStStruct.SFS_Ch1_Lev_St 125
  g_EM_SOAClient_Swc_SOA_CHECK_Prepare("SFSStStruct.SFS_Ch1_Lev_St 126"); // 预期结果 TC_CANTest SOA check SFSStStruct.SFS_Ch1_Lev_St 126
  g_EM_LIN_Swc_LIN_Send("C4_FRS_Level_Container_1 126 CH4"); // 测试步骤 TC_LINTest LIN Send C4_FRS_Level_Container_1 126 CH4
  g_EM_SOAClient_Swc_SOA_CHECK("SFSStStruct.SFS_Ch1_Lev_St 126"); // 预期结果 TC_CANTest SOA check SFSStStruct.SFS_Ch1_Lev_St 126
  g_EM_SOAClient_Swc_SOA_CHECK_Prepare("SFSStStruct.SFS_Ch1_Lev_St 127"); // 预期结果 TC_CANTest SOA check SFSStStruct.SFS_Ch1_Lev_St 127
  g_EM_LIN_Swc_LIN_Send("C4_FRS_Level_Container_1 127 CH4"); // 测试步骤 TC_LINTest LIN Send C4_FRS_Level_Container_1 127 CH4
  g_EM_SOAClient_Swc_SOA_CHECK("SFSStStruct.SFS_Ch1_Lev_St 127"); // 预期结果 TC_CANTest SOA check SFSStStruct.SFS_Ch1_Lev_St 127
  g_EM_SOAClient_Swc_SOA_CHECK_Prepare("SFSStStruct.SFS_Ch1_Lev_St 1"); // 预期结果 TC_CANTest SOA check SFSStStruct.SFS_Ch1_Lev_St 1
  g_EM_LIN_Swc_LIN_Send("C4_FRS_Level_Container_1 1 CH4"); // 测试步骤 TC_LINTest LIN Send C4_FRS_Level_Container_1 1 CH4
  g_EM_SOAClient_Swc_SOA_CHECK("SFSStStruct.SFS_Ch1_Lev_St 1"); // 预期结果 TC_CANTest SOA check SFSStStruct.SFS_Ch1_Lev_St 1
}

testcase SYS_CDCU_xiangfen_0209()
{
  TestDescription("香氛通道2余量信息 Local on");
  teststep("warning","原始用例id为SYS-CDCU-香氛-0209");
  g_EM_SOAClient_Swc_SOA_CHECK_Prepare("SFSStStruct.SFS_Ch2_Lev_St 0"); // 预期结果 TC_CANTest SOA check SFSStStruct.SFS_Ch2_Lev_St 0
  g_EM_LIN_Swc_LIN_Send("C4_FRS_Level_Container_2 0 CH4"); // 测试步骤 TC_LINTest LIN Send C4_FRS_Level_Container_2 0 CH4
  g_EM_SOAClient_Swc_SOA_CHECK("SFSStStruct.SFS_Ch2_Lev_St 0"); // 预期结果 TC_CANTest SOA check SFSStStruct.SFS_Ch2_Lev_St 0
  g_EM_SOAClient_Swc_SOA_CHECK_Prepare("SFSStStruct.SFS_Ch2_Lev_St 10"); // 预期结果 TC_CANTest SOA check SFSStStruct.SFS_Ch2_Lev_St 10
  g_EM_LIN_Swc_LIN_Send("C4_FRS_Level_Container_2 10 CH4"); // 测试步骤 TC_LINTest LIN Send C4_FRS_Level_Container_2 10 CH4
  g_EM_SOAClient_Swc_SOA_CHECK("SFSStStruct.SFS_Ch2_Lev_St 10"); // 预期结果 TC_CANTest SOA check SFSStStruct.SFS_Ch2_Lev_St 10
  g_EM_SOAClient_Swc_SOA_CHECK_Prepare("SFSStStruct.SFS_Ch2_Lev_St 20"); // 预期结果 TC_CANTest SOA check SFSStStruct.SFS_Ch2_Lev_St 20
  g_EM_LIN_Swc_LIN_Send("C4_FRS_Level_Container_2 20 CH4"); // 测试步骤 TC_LINTest LIN Send C4_FRS_Level_Container_2 20 CH4
  g_EM_SOAClient_Swc_SOA_CHECK("SFSStStruct.SFS_Ch2_Lev_St 20"); // 预期结果 TC_CANTest SOA check SFSStStruct.SFS_Ch2_Lev_St 20
  g_EM_SOAClient_Swc_SOA_CHECK_Prepare("SFSStStruct.SFS_Ch2_Lev_St 30"); // 预期结果 TC_CANTest SOA check SFSStStruct.SFS_Ch2_Lev_St 30
  g_EM_LIN_Swc_LIN_Send("C4_FRS_Level_Container_2 30 CH4"); // 测试步骤 TC_LINTest LIN Send C4_FRS_Level_Container_2 30 CH4
  g_EM_SOAClient_Swc_SOA_CHECK("SFSStStruct.SFS_Ch2_Lev_St 30"); // 预期结果 TC_CANTest SOA check SFSStStruct.SFS_Ch2_Lev_St 30
  g_EM_SOAClient_Swc_SOA_CHECK_Prepare("SFSStStruct.SFS_Ch2_Lev_St 40"); // 预期结果 TC_CANTest SOA check SFSStStruct.SFS_Ch2_Lev_St 40
  g_EM_LIN_Swc_LIN_Send("C4_FRS_Level_Container_2 40 CH4"); // 测试步骤 TC_LINTest LIN Send C4_FRS_Level_Container_2 40 CH4
  g_EM_SOAClient_Swc_SOA_CHECK("SFSStStruct.SFS_Ch2_Lev_St 40"); // 预期结果 TC_CANTest SOA check SFSStStruct.SFS_Ch2_Lev_St 40
  g_EM_SOAClient_Swc_SOA_CHECK_Prepare("SFSStStruct.SFS_Ch2_Lev_St 50"); // 预期结果 TC_CANTest SOA check SFSStStruct.SFS_Ch2_Lev_St 50
  g_EM_LIN_Swc_LIN_Send("C4_FRS_Level_Container_2 50 CH4"); // 测试步骤 TC_LINTest LIN Send C4_FRS_Level_Container_2 50 CH4
  g_EM_SOAClient_Swc_SOA_CHECK("SFSStStruct.SFS_Ch2_Lev_St 50"); // 预期结果 TC_CANTest SOA check SFSStStruct.SFS_Ch2_Lev_St 50
  g_EM_SOAClient_Swc_SOA_CHECK_Prepare("SFSStStruct.SFS_Ch2_Lev_St 60"); // 预期结果 TC_CANTest SOA check SFSStStruct.SFS_Ch2_Lev_St 60
  g_EM_LIN_Swc_LIN_Send("C4_FRS_Level_Container_2 60 CH4"); // 测试步骤 TC_LINTest LIN Send C4_FRS_Level_Container_2 60 CH4
  g_EM_SOAClient_Swc_SOA_CHECK("SFSStStruct.SFS_Ch2_Lev_St 60"); // 预期结果 TC_CANTest SOA check SFSStStruct.SFS_Ch2_Lev_St 60
  g_EM_SOAClient_Swc_SOA_CHECK_Prepare("SFSStStruct.SFS_Ch2_Lev_St 70"); // 预期结果 TC_CANTest SOA check SFSStStruct.SFS_Ch2_Lev_St 70
  g_EM_LIN_Swc_LIN_Send("C4_FRS_Level_Container_2 70 CH4"); // 测试步骤 TC_LINTest LIN Send C4_FRS_Level_Container_2 70 CH4
  g_EM_SOAClient_Swc_SOA_CHECK("SFSStStruct.SFS_Ch2_Lev_St 70"); // 预期结果 TC_CANTest SOA check SFSStStruct.SFS_Ch2_Lev_St 70
  g_EM_SOAClient_Swc_SOA_CHECK_Prepare("SFSStStruct.SFS_Ch2_Lev_St 80"); // 预期结果 TC_CANTest SOA check SFSStStruct.SFS_Ch2_Lev_St 80
  g_EM_LIN_Swc_LIN_Send("C4_FRS_Level_Container_2 80 CH4"); // 测试步骤 TC_LINTest LIN Send C4_FRS_Level_Container_2 80 CH4
  g_EM_SOAClient_Swc_SOA_CHECK("SFSStStruct.SFS_Ch2_Lev_St 80"); // 预期结果 TC_CANTest SOA check SFSStStruct.SFS_Ch2_Lev_St 80
  g_EM_SOAClient_Swc_SOA_CHECK_Prepare("SFSStStruct.SFS_Ch2_Lev_St 90"); // 预期结果 TC_CANTest SOA check SFSStStruct.SFS_Ch2_Lev_St 90
  g_EM_LIN_Swc_LIN_Send("C4_FRS_Level_Container_2 90 CH4"); // 测试步骤 TC_LINTest LIN Send C4_FRS_Level_Container_2 90 CH4
  g_EM_SOAClient_Swc_SOA_CHECK("SFSStStruct.SFS_Ch2_Lev_St 90"); // 预期结果 TC_CANTest SOA check SFSStStruct.SFS_Ch2_Lev_St 90
  g_EM_SOAClient_Swc_SOA_CHECK_Prepare("SFSStStruct.SFS_Ch2_Lev_St 100"); // 预期结果 TC_CANTest SOA check SFSStStruct.SFS_Ch2_Lev_St 100
  g_EM_LIN_Swc_LIN_Send("C4_FRS_Level_Container_2 100 CH4"); // 测试步骤 TC_LINTest LIN Send C4_FRS_Level_Container_2 100 CH4
  g_EM_SOAClient_Swc_SOA_CHECK("SFSStStruct.SFS_Ch2_Lev_St 100"); // 预期结果 TC_CANTest SOA check SFSStStruct.SFS_Ch2_Lev_St 100
  g_EM_SOAClient_Swc_SOA_CHECK_Prepare("SFSStStruct.SFS_Ch2_Lev_St 125"); // 预期结果 TC_CANTest SOA check SFSStStruct.SFS_Ch2_Lev_St 125
  g_EM_LIN_Swc_LIN_Send("C4_FRS_Level_Container_2 125 CH4"); // 测试步骤 TC_LINTest LIN Send C4_FRS_Level_Container_2 125 CH4
  g_EM_SOAClient_Swc_SOA_CHECK("SFSStStruct.SFS_Ch2_Lev_St 125"); // 预期结果 TC_CANTest SOA check SFSStStruct.SFS_Ch2_Lev_St 125
  g_EM_SOAClient_Swc_SOA_CHECK_Prepare("SFSStStruct.SFS_Ch2_Lev_St 126"); // 预期结果 TC_CANTest SOA check SFSStStruct.SFS_Ch2_Lev_St 126
  g_EM_LIN_Swc_LIN_Send("C4_FRS_Level_Container_2 126 CH4"); // 测试步骤 TC_LINTest LIN Send C4_FRS_Level_Container_2 126 CH4
  g_EM_SOAClient_Swc_SOA_CHECK("SFSStStruct.SFS_Ch2_Lev_St 126"); // 预期结果 TC_CANTest SOA check SFSStStruct.SFS_Ch2_Lev_St 126
  g_EM_SOAClient_Swc_SOA_CHECK_Prepare("SFSStStruct.SFS_Ch2_Lev_St 127"); // 预期结果 TC_CANTest SOA check SFSStStruct.SFS_Ch2_Lev_St 127
  g_EM_LIN_Swc_LIN_Send("C4_FRS_Level_Container_2 127 CH4"); // 测试步骤 TC_LINTest LIN Send C4_FRS_Level_Container_2 127 CH4
  g_EM_SOAClient_Swc_SOA_CHECK("SFSStStruct.SFS_Ch2_Lev_St 127"); // 预期结果 TC_CANTest SOA check SFSStStruct.SFS_Ch2_Lev_St 127
  g_EM_SOAClient_Swc_SOA_CHECK_Prepare("SFSStStruct.SFS_Ch2_Lev_St 1"); // 预期结果 TC_CANTest SOA check SFSStStruct.SFS_Ch2_Lev_St 1
  g_EM_LIN_Swc_LIN_Send("C4_FRS_Level_Container_2 1 CH4"); // 测试步骤 TC_LINTest LIN Send C4_FRS_Level_Container_2 1 CH4
  g_EM_SOAClient_Swc_SOA_CHECK("SFSStStruct.SFS_Ch2_Lev_St 1"); // 预期结果 TC_CANTest SOA check SFSStStruct.SFS_Ch2_Lev_St 1
}

testcase SYS_CDCU_xiangfen_0210()
{
  TestDescription("香氛通道3余量信息 Local on");
  teststep("warning","原始用例id为SYS-CDCU-香氛-0210");
  g_EM_SOAClient_Swc_SOA_CHECK_Prepare("SFSStStruct.SFS_Ch3_Lev_St 0"); // 预期结果 TC_CANTest SOA check SFSStStruct.SFS_Ch3_Lev_St 0
  g_EM_LIN_Swc_LIN_Send("C4_FRS_Level_Container_3 0 CH4"); // 测试步骤 TC_LINTest LIN Send C4_FRS_Level_Container_3 0 CH4
  g_EM_SOAClient_Swc_SOA_CHECK("SFSStStruct.SFS_Ch3_Lev_St 0"); // 预期结果 TC_CANTest SOA check SFSStStruct.SFS_Ch3_Lev_St 0
  g_EM_SOAClient_Swc_SOA_CHECK_Prepare("SFSStStruct.SFS_Ch3_Lev_St 10"); // 预期结果 TC_CANTest SOA check SFSStStruct.SFS_Ch3_Lev_St 10
  g_EM_LIN_Swc_LIN_Send("C4_FRS_Level_Container_3 10 CH4"); // 测试步骤 TC_LINTest LIN Send C4_FRS_Level_Container_3 10 CH4
  g_EM_SOAClient_Swc_SOA_CHECK("SFSStStruct.SFS_Ch3_Lev_St 10"); // 预期结果 TC_CANTest SOA check SFSStStruct.SFS_Ch3_Lev_St 10
  g_EM_SOAClient_Swc_SOA_CHECK_Prepare("SFSStStruct.SFS_Ch3_Lev_St 20"); // 预期结果 TC_CANTest SOA check SFSStStruct.SFS_Ch3_Lev_St 20
  g_EM_LIN_Swc_LIN_Send("C4_FRS_Level_Container_3 20 CH4"); // 测试步骤 TC_LINTest LIN Send C4_FRS_Level_Container_3 20 CH4
  g_EM_SOAClient_Swc_SOA_CHECK("SFSStStruct.SFS_Ch3_Lev_St 20"); // 预期结果 TC_CANTest SOA check SFSStStruct.SFS_Ch3_Lev_St 20
  g_EM_SOAClient_Swc_SOA_CHECK_Prepare("SFSStStruct.SFS_Ch3_Lev_St 30"); // 预期结果 TC_CANTest SOA check SFSStStruct.SFS_Ch3_Lev_St 30
  g_EM_LIN_Swc_LIN_Send("C4_FRS_Level_Container_3 30 CH4"); // 测试步骤 TC_LINTest LIN Send C4_FRS_Level_Container_3 30 CH4
  g_EM_SOAClient_Swc_SOA_CHECK("SFSStStruct.SFS_Ch3_Lev_St 30"); // 预期结果 TC_CANTest SOA check SFSStStruct.SFS_Ch3_Lev_St 30
  g_EM_SOAClient_Swc_SOA_CHECK_Prepare("SFSStStruct.SFS_Ch3_Lev_St 40"); // 预期结果 TC_CANTest SOA check SFSStStruct.SFS_Ch3_Lev_St 40
  g_EM_LIN_Swc_LIN_Send("C4_FRS_Level_Container_3 40 CH4"); // 测试步骤 TC_LINTest LIN Send C4_FRS_Level_Container_3 40 CH4
  g_EM_SOAClient_Swc_SOA_CHECK("SFSStStruct.SFS_Ch3_Lev_St 40"); // 预期结果 TC_CANTest SOA check SFSStStruct.SFS_Ch3_Lev_St 40
  g_EM_SOAClient_Swc_SOA_CHECK_Prepare("SFSStStruct.SFS_Ch3_Lev_St 50"); // 预期结果 TC_CANTest SOA check SFSStStruct.SFS_Ch3_Lev_St 50
  g_EM_LIN_Swc_LIN_Send("C4_FRS_Level_Container_3 50 CH4"); // 测试步骤 TC_LINTest LIN Send C4_FRS_Level_Container_3 50 CH4
  g_EM_SOAClient_Swc_SOA_CHECK("SFSStStruct.SFS_Ch3_Lev_St 50"); // 预期结果 TC_CANTest SOA check SFSStStruct.SFS_Ch3_Lev_St 50
  g_EM_SOAClient_Swc_SOA_CHECK_Prepare("SFSStStruct.SFS_Ch3_Lev_St 60"); // 预期结果 TC_CANTest SOA check SFSStStruct.SFS_Ch3_Lev_St 60
  g_EM_LIN_Swc_LIN_Send("C4_FRS_Level_Container_3 60 CH4"); // 测试步骤 TC_LINTest LIN Send C4_FRS_Level_Container_3 60 CH4
  g_EM_SOAClient_Swc_SOA_CHECK("SFSStStruct.SFS_Ch3_Lev_St 60"); // 预期结果 TC_CANTest SOA check SFSStStruct.SFS_Ch3_Lev_St 60
  g_EM_SOAClient_Swc_SOA_CHECK_Prepare("SFSStStruct.SFS_Ch3_Lev_St 70"); // 预期结果 TC_CANTest SOA check SFSStStruct.SFS_Ch3_Lev_St 70
  g_EM_LIN_Swc_LIN_Send("C4_FRS_Level_Container_3 70 CH4"); // 测试步骤 TC_LINTest LIN Send C4_FRS_Level_Container_3 70 CH4
  g_EM_SOAClient_Swc_SOA_CHECK("SFSStStruct.SFS_Ch3_Lev_St 70"); // 预期结果 TC_CANTest SOA check SFSStStruct.SFS_Ch3_Lev_St 70
  g_EM_SOAClient_Swc_SOA_CHECK_Prepare("SFSStStruct.SFS_Ch3_Lev_St 80"); // 预期结果 TC_CANTest SOA check SFSStStruct.SFS_Ch3_Lev_St 80
  g_EM_LIN_Swc_LIN_Send("C4_FRS_Level_Container_3 80 CH4"); // 测试步骤 TC_LINTest LIN Send C4_FRS_Level_Container_3 80 CH4
  g_EM_SOAClient_Swc_SOA_CHECK("SFSStStruct.SFS_Ch3_Lev_St 80"); // 预期结果 TC_CANTest SOA check SFSStStruct.SFS_Ch3_Lev_St 80
  g_EM_SOAClient_Swc_SOA_CHECK_Prepare("SFSStStruct.SFS_Ch3_Lev_St 90"); // 预期结果 TC_CANTest SOA check SFSStStruct.SFS_Ch3_Lev_St 90
  g_EM_LIN_Swc_LIN_Send("C4_FRS_Level_Container_3 90 CH4"); // 测试步骤 TC_LINTest LIN Send C4_FRS_Level_Container_3 90 CH4
  g_EM_SOAClient_Swc_SOA_CHECK("SFSStStruct.SFS_Ch3_Lev_St 90"); // 预期结果 TC_CANTest SOA check SFSStStruct.SFS_Ch3_Lev_St 90
  g_EM_SOAClient_Swc_SOA_CHECK_Prepare("SFSStStruct.SFS_Ch3_Lev_St 100"); // 预期结果 TC_CANTest SOA check SFSStStruct.SFS_Ch3_Lev_St 100
  g_EM_LIN_Swc_LIN_Send("C4_FRS_Level_Container_3 100 CH4"); // 测试步骤 TC_LINTest LIN Send C4_FRS_Level_Container_3 100 CH4
  g_EM_SOAClient_Swc_SOA_CHECK("SFSStStruct.SFS_Ch3_Lev_St 100"); // 预期结果 TC_CANTest SOA check SFSStStruct.SFS_Ch3_Lev_St 100
  g_EM_SOAClient_Swc_SOA_CHECK_Prepare("SFSStStruct.SFS_Ch3_Lev_St 125"); // 预期结果 TC_CANTest SOA check SFSStStruct.SFS_Ch3_Lev_St 125
  g_EM_LIN_Swc_LIN_Send("C4_FRS_Level_Container_3 125 CH4"); // 测试步骤 TC_LINTest LIN Send C4_FRS_Level_Container_3 125 CH4
  g_EM_SOAClient_Swc_SOA_CHECK("SFSStStruct.SFS_Ch3_Lev_St 125"); // 预期结果 TC_CANTest SOA check SFSStStruct.SFS_Ch3_Lev_St 125
  g_EM_SOAClient_Swc_SOA_CHECK_Prepare("SFSStStruct.SFS_Ch3_Lev_St 126"); // 预期结果 TC_CANTest SOA check SFSStStruct.SFS_Ch3_Lev_St 126
  g_EM_LIN_Swc_LIN_Send("C4_FRS_Level_Container_3 126 CH4"); // 测试步骤 TC_LINTest LIN Send C4_FRS_Level_Container_3 126 CH4
  g_EM_SOAClient_Swc_SOA_CHECK("SFSStStruct.SFS_Ch3_Lev_St 126"); // 预期结果 TC_CANTest SOA check SFSStStruct.SFS_Ch3_Lev_St 126
  g_EM_SOAClient_Swc_SOA_CHECK_Prepare("SFSStStruct.SFS_Ch3_Lev_St 127"); // 预期结果 TC_CANTest SOA check SFSStStruct.SFS_Ch3_Lev_St 127
  g_EM_LIN_Swc_LIN_Send("C4_FRS_Level_Container_3 127 CH4"); // 测试步骤 TC_LINTest LIN Send C4_FRS_Level_Container_3 127 CH4
  g_EM_SOAClient_Swc_SOA_CHECK("SFSStStruct.SFS_Ch3_Lev_St 127"); // 预期结果 TC_CANTest SOA check SFSStStruct.SFS_Ch3_Lev_St 127
  g_EM_SOAClient_Swc_SOA_CHECK_Prepare("SFSStStruct.SFS_Ch3_Lev_St 1"); // 预期结果 TC_CANTest SOA check SFSStStruct.SFS_Ch3_Lev_St 1
  g_EM_LIN_Swc_LIN_Send("C4_FRS_Level_Container_3 1 CH4"); // 测试步骤 TC_LINTest LIN Send C4_FRS_Level_Container_3 1 CH4
  g_EM_SOAClient_Swc_SOA_CHECK("SFSStStruct.SFS_Ch3_Lev_St 1"); // 预期结果 TC_CANTest SOA check SFSStStruct.SFS_Ch3_Lev_St 1
}

testcase SYS_CDCU_xiangfen_0211()
{
  TestDescription("香氛通道1过期信息 Local on");
  teststep("warning","原始用例id为SYS-CDCU-香氛-0211");
  g_EM_SOAClient_Swc_SOA_CHECK_Prepare("SFSStStruct.FRS_Expiry_Container_1 1"); // 预期结果 TC_CANTest SOA check SFSStStruct.FRS_Expiry_Container_1 1
  g_EM_LIN_Swc_LIN_Send("C4_FRS_Expiry_Container_1 0x1 CH4"); // 测试步骤 TC_LINTest LIN Send C4_FRS_Expiry_Container_1 0x1 CH4
  g_EM_SOAClient_Swc_SOA_CHECK("SFSStStruct.FRS_Expiry_Container_1 1"); // 预期结果 TC_CANTest SOA check SFSStStruct.FRS_Expiry_Container_1 1
  g_EM_SOAClient_Swc_SOA_CHECK_Prepare("SFSStStruct.FRS_Expiry_Container_1 0"); // 预期结果 TC_CANTest SOA check SFSStStruct.FRS_Expiry_Container_1 0
  g_EM_LIN_Swc_LIN_Send("C4_FRS_Expiry_Container_1 0x0 CH4"); // 测试步骤 TC_LINTest LIN Send C4_FRS_Expiry_Container_1 0x0 CH4
  g_EM_SOAClient_Swc_SOA_CHECK("SFSStStruct.FRS_Expiry_Container_1 0"); // 预期结果 TC_CANTest SOA check SFSStStruct.FRS_Expiry_Container_1 0
}

testcase SYS_CDCU_xiangfen_0212()
{
  TestDescription("香氛通道2过期信息 Local on");
  teststep("warning","原始用例id为SYS-CDCU-香氛-0212");
  g_EM_SOAClient_Swc_SOA_CHECK_Prepare("SFSStStruct.FRS_Expiry_Container_2 1"); // 预期结果 TC_CANTest SOA check SFSStStruct.FRS_Expiry_Container_2 1
  g_EM_LIN_Swc_LIN_Send("C4_FRS_Expiry_Container_2 0x1 CH4"); // 测试步骤 TC_LINTest LIN Send C4_FRS_Expiry_Container_2 0x1 CH4
  g_EM_SOAClient_Swc_SOA_CHECK("SFSStStruct.FRS_Expiry_Container_2 1"); // 预期结果 TC_CANTest SOA check SFSStStruct.FRS_Expiry_Container_2 1
  g_EM_SOAClient_Swc_SOA_CHECK_Prepare("SFSStStruct.FRS_Expiry_Container_2 0"); // 预期结果 TC_CANTest SOA check SFSStStruct.FRS_Expiry_Container_2 0
  g_EM_LIN_Swc_LIN_Send("C4_FRS_Expiry_Container_2 0x0 CH4"); // 测试步骤 TC_LINTest LIN Send C4_FRS_Expiry_Container_2 0x0 CH4
  g_EM_SOAClient_Swc_SOA_CHECK("SFSStStruct.FRS_Expiry_Container_2 0"); // 预期结果 TC_CANTest SOA check SFSStStruct.FRS_Expiry_Container_2 0
}

testcase SYS_CDCU_xiangfen_0213()
{
  TestDescription("香氛通道3过期信息 Local on");
  teststep("warning","原始用例id为SYS-CDCU-香氛-0213");
  g_EM_SOAClient_Swc_SOA_CHECK_Prepare("SFSStStruct.FRS_Expiry_Container_3 1"); // 预期结果 TC_CANTest SOA check SFSStStruct.FRS_Expiry_Container_3 1
  g_EM_LIN_Swc_LIN_Send("C4_FRS_Expiry_Container_3 0x1 CH4"); // 测试步骤 TC_LINTest LIN Send C4_FRS_Expiry_Container_3 0x1 CH4
  g_EM_SOAClient_Swc_SOA_CHECK("SFSStStruct.FRS_Expiry_Container_3 1"); // 预期结果 TC_CANTest SOA check SFSStStruct.FRS_Expiry_Container_3 1
  g_EM_SOAClient_Swc_SOA_CHECK_Prepare("SFSStStruct.FRS_Expiry_Container_3 0"); // 预期结果 TC_CANTest SOA check SFSStStruct.FRS_Expiry_Container_3 0
  g_EM_LIN_Swc_LIN_Send("C4_FRS_Expiry_Container_3 0x0 CH4"); // 测试步骤 TC_LINTest LIN Send C4_FRS_Expiry_Container_3 0x0 CH4
  g_EM_SOAClient_Swc_SOA_CHECK("SFSStStruct.FRS_Expiry_Container_3 0"); // 预期结果 TC_CANTest SOA check SFSStStruct.FRS_Expiry_Container_3 0
}

testcase SYS_CDCU_xiangfen_0214()
{
  TestDescription("车内温度 Local on");
  teststep("warning","原始用例id为SYS-CDCU-香氛-0214");
  gTC_CANTest_SOA_SetSever("TempSensorInfoFBStruct.CorrectedCabinTemp:30"); // 测试步骤 TC_CANTest SOA SetServer TempSensorInfoFBStruct.CorrectedCabinTemp:30
  g_EM_LIN_Swc_LIN_Check("C4_KL_Innen_Temp 30 CH4"); // 预期结果 TC_LINTest LIN Check C4_KL_Innen_Temp 30 CH4
  gTC_CANTest_SOA_SetSever("TempSensorInfoFBStruct.CorrectedCabinTemp:40"); // 测试步骤 TC_CANTest SOA SetServer TempSensorInfoFBStruct.CorrectedCabinTemp:40
  g_EM_LIN_Swc_LIN_Check("C4_KL_Innen_Temp 40 CH4"); // 预期结果 TC_LINTest LIN Check C4_KL_Innen_Temp 40 CH4
  gTC_CANTest_SOA_SetSever("TempSensorInfoFBStruct.CorrectedCabinTemp:50"); // 测试步骤 TC_CANTest SOA SetServer TempSensorInfoFBStruct.CorrectedCabinTemp:50
  g_EM_LIN_Swc_LIN_Check("C4_KL_Innen_Temp 50 CH4"); // 预期结果 TC_LINTest LIN Check C4_KL_Innen_Temp 50 CH4
  gTC_CANTest_SOA_SetSever("TempSensorInfoFBStruct.CorrectedCabinTemp:60"); // 测试步骤 TC_CANTest SOA SetServer TempSensorInfoFBStruct.CorrectedCabinTemp:60
  g_EM_LIN_Swc_LIN_Check("C4_KL_Innen_Temp 60 CH4"); // 预期结果 TC_LINTest LIN Check C4_KL_Innen_Temp 60 CH4
  gTC_CANTest_SOA_SetSever("TempSensorInfoFBStruct.CorrectedCabinTemp:76"); // 测试步骤 TC_CANTest SOA SetServer TempSensorInfoFBStruct.CorrectedCabinTemp:76
  g_EM_LIN_Swc_LIN_Check("C4_KL_Innen_Temp 76 CH4"); // 预期结果 TC_LINTest LIN Check C4_KL_Innen_Temp 76 CH4
  gTC_CANTest_SOA_SetSever("TempSensorInfoFBStruct.CorrectedCabinTemp:77"); // 测试步骤 TC_CANTest SOA SetServer TempSensorInfoFBStruct.CorrectedCabinTemp:77
  g_EM_LIN_Swc_LIN_Check("C4_KL_Innen_Temp 76 CH4"); // 预期结果 TC_LINTest LIN Check C4_KL_Innen_Temp 76 CH4
  gTC_CANTest_SOA_SetSever("TempSensorInfoFBStruct.CorrectedCabinTemp:-20"); // 测试步骤 TC_CANTest SOA SetServer TempSensorInfoFBStruct.CorrectedCabinTemp:-20
  g_EM_LIN_Swc_LIN_Check("C4_KL_Innen_Temp -20 CH4"); // 预期结果 TC_LINTest LIN Check C4_KL_Innen_Temp -20 CH4
  gTC_CANTest_SOA_SetSever("TempSensorInfoFBStruct.CorrectedCabinTemp:-40"); // 测试步骤 TC_CANTest SOA SetServer TempSensorInfoFBStruct.CorrectedCabinTemp:-40
  g_EM_LIN_Swc_LIN_Check("C4_KL_Innen_Temp -40 CH4"); // 预期结果 TC_LINTest LIN Check C4_KL_Innen_Temp -40 CH4
  gTC_CANTest_SOA_SetSever("TempSensorInfoFBStruct.CorrectedCabinTemp:-41"); // 测试步骤 TC_CANTest SOA SetServer TempSensorInfoFBStruct.CorrectedCabinTemp:-41
  g_EM_LIN_Swc_LIN_Check("C4_KL_Innen_Temp -40 CH4"); // 预期结果 TC_LINTest LIN Check C4_KL_Innen_Temp -40 CH4
}

testcase SYS_CDCU_xiangfen_0215()
{
  TestDescription("SFS从节点通信异常 U2F2C08");
  teststep("warning","原始用例id为SYS-CDCU-香氛-0215");
  g_CAN_Bus_Swc_Set("C_LDCU_SysSt.C_LDCU_EVSysReadySt 2"); // 测试步骤 TC_CANTest SET C_LDCU_SysSt.C_LDCU_EVSysReadySt 2//上高压
  g_EM_LIN_Swc_LIN_Send("C4_FRS_ResponseError 0x1 CH4"); // 测试步骤 TC_LINTest LIN Send C4_FRS_ResponseError 0x1 CH4
  g_EM_Equipment_Swc_TC_4G_Time_Delay_Second("3"); // 测试步骤 TC_Sleep 3
  g_EM_UDS_CAN_Swc_Diag("19 04 EF 2C 08 FF"); // 测试步骤 TC_CANTest Diag 19 04 EF 2C 08 FF
  g_EM_UDS_CAN_Swc_TC_CheckDiagRes("59 04 EF 2C 08 29 01 *"); // 预期结果 TC_CheckDiagRes 59 04 EF 2C 08 29 01 *
  g_EM_LIN_Swc_LIN_Send("C4_FRS_ResponseError 0x0 CH4"); // 测试步骤 TC_LINTest LIN Send C4_FRS_ResponseError 0x0 CH4
  g_EM_Equipment_Swc_TC_4G_Time_Delay_Second("3"); // 测试步骤 TC_Sleep 3
  g_EM_UDS_CAN_Swc_Diag("14 FF FF FF"); // 测试步骤 TC_CANTest Diag 14 FF FF FF
  g_EM_UDS_CAN_Swc_Diag("19 04 EF 2C 08 FF"); // 测试步骤 TC_CANTest Diag 19 04 EF 2C 08 FF
  g_EM_UDS_CAN_Swc_TC_CheckDiagRes("59 04 EF 2C 08 00"); // 预期结果 TC_CheckDiagRes 59 04 EF 2C 08 00
}

testcase SYS_CDCU_xiangfen_0216()
{
  TestDescription("SFS从节点通信异常 U2F2C08");
  teststep("warning","原始用例id为SYS-CDCU-香氛-0216");
  g_CAN_Bus_Swc_Set("C_LDCU_SysSt.C_LDCU_EVSysReadySt 2"); // 测试步骤 TC_CANTest SET C_LDCU_SysSt.C_LDCU_EVSysReadySt 2//上高压
  g_EM_LIN_Swc_LIN_Send("C4_FRS_ResponseError 0x0 CH4"); // 测试步骤 TC_LINTest LIN Send C4_FRS_ResponseError 0x0 CH4
  g_EM_LIN_Swc_LIN_Disable("0x35 CH4"); // 测试步骤 TC_LINTest LIN Disable 0x35 CH4
  g_EM_Equipment_Swc_TC_4G_Time_Delay_Second("5"); // 测试步骤 TC_Sleep 5
  g_EM_UDS_CAN_Swc_Diag("19 04 EF 2C 08 FF"); // 测试步骤 TC_CANTest Diag 19 04 EF 2C 08 FF
  g_EM_UDS_CAN_Swc_TC_CheckDiagRes("59 04 EF 2C 08 29 01 *"); // 预期结果 TC_CheckDiagRes 59 04 EF 2C 08 29 01 *
  g_EM_LIN_Swc_LIN_Enable("0x35 CH4"); // 测试步骤 TC_LINTest LIN Enable 0x35 CH4
  g_EM_UDS_CAN_Swc_Diag("14 FF FF FF"); // 测试步骤 TC_CANTest Diag 14 FF FF FF
  g_EM_UDS_CAN_Swc_Diag("19 04 EF 2C 08 FF"); // 测试步骤 TC_CANTest Diag 19 04 EF 2C 08 FF
  g_EM_UDS_CAN_Swc_TC_CheckDiagRes("59 04 EF 2C 08 00"); // 预期结果 TC_CheckDiagRes 59 04 EF 2C 08 00
}
