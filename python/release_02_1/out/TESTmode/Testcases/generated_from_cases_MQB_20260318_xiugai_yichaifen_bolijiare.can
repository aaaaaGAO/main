/*@!Encoding: 936*/

includes
{
}

variables
{
}

testcase SYS_CDCU_bolijiare_0001()
{
  TestDescription("开启前挡风玻璃加热 Power=ON");
  teststep("warning","原始用例id为SYS-CDCU-玻璃加热-0001");
  g_EM_Equipment_Swc_TC_PW("ON"); // 测试步骤 TC_PW ON
  g_CAN_Bus_Swc_AllCANDataDefaultAllCh(); // 测试步骤 TC_CANTest SET AllCANDataDefaultAllCh
  g_EM_Equipment_Swc_TC_IG("ON"); // 测试步骤 TC_IG ON
  g_CAN_Bus_Swc_Set("I_LDCU_BodySysSt1.I_LDCU_PowerMode 1"); // 测试步骤 TC_CANTest SET I_LDCU_BodySysSt1.I_LDCU_PowerMode 1
  gTC_CANTest_SOA_Set8001Delay("0"); // 测试步骤 TC_CANTest SOA Set8001Delay 0
  g_CAN_Bus_Swc_Set("C_LDCU_SysSt.C_LDCU_EVSysReadySt 2"); // 测试步骤 TC_CANTest SET C_LDCU_SysSt.C_LDCU_EVSysReadySt 2//上高压
  g_EM_SOAClient_Swc_SOA_SubPeriod("Veh_FrontMirrorHeatService_ErrGrp 1"); // 测试步骤 TC_CANTest SOA SubPeriod Veh_FrontMirrorHeatService_ErrGrp 1
  g_EM_SOAClient_Swc_SOA_SubPeriod("Veh_RearMirrorHeatService_ErrGrp 1"); // 测试步骤 TC_CANTest SOA SubPeriod Veh_RearMirrorHeatService_ErrGrp 1
  g_EM_SOAClient_Swc_SOA_CHECK_Prepare("Veh_FrontMirrorHeatRespStruct.Veh_FrontMirrorHeatNRC 0"); // 预期结果 TC_CANTest SOA check Veh_FrontMirrorHeatRespStruct.Veh_FrontMirrorHeatNRC 0
  gTC_CANTest_SOA_CheckReq_Prepare("FrontMirrorHeatCmdStruct.FrontMirrorHeat 1"); // 预期结果 TC_CANTest SOA CheckReq FrontMirrorHeatCmdStruct.FrontMirrorHeat 1
  g_EM_SOAClient_Swc_SOA_CHECK_Prepare("Veh_FrontMirrorHeatService_ErrStruct.OpeNRC 0 delay6.8"); // 预期结果 TC_CANTest SOA check Veh_FrontMirrorHeatService_ErrStruct.OpeNRC 0 delay6.8 //
  g_EM_SOAClient_Swc_SOA_REQ("Veh_FrontMirrorHeatStruct.Veh_FrontMirrorHeat:1&ServiceExecuteFeedbackFlag:2"); // 测试步骤 TC_CANTest SOA REQ Veh_FrontMirrorHeatStruct.Veh_FrontMirrorHeat:1&ServiceExecuteFeedbackFlag:2 //Open
  g_EM_SOAClient_Swc_SOA_CHECK("Veh_FrontMirrorHeatRespStruct.Veh_FrontMirrorHeatNRC 0"); // 预期结果 TC_CANTest SOA check Veh_FrontMirrorHeatRespStruct.Veh_FrontMirrorHeatNRC 0
  gTC_CANTest_SOA_CheckReq("FrontMirrorHeatCmdStruct.FrontMirrorHeat 1"); // 预期结果 TC_CANTest SOA CheckReq FrontMirrorHeatCmdStruct.FrontMirrorHeat 1
  g_EM_SOAClient_Swc_SOA_CHECK("Veh_FrontMirrorHeatService_ErrStruct.OpeNRC 0 delay6.8"); // 预期结果 TC_CANTest SOA check Veh_FrontMirrorHeatService_ErrStruct.OpeNRC 0 delay6.8 //
}

testcase SYS_CDCU_bolijiare_0002()
{
  TestDescription("关闭前挡风玻璃加热 Power=ON");
  teststep("warning","原始用例id为SYS-CDCU-玻璃加热-0002");
  g_CAN_Bus_Swc_Set("C_LDCU_SysSt.C_LDCU_EVSysReadySt 0"); // 测试步骤 TC_CANTest SET C_LDCU_SysSt.C_LDCU_EVSysReadySt 0//ready
  g_EM_SOAClient_Swc_SOA_CHECK_Prepare("Veh_FrontMirrorHeatRespStruct.Veh_FrontMirrorHeatNRC 0"); // 预期结果 TC_CANTest SOA check Veh_FrontMirrorHeatRespStruct.Veh_FrontMirrorHeatNRC 0
  gTC_CANTest_SOA_CheckReq_Prepare("FrontMirrorHeatCmdStruct.FrontMirrorHeat 2"); // 预期结果 TC_CANTest SOA CheckReq FrontMirrorHeatCmdStruct.FrontMirrorHeat 2
  g_EM_SOAClient_Swc_SOA_CHECK_Prepare("Veh_FrontMirrorHeatService_ErrStruct.OpeNRC 0 delay6.8"); // 预期结果 TC_CANTest SOA check Veh_FrontMirrorHeatService_ErrStruct.OpeNRC 0 delay6.8 //
  g_EM_SOAClient_Swc_SOA_REQ("Veh_FrontMirrorHeatStruct.Veh_FrontMirrorHeat:2&ServiceExecuteFeedbackFlag:2"); // 测试步骤 TC_CANTest SOA REQ Veh_FrontMirrorHeatStruct.Veh_FrontMirrorHeat:2&ServiceExecuteFeedbackFlag:2 //Close
  g_EM_SOAClient_Swc_SOA_CHECK("Veh_FrontMirrorHeatRespStruct.Veh_FrontMirrorHeatNRC 0"); // 预期结果 TC_CANTest SOA check Veh_FrontMirrorHeatRespStruct.Veh_FrontMirrorHeatNRC 0
  gTC_CANTest_SOA_CheckReq("FrontMirrorHeatCmdStruct.FrontMirrorHeat 2"); // 预期结果 TC_CANTest SOA CheckReq FrontMirrorHeatCmdStruct.FrontMirrorHeat 2
  g_EM_SOAClient_Swc_SOA_CHECK("Veh_FrontMirrorHeatService_ErrStruct.OpeNRC 0 delay6.8"); // 预期结果 TC_CANTest SOA check Veh_FrontMirrorHeatService_ErrStruct.OpeNRC 0 delay6.8 //
}

testcase SYS_CDCU_bolijiare_0003()
{
  TestDescription("开启后除霜加热 Power=ON");
  teststep("warning","原始用例id为SYS-CDCU-玻璃加热-0003");
  g_CAN_Bus_Swc_Set("C_LDCU_SysSt.C_LDCU_EVSysReadySt 2"); // 测试步骤 TC_CANTest SET C_LDCU_SysSt.C_LDCU_EVSysReadySt 2//ready
  g_EM_SOAClient_Swc_SOA_CHECK_Prepare("Veh_RearMirrorHeatRespStruct.Veh_RearMirrorHeatNRC 0"); // 预期结果 TC_CANTest SOA check Veh_RearMirrorHeatRespStruct.Veh_RearMirrorHeatNRC 0
  gTC_CANTest_SOA_CheckReq_Prepare("RearMirrorHeatCmdStruct.RearMirrorHeat 1"); // 预期结果 TC_CANTest SOA CheckReq RearMirrorHeatCmdStruct.RearMirrorHeat 1
  g_EM_SOAClient_Swc_SOA_CHECK_Prepare("Veh_RearMirrorHeatService_ErrStruct.OpeNRC 0 delay6.8"); // 预期结果 TC_CANTest SOA check Veh_RearMirrorHeatService_ErrStruct.OpeNRC 0 delay6.8 //
  g_EM_SOAClient_Swc_SOA_REQ("Veh_RearMirrorHeatStruct.Veh_RearMirrorHeat:1&ServiceExecuteFeedbackFlag:2"); // 测试步骤 TC_CANTest SOA REQ Veh_RearMirrorHeatStruct.Veh_RearMirrorHeat:1&ServiceExecuteFeedbackFlag:2 //Open
  g_EM_SOAClient_Swc_SOA_CHECK("Veh_RearMirrorHeatRespStruct.Veh_RearMirrorHeatNRC 0"); // 预期结果 TC_CANTest SOA check Veh_RearMirrorHeatRespStruct.Veh_RearMirrorHeatNRC 0
  gTC_CANTest_SOA_CheckReq("RearMirrorHeatCmdStruct.RearMirrorHeat 1"); // 预期结果 TC_CANTest SOA CheckReq RearMirrorHeatCmdStruct.RearMirrorHeat 1
  g_EM_SOAClient_Swc_SOA_CHECK("Veh_RearMirrorHeatService_ErrStruct.OpeNRC 0 delay6.8"); // 预期结果 TC_CANTest SOA check Veh_RearMirrorHeatService_ErrStruct.OpeNRC 0 delay6.8 //
}

testcase SYS_CDCU_bolijiare_0004()
{
  TestDescription("关闭后除霜加热 Power=ON");
  teststep("warning","原始用例id为SYS-CDCU-玻璃加热-0004");
  g_CAN_Bus_Swc_Set("C_LDCU_SysSt.C_LDCU_EVSysReadySt 0"); // 测试步骤 TC_CANTest SET C_LDCU_SysSt.C_LDCU_EVSysReadySt 0//ready
  g_EM_SOAClient_Swc_SOA_CHECK_Prepare("Veh_RearMirrorHeatRespStruct.Veh_RearMirrorHeatNRC 0"); // 预期结果 TC_CANTest SOA check Veh_RearMirrorHeatRespStruct.Veh_RearMirrorHeatNRC 0
  gTC_CANTest_SOA_CheckReq_Prepare("RearMirrorHeatCmdStruct.RearMirrorHeat 2"); // 预期结果 TC_CANTest SOA CheckReq RearMirrorHeatCmdStruct.RearMirrorHeat 2
  g_EM_SOAClient_Swc_SOA_CHECK_Prepare("Veh_RearMirrorHeatService_ErrStruct.OpeNRC 0 delay6.8"); // 预期结果 TC_CANTest SOA check Veh_RearMirrorHeatService_ErrStruct.OpeNRC 0 delay6.8 //
  g_EM_SOAClient_Swc_SOA_REQ("Veh_RearMirrorHeatStruct.Veh_RearMirrorHeat:2&ServiceExecuteFeedbackFlag:2"); // 测试步骤 TC_CANTest SOA REQ Veh_RearMirrorHeatStruct.Veh_RearMirrorHeat:2&ServiceExecuteFeedbackFlag:2 //Close
  g_EM_SOAClient_Swc_SOA_CHECK("Veh_RearMirrorHeatRespStruct.Veh_RearMirrorHeatNRC 0"); // 预期结果 TC_CANTest SOA check Veh_RearMirrorHeatRespStruct.Veh_RearMirrorHeatNRC 0
  gTC_CANTest_SOA_CheckReq("RearMirrorHeatCmdStruct.RearMirrorHeat 2"); // 预期结果 TC_CANTest SOA CheckReq RearMirrorHeatCmdStruct.RearMirrorHeat 2
  g_EM_SOAClient_Swc_SOA_CHECK("Veh_RearMirrorHeatService_ErrStruct.OpeNRC 0 delay6.8"); // 预期结果 TC_CANTest SOA check Veh_RearMirrorHeatService_ErrStruct.OpeNRC 0 delay6.8 //
}

testcase SYS_CDCU_bolijiare_0005()
{
  TestDescription("开启后除霜加热 Power=ON");
  teststep("warning","原始用例id为SYS-CDCU-玻璃加热-0005");
  g_EM_Equipment_Swc_TC_PW("ON"); // 测试步骤 TC_PW ON
  g_CAN_Bus_Swc_AllCANDataDefaultAllCh(); // 测试步骤 TC_CANTest SET AllCANDataDefaultAllCh
  g_EM_Equipment_Swc_TC_IG("ON"); // 测试步骤 TC_IG ON
  g_CAN_Bus_Swc_Set("I_LDCU_BodySysSt1.I_LDCU_PowerMode 1"); // 测试步骤 TC_CANTest SET I_LDCU_BodySysSt1.I_LDCU_PowerMode 1
  gTC_CANTest_SOA_Set8001Delay("0"); // 测试步骤 TC_CANTest SOA Set8001Delay 0
  g_CAN_Bus_Swc_Set("C_LDCU_SysSt.C_LDCU_EVSysReadySt 0"); // 测试步骤 TC_CANTest SET C_LDCU_SysSt.C_LDCU_EVSysReadySt 0//ready
  g_EM_SOAClient_Swc_SOA_CHECK_Prepare("Veh_RearMirrorHeatRespStruct.Veh_RearMirrorHeatNRC 0"); // 预期结果 TC_CANTest SOA check Veh_RearMirrorHeatRespStruct.Veh_RearMirrorHeatNRC 0
  gTC_CANTest_SOA_CheckReq_Prepare("RearMirrorHeatCmdStruct.RearMirrorHeat 1"); // 预期结果 TC_CANTest SOA CheckReq RearMirrorHeatCmdStruct.RearMirrorHeat 1
  g_EM_SOAClient_Swc_SOA_CHECK_Prepare("Veh_RearMirrorHeatService_ErrStruct.OpeNRC 0 delay6.8"); // 预期结果 TC_CANTest SOA check Veh_RearMirrorHeatService_ErrStruct.OpeNRC 0 delay6.8 //
  g_EM_SOAClient_Swc_SOA_REQ("Veh_RearMirrorHeatStruct.Veh_RearMirrorHeat:1&ServiceExecuteFeedbackFlag:2"); // 测试步骤 TC_CANTest SOA REQ Veh_RearMirrorHeatStruct.Veh_RearMirrorHeat:1&ServiceExecuteFeedbackFlag:2 //Open
  g_EM_SOAClient_Swc_SOA_CHECK("Veh_RearMirrorHeatRespStruct.Veh_RearMirrorHeatNRC 0"); // 预期结果 TC_CANTest SOA check Veh_RearMirrorHeatRespStruct.Veh_RearMirrorHeatNRC 0
  gTC_CANTest_SOA_CheckReq("RearMirrorHeatCmdStruct.RearMirrorHeat 1"); // 预期结果 TC_CANTest SOA CheckReq RearMirrorHeatCmdStruct.RearMirrorHeat 1
  g_EM_SOAClient_Swc_SOA_CHECK("Veh_RearMirrorHeatService_ErrStruct.OpeNRC 0 delay6.8"); // 预期结果 TC_CANTest SOA check Veh_RearMirrorHeatService_ErrStruct.OpeNRC 0 delay6.8 //
}

testcase SYS_CDCU_bolijiare_0006()
{
  TestDescription("关闭后除霜加热 Power=ON");
  teststep("warning","原始用例id为SYS-CDCU-玻璃加热-0006");
  g_CAN_Bus_Swc_Set("C_LDCU_SysSt.C_LDCU_EVSysReadySt 0"); // 测试步骤 TC_CANTest SET C_LDCU_SysSt.C_LDCU_EVSysReadySt 0//ready
  g_EM_SOAClient_Swc_SOA_CHECK_Prepare("Veh_RearMirrorHeatRespStruct.Veh_RearMirrorHeatNRC 0"); // 预期结果 TC_CANTest SOA check Veh_RearMirrorHeatRespStruct.Veh_RearMirrorHeatNRC 0
  gTC_CANTest_SOA_CheckReq_Prepare("RearMirrorHeatCmdStruct.RearMirrorHeat 2"); // 预期结果 TC_CANTest SOA CheckReq RearMirrorHeatCmdStruct.RearMirrorHeat 2
  g_EM_SOAClient_Swc_SOA_CHECK_Prepare("Veh_RearMirrorHeatService_ErrStruct.OpeNRC 0 delay6.8"); // 预期结果 TC_CANTest SOA check Veh_RearMirrorHeatService_ErrStruct.OpeNRC 0 delay6.8 //
  g_EM_SOAClient_Swc_SOA_REQ("Veh_RearMirrorHeatStruct.Veh_RearMirrorHeat:2&ServiceExecuteFeedbackFlag:2"); // 测试步骤 TC_CANTest SOA REQ Veh_RearMirrorHeatStruct.Veh_RearMirrorHeat:2&ServiceExecuteFeedbackFlag:2 //Close
  g_EM_SOAClient_Swc_SOA_CHECK("Veh_RearMirrorHeatRespStruct.Veh_RearMirrorHeatNRC 0"); // 预期结果 TC_CANTest SOA check Veh_RearMirrorHeatRespStruct.Veh_RearMirrorHeatNRC 0
  gTC_CANTest_SOA_CheckReq("RearMirrorHeatCmdStruct.RearMirrorHeat 2"); // 预期结果 TC_CANTest SOA CheckReq RearMirrorHeatCmdStruct.RearMirrorHeat 2
  g_EM_SOAClient_Swc_SOA_CHECK("Veh_RearMirrorHeatService_ErrStruct.OpeNRC 0 delay6.8"); // 预期结果 TC_CANTest SOA check Veh_RearMirrorHeatService_ErrStruct.OpeNRC 0 delay6.8 //
}

testcase SYS_CDCU_bolijiare_0007()
{
  TestDescription("开启前挡风玻璃加热 Power=Remote ON");
  teststep("warning","原始用例id为SYS-CDCU-玻璃加热-0007");
  g_EM_Equipment_Swc_TC_IG("ON"); // 测试步骤 TC_IG ON
  g_CAN_Bus_Swc_Set("I_LDCU_BodySysSt1.I_LDCU_PowerMode 2"); // 测试步骤 TC_CANTest SET I_LDCU_BodySysSt1.I_LDCU_PowerMode 2
  g_CAN_Bus_Swc_Set("C_LDCU_SysSt.C_LDCU_EVSysReadySt 2"); // 测试步骤 TC_CANTest SET C_LDCU_SysSt.C_LDCU_EVSysReadySt 2//ready
  g_EM_SOAClient_Swc_SOA_CHECK_Prepare("Veh_FrontMirrorHeatRespStruct.Veh_FrontMirrorHeatNRC 0"); // 预期结果 TC_CANTest SOA check Veh_FrontMirrorHeatRespStruct.Veh_FrontMirrorHeatNRC 0
  gTC_CANTest_SOA_CheckReq_Prepare("FrontMirrorHeatCmdStruct.FrontMirrorHeat 1 traceback3"); // 预期结果 TC_CANTest SOA CheckReq FrontMirrorHeatCmdStruct.FrontMirrorHeat 1 traceback3
  g_EM_SOAClient_Swc_SOA_CHECK_Prepare("Veh_FrontMirrorHeatService_ErrStruct.OpeNRC 0 traceback3"); // 预期结果 TC_CANTest SOA check Veh_FrontMirrorHeatService_ErrStruct.OpeNRC 0 traceback3 //
  g_EM_SOAClient_Swc_SOA_CHECK_Prepare("Veh_FrontMirrorHeatService_ErrStruct.OpeErrInfo[0-1]:0x00C8 traceback3"); // 预期结果 TC_CANTest SOA check Veh_FrontMirrorHeatService_ErrStruct.OpeErrInfo[0-1]:0x00C8 traceback3 //远控类服务返回码，控制成功
  g_EM_SOAClient_Swc_SOA_CHECK_Prepare("SOAEngineInterSignalStruct.FrontMirrorHeatHVReq 1"); // 预期结果 TC_CANTest SOA check SOAEngineInterSignalStruct.FrontMirrorHeatHVReq 1//请求上高压
  g_EM_SOAClient_Swc_SOA_REQ("Veh_FrontMirrorHeatStruct.Veh_FrontMirrorHeat:1&ServiceExecuteFeedbackFlag:2&UserID:0x01010001&Time:1"); // 测试步骤 TC_CANTest SOA REQ Veh_FrontMirrorHeatStruct.Veh_FrontMirrorHeat:1&ServiceExecuteFeedbackFlag:2&UserID:0x01010001&Time:1 //Open
  g_EM_SOAClient_Swc_SOA_CHECK("Veh_FrontMirrorHeatRespStruct.Veh_FrontMirrorHeatNRC 0"); // 预期结果 TC_CANTest SOA check Veh_FrontMirrorHeatRespStruct.Veh_FrontMirrorHeatNRC 0
  gTC_CANTest_SOA_CheckReq("FrontMirrorHeatCmdStruct.FrontMirrorHeat 1 traceback3"); // 预期结果 TC_CANTest SOA CheckReq FrontMirrorHeatCmdStruct.FrontMirrorHeat 1 traceback3
  g_EM_SOAClient_Swc_SOA_CHECK("Veh_FrontMirrorHeatService_ErrStruct.OpeNRC 0 traceback3"); // 预期结果 TC_CANTest SOA check Veh_FrontMirrorHeatService_ErrStruct.OpeNRC 0 traceback3 //
  g_EM_SOAClient_Swc_SOA_CHECK("Veh_FrontMirrorHeatService_ErrStruct.OpeErrInfo[0-1]:0x00C8 traceback3"); // 预期结果 TC_CANTest SOA check Veh_FrontMirrorHeatService_ErrStruct.OpeErrInfo[0-1]:0x00C8 traceback3 //远控类服务返回码，控制成功
  g_EM_SOAClient_Swc_SOA_CHECK("SOAEngineInterSignalStruct.FrontMirrorHeatHVReq 1"); // 预期结果 TC_CANTest SOA check SOAEngineInterSignalStruct.FrontMirrorHeatHVReq 1//请求上高压
  g_EM_Equipment_Swc_TC_4G_Time_Delay_Second("60"); // 测试步骤 TC_Sleep 60
  gTC_CANTest_SOA_CheckReq_Prepare("HighVoltageCtrlStruct.HighVoltageCtrl 2 traceback60"); // 预期结果 TC_CANTest SOA CheckReq HighVoltageCtrlStruct.HighVoltageCtrl 2 traceback60//请求上高压
  gTC_CANTest_SOA_CheckReq("HighVoltageCtrlStruct.HighVoltageCtrl 2 traceback60"); // 预期结果 TC_CANTest SOA CheckReq HighVoltageCtrlStruct.HighVoltageCtrl 2 traceback60//请求上高压
}

testcase SYS_CDCU_bolijiare_0008()
{
  TestDescription("关闭前挡风玻璃加热 Power=Remote ON");
  teststep("warning","原始用例id为SYS-CDCU-玻璃加热-0008");
  g_EM_SOAClient_Swc_SOA_CHECK_Prepare("Veh_FrontMirrorHeatRespStruct.Veh_FrontMirrorHeatNRC 0"); // 预期结果 TC_CANTest SOA check Veh_FrontMirrorHeatRespStruct.Veh_FrontMirrorHeatNRC 0
  gTC_CANTest_SOA_CheckReq_Prepare("FrontMirrorHeatCmdStruct.FrontMirrorHeat 2"); // 预期结果 TC_CANTest SOA CheckReq FrontMirrorHeatCmdStruct.FrontMirrorHeat 2
  g_EM_SOAClient_Swc_SOA_CHECK_Prepare("Veh_FrontMirrorHeatService_ErrStruct.OpeNRC 0 delay6.8"); // 预期结果 TC_CANTest SOA check Veh_FrontMirrorHeatService_ErrStruct.OpeNRC 0 delay6.8 //
  g_EM_SOAClient_Swc_SOA_CHECK_Prepare("Veh_FrontMirrorHeatService_ErrStruct.OpeErrInfo[0-1]:0x00C8 traceback3"); // 预期结果 TC_CANTest SOA check Veh_FrontMirrorHeatService_ErrStruct.OpeErrInfo[0-1]:0x00C8 traceback3 //远控类服务返回码，控制成功
  g_EM_SOAClient_Swc_SOA_CHECK_Prepare("SOAEngineInterSignalStruct.FrontMirrorHeatHVReq 0"); // 预期结果 TC_CANTest SOA check SOAEngineInterSignalStruct.FrontMirrorHeatHVReq 0//请求下高压
  g_EM_SOAClient_Swc_SOA_REQ("Veh_FrontMirrorHeatStruct.Veh_FrontMirrorHeat:2&ServiceExecuteFeedbackFlag:2&UserID:0x01010001&Time:1"); // 测试步骤 TC_CANTest SOA REQ Veh_FrontMirrorHeatStruct.Veh_FrontMirrorHeat:2&ServiceExecuteFeedbackFlag:2&UserID:0x01010001&Time:1 //Close
  g_EM_SOAClient_Swc_SOA_CHECK("Veh_FrontMirrorHeatRespStruct.Veh_FrontMirrorHeatNRC 0"); // 预期结果 TC_CANTest SOA check Veh_FrontMirrorHeatRespStruct.Veh_FrontMirrorHeatNRC 0
  gTC_CANTest_SOA_CheckReq("FrontMirrorHeatCmdStruct.FrontMirrorHeat 2"); // 预期结果 TC_CANTest SOA CheckReq FrontMirrorHeatCmdStruct.FrontMirrorHeat 2
  g_EM_SOAClient_Swc_SOA_CHECK("Veh_FrontMirrorHeatService_ErrStruct.OpeNRC 0 delay6.8"); // 预期结果 TC_CANTest SOA check Veh_FrontMirrorHeatService_ErrStruct.OpeNRC 0 delay6.8 //
  g_EM_SOAClient_Swc_SOA_CHECK("Veh_FrontMirrorHeatService_ErrStruct.OpeErrInfo[0-1]:0x00C8 traceback3"); // 预期结果 TC_CANTest SOA check Veh_FrontMirrorHeatService_ErrStruct.OpeErrInfo[0-1]:0x00C8 traceback3 //远控类服务返回码，控制成功
  g_EM_SOAClient_Swc_SOA_CHECK("SOAEngineInterSignalStruct.FrontMirrorHeatHVReq 0"); // 预期结果 TC_CANTest SOA check SOAEngineInterSignalStruct.FrontMirrorHeatHVReq 0//请求下高压
}

testcase SYS_CDCU_bolijiare_0009()
{
  TestDescription("开启前挡风玻璃加热失败，赋0x2860 Power=Remote ON");
  teststep("warning","原始用例id为SYS-CDCU-玻璃加热-0009");
  g_EM_Equipment_Swc_TC_IG("ON"); // 测试步骤 TC_IG ON
  gTC_CANTest_SOA_Set8001Delay("20"); // 测试步骤 TC_CANTest SOA Set8001Delay 20
  g_CAN_Bus_Swc_Set("I_LDCU_BodySysSt1.I_LDCU_PowerMode 2"); // 测试步骤 TC_CANTest SET I_LDCU_BodySysSt1.I_LDCU_PowerMode 2
  g_CAN_Bus_Swc_Set("C_LDCU_SysSt.C_LDCU_EVSysReadySt 2"); // 测试步骤 TC_CANTest SET C_LDCU_SysSt.C_LDCU_EVSysReadySt 2//ready
  g_EM_SOAClient_Swc_SOA_CHECK_Prepare("Veh_FrontMirrorHeatRespStruct.Veh_FrontMirrorHeatNRC 0"); // 预期结果 TC_CANTest SOA check Veh_FrontMirrorHeatRespStruct.Veh_FrontMirrorHeatNRC 0
  g_EM_SOAClient_Swc_SOA_CHECK_Prepare("Veh_FrontMirrorHeatService_ErrStruct.OpeErrInfo[0-1]:0x2860 traceback3"); // 预期结果 TC_CANTest SOA check Veh_FrontMirrorHeatService_ErrStruct.OpeErrInfo[0-1]:0x2860 traceback3 //远控类服务返回码，控制成功
  g_EM_SOAClient_Swc_SOA_REQ("Veh_FrontMirrorHeatStruct.Veh_FrontMirrorHeat:1&ServiceExecuteFeedbackFlag:2&UserID:0x01010001&Time:1"); // 测试步骤 TC_CANTest SOA REQ Veh_FrontMirrorHeatStruct.Veh_FrontMirrorHeat:1&ServiceExecuteFeedbackFlag:2&UserID:0x01010001&Time:1 //Open
  g_EM_SOAClient_Swc_SOA_CHECK("Veh_FrontMirrorHeatRespStruct.Veh_FrontMirrorHeatNRC 0"); // 预期结果 TC_CANTest SOA check Veh_FrontMirrorHeatRespStruct.Veh_FrontMirrorHeatNRC 0
  g_EM_Equipment_Swc_TC_4G_Time_Delay_Second("15"); // 测试步骤 TC_Sleep 15
  g_EM_SOAClient_Swc_SOA_CHECK_Prepare("SOAEngineInterSignalStruct.FrontMirrorHeatHVReq 0"); // 预期结果 TC_CANTest SOA check SOAEngineInterSignalStruct.FrontMirrorHeatHVReq 0
  g_EM_SOAClient_Swc_SOA_CHECK("Veh_FrontMirrorHeatService_ErrStruct.OpeErrInfo[0-1]:0x2860 traceback3"); // 预期结果 TC_CANTest SOA check Veh_FrontMirrorHeatService_ErrStruct.OpeErrInfo[0-1]:0x2860 traceback3 //远控类服务返回码，控制成功
  g_EM_SOAClient_Swc_SOA_CHECK("SOAEngineInterSignalStruct.FrontMirrorHeatHVReq 0"); // 预期结果 TC_CANTest SOA check SOAEngineInterSignalStruct.FrontMirrorHeatHVReq 0
  gTC_CANTest_SOA_Set8001Delay("0"); // 测试步骤 TC_CANTest SOA Set8001Delay 0
}

testcase SYS_CDCU_bolijiare_0010()
{
  TestDescription("关闭前挡风玻璃加热失败，赋0x2861 Power=Remote ON");
  teststep("warning","原始用例id为SYS-CDCU-玻璃加热-0010");
  g_EM_Equipment_Swc_TC_IG("ON"); // 测试步骤 TC_IG ON
  gTC_CANTest_SOA_Set8001Delay("20"); // 测试步骤 TC_CANTest SOA Set8001Delay 20
  g_CAN_Bus_Swc_Set("I_LDCU_BodySysSt1.I_LDCU_PowerMode 2"); // 测试步骤 TC_CANTest SET I_LDCU_BodySysSt1.I_LDCU_PowerMode 2
  g_CAN_Bus_Swc_Set("C_LDCU_SysSt.C_LDCU_EVSysReadySt 2"); // 测试步骤 TC_CANTest SET C_LDCU_SysSt.C_LDCU_EVSysReadySt 2//ready
  g_EM_SOAClient_Swc_SOA_CHECK_Prepare("Veh_FrontMirrorHeatRespStruct.Veh_FrontMirrorHeatNRC 0"); // 预期结果 TC_CANTest SOA check Veh_FrontMirrorHeatRespStruct.Veh_FrontMirrorHeatNRC 0
  g_EM_SOAClient_Swc_SOA_CHECK_Prepare("Veh_FrontMirrorHeatService_ErrStruct.OpeErrInfo[0-1]:0x2861 traceback3"); // 预期结果 TC_CANTest SOA check Veh_FrontMirrorHeatService_ErrStruct.OpeErrInfo[0-1]:0x2861 traceback3 //远控类服务返回码，控制成功
  g_EM_SOAClient_Swc_SOA_REQ("Veh_FrontMirrorHeatStruct.Veh_FrontMirrorHeat:2&ServiceExecuteFeedbackFlag:2&UserID:0x01010001&Time:1"); // 测试步骤 TC_CANTest SOA REQ Veh_FrontMirrorHeatStruct.Veh_FrontMirrorHeat:2&ServiceExecuteFeedbackFlag:2&UserID:0x01010001&Time:1 //Close
  g_EM_SOAClient_Swc_SOA_CHECK("Veh_FrontMirrorHeatRespStruct.Veh_FrontMirrorHeatNRC 0"); // 预期结果 TC_CANTest SOA check Veh_FrontMirrorHeatRespStruct.Veh_FrontMirrorHeatNRC 0
  g_EM_Equipment_Swc_TC_4G_Time_Delay_Second("15"); // 测试步骤 TC_Sleep 15
  g_EM_SOAClient_Swc_SOA_CHECK_Prepare("SOAEngineInterSignalStruct.FrontMirrorHeatHVReq 0"); // 预期结果 TC_CANTest SOA check SOAEngineInterSignalStruct.FrontMirrorHeatHVReq 0
  g_EM_SOAClient_Swc_SOA_CHECK("Veh_FrontMirrorHeatService_ErrStruct.OpeErrInfo[0-1]:0x2861 traceback3"); // 预期结果 TC_CANTest SOA check Veh_FrontMirrorHeatService_ErrStruct.OpeErrInfo[0-1]:0x2861 traceback3 //远控类服务返回码，控制成功
  g_EM_SOAClient_Swc_SOA_CHECK("SOAEngineInterSignalStruct.FrontMirrorHeatHVReq 0"); // 预期结果 TC_CANTest SOA check SOAEngineInterSignalStruct.FrontMirrorHeatHVReq 0
  gTC_CANTest_SOA_Set8001Delay("0"); // 测试步骤 TC_CANTest SOA Set8001Delay 0
}

testcase SYS_CDCU_bolijiare_0011()
{
  TestDescription("开启后除霜加热 Power=Remote ON");
  teststep("warning","原始用例id为SYS-CDCU-玻璃加热-0011");
  g_EM_SOAClient_Swc_SOA_CHECK_Prepare("Veh_RearMirrorHeatRespStruct.Veh_RearMirrorHeatNRC 0"); // 预期结果 TC_CANTest SOA check Veh_RearMirrorHeatRespStruct.Veh_RearMirrorHeatNRC 0
  gTC_CANTest_SOA_CheckReq_Prepare("RearMirrorHeatCmdStruct.RearMirrorHeat 1"); // 预期结果 TC_CANTest SOA CheckReq RearMirrorHeatCmdStruct.RearMirrorHeat 1
  g_EM_SOAClient_Swc_SOA_CHECK_Prepare("Veh_RearMirrorHeatService_ErrStruct.OpeNRC 0 delay6.8"); // 预期结果 TC_CANTest SOA check Veh_RearMirrorHeatService_ErrStruct.OpeNRC 0 delay6.8 //
  g_EM_SOAClient_Swc_SOA_REQ("Veh_RearMirrorHeatStruct.Veh_RearMirrorHeat:1&ServiceExecuteFeedbackFlag:2&UserID:0x01010001&Time:1"); // 测试步骤 TC_CANTest SOA REQ Veh_RearMirrorHeatStruct.Veh_RearMirrorHeat:1&ServiceExecuteFeedbackFlag:2&UserID:0x01010001&Time:1 //Open
  g_EM_SOAClient_Swc_SOA_CHECK("Veh_RearMirrorHeatRespStruct.Veh_RearMirrorHeatNRC 0"); // 预期结果 TC_CANTest SOA check Veh_RearMirrorHeatRespStruct.Veh_RearMirrorHeatNRC 0
  gTC_CANTest_SOA_CheckReq("RearMirrorHeatCmdStruct.RearMirrorHeat 1"); // 预期结果 TC_CANTest SOA CheckReq RearMirrorHeatCmdStruct.RearMirrorHeat 1
  g_EM_SOAClient_Swc_SOA_CHECK("Veh_RearMirrorHeatService_ErrStruct.OpeNRC 0 delay6.8"); // 预期结果 TC_CANTest SOA check Veh_RearMirrorHeatService_ErrStruct.OpeNRC 0 delay6.8 //
}

testcase SYS_CDCU_bolijiare_0012()
{
  TestDescription("关闭后除霜加热 Power=Remote ON");
  teststep("warning","原始用例id为SYS-CDCU-玻璃加热-0012");
  g_EM_SOAClient_Swc_SOA_CHECK_Prepare("Veh_RearMirrorHeatRespStruct.Veh_RearMirrorHeatNRC 0"); // 预期结果 TC_CANTest SOA check Veh_RearMirrorHeatRespStruct.Veh_RearMirrorHeatNRC 0
  gTC_CANTest_SOA_CheckReq_Prepare("RearMirrorHeatCmdStruct.RearMirrorHeat 2"); // 预期结果 TC_CANTest SOA CheckReq RearMirrorHeatCmdStruct.RearMirrorHeat 2
  g_EM_SOAClient_Swc_SOA_CHECK_Prepare("Veh_RearMirrorHeatService_ErrStruct.OpeNRC 0 delay6.8"); // 预期结果 TC_CANTest SOA check Veh_RearMirrorHeatService_ErrStruct.OpeNRC 0 delay6.8 //
  g_EM_SOAClient_Swc_SOA_REQ("Veh_RearMirrorHeatStruct.Veh_RearMirrorHeat:2&ServiceExecuteFeedbackFlag:2&UserID:0x01010001&Time:1"); // 测试步骤 TC_CANTest SOA REQ Veh_RearMirrorHeatStruct.Veh_RearMirrorHeat:2&ServiceExecuteFeedbackFlag:2&UserID:0x01010001&Time:1 //Close
  g_EM_SOAClient_Swc_SOA_CHECK("Veh_RearMirrorHeatRespStruct.Veh_RearMirrorHeatNRC 0"); // 预期结果 TC_CANTest SOA check Veh_RearMirrorHeatRespStruct.Veh_RearMirrorHeatNRC 0
  gTC_CANTest_SOA_CheckReq("RearMirrorHeatCmdStruct.RearMirrorHeat 2"); // 预期结果 TC_CANTest SOA CheckReq RearMirrorHeatCmdStruct.RearMirrorHeat 2
  g_EM_SOAClient_Swc_SOA_CHECK("Veh_RearMirrorHeatService_ErrStruct.OpeNRC 0 delay6.8"); // 预期结果 TC_CANTest SOA check Veh_RearMirrorHeatService_ErrStruct.OpeNRC 0 delay6.8 //
}

testcase SYS_CDCU_bolijiare_0013()
{
  TestDescription("开启后除霜加热 Power=Remote ON");
  teststep("warning","原始用例id为SYS-CDCU-玻璃加热-0013");
  g_EM_Equipment_Swc_TC_IG("ON"); // 测试步骤 TC_IG ON
  gTC_CANTest_SOA_Set8001Delay("0"); // 测试步骤 TC_CANTest SOA Set8001Delay 0
  g_CAN_Bus_Swc_Set("I_LDCU_BodySysSt1.I_LDCU_PowerMode 2"); // 测试步骤 TC_CANTest SET I_LDCU_BodySysSt1.I_LDCU_PowerMode 2
  g_CAN_Bus_Swc_Set("C_LDCU_SysSt.C_LDCU_EVSysReadySt 0"); // 测试步骤 TC_CANTest SET C_LDCU_SysSt.C_LDCU_EVSysReadySt 0
  g_EM_SOAClient_Swc_SOA_CHECK_Prepare("Veh_RearMirrorHeatRespStruct.Veh_RearMirrorHeatNRC 0"); // 预期结果 TC_CANTest SOA check Veh_RearMirrorHeatRespStruct.Veh_RearMirrorHeatNRC 0
  gTC_CANTest_SOA_CheckReq_Prepare("RearMirrorHeatCmdStruct.RearMirrorHeat 1"); // 预期结果 TC_CANTest SOA CheckReq RearMirrorHeatCmdStruct.RearMirrorHeat 1
  g_EM_SOAClient_Swc_SOA_CHECK_Prepare("Veh_RearMirrorHeatService_ErrStruct.OpeNRC 0 delay6.8"); // 预期结果 TC_CANTest SOA check Veh_RearMirrorHeatService_ErrStruct.OpeNRC 0 delay6.8 //
  g_EM_SOAClient_Swc_SOA_REQ("Veh_RearMirrorHeatStruct.Veh_RearMirrorHeat:1&ServiceExecuteFeedbackFlag:2&UserID:0x01010001&Time:1"); // 测试步骤 TC_CANTest SOA REQ Veh_RearMirrorHeatStruct.Veh_RearMirrorHeat:1&ServiceExecuteFeedbackFlag:2&UserID:0x01010001&Time:1 //Open
  g_EM_SOAClient_Swc_SOA_CHECK("Veh_RearMirrorHeatRespStruct.Veh_RearMirrorHeatNRC 0"); // 预期结果 TC_CANTest SOA check Veh_RearMirrorHeatRespStruct.Veh_RearMirrorHeatNRC 0
  gTC_CANTest_SOA_CheckReq("RearMirrorHeatCmdStruct.RearMirrorHeat 1"); // 预期结果 TC_CANTest SOA CheckReq RearMirrorHeatCmdStruct.RearMirrorHeat 1
  g_EM_SOAClient_Swc_SOA_CHECK("Veh_RearMirrorHeatService_ErrStruct.OpeNRC 0 delay6.8"); // 预期结果 TC_CANTest SOA check Veh_RearMirrorHeatService_ErrStruct.OpeNRC 0 delay6.8 //
}

testcase SYS_CDCU_bolijiare_0014()
{
  TestDescription("关闭后除霜加热 Power=Remote ON");
  teststep("warning","原始用例id为SYS-CDCU-玻璃加热-0014");
  g_CAN_Bus_Swc_Set("C_LDCU_SysSt.C_LDCU_EVSysReadySt 0"); // 测试步骤 TC_CANTest SET C_LDCU_SysSt.C_LDCU_EVSysReadySt 0
  g_EM_SOAClient_Swc_SOA_CHECK_Prepare("Veh_RearMirrorHeatRespStruct.Veh_RearMirrorHeatNRC 0"); // 预期结果 TC_CANTest SOA check Veh_RearMirrorHeatRespStruct.Veh_RearMirrorHeatNRC 0
  gTC_CANTest_SOA_CheckReq_Prepare("RearMirrorHeatCmdStruct.RearMirrorHeat 2"); // 预期结果 TC_CANTest SOA CheckReq RearMirrorHeatCmdStruct.RearMirrorHeat 2
  g_EM_SOAClient_Swc_SOA_CHECK_Prepare("Veh_RearMirrorHeatService_ErrStruct.OpeNRC 0 delay6.8"); // 预期结果 TC_CANTest SOA check Veh_RearMirrorHeatService_ErrStruct.OpeNRC 0 delay6.8 //
  g_EM_SOAClient_Swc_SOA_REQ("Veh_RearMirrorHeatStruct.Veh_RearMirrorHeat:2&ServiceExecuteFeedbackFlag:2&UserID:0x01010001&Time:1"); // 测试步骤 TC_CANTest SOA REQ Veh_RearMirrorHeatStruct.Veh_RearMirrorHeat:2&ServiceExecuteFeedbackFlag:2&UserID:0x01010001&Time:1 //Close
  g_EM_SOAClient_Swc_SOA_CHECK("Veh_RearMirrorHeatRespStruct.Veh_RearMirrorHeatNRC 0"); // 预期结果 TC_CANTest SOA check Veh_RearMirrorHeatRespStruct.Veh_RearMirrorHeatNRC 0
  gTC_CANTest_SOA_CheckReq("RearMirrorHeatCmdStruct.RearMirrorHeat 2"); // 预期结果 TC_CANTest SOA CheckReq RearMirrorHeatCmdStruct.RearMirrorHeat 2
  g_EM_SOAClient_Swc_SOA_CHECK("Veh_RearMirrorHeatService_ErrStruct.OpeNRC 0 delay6.8"); // 预期结果 TC_CANTest SOA check Veh_RearMirrorHeatService_ErrStruct.OpeNRC 0 delay6.8 //
}

testcase SYS_CDCU_bolijiare_0015()
{
  TestDescription("开启前挡风玻璃加热 Power=OFF");
  teststep("warning","原始用例id为SYS-CDCU-玻璃加热-0015");
  g_EM_Equipment_Swc_TC_IG("OFF"); // 测试步骤 TC_IG OFF
  g_CAN_Bus_Swc_Set("I_LDCU_BodySysSt1.I_LDCU_PowerMode 0"); // 测试步骤 TC_CANTest SET I_LDCU_BodySysSt1.I_LDCU_PowerMode 0
  g_CAN_Bus_Swc_Set("I_LDCU_NM.I_LDCU_NMRepeatMsgReqBit 1"); // 测试步骤 TC_CANTest SET I_LDCU_NM.I_LDCU_NMRepeatMsgReqBit 1 //网络唤醒维持帧
  g_EM_SOAClient_Swc_SOA_CHECK_Prepare("Veh_FrontMirrorHeatRespStruct.Veh_FrontMirrorHeatNRC 0"); // 预期结果 TC_CANTest SOA check Veh_FrontMirrorHeatRespStruct.Veh_FrontMirrorHeatNRC 0
  gTC_CANTest_SOA_CheckReq_Prepare("FrontMirrorHeatCmdStruct.FrontMirrorHeat 1"); // 预期结果 TC_CANTest SOA CheckReq FrontMirrorHeatCmdStruct.FrontMirrorHeat 1
  g_EM_SOAClient_Swc_SOA_CHECK_Prepare("Veh_FrontMirrorHeatService_ErrStruct.OpeNRC 0 delay6.8"); // 预期结果 TC_CANTest SOA check Veh_FrontMirrorHeatService_ErrStruct.OpeNRC 0 delay6.8 //
  g_EM_SOAClient_Swc_SOA_REQ("Veh_FrontMirrorHeatStruct.Veh_FrontMirrorHeat:1&ServiceExecuteFeedbackFlag:2&UserID:0x01010001&Time:1"); // 测试步骤 TC_CANTest SOA REQ Veh_FrontMirrorHeatStruct.Veh_FrontMirrorHeat:1&ServiceExecuteFeedbackFlag:2&UserID:0x01010001&Time:1 //Open
  g_EM_SOAClient_Swc_SOA_CHECK("Veh_FrontMirrorHeatRespStruct.Veh_FrontMirrorHeatNRC 0"); // 预期结果 TC_CANTest SOA check Veh_FrontMirrorHeatRespStruct.Veh_FrontMirrorHeatNRC 0
  gTC_CANTest_SOA_CheckReq("FrontMirrorHeatCmdStruct.FrontMirrorHeat 1"); // 预期结果 TC_CANTest SOA CheckReq FrontMirrorHeatCmdStruct.FrontMirrorHeat 1
  g_EM_SOAClient_Swc_SOA_CHECK("Veh_FrontMirrorHeatService_ErrStruct.OpeNRC 0 delay6.8"); // 预期结果 TC_CANTest SOA check Veh_FrontMirrorHeatService_ErrStruct.OpeNRC 0 delay6.8 //
}

testcase SYS_CDCU_bolijiare_0016()
{
  TestDescription("关闭前挡风玻璃加热 Power=OFF");
  teststep("warning","原始用例id为SYS-CDCU-玻璃加热-0016");
  g_EM_SOAClient_Swc_SOA_CHECK_Prepare("Veh_FrontMirrorHeatRespStruct.Veh_FrontMirrorHeatNRC 0"); // 预期结果 TC_CANTest SOA check Veh_FrontMirrorHeatRespStruct.Veh_FrontMirrorHeatNRC 0
  gTC_CANTest_SOA_CheckReq_Prepare("FrontMirrorHeatCmdStruct.FrontMirrorHeat 2"); // 预期结果 TC_CANTest SOA CheckReq FrontMirrorHeatCmdStruct.FrontMirrorHeat 2
  g_EM_SOAClient_Swc_SOA_CHECK_Prepare("Veh_FrontMirrorHeatService_ErrStruct.OpeNRC 0 delay6.8"); // 预期结果 TC_CANTest SOA check Veh_FrontMirrorHeatService_ErrStruct.OpeNRC 0 delay6.8 //
  g_EM_SOAClient_Swc_SOA_REQ("Veh_FrontMirrorHeatStruct.Veh_FrontMirrorHeat:2&ServiceExecuteFeedbackFlag:2&UserID:0x01010001&Time:1"); // 测试步骤 TC_CANTest SOA REQ Veh_FrontMirrorHeatStruct.Veh_FrontMirrorHeat:2&ServiceExecuteFeedbackFlag:2&UserID:0x01010001&Time:1 //Close
  g_EM_SOAClient_Swc_SOA_CHECK("Veh_FrontMirrorHeatRespStruct.Veh_FrontMirrorHeatNRC 0"); // 预期结果 TC_CANTest SOA check Veh_FrontMirrorHeatRespStruct.Veh_FrontMirrorHeatNRC 0
  gTC_CANTest_SOA_CheckReq("FrontMirrorHeatCmdStruct.FrontMirrorHeat 2"); // 预期结果 TC_CANTest SOA CheckReq FrontMirrorHeatCmdStruct.FrontMirrorHeat 2
  g_EM_SOAClient_Swc_SOA_CHECK("Veh_FrontMirrorHeatService_ErrStruct.OpeNRC 0 delay6.8"); // 预期结果 TC_CANTest SOA check Veh_FrontMirrorHeatService_ErrStruct.OpeNRC 0 delay6.8 //
}

testcase SYS_CDCU_bolijiare_0017()
{
  TestDescription("开启后除霜加热 Power=OFF");
  teststep("warning","原始用例id为SYS-CDCU-玻璃加热-0017");
  g_EM_SOAClient_Swc_SOA_CHECK_Prepare("Veh_RearMirrorHeatRespStruct.Veh_RearMirrorHeatNRC 0"); // 预期结果 TC_CANTest SOA check Veh_RearMirrorHeatRespStruct.Veh_RearMirrorHeatNRC 0
  gTC_CANTest_SOA_CheckReq_Prepare("RearMirrorHeatCmdStruct.RearMirrorHeat 1"); // 预期结果 TC_CANTest SOA CheckReq RearMirrorHeatCmdStruct.RearMirrorHeat 1
  g_EM_SOAClient_Swc_SOA_CHECK_Prepare("Veh_RearMirrorHeatService_ErrStruct.OpeNRC 0 delay6.8"); // 预期结果 TC_CANTest SOA check Veh_RearMirrorHeatService_ErrStruct.OpeNRC 0 delay6.8 //
  g_EM_SOAClient_Swc_SOA_REQ("Veh_RearMirrorHeatStruct.Veh_RearMirrorHeat:1&ServiceExecuteFeedbackFlag:2&UserID:0x01010001&Time:1"); // 测试步骤 TC_CANTest SOA REQ Veh_RearMirrorHeatStruct.Veh_RearMirrorHeat:1&ServiceExecuteFeedbackFlag:2&UserID:0x01010001&Time:1 //Open
  g_EM_SOAClient_Swc_SOA_CHECK("Veh_RearMirrorHeatRespStruct.Veh_RearMirrorHeatNRC 0"); // 预期结果 TC_CANTest SOA check Veh_RearMirrorHeatRespStruct.Veh_RearMirrorHeatNRC 0
  gTC_CANTest_SOA_CheckReq("RearMirrorHeatCmdStruct.RearMirrorHeat 1"); // 预期结果 TC_CANTest SOA CheckReq RearMirrorHeatCmdStruct.RearMirrorHeat 1
  g_EM_SOAClient_Swc_SOA_CHECK("Veh_RearMirrorHeatService_ErrStruct.OpeNRC 0 delay6.8"); // 预期结果 TC_CANTest SOA check Veh_RearMirrorHeatService_ErrStruct.OpeNRC 0 delay6.8 //
}

testcase SYS_CDCU_bolijiare_0018()
{
  TestDescription("关闭后除霜加热 Power=OFF");
  teststep("warning","原始用例id为SYS-CDCU-玻璃加热-0018");
  g_EM_SOAClient_Swc_SOA_CHECK_Prepare("Veh_RearMirrorHeatRespStruct.Veh_RearMirrorHeatNRC 0"); // 预期结果 TC_CANTest SOA check Veh_RearMirrorHeatRespStruct.Veh_RearMirrorHeatNRC 0
  gTC_CANTest_SOA_CheckReq_Prepare("RearMirrorHeatCmdStruct.RearMirrorHeat 2"); // 预期结果 TC_CANTest SOA CheckReq RearMirrorHeatCmdStruct.RearMirrorHeat 2
  g_EM_SOAClient_Swc_SOA_CHECK_Prepare("Veh_RearMirrorHeatService_ErrStruct.OpeNRC 0 delay6.8"); // 预期结果 TC_CANTest SOA check Veh_RearMirrorHeatService_ErrStruct.OpeNRC 0 delay6.8 //
  g_EM_SOAClient_Swc_SOA_REQ("Veh_RearMirrorHeatStruct.Veh_RearMirrorHeat:2&ServiceExecuteFeedbackFlag:2&UserID:0x01010001&Time:1"); // 测试步骤 TC_CANTest SOA REQ Veh_RearMirrorHeatStruct.Veh_RearMirrorHeat:2&ServiceExecuteFeedbackFlag:2&UserID:0x01010001&Time:1 //Close
  g_EM_SOAClient_Swc_SOA_CHECK("Veh_RearMirrorHeatRespStruct.Veh_RearMirrorHeatNRC 0"); // 预期结果 TC_CANTest SOA check Veh_RearMirrorHeatRespStruct.Veh_RearMirrorHeatNRC 0
  gTC_CANTest_SOA_CheckReq("RearMirrorHeatCmdStruct.RearMirrorHeat 2"); // 预期结果 TC_CANTest SOA CheckReq RearMirrorHeatCmdStruct.RearMirrorHeat 2
  g_EM_SOAClient_Swc_SOA_CHECK("Veh_RearMirrorHeatService_ErrStruct.OpeNRC 0 delay6.8"); // 预期结果 TC_CANTest SOA check Veh_RearMirrorHeatService_ErrStruct.OpeNRC 0 delay6.8 //
}

testcase SYS_CDCU_bolijiare_0019()
{
  TestDescription("开启后除霜加热 Power=OFF");
  teststep("warning","原始用例id为SYS-CDCU-玻璃加热-0019");
  g_EM_Equipment_Swc_TC_IG("OFF"); // 测试步骤 TC_IG OFF
  g_CAN_Bus_Swc_Set("I_LDCU_BodySysSt1.I_LDCU_PowerMode 0"); // 测试步骤 TC_CANTest SET I_LDCU_BodySysSt1.I_LDCU_PowerMode 0
  g_CAN_Bus_Swc_Set("I_LDCU_NM.I_LDCU_NMRepeatMsgReqBit 1"); // 测试步骤 TC_CANTest SET I_LDCU_NM.I_LDCU_NMRepeatMsgReqBit 1 //网络唤醒维持帧
  g_CAN_Bus_Swc_Set("C_LDCU_SysSt.C_LDCU_EVSysReadySt 0"); // 测试步骤 TC_CANTest SET C_LDCU_SysSt.C_LDCU_EVSysReadySt 0
  g_EM_SOAClient_Swc_SOA_CHECK_Prepare("Veh_RearMirrorHeatRespStruct.Veh_RearMirrorHeatNRC 0"); // 预期结果 TC_CANTest SOA check Veh_RearMirrorHeatRespStruct.Veh_RearMirrorHeatNRC 0
  gTC_CANTest_SOA_CheckReq_Prepare("RearMirrorHeatCmdStruct.RearMirrorHeat 1"); // 预期结果 TC_CANTest SOA CheckReq RearMirrorHeatCmdStruct.RearMirrorHeat 1
  g_EM_SOAClient_Swc_SOA_CHECK_Prepare("Veh_RearMirrorHeatService_ErrStruct.OpeNRC 0 delay6.8"); // 预期结果 TC_CANTest SOA check Veh_RearMirrorHeatService_ErrStruct.OpeNRC 0 delay6.8 //
  g_EM_SOAClient_Swc_SOA_REQ("Veh_RearMirrorHeatStruct.Veh_RearMirrorHeat:1&ServiceExecuteFeedbackFlag:2&UserID:0x01010001&Time:1"); // 测试步骤 TC_CANTest SOA REQ Veh_RearMirrorHeatStruct.Veh_RearMirrorHeat:1&ServiceExecuteFeedbackFlag:2&UserID:0x01010001&Time:1 //Open
  g_EM_SOAClient_Swc_SOA_CHECK("Veh_RearMirrorHeatRespStruct.Veh_RearMirrorHeatNRC 0"); // 预期结果 TC_CANTest SOA check Veh_RearMirrorHeatRespStruct.Veh_RearMirrorHeatNRC 0
  gTC_CANTest_SOA_CheckReq("RearMirrorHeatCmdStruct.RearMirrorHeat 1"); // 预期结果 TC_CANTest SOA CheckReq RearMirrorHeatCmdStruct.RearMirrorHeat 1
  g_EM_SOAClient_Swc_SOA_CHECK("Veh_RearMirrorHeatService_ErrStruct.OpeNRC 0 delay6.8"); // 预期结果 TC_CANTest SOA check Veh_RearMirrorHeatService_ErrStruct.OpeNRC 0 delay6.8 //
}

testcase SYS_CDCU_bolijiare_0020()
{
  TestDescription("关闭后除霜加热 Power=OFF");
  teststep("warning","原始用例id为SYS-CDCU-玻璃加热-0020");
  g_CAN_Bus_Swc_Set("C_LDCU_SysSt.C_LDCU_EVSysReadySt 0"); // 测试步骤 TC_CANTest SET C_LDCU_SysSt.C_LDCU_EVSysReadySt 0
  g_EM_SOAClient_Swc_SOA_CHECK_Prepare("Veh_RearMirrorHeatRespStruct.Veh_RearMirrorHeatNRC 0"); // 预期结果 TC_CANTest SOA check Veh_RearMirrorHeatRespStruct.Veh_RearMirrorHeatNRC 0
  gTC_CANTest_SOA_CheckReq_Prepare("RearMirrorHeatCmdStruct.RearMirrorHeat 2"); // 预期结果 TC_CANTest SOA CheckReq RearMirrorHeatCmdStruct.RearMirrorHeat 2
  g_EM_SOAClient_Swc_SOA_CHECK_Prepare("Veh_RearMirrorHeatService_ErrStruct.OpeNRC 0 delay6.8"); // 预期结果 TC_CANTest SOA check Veh_RearMirrorHeatService_ErrStruct.OpeNRC 0 delay6.8 //
  g_EM_SOAClient_Swc_SOA_REQ("Veh_RearMirrorHeatStruct.Veh_RearMirrorHeat:2&ServiceExecuteFeedbackFlag:2&UserID:0x01010001&Time:1"); // 测试步骤 TC_CANTest SOA REQ Veh_RearMirrorHeatStruct.Veh_RearMirrorHeat:2&ServiceExecuteFeedbackFlag:2&UserID:0x01010001&Time:1 //Close
  g_EM_SOAClient_Swc_SOA_CHECK("Veh_RearMirrorHeatRespStruct.Veh_RearMirrorHeatNRC 0"); // 预期结果 TC_CANTest SOA check Veh_RearMirrorHeatRespStruct.Veh_RearMirrorHeatNRC 0
  gTC_CANTest_SOA_CheckReq("RearMirrorHeatCmdStruct.RearMirrorHeat 2"); // 预期结果 TC_CANTest SOA CheckReq RearMirrorHeatCmdStruct.RearMirrorHeat 2
  g_EM_SOAClient_Swc_SOA_CHECK("Veh_RearMirrorHeatService_ErrStruct.OpeNRC 0 delay6.8"); // 预期结果 TC_CANTest SOA check Veh_RearMirrorHeatService_ErrStruct.OpeNRC 0 delay6.8 //
}
