/*@!Encoding: 936*/

includes
{
}

variables
{
}

testcase SYS_CDCU_jichufuwu_0001()
{
  TestDescription("基础服务-1");
  teststep("warning","原始用例id为SYS-CDCU-基础服务-0001");
  g_EM_Equipment_Swc_TC_PW("ON"); // 测试步骤 TC_PW ON
  g_EM_Equipment_Swc_TC_IG("ON"); // 测试步骤 TC_IG ON
  gTC_CANTest_SOA_Set8001Delay("0"); // 测试步骤 TC_CANTest SOA Set8001Delay 0
  g_EM_SOAClient_Swc_SOA_SubPeriod("Veh_BodySt 1"); // 测试步骤 TC_CANTest SOA SubPeriod Veh_BodySt 1
  g_CAN_Bus_Swc_Set("I_LDCU_BodySysSt1.I_LDCU_PowerMode 0"); // 测试步骤 TC_CANTest SET I_LDCU_BodySysSt1.I_LDCU_PowerMode 0
  g_EM_Equipment_Swc_TC_4G_Time_Delay_Second("1.5"); // 测试步骤 TC_Sleep 1.5
  g_EM_SOAClient_Swc_SOA_CHECK_Prepare("Veh_BodySts_PwrStruct.Veh_PowerMode 0"); // 预期结果 TC_CANTest SOA check Veh_BodySts_PwrStruct.Veh_PowerMode 0
  g_EM_SOAClient_Swc_SOA_CHECK("Veh_BodySts_PwrStruct.Veh_PowerMode 0"); // 预期结果 TC_CANTest SOA check Veh_BodySts_PwrStruct.Veh_PowerMode 0
}

testcase SYS_CDCU_jichufuwu_0002()
{
  TestDescription("基础服务-2");
  teststep("warning","原始用例id为SYS-CDCU-基础服务-0002");
  g_CAN_Bus_Swc_Set("I_LDCU_BodySysSt1.I_LDCU_PowerMode 1"); // 测试步骤 TC_CANTest SET I_LDCU_BodySysSt1.I_LDCU_PowerMode 1
  g_EM_Equipment_Swc_TC_4G_Time_Delay_Second("1.5"); // 测试步骤 TC_Sleep 1.5
  g_EM_SOAClient_Swc_SOA_CHECK_Prepare("Veh_BodySts_PwrStruct.Veh_PowerMode 1"); // 预期结果 TC_CANTest SOA check Veh_BodySts_PwrStruct.Veh_PowerMode 1
  g_EM_SOAClient_Swc_SOA_CHECK("Veh_BodySts_PwrStruct.Veh_PowerMode 1"); // 预期结果 TC_CANTest SOA check Veh_BodySts_PwrStruct.Veh_PowerMode 1
}

testcase SYS_CDCU_jichufuwu_0003()
{
  TestDescription("基础服务-3");
  teststep("warning","原始用例id为SYS-CDCU-基础服务-0003");
  g_EM_SOAClient_Swc_SOA_CHECK_Prepare("Veh_WindowService_ErrStruct.OpeErrInfo[0-1]:0x9 traceback3"); // 预期结果 TC_CANTest SOA check Veh_WindowService_ErrStruct.OpeErrInfo[0-1]:0x9 traceback3
  g_EM_SOAClient_Swc_SOA_CHECK_Prepare("Veh_BodySts_PwrStruct.Veh_PowerMode 2"); // 预期结果 TC_CANTest SOA check Veh_BodySts_PwrStruct.Veh_PowerMode 2
  g_CAN_Bus_Swc_Set("I_LDCU_BodySysSt1.I_LDCU_PowerMode 2"); // 测试步骤 TC_CANTest SET I_LDCU_BodySysSt1.I_LDCU_PowerMode 2
  g_EM_SOAClient_Swc_SOA_CHECK("Veh_WindowService_ErrStruct.OpeErrInfo[0-1]:0x9 traceback3"); // 预期结果 TC_CANTest SOA check Veh_WindowService_ErrStruct.OpeErrInfo[0-1]:0x9 traceback3
  g_EM_SOAClient_Swc_SOA_CHECK("Veh_BodySts_PwrStruct.Veh_PowerMode 2"); // 预期结果 TC_CANTest SOA check Veh_BodySts_PwrStruct.Veh_PowerMode 2
}

testcase SYS_CDCU_jichufuwu_0004()
{
  TestDescription("基础服务-4");
  teststep("warning","原始用例id为SYS-CDCU-基础服务-0004");
  g_CAN_Bus_Swc_Set("I_LDCU_BodySysSt1.I_LDCU_PowerMode 3"); // 测试步骤 TC_CANTest SET I_LDCU_BodySysSt1.I_LDCU_PowerMode 3
  g_EM_Equipment_Swc_TC_4G_Time_Delay_Second("1.5"); // 测试步骤 TC_Sleep 1.5
  g_EM_SOAClient_Swc_SOA_CHECK_Prepare("Veh_BodySts_PwrStruct.Veh_PowerMode 3"); // 预期结果 TC_CANTest SOA check Veh_BodySts_PwrStruct.Veh_PowerMode 3
  g_EM_SOAClient_Swc_SOA_CHECK("Veh_BodySts_PwrStruct.Veh_PowerMode 3"); // 预期结果 TC_CANTest SOA check Veh_BodySts_PwrStruct.Veh_PowerMode 3
}

testcase SYS_CDCU_jichufuwu_0005()
{
  TestDescription("基础服务-5");
  teststep("warning","原始用例id为SYS-CDCU-基础服务-0005");
  g_CAN_Bus_Swc_Set("I_LDCU_BodySysSt1.I_LDCU_PowerMode 1"); // 测试步骤 TC_CANTest SET I_LDCU_BodySysSt1.I_LDCU_PowerMode 1
  g_EM_Equipment_Swc_TC_4G_Time_Delay_Second("1.5"); // 测试步骤 TC_Sleep 1.5
  g_EM_SOAClient_Swc_SOA_CHECK_Prepare("Veh_BodySts_PwrStruct.Veh_PowerMode 1"); // 预期结果 TC_CANTest SOA check Veh_BodySts_PwrStruct.Veh_PowerMode 1
  g_EM_SOAClient_Swc_SOA_CHECK("Veh_BodySts_PwrStruct.Veh_PowerMode 1"); // 预期结果 TC_CANTest SOA check Veh_BodySts_PwrStruct.Veh_PowerMode 1
}

testcase SYS_CDCU_jichufuwu_0006()
{
  TestDescription("基础服务-6");
  teststep("warning","原始用例id为SYS-CDCU-基础服务-0006");
  g_EM_SOAClient_Swc_SOA_CHECK_Prepare("Veh_BodySts_PwrStruct.Veh_EVSysReadySt 0"); // 预期结果 TC_CANTest SOA check Veh_BodySts_PwrStruct.Veh_EVSysReadySt 0
  g_CAN_Bus_Swc_Set("C_LDCU_SysSt.C_LDCU_EVSysReadySt 0"); // 测试步骤 TC_CANTest SET C_LDCU_SysSt.C_LDCU_EVSysReadySt 0
  g_EM_SOAClient_Swc_SOA_CHECK("Veh_BodySts_PwrStruct.Veh_EVSysReadySt 0"); // 预期结果 TC_CANTest SOA check Veh_BodySts_PwrStruct.Veh_EVSysReadySt 0
}

testcase SYS_CDCU_jichufuwu_0007()
{
  TestDescription("基础服务-7");
  teststep("warning","原始用例id为SYS-CDCU-基础服务-0007");
  g_CAN_Bus_Swc_Set("C_LDCU_SysSt.C_LDCU_EVSysReadySt 1"); // 测试步骤 TC_CANTest SET C_LDCU_SysSt.C_LDCU_EVSysReadySt 1
  g_EM_Equipment_Swc_TC_4G_Time_Delay_Second("1.5"); // 测试步骤 TC_Sleep 1.5
  g_EM_SOAClient_Swc_SOA_CHECK_Prepare("Veh_BodySts_PwrStruct.Veh_EVSysReadySt 1"); // 预期结果 TC_CANTest SOA check Veh_BodySts_PwrStruct.Veh_EVSysReadySt 1
  g_EM_SOAClient_Swc_SOA_CHECK("Veh_BodySts_PwrStruct.Veh_EVSysReadySt 1"); // 预期结果 TC_CANTest SOA check Veh_BodySts_PwrStruct.Veh_EVSysReadySt 1
}

testcase SYS_CDCU_jichufuwu_0008()
{
  TestDescription("基础服务-8");
  teststep("warning","原始用例id为SYS-CDCU-基础服务-0008");
  g_CAN_Bus_Swc_Set("C_LDCU_SysSt.C_LDCU_EVSysReadySt 2"); // 测试步骤 TC_CANTest SET C_LDCU_SysSt.C_LDCU_EVSysReadySt 2
  g_EM_Equipment_Swc_TC_4G_Time_Delay_Second("1.5"); // 测试步骤 TC_Sleep 1.5
  g_EM_SOAClient_Swc_SOA_CHECK_Prepare("Veh_BodySts_PwrStruct.Veh_EVSysReadySt 2"); // 预期结果 TC_CANTest SOA check Veh_BodySts_PwrStruct.Veh_EVSysReadySt 2
  g_EM_SOAClient_Swc_SOA_CHECK("Veh_BodySts_PwrStruct.Veh_EVSysReadySt 2"); // 预期结果 TC_CANTest SOA check Veh_BodySts_PwrStruct.Veh_EVSysReadySt 2
}

testcase SYS_CDCU_jichufuwu_0009()
{
  TestDescription("基础服务-9");
  teststep("warning","原始用例id为SYS-CDCU-基础服务-0009");
  g_CAN_Bus_Swc_Set("C_LDCU_SysSt.C_LDCU_CurrentGearLev 0"); // 测试步骤 TC_CANTest SET C_LDCU_SysSt.C_LDCU_CurrentGearLev 0
  g_EM_Equipment_Swc_TC_4G_Time_Delay_Second("1.5"); // 测试步骤 TC_Sleep 1.5
  g_EM_SOAClient_Swc_SOA_CHECK_Prepare("Veh_BodySts_PwrStruct.Veh_CurrentGearLev 0"); // 预期结果 TC_CANTest SOA check Veh_BodySts_PwrStruct.Veh_CurrentGearLev 0
  g_EM_SOAClient_Swc_SOA_CHECK("Veh_BodySts_PwrStruct.Veh_CurrentGearLev 0"); // 预期结果 TC_CANTest SOA check Veh_BodySts_PwrStruct.Veh_CurrentGearLev 0
}

testcase SYS_CDCU_jichufuwu_0010()
{
  TestDescription("基础服务-10");
  teststep("warning","原始用例id为SYS-CDCU-基础服务-0010");
  g_CAN_Bus_Swc_Set("C_LDCU_SysSt.C_LDCU_CurrentGearLev 1"); // 测试步骤 TC_CANTest SET C_LDCU_SysSt.C_LDCU_CurrentGearLev 1
  g_EM_Equipment_Swc_TC_4G_Time_Delay_Second("1.5"); // 测试步骤 TC_Sleep 1.5
  g_EM_SOAClient_Swc_SOA_CHECK_Prepare("Veh_BodySts_PwrStruct.Veh_CurrentGearLev 1"); // 预期结果 TC_CANTest SOA check Veh_BodySts_PwrStruct.Veh_CurrentGearLev 1
  g_EM_SOAClient_Swc_SOA_CHECK("Veh_BodySts_PwrStruct.Veh_CurrentGearLev 1"); // 预期结果 TC_CANTest SOA check Veh_BodySts_PwrStruct.Veh_CurrentGearLev 1
}

testcase SYS_CDCU_jichufuwu_0011()
{
  TestDescription("基础服务-11");
  teststep("warning","原始用例id为SYS-CDCU-基础服务-0011");
  g_CAN_Bus_Swc_Set("C_LDCU_SysSt.C_LDCU_CurrentGearLev 2"); // 测试步骤 TC_CANTest SET C_LDCU_SysSt.C_LDCU_CurrentGearLev 2
  g_EM_Equipment_Swc_TC_4G_Time_Delay_Second("1.5"); // 测试步骤 TC_Sleep 1.5
  g_EM_SOAClient_Swc_SOA_CHECK_Prepare("Veh_BodySts_PwrStruct.Veh_CurrentGearLev 2"); // 预期结果 TC_CANTest SOA check Veh_BodySts_PwrStruct.Veh_CurrentGearLev 2
  g_EM_SOAClient_Swc_SOA_CHECK("Veh_BodySts_PwrStruct.Veh_CurrentGearLev 2"); // 预期结果 TC_CANTest SOA check Veh_BodySts_PwrStruct.Veh_CurrentGearLev 2
}

testcase SYS_CDCU_jichufuwu_0012()
{
  TestDescription("基础服务-12");
  teststep("warning","原始用例id为SYS-CDCU-基础服务-0012");
  g_CAN_Bus_Swc_Set("C_LDCU_SysSt.C_LDCU_CurrentGearLev 3"); // 测试步骤 TC_CANTest SET C_LDCU_SysSt.C_LDCU_CurrentGearLev 3
  g_EM_Equipment_Swc_TC_4G_Time_Delay_Second("1.5"); // 测试步骤 TC_Sleep 1.5
  g_EM_SOAClient_Swc_SOA_CHECK_Prepare("Veh_BodySts_PwrStruct.Veh_CurrentGearLev 3"); // 预期结果 TC_CANTest SOA check Veh_BodySts_PwrStruct.Veh_CurrentGearLev 3
  g_EM_SOAClient_Swc_SOA_CHECK("Veh_BodySts_PwrStruct.Veh_CurrentGearLev 3"); // 预期结果 TC_CANTest SOA check Veh_BodySts_PwrStruct.Veh_CurrentGearLev 3
}

testcase SYS_CDCU_jichufuwu_0013()
{
  TestDescription("基础服务-13");
  teststep("warning","原始用例id为SYS-CDCU-基础服务-0013");
  g_CAN_Bus_Swc_Set("C_LDCU_SysSt.C_LDCU_CurrentGearLev 4"); // 测试步骤 TC_CANTest SET C_LDCU_SysSt.C_LDCU_CurrentGearLev 4
  g_EM_Equipment_Swc_TC_4G_Time_Delay_Second("1.5"); // 测试步骤 TC_Sleep 1.5
  g_EM_SOAClient_Swc_SOA_CHECK_Prepare("Veh_BodySts_PwrStruct.Veh_CurrentGearLev 4"); // 预期结果 TC_CANTest SOA check Veh_BodySts_PwrStruct.Veh_CurrentGearLev 4
  g_EM_SOAClient_Swc_SOA_CHECK("Veh_BodySts_PwrStruct.Veh_CurrentGearLev 4"); // 预期结果 TC_CANTest SOA check Veh_BodySts_PwrStruct.Veh_CurrentGearLev 4
}

testcase SYS_CDCU_jichufuwu_0014()
{
  TestDescription("基础服务-14");
  teststep("warning","原始用例id为SYS-CDCU-基础服务-0014");
  g_CAN_Bus_Swc_Set("I_LDCU_BodySysSt1.I_LDCU_AlarmSt 0"); // 测试步骤 TC_CANTest SET I_LDCU_BodySysSt1.I_LDCU_AlarmSt 0
  g_EM_Equipment_Swc_TC_4G_Time_Delay_Second("1.5"); // 测试步骤 TC_Sleep 1.5
  g_EM_SOAClient_Swc_SOA_CHECK_Prepare("Veh_BodySts_DoorStruct.Veh_AlarmSt 0"); // 预期结果 TC_CANTest SOA check Veh_BodySts_DoorStruct.Veh_AlarmSt 0
  g_EM_SOAClient_Swc_SOA_CHECK("Veh_BodySts_DoorStruct.Veh_AlarmSt 0"); // 预期结果 TC_CANTest SOA check Veh_BodySts_DoorStruct.Veh_AlarmSt 0
}

testcase SYS_CDCU_jichufuwu_0015()
{
  TestDescription("基础服务-15");
  teststep("warning","原始用例id为SYS-CDCU-基础服务-0015");
  g_CAN_Bus_Swc_Set("I_LDCU_BodySysSt1.I_LDCU_AlarmSt 1"); // 测试步骤 TC_CANTest SET I_LDCU_BodySysSt1.I_LDCU_AlarmSt 1
  g_EM_Equipment_Swc_TC_4G_Time_Delay_Second("1.5"); // 测试步骤 TC_Sleep 1.5
  g_EM_SOAClient_Swc_SOA_CHECK_Prepare("Veh_BodySts_DoorStruct.Veh_AlarmSt 1"); // 预期结果 TC_CANTest SOA check Veh_BodySts_DoorStruct.Veh_AlarmSt 1
  g_EM_SOAClient_Swc_SOA_CHECK("Veh_BodySts_DoorStruct.Veh_AlarmSt 1"); // 预期结果 TC_CANTest SOA check Veh_BodySts_DoorStruct.Veh_AlarmSt 1
}

testcase SYS_CDCU_jichufuwu_0016()
{
  TestDescription("基础服务-16");
  teststep("warning","原始用例id为SYS-CDCU-基础服务-0016");
  g_CAN_Bus_Swc_Set("I_LDCU_BodySysSt1.I_LDCU_AlarmSt 2"); // 测试步骤 TC_CANTest SET I_LDCU_BodySysSt1.I_LDCU_AlarmSt 2
  g_EM_Equipment_Swc_TC_4G_Time_Delay_Second("1.5"); // 测试步骤 TC_Sleep 1.5
  g_EM_SOAClient_Swc_SOA_CHECK_Prepare("Veh_BodySts_DoorStruct.Veh_AlarmSt 2"); // 预期结果 TC_CANTest SOA check Veh_BodySts_DoorStruct.Veh_AlarmSt 2
  g_EM_SOAClient_Swc_SOA_CHECK("Veh_BodySts_DoorStruct.Veh_AlarmSt 2"); // 预期结果 TC_CANTest SOA check Veh_BodySts_DoorStruct.Veh_AlarmSt 2
}

testcase SYS_CDCU_jichufuwu_0017()
{
  TestDescription("基础服务-17");
  teststep("warning","原始用例id为SYS-CDCU-基础服务-0017");
  g_CAN_Bus_Swc_Set("I_LDCU_BodySysSt1.I_LDCU_AlarmSt 3"); // 测试步骤 TC_CANTest SET I_LDCU_BodySysSt1.I_LDCU_AlarmSt 3
  g_EM_Equipment_Swc_TC_4G_Time_Delay_Second("1.5"); // 测试步骤 TC_Sleep 1.5
  g_EM_SOAClient_Swc_SOA_CHECK_Prepare("Veh_BodySts_DoorStruct.Veh_AlarmSt 3"); // 预期结果 TC_CANTest SOA check Veh_BodySts_DoorStruct.Veh_AlarmSt 3
  g_EM_SOAClient_Swc_SOA_CHECK("Veh_BodySts_DoorStruct.Veh_AlarmSt 3"); // 预期结果 TC_CANTest SOA check Veh_BodySts_DoorStruct.Veh_AlarmSt 3
}

testcase SYS_CDCU_jichufuwu_0018()
{
  TestDescription("基础服务-18");
  teststep("warning","原始用例id为SYS-CDCU-基础服务-0018");
  g_CAN_Bus_Swc_Set("I_LDCU_BodySysSt1.I_LDCU_DriverDoorAjarSt 0"); // 测试步骤 TC_CANTest SET I_LDCU_BodySysSt1.I_LDCU_DriverDoorAjarSt 0
  g_EM_Equipment_Swc_TC_4G_Time_Delay_Second("1.5"); // 测试步骤 TC_Sleep 1.5
  g_EM_SOAClient_Swc_SOA_CHECK_Prepare("Veh_BodySts_DoorStruct.Veh_DriverDoorAjarSt 0"); // 预期结果 TC_CANTest SOA check Veh_BodySts_DoorStruct.Veh_DriverDoorAjarSt 0
  g_EM_SOAClient_Swc_SOA_CHECK("Veh_BodySts_DoorStruct.Veh_DriverDoorAjarSt 0"); // 预期结果 TC_CANTest SOA check Veh_BodySts_DoorStruct.Veh_DriverDoorAjarSt 0
}

testcase SYS_CDCU_jichufuwu_0019()
{
  TestDescription("基础服务-19");
  teststep("warning","原始用例id为SYS-CDCU-基础服务-0019");
  g_CAN_Bus_Swc_Set("I_LDCU_BodySysSt1.I_LDCU_DriverDoorAjarSt 1"); // 测试步骤 TC_CANTest SET I_LDCU_BodySysSt1.I_LDCU_DriverDoorAjarSt 1
  g_EM_Equipment_Swc_TC_4G_Time_Delay_Second("1.5"); // 测试步骤 TC_Sleep 1.5
  g_EM_SOAClient_Swc_SOA_CHECK_Prepare("Veh_BodySts_DoorStruct.Veh_DriverDoorAjarSt 1"); // 预期结果 TC_CANTest SOA check Veh_BodySts_DoorStruct.Veh_DriverDoorAjarSt 1
  g_EM_SOAClient_Swc_SOA_CHECK("Veh_BodySts_DoorStruct.Veh_DriverDoorAjarSt 1"); // 预期结果 TC_CANTest SOA check Veh_BodySts_DoorStruct.Veh_DriverDoorAjarSt 1
}

testcase SYS_CDCU_jichufuwu_0020()
{
  TestDescription("基础服务-20");
  teststep("warning","原始用例id为SYS-CDCU-基础服务-0020");
  g_CAN_Bus_Swc_Set("I_RDCU_BodySysSt1.I_RDCU_PsngrDoorAjarSt 0"); // 测试步骤 TC_CANTest SET I_RDCU_BodySysSt1.I_RDCU_PsngrDoorAjarSt 0
  g_EM_Equipment_Swc_TC_4G_Time_Delay_Second("1.5"); // 测试步骤 TC_Sleep 1.5
  g_EM_SOAClient_Swc_SOA_CHECK_Prepare("Veh_BodySts_DoorStruct.Veh_PsngrDoorAjarSt 0"); // 预期结果 TC_CANTest SOA check Veh_BodySts_DoorStruct.Veh_PsngrDoorAjarSt 0
  g_EM_SOAClient_Swc_SOA_CHECK("Veh_BodySts_DoorStruct.Veh_PsngrDoorAjarSt 0"); // 预期结果 TC_CANTest SOA check Veh_BodySts_DoorStruct.Veh_PsngrDoorAjarSt 0
}

testcase SYS_CDCU_jichufuwu_0021()
{
  TestDescription("基础服务-21");
  teststep("warning","原始用例id为SYS-CDCU-基础服务-0021");
  g_CAN_Bus_Swc_Set("I_RDCU_BodySysSt1.I_RDCU_PsngrDoorAjarSt 1"); // 测试步骤 TC_CANTest SET I_RDCU_BodySysSt1.I_RDCU_PsngrDoorAjarSt 1
  g_EM_Equipment_Swc_TC_4G_Time_Delay_Second("1.5"); // 测试步骤 TC_Sleep 1.5
  g_EM_SOAClient_Swc_SOA_CHECK_Prepare("Veh_BodySts_DoorStruct.Veh_PsngrDoorAjarSt 1"); // 预期结果 TC_CANTest SOA check Veh_BodySts_DoorStruct.Veh_PsngrDoorAjarSt 1
  g_EM_SOAClient_Swc_SOA_CHECK("Veh_BodySts_DoorStruct.Veh_PsngrDoorAjarSt 1"); // 预期结果 TC_CANTest SOA check Veh_BodySts_DoorStruct.Veh_PsngrDoorAjarSt 1
}

testcase SYS_CDCU_jichufuwu_0022()
{
  TestDescription("基础服务-22");
  teststep("warning","原始用例id为SYS-CDCU-基础服务-0022");
  g_CAN_Bus_Swc_Set("I_LDCU_BodySysSt1.I_LDCU_RLDoorAjarSt 0"); // 测试步骤 TC_CANTest SET I_LDCU_BodySysSt1.I_LDCU_RLDoorAjarSt 0
  g_EM_Equipment_Swc_TC_4G_Time_Delay_Second("1.5"); // 测试步骤 TC_Sleep 1.5
  g_EM_SOAClient_Swc_SOA_CHECK_Prepare("Veh_BodySts_DoorStruct.Veh_RLDoorAjarSt 0"); // 预期结果 TC_CANTest SOA check Veh_BodySts_DoorStruct.Veh_RLDoorAjarSt 0
  g_EM_SOAClient_Swc_SOA_CHECK("Veh_BodySts_DoorStruct.Veh_RLDoorAjarSt 0"); // 预期结果 TC_CANTest SOA check Veh_BodySts_DoorStruct.Veh_RLDoorAjarSt 0
}

testcase SYS_CDCU_jichufuwu_0023()
{
  TestDescription("基础服务-23");
  teststep("warning","原始用例id为SYS-CDCU-基础服务-0023");
  g_CAN_Bus_Swc_Set("I_LDCU_BodySysSt1.I_LDCU_RLDoorAjarSt 1"); // 测试步骤 TC_CANTest SET I_LDCU_BodySysSt1.I_LDCU_RLDoorAjarSt 1
  g_EM_Equipment_Swc_TC_4G_Time_Delay_Second("1.5"); // 测试步骤 TC_Sleep 1.5
  g_EM_SOAClient_Swc_SOA_CHECK_Prepare("Veh_BodySts_DoorStruct.Veh_RLDoorAjarSt 1"); // 预期结果 TC_CANTest SOA check Veh_BodySts_DoorStruct.Veh_RLDoorAjarSt 1
  g_EM_SOAClient_Swc_SOA_CHECK("Veh_BodySts_DoorStruct.Veh_RLDoorAjarSt 1"); // 预期结果 TC_CANTest SOA check Veh_BodySts_DoorStruct.Veh_RLDoorAjarSt 1
}

testcase SYS_CDCU_jichufuwu_0024()
{
  TestDescription("基础服务-24");
  teststep("warning","原始用例id为SYS-CDCU-基础服务-0024");
  g_CAN_Bus_Swc_Set("I_RDCU_BodySysSt1.I_RDCU_RRDoorAjarSt 0"); // 测试步骤 TC_CANTest SET I_RDCU_BodySysSt1.I_RDCU_RRDoorAjarSt 0
  g_EM_Equipment_Swc_TC_4G_Time_Delay_Second("1.5"); // 测试步骤 TC_Sleep 1.5
  g_EM_SOAClient_Swc_SOA_CHECK_Prepare("Veh_BodySts_DoorStruct.Veh_RRDoorAjarSt 0"); // 预期结果 TC_CANTest SOA check Veh_BodySts_DoorStruct.Veh_RRDoorAjarSt 0
  g_EM_SOAClient_Swc_SOA_CHECK("Veh_BodySts_DoorStruct.Veh_RRDoorAjarSt 0"); // 预期结果 TC_CANTest SOA check Veh_BodySts_DoorStruct.Veh_RRDoorAjarSt 0
}

testcase SYS_CDCU_jichufuwu_0025()
{
  TestDescription("基础服务-25");
  teststep("warning","原始用例id为SYS-CDCU-基础服务-0025");
  g_CAN_Bus_Swc_Set("I_RDCU_BodySysSt1.I_RDCU_RRDoorAjarSt 1"); // 测试步骤 TC_CANTest SET I_RDCU_BodySysSt1.I_RDCU_RRDoorAjarSt 1
  g_EM_Equipment_Swc_TC_4G_Time_Delay_Second("1.5"); // 测试步骤 TC_Sleep 1.5
  g_EM_SOAClient_Swc_SOA_CHECK_Prepare("Veh_BodySts_DoorStruct.Veh_RRDoorAjarSt 1"); // 预期结果 TC_CANTest SOA check Veh_BodySts_DoorStruct.Veh_RRDoorAjarSt 1
  g_EM_SOAClient_Swc_SOA_CHECK("Veh_BodySts_DoorStruct.Veh_RRDoorAjarSt 1"); // 预期结果 TC_CANTest SOA check Veh_BodySts_DoorStruct.Veh_RRDoorAjarSt 1
}

testcase SYS_CDCU_jichufuwu_0026()
{
  TestDescription("基础服务-26");
  teststep("warning","原始用例id为SYS-CDCU-基础服务-0026");
  g_CAN_Bus_Swc_Set("I_RDCU_BodySysSt1.I_RDCU_BonnetAjarSt 0"); // 测试步骤 TC_CANTest SET I_RDCU_BodySysSt1.I_RDCU_BonnetAjarSt 0
  g_EM_Equipment_Swc_TC_4G_Time_Delay_Second("1.5"); // 测试步骤 TC_Sleep 1.5
  g_EM_SOAClient_Swc_SOA_CHECK_Prepare("Veh_BodySts_DoorStruct.Veh_BonnetAjarSt 0"); // 预期结果 TC_CANTest SOA check Veh_BodySts_DoorStruct.Veh_BonnetAjarSt 0
  g_EM_SOAClient_Swc_SOA_CHECK("Veh_BodySts_DoorStruct.Veh_BonnetAjarSt 0"); // 预期结果 TC_CANTest SOA check Veh_BodySts_DoorStruct.Veh_BonnetAjarSt 0
}

testcase SYS_CDCU_jichufuwu_0027()
{
  TestDescription("基础服务-27");
  teststep("warning","原始用例id为SYS-CDCU-基础服务-0027");
  g_CAN_Bus_Swc_Set("I_RDCU_BodySysSt1.I_RDCU_BonnetAjarSt 1"); // 测试步骤 TC_CANTest SET I_RDCU_BodySysSt1.I_RDCU_BonnetAjarSt 1
  g_EM_Equipment_Swc_TC_4G_Time_Delay_Second("1.5"); // 测试步骤 TC_Sleep 1.5
  g_EM_SOAClient_Swc_SOA_CHECK_Prepare("Veh_BodySts_DoorStruct.Veh_BonnetAjarSt 1"); // 预期结果 TC_CANTest SOA check Veh_BodySts_DoorStruct.Veh_BonnetAjarSt 1
  g_EM_SOAClient_Swc_SOA_CHECK("Veh_BodySts_DoorStruct.Veh_BonnetAjarSt 1"); // 预期结果 TC_CANTest SOA check Veh_BodySts_DoorStruct.Veh_BonnetAjarSt 1
}

testcase SYS_CDCU_jichufuwu_0028()
{
  TestDescription("基础服务-28");
  teststep("warning","原始用例id为SYS-CDCU-基础服务-0028");
  g_CAN_Bus_Swc_Set("I_RDCU_BodySysSt1.I_RDCU_BonnetAjarSt 2"); // 测试步骤 TC_CANTest SET I_RDCU_BodySysSt1.I_RDCU_BonnetAjarSt 2
  g_EM_Equipment_Swc_TC_4G_Time_Delay_Second("1.5"); // 测试步骤 TC_Sleep 1.5
  g_EM_SOAClient_Swc_SOA_CHECK_Prepare("Veh_BodySts_DoorStruct.Veh_BonnetAjarSt 2"); // 预期结果 TC_CANTest SOA check Veh_BodySts_DoorStruct.Veh_BonnetAjarSt 2
  g_EM_SOAClient_Swc_SOA_CHECK("Veh_BodySts_DoorStruct.Veh_BonnetAjarSt 2"); // 预期结果 TC_CANTest SOA check Veh_BodySts_DoorStruct.Veh_BonnetAjarSt 2
}

testcase SYS_CDCU_jichufuwu_0029()
{
  TestDescription("基础服务-29");
  teststep("warning","原始用例id为SYS-CDCU-基础服务-0029");
  g_CAN_Bus_Swc_Set("I_RDCU_BodySysSt1.I_RDCU_BonnetAjarSt 3"); // 测试步骤 TC_CANTest SET I_RDCU_BodySysSt1.I_RDCU_BonnetAjarSt 3
  g_EM_Equipment_Swc_TC_4G_Time_Delay_Second("1.5"); // 测试步骤 TC_Sleep 1.5
  g_EM_SOAClient_Swc_SOA_CHECK_Prepare("Veh_BodySts_DoorStruct.Veh_BonnetAjarSt 3"); // 预期结果 TC_CANTest SOA check Veh_BodySts_DoorStruct.Veh_BonnetAjarSt 3
  g_EM_SOAClient_Swc_SOA_CHECK("Veh_BodySts_DoorStruct.Veh_BonnetAjarSt 3"); // 预期结果 TC_CANTest SOA check Veh_BodySts_DoorStruct.Veh_BonnetAjarSt 3
}

testcase SYS_CDCU_jichufuwu_0030()
{
  TestDescription("基础服务-30");
  teststep("warning","原始用例id为SYS-CDCU-基础服务-0030");
  g_CAN_Bus_Swc_Set("I_LDCU_TgateSysSts.I_TgatePosSts 0"); // 测试步骤 TC_CANTest SET I_LDCU_TgateSysSts.I_TgatePosSts 0
  g_EM_Equipment_Swc_TC_4G_Time_Delay_Second("1.5"); // 测试步骤 TC_Sleep 1.5
  g_EM_SOAClient_Swc_SOA_CHECK_Prepare("Veh_BodySts_DoorStruct.Veh_TailgateSt 0"); // 预期结果 TC_CANTest SOA check Veh_BodySts_DoorStruct.Veh_TailgateSt 0
  g_EM_SOAClient_Swc_SOA_CHECK("Veh_BodySts_DoorStruct.Veh_TailgateSt 0"); // 预期结果 TC_CANTest SOA check Veh_BodySts_DoorStruct.Veh_TailgateSt 0
}

testcase SYS_CDCU_jichufuwu_0031()
{
  TestDescription("基础服务-31");
  teststep("warning","原始用例id为SYS-CDCU-基础服务-0031");
  g_CAN_Bus_Swc_Set("I_LDCU_TgateSysSts.I_TgatePosSts 1"); // 测试步骤 TC_CANTest SET I_LDCU_TgateSysSts.I_TgatePosSts 1
  g_EM_Equipment_Swc_TC_4G_Time_Delay_Second("1.5"); // 测试步骤 TC_Sleep 1.5
  g_EM_SOAClient_Swc_SOA_CHECK_Prepare("Veh_BodySts_DoorStruct.Veh_TailgateSt 1"); // 预期结果 TC_CANTest SOA check Veh_BodySts_DoorStruct.Veh_TailgateSt 1
  g_EM_SOAClient_Swc_SOA_CHECK("Veh_BodySts_DoorStruct.Veh_TailgateSt 1"); // 预期结果 TC_CANTest SOA check Veh_BodySts_DoorStruct.Veh_TailgateSt 1
}

testcase SYS_CDCU_jichufuwu_0032()
{
  TestDescription("基础服务-32");
  teststep("warning","原始用例id为SYS-CDCU-基础服务-0032");
  g_CAN_Bus_Swc_Set("I_LDCU_TgateSysSts.I_TgatePosSts 2"); // 测试步骤 TC_CANTest SET I_LDCU_TgateSysSts.I_TgatePosSts 2
  g_EM_Equipment_Swc_TC_4G_Time_Delay_Second("1.5"); // 测试步骤 TC_Sleep 1.5
  g_EM_SOAClient_Swc_SOA_CHECK_Prepare("Veh_BodySts_DoorStruct.Veh_TailgateSt 2"); // 预期结果 TC_CANTest SOA check Veh_BodySts_DoorStruct.Veh_TailgateSt 2
  g_EM_SOAClient_Swc_SOA_CHECK("Veh_BodySts_DoorStruct.Veh_TailgateSt 2"); // 预期结果 TC_CANTest SOA check Veh_BodySts_DoorStruct.Veh_TailgateSt 2
}

testcase SYS_CDCU_jichufuwu_0033()
{
  TestDescription("基础服务-33");
  teststep("warning","原始用例id为SYS-CDCU-基础服务-0033");
  g_CAN_Bus_Swc_Set("I_LDCU_TgateSysSts.I_TgatePosSts 3"); // 测试步骤 TC_CANTest SET I_LDCU_TgateSysSts.I_TgatePosSts 3
  g_EM_Equipment_Swc_TC_4G_Time_Delay_Second("1.5"); // 测试步骤 TC_Sleep 1.5
  g_EM_SOAClient_Swc_SOA_CHECK_Prepare("Veh_BodySts_DoorStruct.Veh_TailgateSt 3"); // 预期结果 TC_CANTest SOA check Veh_BodySts_DoorStruct.Veh_TailgateSt 3
  g_EM_SOAClient_Swc_SOA_CHECK("Veh_BodySts_DoorStruct.Veh_TailgateSt 3"); // 预期结果 TC_CANTest SOA check Veh_BodySts_DoorStruct.Veh_TailgateSt 3
}

testcase SYS_CDCU_jichufuwu_0034()
{
  TestDescription("基础服务-34");
  teststep("warning","原始用例id为SYS-CDCU-基础服务-0034");
  g_CAN_Bus_Swc_Set("I_LDCU_TgateSysSts.I_TgatePosSts 4"); // 测试步骤 TC_CANTest SET I_LDCU_TgateSysSts.I_TgatePosSts 4
  g_EM_Equipment_Swc_TC_4G_Time_Delay_Second("1.5"); // 测试步骤 TC_Sleep 1.5
  g_EM_SOAClient_Swc_SOA_CHECK_Prepare("Veh_BodySts_DoorStruct.Veh_TailgateSt 4"); // 预期结果 TC_CANTest SOA check Veh_BodySts_DoorStruct.Veh_TailgateSt 4
  g_EM_SOAClient_Swc_SOA_CHECK("Veh_BodySts_DoorStruct.Veh_TailgateSt 4"); // 预期结果 TC_CANTest SOA check Veh_BodySts_DoorStruct.Veh_TailgateSt 4
}

testcase SYS_CDCU_jichufuwu_0035()
{
  TestDescription("基础服务-35");
  teststep("warning","原始用例id为SYS-CDCU-基础服务-0035");
  g_CAN_Bus_Swc_Set("I_LDCU_TgateSysSts.I_TgatePosSts 5"); // 测试步骤 TC_CANTest SET I_LDCU_TgateSysSts.I_TgatePosSts 5
  g_EM_Equipment_Swc_TC_4G_Time_Delay_Second("1.5"); // 测试步骤 TC_Sleep 1.5
  g_EM_SOAClient_Swc_SOA_CHECK_Prepare("Veh_BodySts_DoorStruct.Veh_TailgateSt 5"); // 预期结果 TC_CANTest SOA check Veh_BodySts_DoorStruct.Veh_TailgateSt 5
  g_EM_SOAClient_Swc_SOA_CHECK("Veh_BodySts_DoorStruct.Veh_TailgateSt 5"); // 预期结果 TC_CANTest SOA check Veh_BodySts_DoorStruct.Veh_TailgateSt 5
}

testcase SYS_CDCU_jichufuwu_0036()
{
  TestDescription("基础服务-36");
  teststep("warning","原始用例id为SYS-CDCU-基础服务-0036");
  g_CAN_Bus_Swc_Set("I_LDCU_TgateSysSts.I_TgatePosSts 6"); // 测试步骤 TC_CANTest SET I_LDCU_TgateSysSts.I_TgatePosSts 6
  g_EM_Equipment_Swc_TC_4G_Time_Delay_Second("1.5"); // 测试步骤 TC_Sleep 1.5
  g_EM_SOAClient_Swc_SOA_CHECK_Prepare("Veh_BodySts_DoorStruct.Veh_TailgateSt 6"); // 预期结果 TC_CANTest SOA check Veh_BodySts_DoorStruct.Veh_TailgateSt 6
  g_EM_SOAClient_Swc_SOA_CHECK("Veh_BodySts_DoorStruct.Veh_TailgateSt 6"); // 预期结果 TC_CANTest SOA check Veh_BodySts_DoorStruct.Veh_TailgateSt 6
}

testcase SYS_CDCU_jichufuwu_0037()
{
  TestDescription("基础服务-37");
  teststep("warning","原始用例id为SYS-CDCU-基础服务-0037");
  g_CAN_Bus_Swc_Set("I_LDCU_TgateSysSts.I_TgatePosSts 7"); // 测试步骤 TC_CANTest SET I_LDCU_TgateSysSts.I_TgatePosSts 7
  g_EM_Equipment_Swc_TC_4G_Time_Delay_Second("1.5"); // 测试步骤 TC_Sleep 1.5
  g_EM_SOAClient_Swc_SOA_CHECK_Prepare("Veh_BodySts_DoorStruct.Veh_TailgateSt 7"); // 预期结果 TC_CANTest SOA check Veh_BodySts_DoorStruct.Veh_TailgateSt 7
  g_EM_SOAClient_Swc_SOA_CHECK("Veh_BodySts_DoorStruct.Veh_TailgateSt 7"); // 预期结果 TC_CANTest SOA check Veh_BodySts_DoorStruct.Veh_TailgateSt 7
}

testcase SYS_CDCU_jichufuwu_0038()
{
  TestDescription("基础服务-38");
  teststep("warning","原始用例id为SYS-CDCU-基础服务-0038");
  g_CAN_Bus_Swc_Set("I_LDCU_BodySysSt1.I_LDCU_LockLogicSt 0"); // 测试步骤 TC_CANTest SET I_LDCU_BodySysSt1.I_LDCU_LockLogicSt 0
  g_EM_Equipment_Swc_TC_4G_Time_Delay_Second("1.5"); // 测试步骤 TC_Sleep 1.5
  g_EM_SOAClient_Swc_SOA_CHECK_Prepare("Veh_BodySts_DoorStruct.Veh_LockLogicSt 0"); // 预期结果 TC_CANTest SOA check Veh_BodySts_DoorStruct.Veh_LockLogicSt 0
  g_EM_SOAClient_Swc_SOA_CHECK("Veh_BodySts_DoorStruct.Veh_LockLogicSt 0"); // 预期结果 TC_CANTest SOA check Veh_BodySts_DoorStruct.Veh_LockLogicSt 0
}

testcase SYS_CDCU_jichufuwu_0039()
{
  TestDescription("基础服务-39");
  teststep("warning","原始用例id为SYS-CDCU-基础服务-0039");
  g_CAN_Bus_Swc_Set("I_LDCU_BodySysSt1.I_LDCU_LockLogicSt 1"); // 测试步骤 TC_CANTest SET I_LDCU_BodySysSt1.I_LDCU_LockLogicSt 1
  g_EM_Equipment_Swc_TC_4G_Time_Delay_Second("1.5"); // 测试步骤 TC_Sleep 1.5
  g_EM_SOAClient_Swc_SOA_CHECK_Prepare("Veh_BodySts_DoorStruct.Veh_LockLogicSt 1"); // 预期结果 TC_CANTest SOA check Veh_BodySts_DoorStruct.Veh_LockLogicSt 1
  g_EM_SOAClient_Swc_SOA_CHECK("Veh_BodySts_DoorStruct.Veh_LockLogicSt 1"); // 预期结果 TC_CANTest SOA check Veh_BodySts_DoorStruct.Veh_LockLogicSt 1
}

testcase SYS_CDCU_jichufuwu_0040()
{
  TestDescription("基础服务-40");
  teststep("warning","原始用例id为SYS-CDCU-基础服务-0040");
  g_CAN_Bus_Swc_Set("C_IPB_SpdInfoF.C_IPB_VehSpdVD 0"); // 测试步骤 TC_CANTest SET C_IPB_SpdInfoF.C_IPB_VehSpdVD 0
  g_EM_Equipment_Swc_TC_4G_Time_Delay_Second("1.5"); // 测试步骤 TC_Sleep 1.5
  g_EM_SOAClient_Swc_SOA_CHECK_Prepare("Veh_BodySts5_PowertrainStruct.Veh_VehSpdVD 0"); // 预期结果 TC_CANTest SOA check Veh_BodySts5_PowertrainStruct.Veh_VehSpdVD 0
  g_EM_SOAClient_Swc_SOA_CHECK("Veh_BodySts5_PowertrainStruct.Veh_VehSpdVD 0"); // 预期结果 TC_CANTest SOA check Veh_BodySts5_PowertrainStruct.Veh_VehSpdVD 0
}

testcase SYS_CDCU_jichufuwu_0041()
{
  TestDescription("基础服务-41");
  teststep("warning","原始用例id为SYS-CDCU-基础服务-0041");
  g_CAN_Bus_Swc_Set("C_IPB_SpdInfoF.C_IPB_VehSpdVD 1"); // 测试步骤 TC_CANTest SET C_IPB_SpdInfoF.C_IPB_VehSpdVD 1
  g_EM_Equipment_Swc_TC_4G_Time_Delay_Second("1.5"); // 测试步骤 TC_Sleep 1.5
  g_EM_SOAClient_Swc_SOA_CHECK_Prepare("Veh_BodySts5_PowertrainStruct.Veh_VehSpdVD 1"); // 预期结果 TC_CANTest SOA check Veh_BodySts5_PowertrainStruct.Veh_VehSpdVD 1
  g_EM_SOAClient_Swc_SOA_CHECK("Veh_BodySts5_PowertrainStruct.Veh_VehSpdVD 1"); // 预期结果 TC_CANTest SOA check Veh_BodySts5_PowertrainStruct.Veh_VehSpdVD 1
}

testcase SYS_CDCU_jichufuwu_0042()
{
  TestDescription("基础服务-42");
  teststep("warning","原始用例id为SYS-CDCU-基础服务-0042");
  g_CAN_Bus_Swc_Set("C_IPB_SpdInfoF.C_IPB_VehSpdVD 2"); // 测试步骤 TC_CANTest SET C_IPB_SpdInfoF.C_IPB_VehSpdVD 2
  g_EM_Equipment_Swc_TC_4G_Time_Delay_Second("1.5"); // 测试步骤 TC_Sleep 1.5
  g_EM_SOAClient_Swc_SOA_CHECK_Prepare("Veh_BodySts5_PowertrainStruct.Veh_VehSpdVD 2"); // 预期结果 TC_CANTest SOA check Veh_BodySts5_PowertrainStruct.Veh_VehSpdVD 2
  g_EM_SOAClient_Swc_SOA_CHECK("Veh_BodySts5_PowertrainStruct.Veh_VehSpdVD 2"); // 预期结果 TC_CANTest SOA check Veh_BodySts5_PowertrainStruct.Veh_VehSpdVD 2
}

testcase SYS_CDCU_jichufuwu_0043()
{
  TestDescription("基础服务-43");
  teststep("warning","原始用例id为SYS-CDCU-基础服务-0043");
  g_CAN_Bus_Swc_Set("C_IPB_SpdInfoF.C_IPB_VehSpdVD 3"); // 测试步骤 TC_CANTest SET C_IPB_SpdInfoF.C_IPB_VehSpdVD 3
  g_EM_Equipment_Swc_TC_4G_Time_Delay_Second("1.5"); // 测试步骤 TC_Sleep 1.5
  g_EM_SOAClient_Swc_SOA_CHECK_Prepare("Veh_BodySts5_PowertrainStruct.Veh_VehSpdVD 3"); // 预期结果 TC_CANTest SOA check Veh_BodySts5_PowertrainStruct.Veh_VehSpdVD 3
  g_EM_SOAClient_Swc_SOA_CHECK("Veh_BodySts5_PowertrainStruct.Veh_VehSpdVD 3"); // 预期结果 TC_CANTest SOA check Veh_BodySts5_PowertrainStruct.Veh_VehSpdVD 3
}

testcase SYS_CDCU_jichufuwu_0044()
{
  TestDescription("基础服务-44");
  teststep("warning","原始用例id为SYS-CDCU-基础服务-0044");
  g_CAN_Bus_Swc_Set("C_IPB_SpdInfoF.C_IPB_VehSpd 0"); // 测试步骤 TC_CANTest SET C_IPB_SpdInfoF.C_IPB_VehSpd 0
  g_EM_Equipment_Swc_TC_4G_Time_Delay_Second("1.5"); // 测试步骤 TC_Sleep 1.5
  g_EM_SOAClient_Swc_SOA_CHECK_Prepare("Veh_BodySts5_PowertrainStruct.Veh_VehSpd 0"); // 预期结果 TC_CANTest SOA check Veh_BodySts5_PowertrainStruct.Veh_VehSpd 0
  g_EM_SOAClient_Swc_SOA_CHECK("Veh_BodySts5_PowertrainStruct.Veh_VehSpd 0"); // 预期结果 TC_CANTest SOA check Veh_BodySts5_PowertrainStruct.Veh_VehSpd 0
}

testcase SYS_CDCU_jichufuwu_0045()
{
  TestDescription("基础服务-45");
  teststep("warning","原始用例id为SYS-CDCU-基础服务-0045");
  g_CAN_Bus_Swc_Set("C_IPB_SpdInfoF.C_IPB_VehSpd 15"); // 测试步骤 TC_CANTest SET C_IPB_SpdInfoF.C_IPB_VehSpd 15
  g_EM_Equipment_Swc_TC_4G_Time_Delay_Second("1.5"); // 测试步骤 TC_Sleep 1.5
  g_EM_SOAClient_Swc_SOA_CHECK_Prepare("Veh_BodySts5_PowertrainStruct.Veh_VehSpd 15"); // 预期结果 TC_CANTest SOA check Veh_BodySts5_PowertrainStruct.Veh_VehSpd 15
  g_EM_SOAClient_Swc_SOA_CHECK("Veh_BodySts5_PowertrainStruct.Veh_VehSpd 15"); // 预期结果 TC_CANTest SOA check Veh_BodySts5_PowertrainStruct.Veh_VehSpd 15
}

testcase SYS_CDCU_jichufuwu_0046()
{
  TestDescription("基础服务-46");
  teststep("warning","原始用例id为SYS-CDCU-基础服务-0046");
  g_CAN_Bus_Swc_Set("C_IPB_SpdInfoF.C_IPB_VehSpd 50"); // 测试步骤 TC_CANTest SET C_IPB_SpdInfoF.C_IPB_VehSpd 50
  g_EM_Equipment_Swc_TC_4G_Time_Delay_Second("1.5"); // 测试步骤 TC_Sleep 1.5
  g_EM_SOAClient_Swc_SOA_CHECK_Prepare("Veh_BodySts5_PowertrainStruct.Veh_VehSpd 50"); // 预期结果 TC_CANTest SOA check Veh_BodySts5_PowertrainStruct.Veh_VehSpd 50
  g_EM_SOAClient_Swc_SOA_CHECK("Veh_BodySts5_PowertrainStruct.Veh_VehSpd 50"); // 预期结果 TC_CANTest SOA check Veh_BodySts5_PowertrainStruct.Veh_VehSpd 50
}

testcase SYS_CDCU_jichufuwu_0047()
{
  TestDescription("基础服务-47");
  teststep("warning","原始用例id为SYS-CDCU-基础服务-0047");
  g_CAN_Bus_Swc_Set("C_IPB_SpdInfoF.C_IPB_VehSpd 118"); // 测试步骤 TC_CANTest SET C_IPB_SpdInfoF.C_IPB_VehSpd 118
  g_EM_Equipment_Swc_TC_4G_Time_Delay_Second("1.5"); // 测试步骤 TC_Sleep 1.5
  g_EM_SOAClient_Swc_SOA_CHECK_Prepare("Veh_BodySts5_PowertrainStruct.Veh_VehSpd 118"); // 预期结果 TC_CANTest SOA check Veh_BodySts5_PowertrainStruct.Veh_VehSpd 118
  g_EM_SOAClient_Swc_SOA_CHECK("Veh_BodySts5_PowertrainStruct.Veh_VehSpd 118"); // 预期结果 TC_CANTest SOA check Veh_BodySts5_PowertrainStruct.Veh_VehSpd 118
}

testcase SYS_CDCU_jichufuwu_0048()
{
  TestDescription("基础服务-48");
  teststep("warning","原始用例id为SYS-CDCU-基础服务-0048");
  g_CAN_Bus_Swc_Set("C_IPB_SpdInfoF.C_IPB_VehSpd 140"); // 测试步骤 TC_CANTest SET C_IPB_SpdInfoF.C_IPB_VehSpd 140
  g_EM_Equipment_Swc_TC_4G_Time_Delay_Second("1.5"); // 测试步骤 TC_Sleep 1.5
  g_EM_SOAClient_Swc_SOA_CHECK_Prepare("Veh_BodySts5_PowertrainStruct.Veh_VehSpd 140"); // 预期结果 TC_CANTest SOA check Veh_BodySts5_PowertrainStruct.Veh_VehSpd 140
  g_EM_SOAClient_Swc_SOA_CHECK("Veh_BodySts5_PowertrainStruct.Veh_VehSpd 140"); // 预期结果 TC_CANTest SOA check Veh_BodySts5_PowertrainStruct.Veh_VehSpd 140
}

testcase SYS_CDCU_jichufuwu_0049()
{
  TestDescription("基础服务-49");
  teststep("warning","原始用例id为SYS-CDCU-基础服务-0049");
  g_CAN_Bus_Swc_Set("I_LDCU_SysStDisp1.I_LDCU_dstBatDisp 0"); // 测试步骤 TC_CANTest SET I_LDCU_SysStDisp1.I_LDCU_dstBatDisp 0
  g_EM_Equipment_Swc_TC_4G_Time_Delay_Second("1.5"); // 测试步骤 TC_Sleep 1.5
  g_EM_SOAClient_Swc_SOA_CHECK_Prepare("Veh_BodySts5_PowertrainStruct.Veh_dstBatDisp 0"); // 预期结果 TC_CANTest SOA check Veh_BodySts5_PowertrainStruct.Veh_dstBatDisp 0
  g_EM_SOAClient_Swc_SOA_CHECK("Veh_BodySts5_PowertrainStruct.Veh_dstBatDisp 0"); // 预期结果 TC_CANTest SOA check Veh_BodySts5_PowertrainStruct.Veh_dstBatDisp 0
}

testcase SYS_CDCU_jichufuwu_0050()
{
  TestDescription("基础服务-50");
  teststep("warning","原始用例id为SYS-CDCU-基础服务-0050");
  g_CAN_Bus_Swc_Set("I_LDCU_SysStDisp1.I_LDCU_dstBatDisp 100"); // 测试步骤 TC_CANTest SET I_LDCU_SysStDisp1.I_LDCU_dstBatDisp 100
  g_EM_Equipment_Swc_TC_4G_Time_Delay_Second("1.5"); // 测试步骤 TC_Sleep 1.5
  g_EM_SOAClient_Swc_SOA_CHECK_Prepare("Veh_BodySts5_PowertrainStruct.Veh_dstBatDisp 100"); // 预期结果 TC_CANTest SOA check Veh_BodySts5_PowertrainStruct.Veh_dstBatDisp 100
  g_EM_SOAClient_Swc_SOA_CHECK("Veh_BodySts5_PowertrainStruct.Veh_dstBatDisp 100"); // 预期结果 TC_CANTest SOA check Veh_BodySts5_PowertrainStruct.Veh_dstBatDisp 100
}

testcase SYS_CDCU_jichufuwu_0051()
{
  TestDescription("基础服务-51");
  teststep("warning","原始用例id为SYS-CDCU-基础服务-0051");
  g_CAN_Bus_Swc_Set("I_LDCU_SysStDisp1.I_LDCU_dstBatDisp 200"); // 测试步骤 TC_CANTest SET I_LDCU_SysStDisp1.I_LDCU_dstBatDisp 200
  g_EM_Equipment_Swc_TC_4G_Time_Delay_Second("1.5"); // 测试步骤 TC_Sleep 1.5
  g_EM_SOAClient_Swc_SOA_CHECK_Prepare("Veh_BodySts5_PowertrainStruct.Veh_dstBatDisp 200"); // 预期结果 TC_CANTest SOA check Veh_BodySts5_PowertrainStruct.Veh_dstBatDisp 200
  g_EM_SOAClient_Swc_SOA_CHECK("Veh_BodySts5_PowertrainStruct.Veh_dstBatDisp 200"); // 预期结果 TC_CANTest SOA check Veh_BodySts5_PowertrainStruct.Veh_dstBatDisp 200
}

testcase SYS_CDCU_jichufuwu_0052()
{
  TestDescription("基础服务-52");
  teststep("warning","原始用例id为SYS-CDCU-基础服务-0052");
  g_CAN_Bus_Swc_Set("I_LDCU_SysStDisp1.I_LDCU_dstBatDisp 300"); // 测试步骤 TC_CANTest SET I_LDCU_SysStDisp1.I_LDCU_dstBatDisp 300
  g_EM_Equipment_Swc_TC_4G_Time_Delay_Second("1.5"); // 测试步骤 TC_Sleep 1.5
  g_EM_SOAClient_Swc_SOA_CHECK_Prepare("Veh_BodySts5_PowertrainStruct.Veh_dstBatDisp 300"); // 预期结果 TC_CANTest SOA check Veh_BodySts5_PowertrainStruct.Veh_dstBatDisp 300
  g_EM_SOAClient_Swc_SOA_CHECK("Veh_BodySts5_PowertrainStruct.Veh_dstBatDisp 300"); // 预期结果 TC_CANTest SOA check Veh_BodySts5_PowertrainStruct.Veh_dstBatDisp 300
}

testcase SYS_CDCU_jichufuwu_0053()
{
  TestDescription("基础服务-53");
  teststep("warning","原始用例id为SYS-CDCU-基础服务-0053");
  g_CAN_Bus_Swc_Set("I_LDCU_SysStDisp1.I_LDCU_dstBatDisp 400"); // 测试步骤 TC_CANTest SET I_LDCU_SysStDisp1.I_LDCU_dstBatDisp 400
  g_EM_Equipment_Swc_TC_4G_Time_Delay_Second("1.5"); // 测试步骤 TC_Sleep 1.5
  g_EM_SOAClient_Swc_SOA_CHECK_Prepare("Veh_BodySts5_PowertrainStruct.Veh_dstBatDisp 400"); // 预期结果 TC_CANTest SOA check Veh_BodySts5_PowertrainStruct.Veh_dstBatDisp 400
  g_EM_SOAClient_Swc_SOA_CHECK("Veh_BodySts5_PowertrainStruct.Veh_dstBatDisp 400"); // 预期结果 TC_CANTest SOA check Veh_BodySts5_PowertrainStruct.Veh_dstBatDisp 400
}

testcase SYS_CDCU_jichufuwu_0054()
{
  TestDescription("基础服务-54");
  teststep("warning","原始用例id为SYS-CDCU-基础服务-0054");
  g_CAN_Bus_Swc_Set("I_LDCU_SysStDisp1.I_LDCU_dstBatDisp 500"); // 测试步骤 TC_CANTest SET I_LDCU_SysStDisp1.I_LDCU_dstBatDisp 500
  g_EM_Equipment_Swc_TC_4G_Time_Delay_Second("1.5"); // 测试步骤 TC_Sleep 1.5
  g_EM_SOAClient_Swc_SOA_CHECK_Prepare("Veh_BodySts5_PowertrainStruct.Veh_dstBatDisp 500"); // 预期结果 TC_CANTest SOA check Veh_BodySts5_PowertrainStruct.Veh_dstBatDisp 500
  g_EM_SOAClient_Swc_SOA_CHECK("Veh_BodySts5_PowertrainStruct.Veh_dstBatDisp 500"); // 预期结果 TC_CANTest SOA check Veh_BodySts5_PowertrainStruct.Veh_dstBatDisp 500
}

testcase SYS_CDCU_jichufuwu_0055()
{
  TestDescription("基础服务-55");
  teststep("warning","原始用例id为SYS-CDCU-基础服务-0055");
  g_CAN_Bus_Swc_Set("I_LDCU_SysStDisp1.I_LDCU_dstBatDisp 600"); // 测试步骤 TC_CANTest SET I_LDCU_SysStDisp1.I_LDCU_dstBatDisp 600
  g_EM_Equipment_Swc_TC_4G_Time_Delay_Second("1.5"); // 测试步骤 TC_Sleep 1.5
  g_EM_SOAClient_Swc_SOA_CHECK_Prepare("Veh_BodySts5_PowertrainStruct.Veh_dstBatDisp 600"); // 预期结果 TC_CANTest SOA check Veh_BodySts5_PowertrainStruct.Veh_dstBatDisp 600
  g_EM_SOAClient_Swc_SOA_CHECK("Veh_BodySts5_PowertrainStruct.Veh_dstBatDisp 600"); // 预期结果 TC_CANTest SOA check Veh_BodySts5_PowertrainStruct.Veh_dstBatDisp 600
}

testcase SYS_CDCU_jichufuwu_0056()
{
  TestDescription("基础服务-56");
  teststep("warning","原始用例id为SYS-CDCU-基础服务-0056");
  g_CAN_Bus_Swc_Set("I_LDCU_SysStDisp1.I_LDCU_dstBatDisp 700"); // 测试步骤 TC_CANTest SET I_LDCU_SysStDisp1.I_LDCU_dstBatDisp 700
  g_EM_Equipment_Swc_TC_4G_Time_Delay_Second("1.5"); // 测试步骤 TC_Sleep 1.5
  g_EM_SOAClient_Swc_SOA_CHECK_Prepare("Veh_BodySts5_PowertrainStruct.Veh_dstBatDisp 700"); // 预期结果 TC_CANTest SOA check Veh_BodySts5_PowertrainStruct.Veh_dstBatDisp 700
  g_EM_SOAClient_Swc_SOA_CHECK("Veh_BodySts5_PowertrainStruct.Veh_dstBatDisp 700"); // 预期结果 TC_CANTest SOA check Veh_BodySts5_PowertrainStruct.Veh_dstBatDisp 700
}

testcase SYS_CDCU_jichufuwu_0057()
{
  TestDescription("基础服务-57");
  teststep("warning","原始用例id为SYS-CDCU-基础服务-0057");
  g_CAN_Bus_Swc_Set("I_LDCU_SysStDisp1.I_LDCU_dstBatDisp 800"); // 测试步骤 TC_CANTest SET I_LDCU_SysStDisp1.I_LDCU_dstBatDisp 800
  g_EM_Equipment_Swc_TC_4G_Time_Delay_Second("1.5"); // 测试步骤 TC_Sleep 1.5
  g_EM_SOAClient_Swc_SOA_CHECK_Prepare("Veh_BodySts5_PowertrainStruct.Veh_dstBatDisp 800"); // 预期结果 TC_CANTest SOA check Veh_BodySts5_PowertrainStruct.Veh_dstBatDisp 800
  g_EM_SOAClient_Swc_SOA_CHECK("Veh_BodySts5_PowertrainStruct.Veh_dstBatDisp 800"); // 预期结果 TC_CANTest SOA check Veh_BodySts5_PowertrainStruct.Veh_dstBatDisp 800
}

testcase SYS_CDCU_jichufuwu_0058()
{
  TestDescription("基础服务-58");
  teststep("warning","原始用例id为SYS-CDCU-基础服务-0058");
  g_CAN_Bus_Swc_Set("I_LDCU_SysStDisp1.I_LDCU_BMS_SOC_Disp 0"); // 测试步骤 TC_CANTest SET I_LDCU_SysStDisp1.I_LDCU_BMS_SOC_Disp 0
  g_EM_Equipment_Swc_TC_4G_Time_Delay_Second("1.5"); // 测试步骤 TC_Sleep 1.5
  g_EM_SOAClient_Swc_SOA_CHECK_Prepare("Veh_BodySts5_PowertrainStruct.Veh_BMS_SOC_Disp 0"); // 预期结果 TC_CANTest SOA check Veh_BodySts5_PowertrainStruct.Veh_BMS_SOC_Disp 0
  g_EM_SOAClient_Swc_SOA_CHECK("Veh_BodySts5_PowertrainStruct.Veh_BMS_SOC_Disp 0"); // 预期结果 TC_CANTest SOA check Veh_BodySts5_PowertrainStruct.Veh_BMS_SOC_Disp 0
}

testcase SYS_CDCU_jichufuwu_0059()
{
  TestDescription("基础服务-59");
  teststep("warning","原始用例id为SYS-CDCU-基础服务-0059");
  g_CAN_Bus_Swc_Set("I_LDCU_SysStDisp1.I_LDCU_BMS_SOC_Disp 18"); // 测试步骤 TC_CANTest SET I_LDCU_SysStDisp1.I_LDCU_BMS_SOC_Disp 18
  g_EM_Equipment_Swc_TC_4G_Time_Delay_Second("1.5"); // 测试步骤 TC_Sleep 1.5
  g_EM_SOAClient_Swc_SOA_CHECK_Prepare("Veh_BodySts5_PowertrainStruct.Veh_BMS_SOC_Disp 18"); // 预期结果 TC_CANTest SOA check Veh_BodySts5_PowertrainStruct.Veh_BMS_SOC_Disp 18
  g_EM_SOAClient_Swc_SOA_CHECK("Veh_BodySts5_PowertrainStruct.Veh_BMS_SOC_Disp 18"); // 预期结果 TC_CANTest SOA check Veh_BodySts5_PowertrainStruct.Veh_BMS_SOC_Disp 18
}

testcase SYS_CDCU_jichufuwu_0060()
{
  TestDescription("基础服务-60");
  teststep("warning","原始用例id为SYS-CDCU-基础服务-0060");
  g_CAN_Bus_Swc_Set("I_LDCU_SysStDisp1.I_LDCU_BMS_SOC_Disp 36"); // 测试步骤 TC_CANTest SET I_LDCU_SysStDisp1.I_LDCU_BMS_SOC_Disp 36
  g_EM_Equipment_Swc_TC_4G_Time_Delay_Second("1.5"); // 测试步骤 TC_Sleep 1.5
  g_EM_SOAClient_Swc_SOA_CHECK_Prepare("Veh_BodySts5_PowertrainStruct.Veh_BMS_SOC_Disp 36"); // 预期结果 TC_CANTest SOA check Veh_BodySts5_PowertrainStruct.Veh_BMS_SOC_Disp 36
  g_EM_SOAClient_Swc_SOA_CHECK("Veh_BodySts5_PowertrainStruct.Veh_BMS_SOC_Disp 36"); // 预期结果 TC_CANTest SOA check Veh_BodySts5_PowertrainStruct.Veh_BMS_SOC_Disp 36
}

testcase SYS_CDCU_jichufuwu_0061()
{
  TestDescription("基础服务-61");
  teststep("warning","原始用例id为SYS-CDCU-基础服务-0061");
  g_CAN_Bus_Swc_Set("I_LDCU_SysStDisp1.I_LDCU_BMS_SOC_Disp 50"); // 测试步骤 TC_CANTest SET I_LDCU_SysStDisp1.I_LDCU_BMS_SOC_Disp 50
  g_EM_Equipment_Swc_TC_4G_Time_Delay_Second("1.5"); // 测试步骤 TC_Sleep 1.5
  g_EM_SOAClient_Swc_SOA_CHECK_Prepare("Veh_BodySts5_PowertrainStruct.Veh_BMS_SOC_Disp 50"); // 预期结果 TC_CANTest SOA check Veh_BodySts5_PowertrainStruct.Veh_BMS_SOC_Disp 50
  g_EM_SOAClient_Swc_SOA_CHECK("Veh_BodySts5_PowertrainStruct.Veh_BMS_SOC_Disp 50"); // 预期结果 TC_CANTest SOA check Veh_BodySts5_PowertrainStruct.Veh_BMS_SOC_Disp 50
}

testcase SYS_CDCU_jichufuwu_0062()
{
  TestDescription("基础服务-62");
  teststep("warning","原始用例id为SYS-CDCU-基础服务-0062");
  g_CAN_Bus_Swc_Set("I_LDCU_SysStDisp1.I_LDCU_BMS_SOC_Disp 88"); // 测试步骤 TC_CANTest SET I_LDCU_SysStDisp1.I_LDCU_BMS_SOC_Disp 88
  g_EM_Equipment_Swc_TC_4G_Time_Delay_Second("1.5"); // 测试步骤 TC_Sleep 1.5
  g_EM_SOAClient_Swc_SOA_CHECK_Prepare("Veh_BodySts5_PowertrainStruct.Veh_BMS_SOC_Disp 88"); // 预期结果 TC_CANTest SOA check Veh_BodySts5_PowertrainStruct.Veh_BMS_SOC_Disp 88
  g_EM_SOAClient_Swc_SOA_CHECK("Veh_BodySts5_PowertrainStruct.Veh_BMS_SOC_Disp 88"); // 预期结果 TC_CANTest SOA check Veh_BodySts5_PowertrainStruct.Veh_BMS_SOC_Disp 88
}

testcase SYS_CDCU_jichufuwu_0063()
{
  TestDescription("基础服务-63");
  teststep("warning","原始用例id为SYS-CDCU-基础服务-0063");
  g_CAN_Bus_Swc_Set("I_LDCU_SysStDisp1.I_LDCU_BMS_SOC_Disp 100"); // 测试步骤 TC_CANTest SET I_LDCU_SysStDisp1.I_LDCU_BMS_SOC_Disp 100
  g_EM_Equipment_Swc_TC_4G_Time_Delay_Second("1.5"); // 测试步骤 TC_Sleep 1.5
  g_EM_SOAClient_Swc_SOA_CHECK_Prepare("Veh_BodySts5_PowertrainStruct.Veh_BMS_SOC_Disp 100"); // 预期结果 TC_CANTest SOA check Veh_BodySts5_PowertrainStruct.Veh_BMS_SOC_Disp 100
  g_EM_SOAClient_Swc_SOA_CHECK("Veh_BodySts5_PowertrainStruct.Veh_BMS_SOC_Disp 100"); // 预期结果 TC_CANTest SOA check Veh_BodySts5_PowertrainStruct.Veh_BMS_SOC_Disp 100
}

testcase SYS_CDCU_jichufuwu_0064()
{
  TestDescription("基础服务-64");
  teststep("warning","原始用例id为SYS-CDCU-基础服务-0064");
  g_CAN_Bus_Swc_Set("I_LDCU_BodySysSt1.I_LDCU_DrvSeatOccupancySt 0"); // 测试步骤 TC_CANTest SET I_LDCU_BodySysSt1.I_LDCU_DrvSeatOccupancySt 0
  g_CAN_Bus_Swc_Set("B_SRS_SysSt.B_SRS_DrvSeatBeltBuckleSt 0"); // 测试步骤 TC_CANTest SET B_SRS_SysSt.B_SRS_DrvSeatBeltBuckleSt 0
  g_EM_Equipment_Swc_TC_4G_Time_Delay_Second("1.5"); // 测试步骤 TC_Sleep 1.5
  g_EM_SOAClient_Swc_SOA_CHECK_Prepare("Veh_BodySts_SeatStruct.Veh_DrvSeatOccupancySt 0"); // 预期结果 TC_CANTest SOA check Veh_BodySts_SeatStruct.Veh_DrvSeatOccupancySt 0
  g_EM_SOAClient_Swc_SOA_CHECK("Veh_BodySts_SeatStruct.Veh_DrvSeatOccupancySt 0"); // 预期结果 TC_CANTest SOA check Veh_BodySts_SeatStruct.Veh_DrvSeatOccupancySt 0
}

testcase SYS_CDCU_jichufuwu_0065()
{
  TestDescription("基础服务-65");
  teststep("warning","原始用例id为SYS-CDCU-基础服务-0065");
  g_CAN_Bus_Swc_Set("I_LDCU_BodySysSt1.I_LDCU_DrvSeatOccupancySt 1"); // 测试步骤 TC_CANTest SET I_LDCU_BodySysSt1.I_LDCU_DrvSeatOccupancySt 1
  g_EM_Equipment_Swc_TC_4G_Time_Delay_Second("1.5"); // 测试步骤 TC_Sleep 1.5
  g_EM_SOAClient_Swc_SOA_CHECK_Prepare("Veh_BodySts_SeatStruct.Veh_DrvSeatOccupancySt 1"); // 预期结果 TC_CANTest SOA check Veh_BodySts_SeatStruct.Veh_DrvSeatOccupancySt 1
  g_EM_SOAClient_Swc_SOA_CHECK("Veh_BodySts_SeatStruct.Veh_DrvSeatOccupancySt 1"); // 预期结果 TC_CANTest SOA check Veh_BodySts_SeatStruct.Veh_DrvSeatOccupancySt 1
  g_CAN_Bus_Swc_Set("I_LDCU_BodySysSt1.I_LDCU_DrvSeatOccupancySt 0"); // 测试步骤 TC_CANTest SET I_LDCU_BodySysSt1.I_LDCU_DrvSeatOccupancySt 0
  g_EM_Equipment_Swc_TC_4G_Time_Delay_Second("7"); // 测试步骤 TC_Sleep 7
  g_EM_SOAClient_Swc_SOA_CHECK_Prepare("Veh_BodySts_SeatStruct.Veh_DrvSeatOccupancySt 1"); // 预期结果 TC_CANTest SOA check Veh_BodySts_SeatStruct.Veh_DrvSeatOccupancySt 1
  g_EM_SOAClient_Swc_SOA_CHECK("Veh_BodySts_SeatStruct.Veh_DrvSeatOccupancySt 1"); // 预期结果 TC_CANTest SOA check Veh_BodySts_SeatStruct.Veh_DrvSeatOccupancySt 1
  g_EM_Equipment_Swc_TC_4G_Time_Delay_Second("1.5"); // 测试步骤 TC_Sleep 1.5
  g_EM_SOAClient_Swc_SOA_CHECK_Prepare("Veh_BodySts_SeatStruct.Veh_DrvSeatOccupancySt 0"); // 预期结果 TC_CANTest SOA check Veh_BodySts_SeatStruct.Veh_DrvSeatOccupancySt 0
  g_EM_SOAClient_Swc_SOA_CHECK("Veh_BodySts_SeatStruct.Veh_DrvSeatOccupancySt 0"); // 预期结果 TC_CANTest SOA check Veh_BodySts_SeatStruct.Veh_DrvSeatOccupancySt 0
  g_CAN_Bus_Swc_Set("B_SRS_SysSt.B_SRS_DrvSeatBeltBuckleSt 1"); // 测试步骤 TC_CANTest SET B_SRS_SysSt.B_SRS_DrvSeatBeltBuckleSt 1
  g_EM_Equipment_Swc_TC_4G_Time_Delay_Second("1.5"); // 测试步骤 TC_Sleep 1.5
  g_EM_SOAClient_Swc_SOA_CHECK_Prepare("Veh_BodySts_SeatStruct.Veh_DrvSeatOccupancySt 1"); // 预期结果 TC_CANTest SOA check Veh_BodySts_SeatStruct.Veh_DrvSeatOccupancySt 1
  g_EM_SOAClient_Swc_SOA_CHECK("Veh_BodySts_SeatStruct.Veh_DrvSeatOccupancySt 1"); // 预期结果 TC_CANTest SOA check Veh_BodySts_SeatStruct.Veh_DrvSeatOccupancySt 1
  g_CAN_Bus_Swc_Set("B_SRS_SysSt.B_SRS_DrvSeatBeltBuckleSt 0"); // 测试步骤 TC_CANTest SET B_SRS_SysSt.B_SRS_DrvSeatBeltBuckleSt 0
  g_EM_Equipment_Swc_TC_4G_Time_Delay_Second("7"); // 测试步骤 TC_Sleep 7
  g_EM_SOAClient_Swc_SOA_CHECK_Prepare("Veh_BodySts_SeatStruct.Veh_DrvSeatOccupancySt 1"); // 预期结果 TC_CANTest SOA check Veh_BodySts_SeatStruct.Veh_DrvSeatOccupancySt 1
  g_EM_SOAClient_Swc_SOA_CHECK("Veh_BodySts_SeatStruct.Veh_DrvSeatOccupancySt 1"); // 预期结果 TC_CANTest SOA check Veh_BodySts_SeatStruct.Veh_DrvSeatOccupancySt 1
  g_EM_Equipment_Swc_TC_4G_Time_Delay_Second("1.5"); // 测试步骤 TC_Sleep 1.5
  g_EM_SOAClient_Swc_SOA_CHECK_Prepare("Veh_BodySts_SeatStruct.Veh_DrvSeatOccupancySt 0"); // 预期结果 TC_CANTest SOA check Veh_BodySts_SeatStruct.Veh_DrvSeatOccupancySt 0
  g_EM_SOAClient_Swc_SOA_CHECK("Veh_BodySts_SeatStruct.Veh_DrvSeatOccupancySt 0"); // 预期结果 TC_CANTest SOA check Veh_BodySts_SeatStruct.Veh_DrvSeatOccupancySt 0
}

testcase SYS_CDCU_jichufuwu_0066()
{
  TestDescription("基础服务-66");
  teststep("warning","原始用例id为SYS-CDCU-基础服务-0066");
  g_CAN_Bus_Swc_Set("I_RDCU_BodySysSt1.I_RDCU_PsngrSeatOccupancySt 0"); // 测试步骤 TC_CANTest SET I_RDCU_BodySysSt1.I_RDCU_PsngrSeatOccupancySt 0
  g_CAN_Bus_Swc_Set("B_SRS_SysSt.B_SRS_PsngrSeatBeltBuckleSt 0"); // 测试步骤 TC_CANTest SET B_SRS_SysSt.B_SRS_PsngrSeatBeltBuckleSt 0
  g_EM_Equipment_Swc_TC_4G_Time_Delay_Second("1.5"); // 测试步骤 TC_Sleep 1.5
  g_EM_SOAClient_Swc_SOA_CHECK_Prepare("Veh_BodySts_SeatStruct.Veh_PsngrSeatOccupancySt 0"); // 预期结果 TC_CANTest SOA check Veh_BodySts_SeatStruct.Veh_PsngrSeatOccupancySt 0
  g_EM_SOAClient_Swc_SOA_CHECK("Veh_BodySts_SeatStruct.Veh_PsngrSeatOccupancySt 0"); // 预期结果 TC_CANTest SOA check Veh_BodySts_SeatStruct.Veh_PsngrSeatOccupancySt 0
}

testcase SYS_CDCU_jichufuwu_0067()
{
  TestDescription("基础服务-67");
  teststep("warning","原始用例id为SYS-CDCU-基础服务-0067");
  g_CAN_Bus_Swc_Set("I_RDCU_BodySysSt1.I_RDCU_PsngrSeatOccupancySt 1"); // 测试步骤 TC_CANTest SET I_RDCU_BodySysSt1.I_RDCU_PsngrSeatOccupancySt 1
  g_EM_Equipment_Swc_TC_4G_Time_Delay_Second("1.5"); // 测试步骤 TC_Sleep 1.5
  g_EM_SOAClient_Swc_SOA_CHECK_Prepare("Veh_BodySts_SeatStruct.Veh_PsngrSeatOccupancySt 1"); // 预期结果 TC_CANTest SOA check Veh_BodySts_SeatStruct.Veh_PsngrSeatOccupancySt 1
  g_EM_SOAClient_Swc_SOA_CHECK("Veh_BodySts_SeatStruct.Veh_PsngrSeatOccupancySt 1"); // 预期结果 TC_CANTest SOA check Veh_BodySts_SeatStruct.Veh_PsngrSeatOccupancySt 1
  g_CAN_Bus_Swc_Set("I_RDCU_BodySysSt1.I_RDCU_PsngrSeatOccupancySt 0"); // 测试步骤 TC_CANTest SET I_RDCU_BodySysSt1.I_RDCU_PsngrSeatOccupancySt 0
  g_EM_Equipment_Swc_TC_4G_Time_Delay_Second("7"); // 测试步骤 TC_Sleep 7
  g_EM_SOAClient_Swc_SOA_CHECK_Prepare("Veh_BodySts_SeatStruct.Veh_PsngrSeatOccupancySt 1"); // 预期结果 TC_CANTest SOA check Veh_BodySts_SeatStruct.Veh_PsngrSeatOccupancySt 1
  g_EM_SOAClient_Swc_SOA_CHECK("Veh_BodySts_SeatStruct.Veh_PsngrSeatOccupancySt 1"); // 预期结果 TC_CANTest SOA check Veh_BodySts_SeatStruct.Veh_PsngrSeatOccupancySt 1
  g_EM_Equipment_Swc_TC_4G_Time_Delay_Second("1.5"); // 测试步骤 TC_Sleep 1.5
  g_EM_SOAClient_Swc_SOA_CHECK_Prepare("Veh_BodySts_SeatStruct.Veh_PsngrSeatOccupancySt 0"); // 预期结果 TC_CANTest SOA check Veh_BodySts_SeatStruct.Veh_PsngrSeatOccupancySt 0
  g_EM_SOAClient_Swc_SOA_CHECK("Veh_BodySts_SeatStruct.Veh_PsngrSeatOccupancySt 0"); // 预期结果 TC_CANTest SOA check Veh_BodySts_SeatStruct.Veh_PsngrSeatOccupancySt 0
  g_CAN_Bus_Swc_Set("B_SRS_SysSt.B_SRS_PsngrSeatBeltBuckleSt 1"); // 测试步骤 TC_CANTest SET B_SRS_SysSt.B_SRS_PsngrSeatBeltBuckleSt 1
  g_EM_Equipment_Swc_TC_4G_Time_Delay_Second("1.5"); // 测试步骤 TC_Sleep 1.5
  g_EM_SOAClient_Swc_SOA_CHECK_Prepare("Veh_BodySts_SeatStruct.Veh_PsngrSeatOccupancySt 1"); // 预期结果 TC_CANTest SOA check Veh_BodySts_SeatStruct.Veh_PsngrSeatOccupancySt 1
  g_EM_SOAClient_Swc_SOA_CHECK("Veh_BodySts_SeatStruct.Veh_PsngrSeatOccupancySt 1"); // 预期结果 TC_CANTest SOA check Veh_BodySts_SeatStruct.Veh_PsngrSeatOccupancySt 1
  g_CAN_Bus_Swc_Set("B_SRS_SysSt.B_SRS_PsngrSeatBeltBuckleSt 0"); // 测试步骤 TC_CANTest SET B_SRS_SysSt.B_SRS_PsngrSeatBeltBuckleSt 0
  g_EM_Equipment_Swc_TC_4G_Time_Delay_Second("7"); // 测试步骤 TC_Sleep 7
  g_EM_SOAClient_Swc_SOA_CHECK_Prepare("Veh_BodySts_SeatStruct.Veh_PsngrSeatOccupancySt 1"); // 预期结果 TC_CANTest SOA check Veh_BodySts_SeatStruct.Veh_PsngrSeatOccupancySt 1
  g_EM_SOAClient_Swc_SOA_CHECK("Veh_BodySts_SeatStruct.Veh_PsngrSeatOccupancySt 1"); // 预期结果 TC_CANTest SOA check Veh_BodySts_SeatStruct.Veh_PsngrSeatOccupancySt 1
  g_EM_Equipment_Swc_TC_4G_Time_Delay_Second("1.5"); // 测试步骤 TC_Sleep 1.5
  g_EM_SOAClient_Swc_SOA_CHECK_Prepare("Veh_BodySts_SeatStruct.Veh_PsngrSeatOccupancySt 0"); // 预期结果 TC_CANTest SOA check Veh_BodySts_SeatStruct.Veh_PsngrSeatOccupancySt 0
  g_EM_SOAClient_Swc_SOA_CHECK("Veh_BodySts_SeatStruct.Veh_PsngrSeatOccupancySt 0"); // 预期结果 TC_CANTest SOA check Veh_BodySts_SeatStruct.Veh_PsngrSeatOccupancySt 0
}

testcase SYS_CDCU_jichufuwu_0068()
{
  TestDescription("基础服务-68");
  teststep("warning","原始用例id为SYS-CDCU-基础服务-0068");
  g_CAN_Bus_Swc_Set("I_LDCU_BodySysSt1.I_LDCU_RLSeatOccupancySt 0"); // 测试步骤 TC_CANTest SET I_LDCU_BodySysSt1.I_LDCU_RLSeatOccupancySt 0
  g_CAN_Bus_Swc_Set("B_SRS_SysSt.B_SRS_2ndLeftSeatBeltBuckleSt 0"); // 测试步骤 TC_CANTest SET B_SRS_SysSt.B_SRS_2ndLeftSeatBeltBuckleSt 0
  g_EM_Equipment_Swc_TC_4G_Time_Delay_Second("1.5"); // 测试步骤 TC_Sleep 1.5
  g_EM_SOAClient_Swc_SOA_CHECK_Prepare("Veh_BodySts_SeatStruct.Veh_SecRowLtSeatOccupancySt 0"); // 预期结果 TC_CANTest SOA check Veh_BodySts_SeatStruct.Veh_SecRowLtSeatOccupancySt 0
  g_EM_SOAClient_Swc_SOA_CHECK("Veh_BodySts_SeatStruct.Veh_SecRowLtSeatOccupancySt 0"); // 预期结果 TC_CANTest SOA check Veh_BodySts_SeatStruct.Veh_SecRowLtSeatOccupancySt 0
}

testcase SYS_CDCU_jichufuwu_0069()
{
  TestDescription("基础服务-69");
  teststep("warning","原始用例id为SYS-CDCU-基础服务-0069");
  g_CAN_Bus_Swc_Set("I_LDCU_BodySysSt1.I_LDCU_RLSeatOccupancySt 1"); // 测试步骤 TC_CANTest SET I_LDCU_BodySysSt1.I_LDCU_RLSeatOccupancySt 1
  g_EM_SOAClient_Swc_SOA_CHECK_Prepare("Veh_WindowService_ErrStruct.OpeErrInfo[0-1]:0x9 traceback7"); // 预期结果 TC_CANTest SOA check Veh_WindowService_ErrStruct.OpeErrInfo[0-1]:0x9 traceback7
  g_EM_Equipment_Swc_TC_4G_Time_Delay_Second("7"); // 测试步骤 TC_Sleep 7
  g_EM_SOAClient_Swc_SOA_CHECK("Veh_WindowService_ErrStruct.OpeErrInfo[0-1]:0x9 traceback7"); // 预期结果 TC_CANTest SOA check Veh_WindowService_ErrStruct.OpeErrInfo[0-1]:0x9 traceback7
  g_EM_SOAClient_Swc_SOA_REQ("Veh_CtrlAllWinUpDownStruct.Veh_CtrlAllWinAutoupDown:1&ServiceExecuteFeedbackFlag:2&UserID:0x01000002"); // 测试步骤 TC_CANTest SOA REQ Veh_CtrlAllWinUpDownStruct.Veh_CtrlAllWinAutoupDown:1&ServiceExecuteFeedbackFlag:2&UserID:0x01000002 //Auto Up
  g_EM_SOAClient_Swc_SOA_CHECK_Prepare("Veh_WindowService_ErrStruct.OpeErrInfo[0-1]:0x9 traceback3"); // 预期结果 TC_CANTest SOA check Veh_WindowService_ErrStruct.OpeErrInfo[0-1]:0x9 traceback3
  g_EM_SOAClient_Swc_SOA_REQ("Veh_CtrlAllWinUpDownStruct.Veh_CtrlAllWinAutoupDown:1&ServiceExecuteFeedbackFlag:2&UserID:0x01000002"); // 测试步骤 TC_CANTest SOA REQ Veh_CtrlAllWinUpDownStruct.Veh_CtrlAllWinAutoupDown:1&ServiceExecuteFeedbackFlag:2&UserID:0x01000002 //Auto Up
  g_EM_Equipment_Swc_TC_4G_Time_Delay_Second("1.5"); // 测试步骤 TC_Sleep 1.5
  g_EM_SOAClient_Swc_SOA_CHECK_Prepare("Veh_BodySts_SeatStruct.Veh_SecRowLtSeatOccupancySt 1"); // 预期结果 TC_CANTest SOA check Veh_BodySts_SeatStruct.Veh_SecRowLtSeatOccupancySt 1
  g_CAN_Bus_Swc_Set("B_SRS_SysSt.B_SRS_2ndLeftSeatBeltBuckleSt 0"); // 测试步骤 TC_CANTest SET B_SRS_SysSt.B_SRS_2ndLeftSeatBeltBuckleSt 0
  g_EM_SOAClient_Swc_SOA_CHECK("Veh_WindowService_ErrStruct.OpeErrInfo[0-1]:0x9 traceback3"); // 预期结果 TC_CANTest SOA check Veh_WindowService_ErrStruct.OpeErrInfo[0-1]:0x9 traceback3
  g_EM_SOAClient_Swc_SOA_CHECK("Veh_BodySts_SeatStruct.Veh_SecRowLtSeatOccupancySt 1"); // 预期结果 TC_CANTest SOA check Veh_BodySts_SeatStruct.Veh_SecRowLtSeatOccupancySt 1
  g_EM_Equipment_Swc_TC_4G_Time_Delay_Second("1.5"); // 测试步骤 TC_Sleep 1.5
  g_EM_SOAClient_Swc_SOA_CHECK_Prepare("Veh_BodySts_SeatStruct.Veh_SecRowLtSeatOccupancySt 0"); // 预期结果 TC_CANTest SOA check Veh_BodySts_SeatStruct.Veh_SecRowLtSeatOccupancySt 0
  g_EM_SOAClient_Swc_SOA_CHECK("Veh_BodySts_SeatStruct.Veh_SecRowLtSeatOccupancySt 0"); // 预期结果 TC_CANTest SOA check Veh_BodySts_SeatStruct.Veh_SecRowLtSeatOccupancySt 0
}

testcase SYS_CDCU_jichufuwu_0070()
{
  TestDescription("基础服务-70");
  teststep("warning","原始用例id为SYS-CDCU-基础服务-0070");
  g_CAN_Bus_Swc_Set("I_RDCU_BodySysSt1.I_RDCU_RMSeatOccupancySt 0"); // 测试步骤 TC_CANTest SET I_RDCU_BodySysSt1.I_RDCU_RMSeatOccupancySt 0
  g_CAN_Bus_Swc_Set("B_SRS_SysSt.B_SRS_2ndMiddleBeltBuckleSt 0"); // 测试步骤 TC_CANTest SET B_SRS_SysSt.B_SRS_2ndMiddleBeltBuckleSt 0
  g_EM_Equipment_Swc_TC_4G_Time_Delay_Second("1.5"); // 测试步骤 TC_Sleep 1.5
  g_EM_SOAClient_Swc_SOA_CHECK_Prepare("Veh_BodySts_SeatStruct.Veh_SecRowMidSeatOccupancySt 0"); // 预期结果 TC_CANTest SOA check Veh_BodySts_SeatStruct.Veh_SecRowMidSeatOccupancySt 0
  g_EM_SOAClient_Swc_SOA_CHECK("Veh_BodySts_SeatStruct.Veh_SecRowMidSeatOccupancySt 0"); // 预期结果 TC_CANTest SOA check Veh_BodySts_SeatStruct.Veh_SecRowMidSeatOccupancySt 0
}

testcase SYS_CDCU_jichufuwu_0071()
{
  TestDescription("基础服务-71");
  teststep("warning","原始用例id为SYS-CDCU-基础服务-0071");
  g_CAN_Bus_Swc_Set("I_RDCU_BodySysSt1.I_RDCU_RMSeatOccupancySt 1"); // 测试步骤 TC_CANTest SET I_RDCU_BodySysSt1.I_RDCU_RMSeatOccupancySt 1
  g_EM_Equipment_Swc_TC_4G_Time_Delay_Second("1.5"); // 测试步骤 TC_Sleep 1.5
  g_EM_SOAClient_Swc_SOA_CHECK_Prepare("Veh_BodySts_SeatStruct.Veh_SecRowMidSeatOccupancySt 1"); // 预期结果 TC_CANTest SOA check Veh_BodySts_SeatStruct.Veh_SecRowMidSeatOccupancySt 1
  g_EM_SOAClient_Swc_SOA_CHECK("Veh_BodySts_SeatStruct.Veh_SecRowMidSeatOccupancySt 1"); // 预期结果 TC_CANTest SOA check Veh_BodySts_SeatStruct.Veh_SecRowMidSeatOccupancySt 1
  g_CAN_Bus_Swc_Set("I_RDCU_BodySysSt1.I_RDCU_RMSeatOccupancySt 0"); // 测试步骤 TC_CANTest SET I_RDCU_BodySysSt1.I_RDCU_RMSeatOccupancySt 0
  g_EM_Equipment_Swc_TC_4G_Time_Delay_Second("7"); // 测试步骤 TC_Sleep 7
  g_EM_SOAClient_Swc_SOA_CHECK_Prepare("Veh_BodySts_SeatStruct.Veh_SecRowMidSeatOccupancySt 1"); // 预期结果 TC_CANTest SOA check Veh_BodySts_SeatStruct.Veh_SecRowMidSeatOccupancySt 1
  g_EM_SOAClient_Swc_SOA_CHECK("Veh_BodySts_SeatStruct.Veh_SecRowMidSeatOccupancySt 1"); // 预期结果 TC_CANTest SOA check Veh_BodySts_SeatStruct.Veh_SecRowMidSeatOccupancySt 1
  g_EM_Equipment_Swc_TC_4G_Time_Delay_Second("1.5"); // 测试步骤 TC_Sleep 1.5
  g_EM_SOAClient_Swc_SOA_CHECK_Prepare("Veh_BodySts_SeatStruct.Veh_SecRowMidSeatOccupancySt 0"); // 预期结果 TC_CANTest SOA check Veh_BodySts_SeatStruct.Veh_SecRowMidSeatOccupancySt 0
  g_EM_SOAClient_Swc_SOA_CHECK("Veh_BodySts_SeatStruct.Veh_SecRowMidSeatOccupancySt 0"); // 预期结果 TC_CANTest SOA check Veh_BodySts_SeatStruct.Veh_SecRowMidSeatOccupancySt 0
  g_CAN_Bus_Swc_Set("B_SRS_SysSt.B_SRS_2ndMiddleBeltBuckleSt 1"); // 测试步骤 TC_CANTest SET B_SRS_SysSt.B_SRS_2ndMiddleBeltBuckleSt 1
  g_EM_Equipment_Swc_TC_4G_Time_Delay_Second("1.5"); // 测试步骤 TC_Sleep 1.5
  g_EM_SOAClient_Swc_SOA_CHECK_Prepare("Veh_BodySts_SeatStruct.Veh_SecRowMidSeatOccupancySt 1"); // 预期结果 TC_CANTest SOA check Veh_BodySts_SeatStruct.Veh_SecRowMidSeatOccupancySt 1
  g_EM_SOAClient_Swc_SOA_CHECK("Veh_BodySts_SeatStruct.Veh_SecRowMidSeatOccupancySt 1"); // 预期结果 TC_CANTest SOA check Veh_BodySts_SeatStruct.Veh_SecRowMidSeatOccupancySt 1
  g_CAN_Bus_Swc_Set("B_SRS_SysSt.B_SRS_2ndMiddleBeltBuckleSt 0"); // 测试步骤 TC_CANTest SET B_SRS_SysSt.B_SRS_2ndMiddleBeltBuckleSt 0
  g_EM_Equipment_Swc_TC_4G_Time_Delay_Second("7"); // 测试步骤 TC_Sleep 7
  g_EM_SOAClient_Swc_SOA_CHECK_Prepare("Veh_BodySts_SeatStruct.Veh_SecRowMidSeatOccupancySt 1"); // 预期结果 TC_CANTest SOA check Veh_BodySts_SeatStruct.Veh_SecRowMidSeatOccupancySt 1
  g_EM_SOAClient_Swc_SOA_CHECK("Veh_BodySts_SeatStruct.Veh_SecRowMidSeatOccupancySt 1"); // 预期结果 TC_CANTest SOA check Veh_BodySts_SeatStruct.Veh_SecRowMidSeatOccupancySt 1
  g_EM_Equipment_Swc_TC_4G_Time_Delay_Second("1.5"); // 测试步骤 TC_Sleep 1.5
  g_EM_SOAClient_Swc_SOA_CHECK_Prepare("Veh_BodySts_SeatStruct.Veh_SecRowMidSeatOccupancySt 0"); // 预期结果 TC_CANTest SOA check Veh_BodySts_SeatStruct.Veh_SecRowMidSeatOccupancySt 0
  g_EM_SOAClient_Swc_SOA_CHECK("Veh_BodySts_SeatStruct.Veh_SecRowMidSeatOccupancySt 0"); // 预期结果 TC_CANTest SOA check Veh_BodySts_SeatStruct.Veh_SecRowMidSeatOccupancySt 0
}

testcase SYS_CDCU_jichufuwu_0072()
{
  TestDescription("基础服务-72");
  teststep("warning","原始用例id为SYS-CDCU-基础服务-0072");
  g_CAN_Bus_Swc_Set("I_RDCU_BodySysSt1.I_RDCU_RRSeatOccupancySt 0"); // 测试步骤 TC_CANTest SET I_RDCU_BodySysSt1.I_RDCU_RRSeatOccupancySt 0
  g_CAN_Bus_Swc_Set("B_SRS_SysSt.B_SRS_2ndRightSeatBeltBuckleSt 0"); // 测试步骤 TC_CANTest SET B_SRS_SysSt.B_SRS_2ndRightSeatBeltBuckleSt 0
  g_EM_Equipment_Swc_TC_4G_Time_Delay_Second("1.5"); // 测试步骤 TC_Sleep 1.5
  g_EM_SOAClient_Swc_SOA_CHECK_Prepare("Veh_BodySts_SeatStruct.Veh_SecRowRtSeatOccupancySt 0"); // 预期结果 TC_CANTest SOA check Veh_BodySts_SeatStruct.Veh_SecRowRtSeatOccupancySt 0
  g_EM_SOAClient_Swc_SOA_CHECK("Veh_BodySts_SeatStruct.Veh_SecRowRtSeatOccupancySt 0"); // 预期结果 TC_CANTest SOA check Veh_BodySts_SeatStruct.Veh_SecRowRtSeatOccupancySt 0
}

testcase SYS_CDCU_jichufuwu_0073()
{
  TestDescription("基础服务-73");
  teststep("warning","原始用例id为SYS-CDCU-基础服务-0073");
  g_CAN_Bus_Swc_Set("I_RDCU_BodySysSt1.I_RDCU_RRSeatOccupancySt 1"); // 测试步骤 TC_CANTest SET I_RDCU_BodySysSt1.I_RDCU_RRSeatOccupancySt 1
  g_EM_Equipment_Swc_TC_4G_Time_Delay_Second("1.5"); // 测试步骤 TC_Sleep 1.5
  g_EM_SOAClient_Swc_SOA_CHECK_Prepare("Veh_BodySts_SeatStruct.Veh_SecRowRtSeatOccupancySt 1"); // 预期结果 TC_CANTest SOA check Veh_BodySts_SeatStruct.Veh_SecRowRtSeatOccupancySt 1
  g_EM_SOAClient_Swc_SOA_CHECK("Veh_BodySts_SeatStruct.Veh_SecRowRtSeatOccupancySt 1"); // 预期结果 TC_CANTest SOA check Veh_BodySts_SeatStruct.Veh_SecRowRtSeatOccupancySt 1
  g_CAN_Bus_Swc_Set("I_RDCU_BodySysSt1.I_RDCU_RRSeatOccupancySt 0"); // 测试步骤 TC_CANTest SET I_RDCU_BodySysSt1.I_RDCU_RRSeatOccupancySt 0
  g_EM_Equipment_Swc_TC_4G_Time_Delay_Second("7"); // 测试步骤 TC_Sleep 7
  g_EM_SOAClient_Swc_SOA_CHECK_Prepare("Veh_BodySts_SeatStruct.Veh_SecRowRtSeatOccupancySt 1"); // 预期结果 TC_CANTest SOA check Veh_BodySts_SeatStruct.Veh_SecRowRtSeatOccupancySt 1
  g_EM_SOAClient_Swc_SOA_CHECK("Veh_BodySts_SeatStruct.Veh_SecRowRtSeatOccupancySt 1"); // 预期结果 TC_CANTest SOA check Veh_BodySts_SeatStruct.Veh_SecRowRtSeatOccupancySt 1
  g_EM_Equipment_Swc_TC_4G_Time_Delay_Second("1.5"); // 测试步骤 TC_Sleep 1.5
  g_EM_SOAClient_Swc_SOA_CHECK_Prepare("Veh_BodySts_SeatStruct.Veh_SecRowRtSeatOccupancySt 0"); // 预期结果 TC_CANTest SOA check Veh_BodySts_SeatStruct.Veh_SecRowRtSeatOccupancySt 0
  g_EM_SOAClient_Swc_SOA_CHECK("Veh_BodySts_SeatStruct.Veh_SecRowRtSeatOccupancySt 0"); // 预期结果 TC_CANTest SOA check Veh_BodySts_SeatStruct.Veh_SecRowRtSeatOccupancySt 0
  g_CAN_Bus_Swc_Set("B_SRS_SysSt.B_SRS_2ndRightSeatBeltBuckleSt 1"); // 测试步骤 TC_CANTest SET B_SRS_SysSt.B_SRS_2ndRightSeatBeltBuckleSt 1
  g_EM_Equipment_Swc_TC_4G_Time_Delay_Second("1.5"); // 测试步骤 TC_Sleep 1.5
  g_EM_SOAClient_Swc_SOA_CHECK_Prepare("Veh_BodySts_SeatStruct.Veh_SecRowRtSeatOccupancySt 1"); // 预期结果 TC_CANTest SOA check Veh_BodySts_SeatStruct.Veh_SecRowRtSeatOccupancySt 1
  g_EM_SOAClient_Swc_SOA_CHECK("Veh_BodySts_SeatStruct.Veh_SecRowRtSeatOccupancySt 1"); // 预期结果 TC_CANTest SOA check Veh_BodySts_SeatStruct.Veh_SecRowRtSeatOccupancySt 1
  g_CAN_Bus_Swc_Set("B_SRS_SysSt.B_SRS_2ndRightSeatBeltBuckleSt 0"); // 测试步骤 TC_CANTest SET B_SRS_SysSt.B_SRS_2ndRightSeatBeltBuckleSt 0
  g_EM_Equipment_Swc_TC_4G_Time_Delay_Second("7"); // 测试步骤 TC_Sleep 7
  g_EM_SOAClient_Swc_SOA_CHECK_Prepare("Veh_BodySts_SeatStruct.Veh_SecRowRtSeatOccupancySt 1"); // 预期结果 TC_CANTest SOA check Veh_BodySts_SeatStruct.Veh_SecRowRtSeatOccupancySt 1
  g_EM_SOAClient_Swc_SOA_CHECK("Veh_BodySts_SeatStruct.Veh_SecRowRtSeatOccupancySt 1"); // 预期结果 TC_CANTest SOA check Veh_BodySts_SeatStruct.Veh_SecRowRtSeatOccupancySt 1
  g_EM_Equipment_Swc_TC_4G_Time_Delay_Second("1.5"); // 测试步骤 TC_Sleep 1.5
  g_EM_SOAClient_Swc_SOA_CHECK_Prepare("Veh_BodySts_SeatStruct.Veh_SecRowRtSeatOccupancySt 0"); // 预期结果 TC_CANTest SOA check Veh_BodySts_SeatStruct.Veh_SecRowRtSeatOccupancySt 0
  g_EM_SOAClient_Swc_SOA_CHECK("Veh_BodySts_SeatStruct.Veh_SecRowRtSeatOccupancySt 0"); // 预期结果 TC_CANTest SOA check Veh_BodySts_SeatStruct.Veh_SecRowRtSeatOccupancySt 0
}

testcase SYS_CDCU_jichufuwu_0074()
{
  TestDescription("基础服务-74");
  teststep("warning","原始用例id为SYS-CDCU-基础服务-0074");
  g_CAN_Bus_Swc_Set("I_LDCU_SeatInfo.I_LDCU_TrdRowLtSeatOccupancySt 0"); // 测试步骤 TC_CANTest SET I_LDCU_SeatInfo.I_LDCU_TrdRowLtSeatOccupancySt 0
  g_CAN_Bus_Swc_Set("I_LDCU_SeatInfo.I_LDCU_TrdRowLtSeatBeltBuckleSt 0"); // 测试步骤 TC_CANTest SET I_LDCU_SeatInfo.I_LDCU_TrdRowLtSeatBeltBuckleSt 0
  g_EM_Equipment_Swc_TC_4G_Time_Delay_Second("1.5"); // 测试步骤 TC_Sleep 1.5
  g_EM_SOAClient_Swc_SOA_CHECK_Prepare("Veh_BodySts_SeatStruct.Veh_TrdRowLtSeatOccupancySt 0"); // 预期结果 TC_CANTest SOA check Veh_BodySts_SeatStruct.Veh_TrdRowLtSeatOccupancySt 0
  g_EM_SOAClient_Swc_SOA_CHECK("Veh_BodySts_SeatStruct.Veh_TrdRowLtSeatOccupancySt 0"); // 预期结果 TC_CANTest SOA check Veh_BodySts_SeatStruct.Veh_TrdRowLtSeatOccupancySt 0
}

testcase SYS_CDCU_jichufuwu_0075()
{
  TestDescription("基础服务-75");
  teststep("warning","原始用例id为SYS-CDCU-基础服务-0075");
  g_CAN_Bus_Swc_Set("I_LDCU_SeatInfo.I_LDCU_TrdRowLtSeatOccupancySt 1"); // 测试步骤 TC_CANTest SET I_LDCU_SeatInfo.I_LDCU_TrdRowLtSeatOccupancySt 1
  g_EM_Equipment_Swc_TC_4G_Time_Delay_Second("1.5"); // 测试步骤 TC_Sleep 1.5
  g_EM_SOAClient_Swc_SOA_CHECK_Prepare("Veh_BodySts_SeatStruct.Veh_TrdRowLtSeatOccupancySt 1"); // 预期结果 TC_CANTest SOA check Veh_BodySts_SeatStruct.Veh_TrdRowLtSeatOccupancySt 1
  g_EM_SOAClient_Swc_SOA_CHECK("Veh_BodySts_SeatStruct.Veh_TrdRowLtSeatOccupancySt 1"); // 预期结果 TC_CANTest SOA check Veh_BodySts_SeatStruct.Veh_TrdRowLtSeatOccupancySt 1
  g_CAN_Bus_Swc_Set("I_LDCU_SeatInfo.I_LDCU_TrdRowLtSeatOccupancySt 0"); // 测试步骤 TC_CANTest SET I_LDCU_SeatInfo.I_LDCU_TrdRowLtSeatOccupancySt 0
  g_EM_Equipment_Swc_TC_4G_Time_Delay_Second("7"); // 测试步骤 TC_Sleep 7
  g_EM_SOAClient_Swc_SOA_CHECK_Prepare("Veh_BodySts_SeatStruct.Veh_TrdRowLtSeatOccupancySt 1"); // 预期结果 TC_CANTest SOA check Veh_BodySts_SeatStruct.Veh_TrdRowLtSeatOccupancySt 1
  g_EM_SOAClient_Swc_SOA_CHECK("Veh_BodySts_SeatStruct.Veh_TrdRowLtSeatOccupancySt 1"); // 预期结果 TC_CANTest SOA check Veh_BodySts_SeatStruct.Veh_TrdRowLtSeatOccupancySt 1
  g_EM_Equipment_Swc_TC_4G_Time_Delay_Second("1.5"); // 测试步骤 TC_Sleep 1.5
  g_EM_SOAClient_Swc_SOA_CHECK_Prepare("Veh_BodySts_SeatStruct.Veh_TrdRowLtSeatOccupancySt 0"); // 预期结果 TC_CANTest SOA check Veh_BodySts_SeatStruct.Veh_TrdRowLtSeatOccupancySt 0
  g_EM_SOAClient_Swc_SOA_CHECK("Veh_BodySts_SeatStruct.Veh_TrdRowLtSeatOccupancySt 0"); // 预期结果 TC_CANTest SOA check Veh_BodySts_SeatStruct.Veh_TrdRowLtSeatOccupancySt 0
  g_CAN_Bus_Swc_Set("I_LDCU_SeatInfo.I_LDCU_TrdRowLtSeatBeltBuckleSt 1"); // 测试步骤 TC_CANTest SET I_LDCU_SeatInfo.I_LDCU_TrdRowLtSeatBeltBuckleSt 1
  g_EM_Equipment_Swc_TC_4G_Time_Delay_Second("1.5"); // 测试步骤 TC_Sleep 1.5
  g_EM_SOAClient_Swc_SOA_CHECK_Prepare("Veh_BodySts_SeatStruct.Veh_TrdRowLtSeatOccupancySt 1"); // 预期结果 TC_CANTest SOA check Veh_BodySts_SeatStruct.Veh_TrdRowLtSeatOccupancySt 1
  g_EM_SOAClient_Swc_SOA_CHECK("Veh_BodySts_SeatStruct.Veh_TrdRowLtSeatOccupancySt 1"); // 预期结果 TC_CANTest SOA check Veh_BodySts_SeatStruct.Veh_TrdRowLtSeatOccupancySt 1
  g_CAN_Bus_Swc_Set("I_LDCU_SeatInfo.I_LDCU_TrdRowLtSeatBeltBuckleSt 0"); // 测试步骤 TC_CANTest SET I_LDCU_SeatInfo.I_LDCU_TrdRowLtSeatBeltBuckleSt 0
  g_EM_Equipment_Swc_TC_4G_Time_Delay_Second("7"); // 测试步骤 TC_Sleep 7
  g_EM_SOAClient_Swc_SOA_CHECK_Prepare("Veh_BodySts_SeatStruct.Veh_TrdRowLtSeatOccupancySt 1"); // 预期结果 TC_CANTest SOA check Veh_BodySts_SeatStruct.Veh_TrdRowLtSeatOccupancySt 1
  g_EM_SOAClient_Swc_SOA_CHECK("Veh_BodySts_SeatStruct.Veh_TrdRowLtSeatOccupancySt 1"); // 预期结果 TC_CANTest SOA check Veh_BodySts_SeatStruct.Veh_TrdRowLtSeatOccupancySt 1
  g_EM_Equipment_Swc_TC_4G_Time_Delay_Second("1.5"); // 测试步骤 TC_Sleep 1.5
  g_EM_SOAClient_Swc_SOA_CHECK_Prepare("Veh_BodySts_SeatStruct.Veh_TrdRowLtSeatOccupancySt 0"); // 预期结果 TC_CANTest SOA check Veh_BodySts_SeatStruct.Veh_TrdRowLtSeatOccupancySt 0
  g_EM_SOAClient_Swc_SOA_CHECK("Veh_BodySts_SeatStruct.Veh_TrdRowLtSeatOccupancySt 0"); // 预期结果 TC_CANTest SOA check Veh_BodySts_SeatStruct.Veh_TrdRowLtSeatOccupancySt 0
}

testcase SYS_CDCU_jichufuwu_0076()
{
  TestDescription("基础服务-76");
  teststep("warning","原始用例id为SYS-CDCU-基础服务-0076");
  g_CAN_Bus_Swc_Set("I_RDCU_SeatInfo.I_RDCU_TrdRowMidSeatOccupancySt 0"); // 测试步骤 TC_CANTest SET I_RDCU_SeatInfo.I_RDCU_TrdRowMidSeatOccupancySt 0
  g_CAN_Bus_Swc_Set("I_LDCU_SeatInfo.I_LDCU_TrdRowMidSeatBeltBuckleSt 0"); // 测试步骤 TC_CANTest SET I_LDCU_SeatInfo.I_LDCU_TrdRowMidSeatBeltBuckleSt 0
  g_EM_Equipment_Swc_TC_4G_Time_Delay_Second("1.5"); // 测试步骤 TC_Sleep 1.5
  g_EM_SOAClient_Swc_SOA_CHECK_Prepare("Veh_BodySts_SeatStruct.Veh_TrdRowMidSeatOccupancySt 0"); // 预期结果 TC_CANTest SOA check Veh_BodySts_SeatStruct.Veh_TrdRowMidSeatOccupancySt 0
  g_EM_SOAClient_Swc_SOA_CHECK("Veh_BodySts_SeatStruct.Veh_TrdRowMidSeatOccupancySt 0"); // 预期结果 TC_CANTest SOA check Veh_BodySts_SeatStruct.Veh_TrdRowMidSeatOccupancySt 0
}

testcase SYS_CDCU_jichufuwu_0077()
{
  TestDescription("基础服务-77");
  teststep("warning","原始用例id为SYS-CDCU-基础服务-0077");
  g_CAN_Bus_Swc_Set("I_RDCU_SeatInfo.I_RDCU_TrdRowMidSeatOccupancySt 1"); // 测试步骤 TC_CANTest SET I_RDCU_SeatInfo.I_RDCU_TrdRowMidSeatOccupancySt 1
  g_EM_Equipment_Swc_TC_4G_Time_Delay_Second("1.5"); // 测试步骤 TC_Sleep 1.5
  g_EM_SOAClient_Swc_SOA_CHECK_Prepare("Veh_BodySts_SeatStruct.Veh_TrdRowMidSeatOccupancySt 1"); // 预期结果 TC_CANTest SOA check Veh_BodySts_SeatStruct.Veh_TrdRowMidSeatOccupancySt 1
  g_EM_SOAClient_Swc_SOA_CHECK("Veh_BodySts_SeatStruct.Veh_TrdRowMidSeatOccupancySt 1"); // 预期结果 TC_CANTest SOA check Veh_BodySts_SeatStruct.Veh_TrdRowMidSeatOccupancySt 1
  g_CAN_Bus_Swc_Set("I_RDCU_SeatInfo.I_RDCU_TrdRowMidSeatOccupancySt 0"); // 测试步骤 TC_CANTest SET I_RDCU_SeatInfo.I_RDCU_TrdRowMidSeatOccupancySt 0
  g_EM_Equipment_Swc_TC_4G_Time_Delay_Second("7"); // 测试步骤 TC_Sleep 7
  g_EM_SOAClient_Swc_SOA_CHECK_Prepare("Veh_BodySts_SeatStruct.Veh_TrdRowMidSeatOccupancySt 1"); // 预期结果 TC_CANTest SOA check Veh_BodySts_SeatStruct.Veh_TrdRowMidSeatOccupancySt 1
  g_EM_SOAClient_Swc_SOA_CHECK("Veh_BodySts_SeatStruct.Veh_TrdRowMidSeatOccupancySt 1"); // 预期结果 TC_CANTest SOA check Veh_BodySts_SeatStruct.Veh_TrdRowMidSeatOccupancySt 1
  g_EM_Equipment_Swc_TC_4G_Time_Delay_Second("1.5"); // 测试步骤 TC_Sleep 1.5
  g_EM_SOAClient_Swc_SOA_CHECK_Prepare("Veh_BodySts_SeatStruct.Veh_TrdRowMidSeatOccupancySt 0"); // 预期结果 TC_CANTest SOA check Veh_BodySts_SeatStruct.Veh_TrdRowMidSeatOccupancySt 0
  g_EM_SOAClient_Swc_SOA_CHECK("Veh_BodySts_SeatStruct.Veh_TrdRowMidSeatOccupancySt 0"); // 预期结果 TC_CANTest SOA check Veh_BodySts_SeatStruct.Veh_TrdRowMidSeatOccupancySt 0
  g_CAN_Bus_Swc_Set("I_LDCU_SeatInfo.I_LDCU_TrdRowMidSeatBeltBuckleSt 1"); // 测试步骤 TC_CANTest SET I_LDCU_SeatInfo.I_LDCU_TrdRowMidSeatBeltBuckleSt 1
  g_EM_Equipment_Swc_TC_4G_Time_Delay_Second("1.5"); // 测试步骤 TC_Sleep 1.5
  g_EM_SOAClient_Swc_SOA_CHECK_Prepare("Veh_BodySts_SeatStruct.Veh_TrdRowMidSeatOccupancySt 1"); // 预期结果 TC_CANTest SOA check Veh_BodySts_SeatStruct.Veh_TrdRowMidSeatOccupancySt 1
  g_EM_SOAClient_Swc_SOA_CHECK("Veh_BodySts_SeatStruct.Veh_TrdRowMidSeatOccupancySt 1"); // 预期结果 TC_CANTest SOA check Veh_BodySts_SeatStruct.Veh_TrdRowMidSeatOccupancySt 1
  g_CAN_Bus_Swc_Set("I_LDCU_SeatInfo.I_LDCU_TrdRowMidSeatBeltBuckleSt 0"); // 测试步骤 TC_CANTest SET I_LDCU_SeatInfo.I_LDCU_TrdRowMidSeatBeltBuckleSt 0
  g_EM_Equipment_Swc_TC_4G_Time_Delay_Second("7"); // 测试步骤 TC_Sleep 7
  g_EM_SOAClient_Swc_SOA_CHECK_Prepare("Veh_BodySts_SeatStruct.Veh_TrdRowMidSeatOccupancySt 1"); // 预期结果 TC_CANTest SOA check Veh_BodySts_SeatStruct.Veh_TrdRowMidSeatOccupancySt 1
  g_EM_SOAClient_Swc_SOA_CHECK("Veh_BodySts_SeatStruct.Veh_TrdRowMidSeatOccupancySt 1"); // 预期结果 TC_CANTest SOA check Veh_BodySts_SeatStruct.Veh_TrdRowMidSeatOccupancySt 1
  g_EM_Equipment_Swc_TC_4G_Time_Delay_Second("1.5"); // 测试步骤 TC_Sleep 1.5
  g_EM_SOAClient_Swc_SOA_CHECK_Prepare("Veh_BodySts_SeatStruct.Veh_TrdRowMidSeatOccupancySt 0"); // 预期结果 TC_CANTest SOA check Veh_BodySts_SeatStruct.Veh_TrdRowMidSeatOccupancySt 0
  g_EM_SOAClient_Swc_SOA_CHECK("Veh_BodySts_SeatStruct.Veh_TrdRowMidSeatOccupancySt 0"); // 预期结果 TC_CANTest SOA check Veh_BodySts_SeatStruct.Veh_TrdRowMidSeatOccupancySt 0
}

testcase SYS_CDCU_jichufuwu_0078()
{
  TestDescription("基础服务-78");
  teststep("warning","原始用例id为SYS-CDCU-基础服务-0078");
  g_CAN_Bus_Swc_Set("I_RDCU_SeatInfo.I_RDCU_TrdRowRtSeatOccupancySt 0"); // 测试步骤 TC_CANTest SET I_RDCU_SeatInfo.I_RDCU_TrdRowRtSeatOccupancySt 0
  g_CAN_Bus_Swc_Set("I_RDCU_SeatInfo.I_RDCU_TrdRowRtSeatBeltBuckleSt 0"); // 测试步骤 TC_CANTest SET I_RDCU_SeatInfo.I_RDCU_TrdRowRtSeatBeltBuckleSt 0
  g_EM_Equipment_Swc_TC_4G_Time_Delay_Second("1.5"); // 测试步骤 TC_Sleep 1.5
  g_EM_SOAClient_Swc_SOA_CHECK_Prepare("Veh_BodySts_SeatStruct.Veh_TrdRowRtSeatOccupancySt 0"); // 预期结果 TC_CANTest SOA check Veh_BodySts_SeatStruct.Veh_TrdRowRtSeatOccupancySt 0
  g_EM_SOAClient_Swc_SOA_CHECK("Veh_BodySts_SeatStruct.Veh_TrdRowRtSeatOccupancySt 0"); // 预期结果 TC_CANTest SOA check Veh_BodySts_SeatStruct.Veh_TrdRowRtSeatOccupancySt 0
}

testcase SYS_CDCU_jichufuwu_0079()
{
  TestDescription("基础服务-79");
  teststep("warning","原始用例id为SYS-CDCU-基础服务-0079");
  g_CAN_Bus_Swc_Set("I_RDCU_SeatInfo.I_RDCU_TrdRowRtSeatOccupancySt 1"); // 测试步骤 TC_CANTest SET I_RDCU_SeatInfo.I_RDCU_TrdRowRtSeatOccupancySt 1
  g_EM_Equipment_Swc_TC_4G_Time_Delay_Second("1.5"); // 测试步骤 TC_Sleep 1.5
  g_EM_SOAClient_Swc_SOA_CHECK_Prepare("Veh_BodySts_SeatStruct.Veh_TrdRowRtSeatOccupancySt 1"); // 预期结果 TC_CANTest SOA check Veh_BodySts_SeatStruct.Veh_TrdRowRtSeatOccupancySt 1
  g_EM_SOAClient_Swc_SOA_CHECK("Veh_BodySts_SeatStruct.Veh_TrdRowRtSeatOccupancySt 1"); // 预期结果 TC_CANTest SOA check Veh_BodySts_SeatStruct.Veh_TrdRowRtSeatOccupancySt 1
  g_CAN_Bus_Swc_Set("I_RDCU_SeatInfo.I_RDCU_TrdRowRtSeatOccupancySt 0"); // 测试步骤 TC_CANTest SET I_RDCU_SeatInfo.I_RDCU_TrdRowRtSeatOccupancySt 0
  g_EM_Equipment_Swc_TC_4G_Time_Delay_Second("7"); // 测试步骤 TC_Sleep 7
  g_EM_SOAClient_Swc_SOA_CHECK_Prepare("Veh_BodySts_SeatStruct.Veh_TrdRowRtSeatOccupancySt 1"); // 预期结果 TC_CANTest SOA check Veh_BodySts_SeatStruct.Veh_TrdRowRtSeatOccupancySt 1
  g_EM_SOAClient_Swc_SOA_CHECK("Veh_BodySts_SeatStruct.Veh_TrdRowRtSeatOccupancySt 1"); // 预期结果 TC_CANTest SOA check Veh_BodySts_SeatStruct.Veh_TrdRowRtSeatOccupancySt 1
  g_EM_Equipment_Swc_TC_4G_Time_Delay_Second("1.5"); // 测试步骤 TC_Sleep 1.5
  g_EM_SOAClient_Swc_SOA_CHECK_Prepare("Veh_BodySts_SeatStruct.Veh_TrdRowRtSeatOccupancySt 0"); // 预期结果 TC_CANTest SOA check Veh_BodySts_SeatStruct.Veh_TrdRowRtSeatOccupancySt 0
  g_EM_SOAClient_Swc_SOA_CHECK("Veh_BodySts_SeatStruct.Veh_TrdRowRtSeatOccupancySt 0"); // 预期结果 TC_CANTest SOA check Veh_BodySts_SeatStruct.Veh_TrdRowRtSeatOccupancySt 0
  g_CAN_Bus_Swc_Set("I_RDCU_SeatInfo.I_RDCU_TrdRowRtSeatBeltBuckleSt 1"); // 测试步骤 TC_CANTest SET I_RDCU_SeatInfo.I_RDCU_TrdRowRtSeatBeltBuckleSt 1
  g_EM_Equipment_Swc_TC_4G_Time_Delay_Second("1.5"); // 测试步骤 TC_Sleep 1.5
  g_EM_SOAClient_Swc_SOA_CHECK_Prepare("Veh_BodySts_SeatStruct.Veh_TrdRowRtSeatOccupancySt 1"); // 预期结果 TC_CANTest SOA check Veh_BodySts_SeatStruct.Veh_TrdRowRtSeatOccupancySt 1
  g_EM_SOAClient_Swc_SOA_CHECK("Veh_BodySts_SeatStruct.Veh_TrdRowRtSeatOccupancySt 1"); // 预期结果 TC_CANTest SOA check Veh_BodySts_SeatStruct.Veh_TrdRowRtSeatOccupancySt 1
  g_CAN_Bus_Swc_Set("I_RDCU_SeatInfo.I_RDCU_TrdRowRtSeatBeltBuckleSt 0"); // 测试步骤 TC_CANTest SET I_RDCU_SeatInfo.I_RDCU_TrdRowRtSeatBeltBuckleSt 0
  g_EM_Equipment_Swc_TC_4G_Time_Delay_Second("7"); // 测试步骤 TC_Sleep 7
  g_EM_SOAClient_Swc_SOA_CHECK_Prepare("Veh_BodySts_SeatStruct.Veh_TrdRowRtSeatOccupancySt 1"); // 预期结果 TC_CANTest SOA check Veh_BodySts_SeatStruct.Veh_TrdRowRtSeatOccupancySt 1
  g_EM_SOAClient_Swc_SOA_CHECK("Veh_BodySts_SeatStruct.Veh_TrdRowRtSeatOccupancySt 1"); // 预期结果 TC_CANTest SOA check Veh_BodySts_SeatStruct.Veh_TrdRowRtSeatOccupancySt 1
  g_EM_Equipment_Swc_TC_4G_Time_Delay_Second("1.5"); // 测试步骤 TC_Sleep 1.5
  g_EM_SOAClient_Swc_SOA_CHECK_Prepare("Veh_BodySts_SeatStruct.Veh_TrdRowRtSeatOccupancySt 0"); // 预期结果 TC_CANTest SOA check Veh_BodySts_SeatStruct.Veh_TrdRowRtSeatOccupancySt 0
  g_EM_SOAClient_Swc_SOA_CHECK("Veh_BodySts_SeatStruct.Veh_TrdRowRtSeatOccupancySt 0"); // 预期结果 TC_CANTest SOA check Veh_BodySts_SeatStruct.Veh_TrdRowRtSeatOccupancySt 0
}

testcase SYS_CDCU_jichufuwu_0080()
{
  TestDescription("基础服务-80");
  teststep("warning","原始用例id为SYS-CDCU-基础服务-0080");
  g_CAN_Bus_Swc_Set("B_SRS_SysSt.B_SRS_DrvSeatBeltBuckleSt 0"); // 测试步骤 TC_CANTest SET B_SRS_SysSt.B_SRS_DrvSeatBeltBuckleSt 0
  g_EM_Equipment_Swc_TC_4G_Time_Delay_Second("1.5"); // 测试步骤 TC_Sleep 1.5
  g_EM_SOAClient_Swc_SOA_CHECK_Prepare("Veh_BodySts_SeatStruct.Veh_DrvSeatBeltBuckleSt 0"); // 预期结果 TC_CANTest SOA check Veh_BodySts_SeatStruct.Veh_DrvSeatBeltBuckleSt 0
  g_EM_SOAClient_Swc_SOA_CHECK("Veh_BodySts_SeatStruct.Veh_DrvSeatBeltBuckleSt 0"); // 预期结果 TC_CANTest SOA check Veh_BodySts_SeatStruct.Veh_DrvSeatBeltBuckleSt 0
}

testcase SYS_CDCU_jichufuwu_0081()
{
  TestDescription("基础服务-81");
  teststep("warning","原始用例id为SYS-CDCU-基础服务-0081");
  g_CAN_Bus_Swc_Set("B_SRS_SysSt.B_SRS_DrvSeatBeltBuckleSt 1"); // 测试步骤 TC_CANTest SET B_SRS_SysSt.B_SRS_DrvSeatBeltBuckleSt 1
  g_EM_Equipment_Swc_TC_4G_Time_Delay_Second("1.5"); // 测试步骤 TC_Sleep 1.5
  g_EM_SOAClient_Swc_SOA_CHECK_Prepare("Veh_BodySts_SeatStruct.Veh_DrvSeatBeltBuckleSt 1"); // 预期结果 TC_CANTest SOA check Veh_BodySts_SeatStruct.Veh_DrvSeatBeltBuckleSt 1
  g_EM_SOAClient_Swc_SOA_CHECK("Veh_BodySts_SeatStruct.Veh_DrvSeatBeltBuckleSt 1"); // 预期结果 TC_CANTest SOA check Veh_BodySts_SeatStruct.Veh_DrvSeatBeltBuckleSt 1
}

testcase SYS_CDCU_jichufuwu_0082()
{
  TestDescription("基础服务-82");
  teststep("warning","原始用例id为SYS-CDCU-基础服务-0082");
  g_CAN_Bus_Swc_Set("B_SRS_SysSt.B_SRS_PsngrSeatBeltBuckleSt 0"); // 测试步骤 TC_CANTest SET B_SRS_SysSt.B_SRS_PsngrSeatBeltBuckleSt 0
  g_EM_Equipment_Swc_TC_4G_Time_Delay_Second("1.5"); // 测试步骤 TC_Sleep 1.5
  g_EM_SOAClient_Swc_SOA_CHECK_Prepare("Veh_BodySts_SeatStruct.Veh_PsngrSeatBeltBuckleSt 0"); // 预期结果 TC_CANTest SOA check Veh_BodySts_SeatStruct.Veh_PsngrSeatBeltBuckleSt 0
  g_EM_SOAClient_Swc_SOA_CHECK("Veh_BodySts_SeatStruct.Veh_PsngrSeatBeltBuckleSt 0"); // 预期结果 TC_CANTest SOA check Veh_BodySts_SeatStruct.Veh_PsngrSeatBeltBuckleSt 0
}

testcase SYS_CDCU_jichufuwu_0083()
{
  TestDescription("基础服务-83");
  teststep("warning","原始用例id为SYS-CDCU-基础服务-0083");
  g_CAN_Bus_Swc_Set("B_SRS_SysSt.B_SRS_PsngrSeatBeltBuckleSt 1"); // 测试步骤 TC_CANTest SET B_SRS_SysSt.B_SRS_PsngrSeatBeltBuckleSt 1
  g_EM_Equipment_Swc_TC_4G_Time_Delay_Second("1.5"); // 测试步骤 TC_Sleep 1.5
  g_EM_SOAClient_Swc_SOA_CHECK_Prepare("Veh_BodySts_SeatStruct.Veh_PsngrSeatBeltBuckleSt 1"); // 预期结果 TC_CANTest SOA check Veh_BodySts_SeatStruct.Veh_PsngrSeatBeltBuckleSt 1
  g_EM_SOAClient_Swc_SOA_CHECK("Veh_BodySts_SeatStruct.Veh_PsngrSeatBeltBuckleSt 1"); // 预期结果 TC_CANTest SOA check Veh_BodySts_SeatStruct.Veh_PsngrSeatBeltBuckleSt 1
}

testcase SYS_CDCU_jichufuwu_0084()
{
  TestDescription("基础服务-84");
  teststep("warning","原始用例id为SYS-CDCU-基础服务-0084");
  g_CAN_Bus_Swc_Set("B_SRS_SysSt.B_SRS_2ndLeftSeatBeltBuckleSt 0"); // 测试步骤 TC_CANTest SET B_SRS_SysSt.B_SRS_2ndLeftSeatBeltBuckleSt 0
  g_EM_Equipment_Swc_TC_4G_Time_Delay_Second("1.5"); // 测试步骤 TC_Sleep 1.5
  g_EM_SOAClient_Swc_SOA_CHECK_Prepare("Veh_BodySts_SeatStruct.Veh_SecRowLtSeatBeltBuckleSt 0"); // 预期结果 TC_CANTest SOA check Veh_BodySts_SeatStruct.Veh_SecRowLtSeatBeltBuckleSt 0
  g_EM_SOAClient_Swc_SOA_CHECK("Veh_BodySts_SeatStruct.Veh_SecRowLtSeatBeltBuckleSt 0"); // 预期结果 TC_CANTest SOA check Veh_BodySts_SeatStruct.Veh_SecRowLtSeatBeltBuckleSt 0
}

testcase SYS_CDCU_jichufuwu_0085()
{
  TestDescription("基础服务-85");
  teststep("warning","原始用例id为SYS-CDCU-基础服务-0085");
  g_CAN_Bus_Swc_Set("B_SRS_SysSt.B_SRS_2ndLeftSeatBeltBuckleSt 1"); // 测试步骤 TC_CANTest SET B_SRS_SysSt.B_SRS_2ndLeftSeatBeltBuckleSt 1
  g_EM_Equipment_Swc_TC_4G_Time_Delay_Second("1.5"); // 测试步骤 TC_Sleep 1.5
  g_EM_SOAClient_Swc_SOA_CHECK_Prepare("Veh_BodySts_SeatStruct.Veh_SecRowLtSeatBeltBuckleSt 1"); // 预期结果 TC_CANTest SOA check Veh_BodySts_SeatStruct.Veh_SecRowLtSeatBeltBuckleSt 1
  g_EM_SOAClient_Swc_SOA_CHECK("Veh_BodySts_SeatStruct.Veh_SecRowLtSeatBeltBuckleSt 1"); // 预期结果 TC_CANTest SOA check Veh_BodySts_SeatStruct.Veh_SecRowLtSeatBeltBuckleSt 1
}

testcase SYS_CDCU_jichufuwu_0086()
{
  TestDescription("基础服务-86");
  teststep("warning","原始用例id为SYS-CDCU-基础服务-0086");
  g_CAN_Bus_Swc_Set("B_SRS_SysSt.B_SRS_2ndRightSeatBeltBuckleSt 0"); // 测试步骤 TC_CANTest SET B_SRS_SysSt.B_SRS_2ndRightSeatBeltBuckleSt 0
  g_EM_Equipment_Swc_TC_4G_Time_Delay_Second("1.5"); // 测试步骤 TC_Sleep 1.5
  g_EM_SOAClient_Swc_SOA_CHECK_Prepare("Veh_BodySts_SeatStruct.Veh_SecRowRtSeatBeltBuckleSt 0"); // 预期结果 TC_CANTest SOA check Veh_BodySts_SeatStruct.Veh_SecRowRtSeatBeltBuckleSt 0
  g_EM_SOAClient_Swc_SOA_CHECK("Veh_BodySts_SeatStruct.Veh_SecRowRtSeatBeltBuckleSt 0"); // 预期结果 TC_CANTest SOA check Veh_BodySts_SeatStruct.Veh_SecRowRtSeatBeltBuckleSt 0
}

testcase SYS_CDCU_jichufuwu_0087()
{
  TestDescription("基础服务-87");
  teststep("warning","原始用例id为SYS-CDCU-基础服务-0087");
  g_CAN_Bus_Swc_Set("B_SRS_SysSt.B_SRS_2ndRightSeatBeltBuckleSt 1"); // 测试步骤 TC_CANTest SET B_SRS_SysSt.B_SRS_2ndRightSeatBeltBuckleSt 1
  g_EM_Equipment_Swc_TC_4G_Time_Delay_Second("1.5"); // 测试步骤 TC_Sleep 1.5
  g_EM_SOAClient_Swc_SOA_CHECK_Prepare("Veh_BodySts_SeatStruct.Veh_SecRowRtSeatBeltBuckleSt 1"); // 预期结果 TC_CANTest SOA check Veh_BodySts_SeatStruct.Veh_SecRowRtSeatBeltBuckleSt 1
  g_EM_SOAClient_Swc_SOA_CHECK("Veh_BodySts_SeatStruct.Veh_SecRowRtSeatBeltBuckleSt 1"); // 预期结果 TC_CANTest SOA check Veh_BodySts_SeatStruct.Veh_SecRowRtSeatBeltBuckleSt 1
}

testcase SYS_CDCU_jichufuwu_0088()
{
  TestDescription("基础服务-88");
  teststep("warning","原始用例id为SYS-CDCU-基础服务-0088");
  g_CAN_Bus_Swc_Set("I_LDCU_SeatInfo.I_LDCU_TrdRowLtSeatBeltBuckleSt 0"); // 测试步骤 TC_CANTest SET I_LDCU_SeatInfo.I_LDCU_TrdRowLtSeatBeltBuckleSt 0
  g_EM_Equipment_Swc_TC_4G_Time_Delay_Second("1.5"); // 测试步骤 TC_Sleep 1.5
  g_EM_SOAClient_Swc_SOA_CHECK_Prepare("Veh_BodySts_SeatStruct.Veh_TrdRowLtSeatBeltBuckleSt 0"); // 预期结果 TC_CANTest SOA check Veh_BodySts_SeatStruct.Veh_TrdRowLtSeatBeltBuckleSt 0
  g_EM_SOAClient_Swc_SOA_CHECK("Veh_BodySts_SeatStruct.Veh_TrdRowLtSeatBeltBuckleSt 0"); // 预期结果 TC_CANTest SOA check Veh_BodySts_SeatStruct.Veh_TrdRowLtSeatBeltBuckleSt 0
}

testcase SYS_CDCU_jichufuwu_0089()
{
  TestDescription("基础服务-89");
  teststep("warning","原始用例id为SYS-CDCU-基础服务-0089");
  g_CAN_Bus_Swc_Set("I_LDCU_SeatInfo.I_LDCU_TrdRowLtSeatBeltBuckleSt 1"); // 测试步骤 TC_CANTest SET I_LDCU_SeatInfo.I_LDCU_TrdRowLtSeatBeltBuckleSt 1
  g_EM_Equipment_Swc_TC_4G_Time_Delay_Second("1.5"); // 测试步骤 TC_Sleep 1.5
  g_EM_SOAClient_Swc_SOA_CHECK_Prepare("Veh_BodySts_SeatStruct.Veh_TrdRowLtSeatBeltBuckleSt 1"); // 预期结果 TC_CANTest SOA check Veh_BodySts_SeatStruct.Veh_TrdRowLtSeatBeltBuckleSt 1
  g_EM_SOAClient_Swc_SOA_CHECK("Veh_BodySts_SeatStruct.Veh_TrdRowLtSeatBeltBuckleSt 1"); // 预期结果 TC_CANTest SOA check Veh_BodySts_SeatStruct.Veh_TrdRowLtSeatBeltBuckleSt 1
}

testcase SYS_CDCU_jichufuwu_0090()
{
  TestDescription("基础服务-90");
  teststep("warning","原始用例id为SYS-CDCU-基础服务-0090");
  g_CAN_Bus_Swc_Set("I_LDCU_SeatInfo.I_LDCU_TrdRowMidSeatBeltBuckleSt 0"); // 测试步骤 TC_CANTest SET I_LDCU_SeatInfo.I_LDCU_TrdRowMidSeatBeltBuckleSt 0
  g_EM_Equipment_Swc_TC_4G_Time_Delay_Second("1.5"); // 测试步骤 TC_Sleep 1.5
  g_EM_SOAClient_Swc_SOA_CHECK_Prepare("Veh_BodySts_SeatStruct.Veh_TrdRowMidSeatBeltBuckleSt 0"); // 预期结果 TC_CANTest SOA check Veh_BodySts_SeatStruct.Veh_TrdRowMidSeatBeltBuckleSt 0
  g_EM_SOAClient_Swc_SOA_CHECK("Veh_BodySts_SeatStruct.Veh_TrdRowMidSeatBeltBuckleSt 0"); // 预期结果 TC_CANTest SOA check Veh_BodySts_SeatStruct.Veh_TrdRowMidSeatBeltBuckleSt 0
}

testcase SYS_CDCU_jichufuwu_0091()
{
  TestDescription("基础服务-91");
  teststep("warning","原始用例id为SYS-CDCU-基础服务-0091");
  g_CAN_Bus_Swc_Set("I_LDCU_SeatInfo.I_LDCU_TrdRowMidSeatBeltBuckleSt 1"); // 测试步骤 TC_CANTest SET I_LDCU_SeatInfo.I_LDCU_TrdRowMidSeatBeltBuckleSt 1
  g_EM_Equipment_Swc_TC_4G_Time_Delay_Second("1.5"); // 测试步骤 TC_Sleep 1.5
  g_EM_SOAClient_Swc_SOA_CHECK_Prepare("Veh_BodySts_SeatStruct.Veh_TrdRowMidSeatBeltBuckleSt 1"); // 预期结果 TC_CANTest SOA check Veh_BodySts_SeatStruct.Veh_TrdRowMidSeatBeltBuckleSt 1
  g_EM_SOAClient_Swc_SOA_CHECK("Veh_BodySts_SeatStruct.Veh_TrdRowMidSeatBeltBuckleSt 1"); // 预期结果 TC_CANTest SOA check Veh_BodySts_SeatStruct.Veh_TrdRowMidSeatBeltBuckleSt 1
}

testcase SYS_CDCU_jichufuwu_0092()
{
  TestDescription("基础服务-92");
  teststep("warning","原始用例id为SYS-CDCU-基础服务-0092");
  g_CAN_Bus_Swc_Set("I_RDCU_SeatInfo.I_RDCU_TrdRowRtSeatBeltBuckleSt 0"); // 测试步骤 TC_CANTest SET I_RDCU_SeatInfo.I_RDCU_TrdRowRtSeatBeltBuckleSt 0
  g_EM_Equipment_Swc_TC_4G_Time_Delay_Second("1.5"); // 测试步骤 TC_Sleep 1.5
  g_EM_SOAClient_Swc_SOA_CHECK_Prepare("Veh_BodySts_SeatStruct.Veh_TrdRowRtSeatBeltBuckleSt 0"); // 预期结果 TC_CANTest SOA check Veh_BodySts_SeatStruct.Veh_TrdRowRtSeatBeltBuckleSt 0
  g_EM_SOAClient_Swc_SOA_CHECK("Veh_BodySts_SeatStruct.Veh_TrdRowRtSeatBeltBuckleSt 0"); // 预期结果 TC_CANTest SOA check Veh_BodySts_SeatStruct.Veh_TrdRowRtSeatBeltBuckleSt 0
}

testcase SYS_CDCU_jichufuwu_0093()
{
  TestDescription("基础服务-93");
  teststep("warning","原始用例id为SYS-CDCU-基础服务-0093");
  g_CAN_Bus_Swc_Set("I_RDCU_SeatInfo.I_RDCU_TrdRowRtSeatBeltBuckleSt 1"); // 测试步骤 TC_CANTest SET I_RDCU_SeatInfo.I_RDCU_TrdRowRtSeatBeltBuckleSt 1
  g_EM_Equipment_Swc_TC_4G_Time_Delay_Second("1.5"); // 测试步骤 TC_Sleep 1.5
  g_EM_SOAClient_Swc_SOA_CHECK_Prepare("Veh_BodySts_SeatStruct.Veh_TrdRowRtSeatBeltBuckleSt 1"); // 预期结果 TC_CANTest SOA check Veh_BodySts_SeatStruct.Veh_TrdRowRtSeatBeltBuckleSt 1
  g_EM_SOAClient_Swc_SOA_CHECK("Veh_BodySts_SeatStruct.Veh_TrdRowRtSeatBeltBuckleSt 1"); // 预期结果 TC_CANTest SOA check Veh_BodySts_SeatStruct.Veh_TrdRowRtSeatBeltBuckleSt 1
}

testcase SYS_CDCU_jichufuwu_0094()
{
  TestDescription("基础服务-94");
  teststep("warning","原始用例id为SYS-CDCU-基础服务-0094");
  g_CAN_Bus_Swc_Set("I_LDCU_BodySysSt2.I_LDCU_DriveLockOrHandleSt 0"); // 测试步骤 TC_CANTest SET I_LDCU_BodySysSt2.I_LDCU_DriveLockOrHandleSt 0
  g_EM_Equipment_Swc_TC_4G_Time_Delay_Second("1.5"); // 测试步骤 TC_Sleep 1.5
  g_EM_SOAClient_Swc_SOA_CHECK_Prepare("Veh_BodySts_DoorStruct.Veh_DriveLockOrHandleSt 0"); // 预期结果 TC_CANTest SOA check Veh_BodySts_DoorStruct.Veh_DriveLockOrHandleSt 0
  g_EM_SOAClient_Swc_SOA_CHECK("Veh_BodySts_DoorStruct.Veh_DriveLockOrHandleSt 0"); // 预期结果 TC_CANTest SOA check Veh_BodySts_DoorStruct.Veh_DriveLockOrHandleSt 0
}

testcase SYS_CDCU_jichufuwu_0095()
{
  TestDescription("基础服务-95");
  teststep("warning","原始用例id为SYS-CDCU-基础服务-0095");
  g_CAN_Bus_Swc_Set("I_LDCU_BodySysSt2.I_LDCU_DriveLockOrHandleSt 1"); // 测试步骤 TC_CANTest SET I_LDCU_BodySysSt2.I_LDCU_DriveLockOrHandleSt 1
  g_EM_Equipment_Swc_TC_4G_Time_Delay_Second("1.5"); // 测试步骤 TC_Sleep 1.5
  g_EM_SOAClient_Swc_SOA_CHECK_Prepare("Veh_BodySts_DoorStruct.Veh_DriveLockOrHandleSt 1"); // 预期结果 TC_CANTest SOA check Veh_BodySts_DoorStruct.Veh_DriveLockOrHandleSt 1
  g_EM_SOAClient_Swc_SOA_CHECK("Veh_BodySts_DoorStruct.Veh_DriveLockOrHandleSt 1"); // 预期结果 TC_CANTest SOA check Veh_BodySts_DoorStruct.Veh_DriveLockOrHandleSt 1
}

testcase SYS_CDCU_jichufuwu_0096()
{
  TestDescription("基础服务-96");
  teststep("warning","原始用例id为SYS-CDCU-基础服务-0096");
  g_CAN_Bus_Swc_Set("I_RDCU_BodySysSt4.I_RDCU_PsngrHandleSt 0"); // 测试步骤 TC_CANTest SET I_RDCU_BodySysSt4.I_RDCU_PsngrHandleSt 0
  g_EM_Equipment_Swc_TC_4G_Time_Delay_Second("1.5"); // 测试步骤 TC_Sleep 1.5
  g_EM_SOAClient_Swc_SOA_CHECK_Prepare("Veh_BodySts_DoorStruct.Veh_PsngrHandleSt 0"); // 预期结果 TC_CANTest SOA check Veh_BodySts_DoorStruct.Veh_PsngrHandleSt 0
  g_EM_SOAClient_Swc_SOA_CHECK("Veh_BodySts_DoorStruct.Veh_PsngrHandleSt 0"); // 预期结果 TC_CANTest SOA check Veh_BodySts_DoorStruct.Veh_PsngrHandleSt 0
}

testcase SYS_CDCU_jichufuwu_0097()
{
  TestDescription("基础服务-97");
  teststep("warning","原始用例id为SYS-CDCU-基础服务-0097");
  g_CAN_Bus_Swc_Set("I_RDCU_BodySysSt4.I_RDCU_PsngrHandleSt 1"); // 测试步骤 TC_CANTest SET I_RDCU_BodySysSt4.I_RDCU_PsngrHandleSt 1
  g_EM_Equipment_Swc_TC_4G_Time_Delay_Second("1.5"); // 测试步骤 TC_Sleep 1.5
  g_EM_SOAClient_Swc_SOA_CHECK_Prepare("Veh_BodySts_DoorStruct.Veh_PsngrHandleSt 1"); // 预期结果 TC_CANTest SOA check Veh_BodySts_DoorStruct.Veh_PsngrHandleSt 1
  g_EM_SOAClient_Swc_SOA_CHECK("Veh_BodySts_DoorStruct.Veh_PsngrHandleSt 1"); // 预期结果 TC_CANTest SOA check Veh_BodySts_DoorStruct.Veh_PsngrHandleSt 1
}

testcase SYS_CDCU_jichufuwu_0098()
{
  TestDescription("基础服务-98");
  teststep("warning","原始用例id为SYS-CDCU-基础服务-0098");
  g_CAN_Bus_Swc_Set("I_RDCU_BodySysSt4.I_RDCU_PsngrHandleSt 1"); // 测试步骤 TC_CANTest SET I_RDCU_BodySysSt4.I_RDCU_PsngrHandleSt 1
  g_EM_Equipment_Swc_TC_4G_Time_Delay_Second("1.5"); // 测试步骤 TC_Sleep 1.5
  g_EM_SOAClient_Swc_SOA_CHECK_Prepare("Veh_BodySts_DoorStruct.Veh_PsngrHandleSt 1"); // 预期结果 TC_CANTest SOA check Veh_BodySts_DoorStruct.Veh_PsngrHandleSt 1
  g_EM_SOAClient_Swc_SOA_CHECK("Veh_BodySts_DoorStruct.Veh_PsngrHandleSt 1"); // 预期结果 TC_CANTest SOA check Veh_BodySts_DoorStruct.Veh_PsngrHandleSt 1
}

testcase SYS_CDCU_jichufuwu_0099()
{
  TestDescription("基础服务-99");
  teststep("warning","原始用例id为SYS-CDCU-基础服务-0099");
  g_CAN_Bus_Swc_Set("I_LDCU_BodySysSt2.I_LDCU_RLHandleSt 0"); // 测试步骤 TC_CANTest SET I_LDCU_BodySysSt2.I_LDCU_RLHandleSt 0
  g_EM_Equipment_Swc_TC_4G_Time_Delay_Second("1.5"); // 测试步骤 TC_Sleep 1.5
  g_EM_SOAClient_Swc_SOA_CHECK_Prepare("Veh_BodySts_DoorStruct.Veh_RLHandleSt 0"); // 预期结果 TC_CANTest SOA check Veh_BodySts_DoorStruct.Veh_RLHandleSt 0
  g_EM_SOAClient_Swc_SOA_CHECK("Veh_BodySts_DoorStruct.Veh_RLHandleSt 0"); // 预期结果 TC_CANTest SOA check Veh_BodySts_DoorStruct.Veh_RLHandleSt 0
}

testcase SYS_CDCU_jichufuwu_0100()
{
  TestDescription("基础服务-100");
  teststep("warning","原始用例id为SYS-CDCU-基础服务-0100");
  g_CAN_Bus_Swc_Set("I_LDCU_BodySysSt2.I_LDCU_RLHandleSt 1"); // 测试步骤 TC_CANTest SET I_LDCU_BodySysSt2.I_LDCU_RLHandleSt 1
  g_EM_Equipment_Swc_TC_4G_Time_Delay_Second("1.5"); // 测试步骤 TC_Sleep 1.5
  g_EM_SOAClient_Swc_SOA_CHECK_Prepare("Veh_BodySts_DoorStruct.Veh_RLHandleSt 1"); // 预期结果 TC_CANTest SOA check Veh_BodySts_DoorStruct.Veh_RLHandleSt 1
  g_EM_SOAClient_Swc_SOA_CHECK("Veh_BodySts_DoorStruct.Veh_RLHandleSt 1"); // 预期结果 TC_CANTest SOA check Veh_BodySts_DoorStruct.Veh_RLHandleSt 1
}

testcase SYS_CDCU_jichufuwu_0101()
{
  TestDescription("基础服务-101");
  teststep("warning","原始用例id为SYS-CDCU-基础服务-0101");
  g_CAN_Bus_Swc_Set("I_RDCU_BodySysSt4.I_RDCU_RRHandleSt 0"); // 测试步骤 TC_CANTest SET I_RDCU_BodySysSt4.I_RDCU_RRHandleSt 0
  g_EM_Equipment_Swc_TC_4G_Time_Delay_Second("1.5"); // 测试步骤 TC_Sleep 1.5
  g_EM_SOAClient_Swc_SOA_CHECK_Prepare("Veh_BodySts_DoorStruct.Veh_RRHandleSt 0"); // 预期结果 TC_CANTest SOA check Veh_BodySts_DoorStruct.Veh_RRHandleSt 0
  g_EM_SOAClient_Swc_SOA_CHECK("Veh_BodySts_DoorStruct.Veh_RRHandleSt 0"); // 预期结果 TC_CANTest SOA check Veh_BodySts_DoorStruct.Veh_RRHandleSt 0
  g_CAN_Bus_Swc_Set("I_RDCU_BodySysSt4.I_RDCU_RRHandleSt 1"); // 测试步骤 TC_CANTest SET I_RDCU_BodySysSt4.I_RDCU_RRHandleSt 1
  g_EM_Equipment_Swc_TC_4G_Time_Delay_Second("1.5"); // 测试步骤 TC_Sleep 1.5
  g_EM_SOAClient_Swc_SOA_CHECK_Prepare("Veh_BodySts_DoorStruct.Veh_RRHandleSt 1"); // 预期结果 TC_CANTest SOA check Veh_BodySts_DoorStruct.Veh_RRHandleSt 1
  g_EM_SOAClient_Swc_SOA_CHECK("Veh_BodySts_DoorStruct.Veh_RRHandleSt 1"); // 预期结果 TC_CANTest SOA check Veh_BodySts_DoorStruct.Veh_RRHandleSt 1
}
