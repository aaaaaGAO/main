/*@!Encoding:936*/
includes
{
  #include "../SOALib/SOALib_Node.cin"
}

variables
{
  char     SOA_NodeName[512] = "LDCU";
  
  dword    SOA_NodeProtocol = 17;
  dword    SOA_NodePort = 55114;
  
  const SOA_NodeProvidedServiceListNum = 24;
  struct SOALib_ProvidedServiceType SOA_NodeProvidedServiceList[SOA_NodeProvidedServiceListNum] = 
  {
    
    { 0x0000, 0x00, 0x00, 0x00 },
    
    { 0x0041, 0x01, 0x01, 0x00 },
    
    { 0x0050, 0x01, 0x01, 0x00 },
    
    { 0x0051, 0x01, 0x01, 0x00 },
    
    { 0x0058, 0x01, 0x01, 0x00 },
    
    { 0x005A, 0x01, 0x01, 0x00 },
    
    { 0x005D, 0x01, 0x01, 0x00 },
    
    { 0x0060, 0x01, 0x01, 0x00 },
    
    { 0x0061, 0x01, 0x01, 0x00 },
    
    { 0x0063, 0x01, 0x01, 0x00 },
    
    { 0x0064, 0x01, 0x01, 0x00 },
    
    { 0x0066, 0x01, 0x01, 0x00 },
    
    { 0x006C, 0x01, 0x01, 0x00 },
    
    { 0x006D, 0x01, 0x01, 0x00 },
    
    { 0x0300, 0x01, 0x01, 0x00 },
    
    { 0x0501, 0x01, 0x01, 0x00 },
    
    { 0x1100, 0x01, 0x01, 0x00 },
    
    { 0x1101, 0x01, 0x01, 0x00 },
    
    { 0x200F, 0x01, 0x01, 0x00 },
    
    { 0x0101, 0x01, 0x01, 0x00 },
    
    { 0x0110, 0x01, 0x01, 0x00 },
    
    { 0x0136, 0x01, 0x01, 0x00 },
    
    { 0x0185, 0x01, 0x01, 0x00 },
    
    { 0x0068, 0x01, 0x01, 0x00 }
    
  };
  
  const SOA_NodeConsumedServiceListNum = 5;
  struct SOALib_ConsumedServiceType SOA_NodeConsumedServiceList[SOA_NodeConsumedServiceListNum] = 
  {
    
    { 0x0000, 0x00, 0x00, 0x00 },
    
    { 0x0062, 0x01, 0x01, 0x00 },
    
    { 0x0400, 0x01, 0x01, 0x00 },
    
    { 0x0401, 0x01, 0x01, 0x00 },
    
    { 0x0073, 0x01, 0x01, 0x00 }
    
  };
}