/*@!Encoding:65001*/
includes
{
  
}

variables
{
  
}

void gTC_SOA_Setserver_Event()
{
    gTC_CANTest_SOA_SetSever("SshdSysSt1Struct.SshdMoveStatus:0 sleep0.5");
    gTC_CANTest_SOA_SetSever("SshdSysSt2Struct.SshdPosValue:0 sleep1");
    gTC_CANTest_SOA_SetSever("LSlideDoorStStruct.PSDL_PSDFaultStatus:0 sleep0.5");
    gTC_CANTest_SOA_SetSever("LSlideDoorSt2Struct.PSDL_SlideDoorPosition:0 sleep1");
    gTC_CANTest_SOA_SetSever("RSlideDoorStStruct.PSDR_PSDFaultStatus:0 sleep0.5");
    gTC_CANTest_SOA_SetSever("RSlideDoorSt2Struct.PSDR_SlideDoorPosition:0 sleep1");
    gTC_CANTest_SOA_SetSever("FwiperStStruct.FWiperSpd:0 sleep1");
    gTC_CANTest_SOA_SetSever("FwiperSt2Struct.FWiperMotorAngle:0 sleep1");
    gTC_CANTest_SOA_SetSever("RLSStStruct.RLSRainIntensity:0 sleep0.04");
    gTC_CANTest_SOA_SetSever("DrvSeatPstStruct.DrvSeatHorzPos:0 sleep1");
    gTC_CANTest_SOA_SetSever("DrvSeatFuncStStruct.DrvSeatEasyEntrySt:0 sleep1");
    gTC_CANTest_SOA_SetSever("DrvSeatOccupancyStStruct.DrvSeatOccupancySt:0 sleep1");
    gTC_CANTest_SOA_SetSever("PsngrSeatPstStruct.PsngrSeatHorzPos:0 sleep1");
    gTC_CANTest_SOA_SetSever("PsngrSeatFuncStStruct.PsngrSeatEasyEntrySt:0 sleep1");
    gTC_CANTest_SOA_SetSever("SecRowLtSeatPstStruct.SecRowLtSeatTiltingPos:0 sleep1");
    gTC_CANTest_SOA_SetSever("SecRowLtSeatFuncStStruct.SecRowLtSeatAutoAdjEnableSt:0 sleep1");
    gTC_CANTest_SOA_SetSever("SecRowRtSeatPstStruct.SecRowRtSeatTiltingPos:0 sleep1");
    gTC_CANTest_SOA_SetSever("SecRowRtSeatFuncStStruct.SecRowRtSeatAutoAdjEnableSt:0 sleep1");
    gTC_CANTest_SOA_SetSever("CollumnPstStruct.ColumnHorizonalPos:0 sleep1");
    gTC_CANTest_SOA_SetSever("CollumnFuncStStruct.ColumnLowTempCompensationSt:0 sleep1");
    gTC_CANTest_SOA_SetSever("HandleStStruct.FLHandlePos:0 sleep1");
    gTC_CANTest_SOA_SetSever("FLWindowStStruct.DFLWinSwSt:0 sleep0.5");
    gTC_CANTest_SOA_SetSever("FLWindowSt2Struct.FLWinHallCounts:0 sleep1");
    gTC_CANTest_SOA_SetSever("RLWindowStStruct.RLWinSwSt:0 sleep0.5");
    gTC_CANTest_SOA_SetSever("RLWindowSt2Struct.RLWinHallCounts:0 sleep1");
    gTC_CANTest_SOA_SetSever("FRWindowStStruct.FRWinSwSt:0 sleep0.5");
    gTC_CANTest_SOA_SetSever("FRWindowSt2Struct.FRWinHallCounts:0 sleep1");
    gTC_CANTest_SOA_SetSever("RRWindowStStruct.RRWinSwSt:0 sleep0.5");
    gTC_CANTest_SOA_SetSever("RRWindowSt2Struct.RRWinHallCounts:0 sleep1");
    gTC_CANTest_SOA_SetSever("DoorLockStStruct.LockLogicSt:0 sleep0.5");
    gTC_CANTest_SOA_SetSever("FLDoorSwSt1Struct.FLDoorReleaseSource:0 sleep0.5");
    gTC_CANTest_SOA_SetSever("FRDoorSwSt1Struct.FRDoorReleaseSource:0 sleep0.5");
    gTC_CANTest_SOA_SetSever("DoorChildLockLogicStStruct.LChildLockLogicSt:0 sleep1");
    gTC_CANTest_SOA_SetSever("TPMSStStruct.TPMSFaultWarn:0 sleep0.5");
    gTC_CANTest_SOA_SetSever("LMirrorPosStruct.LMirrorLRCurPos:0 sleep1");
    gTC_CANTest_SOA_SetSever("LMirrorStStruct.LMirrorFoldOutputSt:0 sleep0.5");
    gTC_CANTest_SOA_SetSever("RMirrorPosStruct.RMirrorLRCurPos:0 sleep1");
    gTC_CANTest_SOA_SetSever("RMirrorStStruct.RMirrorFoldOutputSt:0 sleep0.5");
    gTC_CANTest_SOA_SetSever("LightsStStruct.LowBeamOutputSt:0 sleep0.5");
    gTC_CANTest_SOA_SetSever("RLDoorSwSt1Struct.RLDoorReleaseSource:0 sleep0.5");
    gTC_CANTest_SOA_SetSever("RRDoorSwSt1Struct.RRDoorReleaseSource:0 sleep0.5");
    gTC_CANTest_SOA_SetSever("ChargePortStateStruct.ChrgConnStReq:0 sleep1");
    gTC_CANTest_SOA_SetSever("ChargePortState2Struct.ChargePortSesorPercent:0 sleep1");
    gTC_CANTest_SOA_SetSever("ChargeGunLockStateStruct.ChargeLockType:0 sleep1");
    gTC_CANTest_SOA_SetSever("TgateStsStruct.TgateMvtSts:0 sleep0.5");
    gTC_CANTest_SOA_SetSever("TgatePosInfoStruct.TgatePos:0 sleep1");
    gTC_CANTest_SOA_SetSever("HighVoltageStStruct.HighVolSt:0 sleep0.05");
    gTC_CANTest_SOA_SetSever("V2LDisChrgStStruct.DisChrgSt:0 sleep0.1");
    gTC_CANTest_SOA_SetSever("ACSysStateStruct.AutoSt:0 sleep0.5");
    gTC_CANTest_SOA_SetSever("WindExitSpdStruct.WindExitSpd:0 sleep0.5");
    gTC_CANTest_SOA_SetSever("TempSelectStStruct.DriverTempSelectSt:0 sleep0.5");
    gTC_CANTest_SOA_SetSever("AirDistributionModeStruct.AirDistributionMode:0 sleep0.5");
    gTC_CANTest_SOA_SetSever("AirIntakeStStruct.AirIntakeSt:0 sleep0.5");
    gTC_CANTest_SOA_SetSever("AirCleanStStruct.AirCleanSt:0 sleep0.5");
    gTC_CANTest_SOA_SetSever("TempSensorInfoFBStruct.CorrectedExterTemp:0 sleep0.1");
    gTC_CANTest_SOA_SetSever("TempSensorInfoFB2Struct.WindModeColour:0 sleep0.5");
    gTC_CANTest_SOA_SetSever("TuyereAndModeStStruct.EAVDrvLeftHorzPosFB:0 sleep0.1");
    gTC_CANTest_SOA_SetSever("ThermalSys1Struct.BTMActualWorkSt:0 sleep0.5");
    gTC_CANTest_SOA_SetSever("ThermalSys2Struct.CompComsumePwr:0 sleep0.1");
    gTC_CANTest_SOA_SetSever("ThermalSysSenInfoStruct.RefHPT_Temp:0 sleep0.1");
    gTC_CANTest_SOA_SetSever("ThermalSysActuator1Struct.AM_VolFb_Left:0 sleep0.1");
    gTC_CANTest_SOA_SetSever("ThermalSysActuator2Struct.TS_PwrRelaySt:0 sleep0.1");
    gTC_CANTest_SOA_SetSever("TMC_DTCStruct.LftFaceSe_Sht2GND:0 sleep0.1");
    gTC_CANTest_SOA_SetSever("HcvStStruct.HcvSt:0 sleep0.5");
    gTC_CANTest_SOA_SetSever("RearMirrorHeatStStruct.RearMirrorHeatOutputSt:0 sleep0.5");
    gTC_CANTest_SOA_SetSever("FrontMirrorHeatStStruct.FrontMirrorHeatOutputSt:0 sleep0.5");
    gTC_CANTest_SOA_SetSever("EntryExitCfgStStruct.UnlockHazardLightCfgFb:0 sleep1");
    gTC_CANTest_SOA_SetSever("EntryExitFuncStStruct.PElockUnlockSt:0 sleep1");
    gTC_CANTest_SOA_SetSever("RWiperStStruct.RWiperWashSwSt:0 sleep1");
    gTC_CANTest_SOA_SetSever("LeadAcidbattState1Struct.LVCharReqEnable:0 sleep1");
    gTC_CANTest_SOA_SetSever("LeadAcidbattState2Struct.EBSBattSOC:0 sleep1");
    gTC_CANTest_SOA_SetSever("LithiumIonbattState1Struct.LBMS_LVCharReq:0 sleep1");
    gTC_CANTest_SOA_SetSever("LithiumIonbattState2Struct.LBMS_SOC:0 sleep1");
    gTC_CANTest_SOA_SetSever("LithiumIonbattState3Struct.LBMS_PackOvTempFault:0 sleep1");
    gTC_CANTest_SOA_SetSever("InteriorLightState1Struct.DomeLightModeFb:0 sleep0.5");
    gTC_CANTest_SOA_SetSever("WelCarpetLightState1Struct.WelCarpetLightCfgSt:0 sleep0.5");
    gTC_CANTest_SOA_SetSever("HornStStruct.HornActivationSt:0 sleep1");
    gTC_CANTest_SOA_SetSever("ARSSysSt1Struct.ARSModeSt:0 sleep1");
    gTC_CANTest_SOA_SetSever("ARSSysSt2Struct.ARSPstValu:0 sleep1");
    gTC_CANTest_SOA_SetSever("DoorLockSt2Struct.BonnetAjarSt:0 sleep0.5");
    gTC_CANTest_SOA_SetSever("LeftRockingDoorSysSt1Struct.SDC_SysErr:0 sleep0.5");
    gTC_CANTest_SOA_SetSever("RightRockingDoorSysSt2Struct.SDC_SysErr:0 sleep0.5");
    gTC_CANTest_SOA_SetSever("RightRockingDoorRadarInfoStruct.SDC_L_MoveReq:0 sleep0.5");
    gTC_CANTest_SOA_SetSever("RockingDoorSettingFbStruct.SDC_OpenPercentCfgSts:0 sleep0.5");
    gTC_CANTest_SOA_SetSever("RoofSysSt1Struct.RoofMoveStatus:0 sleep0.5");
    gTC_CANTest_SOA_SetSever("RoofSysSt2Struct.RoofPosValue:0 sleep1");
}

void gTC_SOA_Setserver_Method()
{
    gTC_CANTest_SOA_SetSever("CtrlSshdMovRespStruct.RespCode:0");
    gTC_CANTest_SOA_SetSever("CtrlSshdPosTargtMovRespStruct.RespCode:0");
    gTC_CANTest_SOA_SetSever("CtrlSshdLearnRespStruct.RespCode:0");
    gTC_CANTest_SOA_SetSever("LSlideDoorPosCtrRespStruct.RespCode:0");
    gTC_CANTest_SOA_SetSever("LSlideDoorCtrRespStruct.RespCode:0");
    gTC_CANTest_SOA_SetSever("LSlideDoorLockCtrRespStruct.RespCode:0");
    gTC_CANTest_SOA_SetSever("RSlideDoorPosCtrRespStruct.RespCode:0");
    gTC_CANTest_SOA_SetSever("RSlideDoorCtrRespStruct.RespCode:0");
    gTC_CANTest_SOA_SetSever("RSlideDoorLockCtrRespStruct.RespCode:0");
    gTC_CANTest_SOA_SetSever("FwiperSensitivityCmdRespStruct.RespCode:0");
    gTC_CANTest_SOA_SetSever("FwiperSensitivityCfgRespStruct.RespCode:0");
    gTC_CANTest_SOA_SetSever("FWiperServiceCmdRespStruct.RespCode:0");
    gTC_CANTest_SOA_SetSever("SetFwiperSWStsRespStruct.RespCode:0");
    gTC_CANTest_SOA_SetSever("SetFwiperAutoFuncRespStruct.RespCode:0");
    gTC_CANTest_SOA_SetSever("SetWiperFuncInactiveRespStruct.RespCode:0");
    gTC_CANTest_SOA_SetSever("RecallDrvSeatPstRespStruct.RespCode:0");
    gTC_CANTest_SOA_SetSever("SyncDrvSeatPstRespStruct.RespCode:0");
    gTC_CANTest_SOA_SetSever("StopDrvSeatMovingRespStruct.RespCode:0");
    gTC_CANTest_SOA_SetSever("SetDrvSeatEasyEntryRespStruct.RespCode:0");
    gTC_CANTest_SOA_SetSever("SetDrvSeatHeatingRespStruct.RespCode:0");
    gTC_CANTest_SOA_SetSever("SetDrvSeatVentilationRespStruct.RespCode:0");
    gTC_CANTest_SOA_SetSever("DrvSeatSplModCtrlRespStruct.RespCode:0");
    gTC_CANTest_SOA_SetSever("RecallDrvSeatHorzPstRespStruct.RespCode:0");
    gTC_CANTest_SOA_SetSever("RecallDrvSeatVertPstRespStruct.RespCode:0");
    gTC_CANTest_SOA_SetSever("RecallDrvSeatTiltPstRespStruct.RespCode:0");
    gTC_CANTest_SOA_SetSever("RecallDrvSeatCushExtPstRespStruct.RespCode:0");
    gTC_CANTest_SOA_SetSever("RecallDrvSeatCushTiltPstRespStruct.RespCode:0");
    gTC_CANTest_SOA_SetSever("RecallPsngrSeatPstRespStruct.RespCode:0");
    gTC_CANTest_SOA_SetSever("SyncPsngrSeatPstRespStruct.RespCode:0");
    gTC_CANTest_SOA_SetSever("StopPsngrSeatMovingRespStruct.RespCode:0");
    gTC_CANTest_SOA_SetSever("SetPsngrSeatEasyEntryRespStruct.RespCode:0");
    gTC_CANTest_SOA_SetSever("SetPsngrSeatHeatingRespStruct.RespCode:0");
    gTC_CANTest_SOA_SetSever("SetPsngrSeatVentilationRespStruct.RespCode:0");
    gTC_CANTest_SOA_SetSever("PsngrSeatSplModCtrlRespStruct.RespCode:0");
    gTC_CANTest_SOA_SetSever("RecallPsngrSeatHorzPstRespStruct.RespCode:0");
    gTC_CANTest_SOA_SetSever("RecallPsngrSeatVertPstRespStruct.RespCode:0");
    gTC_CANTest_SOA_SetSever("RecallPsngrSeatTiltPstRespStruct.RespCode:0");
    gTC_CANTest_SOA_SetSever("RecallPsngrSeatLeSuHeigPstRespStruct.RespCode:0");
    gTC_CANTest_SOA_SetSever("RecallPsngrSeatLeSuLengPstRespStruct.RespCode:0");
    gTC_CANTest_SOA_SetSever("RecallPsngrSeatZeroGravPstRespStruct.RespCode:0");
    gTC_CANTest_SOA_SetSever("RecallPsngrSeatCushTiltPstRespStruct.RespCode:0");
    gTC_CANTest_SOA_SetSever("RecallSecRowLtSeatPstRespStruct.RespCode:0");
    gTC_CANTest_SOA_SetSever("StopSecRowLtSeatMovingRespStruct.RespCode:0");
    gTC_CANTest_SOA_SetSever("SetSecRowLtSeatHeatingRespStruct.RespCode:0");
    gTC_CANTest_SOA_SetSever("SetSecRowLtSeatVentilationRespStruct.RespCode:0");
    gTC_CANTest_SOA_SetSever("RecallSecRowLtSeatTiltPstRespStruct.RespCode:0");
    gTC_CANTest_SOA_SetSever("SetSecRowLtSeatEasyEntryRespStruct.RespCode:0");
    gTC_CANTest_SOA_SetSever("RecallSecRowRtSeatPstRespStruct.RespCode:0");
    gTC_CANTest_SOA_SetSever("StopSecRowRtSeatMovingRespStruct.RespCode:0");
    gTC_CANTest_SOA_SetSever("SetSecRowRtSeatHeatingRespStruct.RespCode:0");
    gTC_CANTest_SOA_SetSever("SetSecRowRtSeatVentilationRespStruct.RespCode:0");
    gTC_CANTest_SOA_SetSever("RecallSecRowRtSeatTiltPstRespStruct.RespCode:0");
    gTC_CANTest_SOA_SetSever("SetSecRowRtSeatEasyEntryRespStruct.RespCode:0");
    gTC_CANTest_SOA_SetSever("RecallColumnPstRespStruct.RespCode:0");
    gTC_CANTest_SOA_SetSever("SyncColumnPstRespStruct.RespCode:0");
    gTC_CANTest_SOA_SetSever("AllHandleCtrRespStruct.RespCode:0");
    gTC_CANTest_SOA_SetSever("HandleAUTOSetRespStruct.RespCode:0");
    gTC_CANTest_SOA_SetSever("FLWinPosCmdRespStruct.RespCode:0");
    gTC_CANTest_SOA_SetSever("RLWinPosCmdRespStruct.RespCode:0");
    gTC_CANTest_SOA_SetSever("CtrlFLWinRespStruct.RespCode:0");
    gTC_CANTest_SOA_SetSever("CtrlRLWinRespStruct.RespCode:0");
    gTC_CANTest_SOA_SetSever("WinLockCtrlReqRespStruct.RespCode:0");
    gTC_CANTest_SOA_SetSever("LockWinCfgRespStruct.RespCode:0");
    gTC_CANTest_SOA_SetSever("FRWinPosCmdRespStruct.RespCode:0");
    gTC_CANTest_SOA_SetSever("RRWinPosCmdRespStruct.RespCode:0");
    gTC_CANTest_SOA_SetSever("CtrlFRWinRespStruct.RespCode:0");
    gTC_CANTest_SOA_SetSever("CtrlRRWinRespStruct.RespCode:0");
    gTC_CANTest_SOA_SetSever("SetDoorLockStateRespStruct.RespCode:0");
    gTC_CANTest_SOA_SetSever("SetDoorOriLockStRespStruct.RespCode:0");
    gTC_CANTest_SOA_SetSever("SetDoorOriUnlockStRespStruct.RespCode:0");
    gTC_CANTest_SOA_SetSever("SetAutoUnlockFuncRespStruct.RespCode:0");
    gTC_CANTest_SOA_SetSever("SetAutoLockFuncRespStruct.RespCode:0");
    gTC_CANTest_SOA_SetSever("SetPollingUnlockFuncRespStruct.RespCode:0");
    gTC_CANTest_SOA_SetSever("SetPollingLockFuncRespStruct.RespCode:0");
    gTC_CANTest_SOA_SetSever("FLDoorPowerReleaseCtrlRespStruct.RespCode:0");
    gTC_CANTest_SOA_SetSever("FRDoorPowerReleaseCtrlRespStruct.RespCode:0");
    gTC_CANTest_SOA_SetSever("SetRLDoorChildLockRespStruct.RespCode:0");
    gTC_CANTest_SOA_SetSever("SetRRDoorChildLockRespStruct.RespCode:0");
    gTC_CANTest_SOA_SetSever("CtrlLMirrorMoveRespStruct.RespCode:0");
    gTC_CANTest_SOA_SetSever("CtrlLMirrorPosRespStruct.RespCode:0");
    gTC_CANTest_SOA_SetSever("FoldTwoMirrorRespStruct.RespCode:0");
    gTC_CANTest_SOA_SetSever("TwoMirrorAutoFoldCfgRespStruct.RespCode:0");
    gTC_CANTest_SOA_SetSever("CtrlLMirrorLRPosRespStruct.RespCode:0");
    gTC_CANTest_SOA_SetSever("CtrlLMirrorUDPosRespStruct.RespCode:0");
    gTC_CANTest_SOA_SetSever("SyncLMirrorPosRespStruct.RespCode:0");
    gTC_CANTest_SOA_SetSever("CtrlRMirrorMoveRespStruct.RespCode:0");
    gTC_CANTest_SOA_SetSever("CtrlRMirrorPosRespStruct.RespCode:0");
    gTC_CANTest_SOA_SetSever("CtrlRMirrorLRPosRespStruct.RespCode:0");
    gTC_CANTest_SOA_SetSever("CtrlRMirrorUDPosRespStruct.RespCode:0");
    gTC_CANTest_SOA_SetSever("SyncRMirrorPosRespStruct.RespCode:0");
    gTC_CANTest_SOA_SetSever("LowbeamCtrlRespStruct.RespCode:0");
    gTC_CANTest_SOA_SetSever("HighbeamCtrlRespStruct.RespCode:0");
    gTC_CANTest_SOA_SetSever("ParkinglightCtrlRespStruct.RespCode:0");
    gTC_CANTest_SOA_SetSever("LTurnLighCtrlRespStruct.RespCode:0");
    gTC_CANTest_SOA_SetSever("RTurnLightCtrlRespStruct.RespCode:0");
    gTC_CANTest_SOA_SetSever("HazardLightCtrlRespStruct.RespCode:0");
    gTC_CANTest_SOA_SetSever("RearFogLampCtrlRespStruct.RespCode:0");
    gTC_CANTest_SOA_SetSever("RLDoorPowerReleaseCtrlRespStruct.RespCode:0");
    gTC_CANTest_SOA_SetSever("RRDoorPowerReleaseCtrlRespStruct.RespCode:0");
    gTC_CANTest_SOA_SetSever("ChargePortCtrlRespStruct.RespCode:0");
    gTC_CANTest_SOA_SetSever("ChargePortLockCtrlRespStruct.RespCode:0");
    gTC_CANTest_SOA_SetSever("ChargeGunLockCtrlRespStruct.RespCode:0");
    gTC_CANTest_SOA_SetSever("TgateMvtCtrlRespStruct.RespCode:0");
    gTC_CANTest_SOA_SetSever("SetTgateMemHtPosRespStruct.RespCode:0");
    gTC_CANTest_SOA_SetSever("HighVoltageCtrlRespStruct.RespCode:0");
    gTC_CANTest_SOA_SetSever("V2LCtrlRespStruct.RespCode:0");
    gTC_CANTest_SOA_SetSever("TurnOnOffFrAutoACRespStruct.RespCode:0");
    gTC_CANTest_SOA_SetSever("TurnOnFrACRespStruct.RespCode:0");
    gTC_CANTest_SOA_SetSever("TurnOffFrACRespStruct.RespCode:0");
    gTC_CANTest_SOA_SetSever("TurnOnOffRrAutoACRespStruct.RespCode:0");
    gTC_CANTest_SOA_SetSever("TurnOnRrACRespStruct.RespCode:0");
    gTC_CANTest_SOA_SetSever("TurnOffRrACRespStruct.RespCode:0");
    gTC_CANTest_SOA_SetSever("SetOnOffDeodorizeRespStruct.RespCode:0");
    gTC_CANTest_SOA_SetSever("TurnOnOffDefrostRespStruct.RespCode:0");
    gTC_CANTest_SOA_SetSever("SetOnOffECOModeRespStruct.RespCode:0");
    gTC_CANTest_SOA_SetSever("TurnOnOffMaxCoolingRespStruct.RespCode:0");
    gTC_CANTest_SOA_SetSever("TurnOnOffMaxHeatingRespStruct.RespCode:0");
    gTC_CANTest_SOA_SetSever("SetACAfterBlowRespStruct.RespCode:0");
    gTC_CANTest_SOA_SetSever("TurnOnOffInsenVentRespStruct.RespCode:0");
    gTC_CANTest_SOA_SetSever("TurnOnOffSterilizationRespStruct.RespCode:0");
    gTC_CANTest_SOA_SetSever("SetACSelfCleanRespStruct.RespCode:0");
    gTC_CANTest_SOA_SetSever("RestoreAcToMemoStRespStruct.RespCode:0");
    gTC_CANTest_SOA_SetSever("SetBlowCompensationRespStruct.RespCode:0");
    gTC_CANTest_SOA_SetSever("CtrlFrWindSpdRespStruct.RespCode:0");
    gTC_CANTest_SOA_SetSever("CtrlRrWindSpdRespStruct.RespCode:0");
    gTC_CANTest_SOA_SetSever("SetDrvTempRespStruct.RespCode:0");
    gTC_CANTest_SOA_SetSever("SetPsnTempRespStruct.RespCode:0");
    gTC_CANTest_SOA_SetSever("SetRLTempRespStruct.RespCode:0");
    gTC_CANTest_SOA_SetSever("SetRRTempRespStruct.RespCode:0");
    gTC_CANTest_SOA_SetSever("Set3rdRowTempRespStruct.RespCode:0");
    gTC_CANTest_SOA_SetSever("SetSyncRespStruct.RespCode:0");
    gTC_CANTest_SOA_SetSever("SetFrAirDisModeRespStruct.RespCode:0");
    gTC_CANTest_SOA_SetSever("SetRrAirDisModeRespStruct.RespCode:0");
    gTC_CANTest_SOA_SetSever("Set3rdRowAirDisModeRespStruct.RespCode:0");
    gTC_CANTest_SOA_SetSever("SetAirIntakeRespStruct.RespCode:0");
    gTC_CANTest_SOA_SetSever("TurnOnOffAQSRespStruct.RespCode:0");
    gTC_CANTest_SOA_SetSever("TurnOnOffAirCleanRespStruct.RespCode:0");
    gTC_CANTest_SOA_SetSever("SetEAVDrvLeftHorzPosRespStruct.RespCode:0");
    gTC_CANTest_SOA_SetSever("SetEAVDrvLeftVertPosRespStruct.RespCode:0");
    gTC_CANTest_SOA_SetSever("SetEAVDrvRightHorzPosRespStruct.RespCode:0");
    gTC_CANTest_SOA_SetSever("SetEAVDrvRightVertPosRespStruct.RespCode:0");
    gTC_CANTest_SOA_SetSever("SetEAVPsnLeftHorzPosRespStruct.RespCode:0");
    gTC_CANTest_SOA_SetSever("SetEAVPsnLeftVertPosRespStruct.RespCode:0");
    gTC_CANTest_SOA_SetSever("SetEAVPsnRightHorzPosRespStruct.RespCode:0");
    gTC_CANTest_SOA_SetSever("SetEAVPsnRightVertPosRespStruct.RespCode:0");
    gTC_CANTest_SOA_SetSever("SetEAVDrvWindModeRespStruct.RespCode:0");
    gTC_CANTest_SOA_SetSever("SetEAVPsnWindModeRespStruct.RespCode:0");
    gTC_CANTest_SOA_SetSever("SetEAVSweepWindRespStruct.RespCode:0");
    gTC_CANTest_SOA_SetSever("SetEAVRLHorzPosRespStruct.RespCode:0");
    gTC_CANTest_SOA_SetSever("SetEAVRLVertPosRespStruct.RespCode:0");
    gTC_CANTest_SOA_SetSever("SetEAVRRHorzPosRespStruct.RespCode:0");
    gTC_CANTest_SOA_SetSever("SetEAVRRVertPosRespStruct.RespCode:0");
    gTC_CANTest_SOA_SetSever("SetEAVRLWindModeRespStruct.RespCode:0");
    gTC_CANTest_SOA_SetSever("SetEAVRRWindModeRespStruct.RespCode:0");
    gTC_CANTest_SOA_SetSever("SetREAVSweepWindRespStruct.RespCode:0");
    gTC_CANTest_SOA_SetSever("TurnOnOFFHCVRespStruct.RespCode:0");
    gTC_CANTest_SOA_SetSever("RearMirrorHeatCmdRespStruct.RespCode:0");
    gTC_CANTest_SOA_SetSever("FrontMirrorHeatCmdRespStruct.RespCode:0");
    gTC_CANTest_SOA_SetSever("UnlockHazardLightSetRespStruct.RespCode:0");
    gTC_CANTest_SOA_SetSever("UnlockHornSetRespStruct.RespCode:0");
    gTC_CANTest_SOA_SetSever("LockHazardLightSetRespStruct.RespCode:0");
    gTC_CANTest_SOA_SetSever("LockHornSetRespStruct.RespCode:0");
    gTC_CANTest_SOA_SetSever("PollingWelcomeSetRespStruct.RespCode:0");
    gTC_CANTest_SOA_SetSever("EntryExitPEFuncSetRespStruct.RespCode:0");
    gTC_CANTest_SOA_SetSever("RWiperServiceCmdRespStruct.RespCode:0");
    gTC_CANTest_SOA_SetSever("SetDomeLightModeRespStruct.RespCode:0");
    gTC_CANTest_SOA_SetSever("SetDomeLightBrightRespStruct.RespCode:0");
    gTC_CANTest_SOA_SetSever("DomeLightCtrlRespStruct.RespCode:0");
    gTC_CANTest_SOA_SetSever("FLDomeLightCtrlRespStruct.RespCode:0");
    gTC_CANTest_SOA_SetSever("FRDomeLightCtrlRespStruct.RespCode:0");
    gTC_CANTest_SOA_SetSever("RLDomeLightCtrlRespStruct.RespCode:0");
    gTC_CANTest_SOA_SetSever("RRDomeLightCtrlRespStruct.RespCode:0");
    gTC_CANTest_SOA_SetSever("TLDomeLightCtrlRespStruct.RespCode:0");
    gTC_CANTest_SOA_SetSever("TRDomeLightCtrlRespStruct.RespCode:0");
    gTC_CANTest_SOA_SetSever("TrunkLightCtrlRespStruct.RespCode:0");
    gTC_CANTest_SOA_SetSever("FLFootLightCtrlRespStruct.RespCode:0");
    gTC_CANTest_SOA_SetSever("FRFootLightCtrlRespStruct.RespCode:0");
    gTC_CANTest_SOA_SetSever("WelCarpetLightCfgRespStruct.RespCode:0");
    gTC_CANTest_SOA_SetSever("LWelCarpetLightCtrlRespStruct.RespCode:0");
    gTC_CANTest_SOA_SetSever("RWelCarpetLightCtrlRespStruct.RespCode:0");
    gTC_CANTest_SOA_SetSever("HornCtrlRespStruct.RespCode:0");
    gTC_CANTest_SOA_SetSever("CtrlARSMovRespStruct.RespCode:0");
    gTC_CANTest_SOA_SetSever("CtrlARSModeRespStruct.RespCode:0");
    gTC_CANTest_SOA_SetSever("CtrlARSLearnRespStruct.RespCode:0");
    gTC_CANTest_SOA_SetSever("CtrlVehLockARSAutoFoldRespStruct.RespCode:0");
    gTC_CANTest_SOA_SetSever("BonnetUnlockCtrRespStruct.RespCode:0");
    gTC_CANTest_SOA_SetSever("CtrlGloveBoxOpenRespStruct.RespCode:0");
    gTC_CANTest_SOA_SetSever("SDC_ManualModeSetRespStruct.RespCode:0");
    gTC_CANTest_SOA_SetSever("SDC_OpenPercentSetRespStruct.RespCode:0");
    gTC_CANTest_SOA_SetSever("SDC_BrakeCloseSetRespStruct.RespCode:0");
    gTC_CANTest_SOA_SetSever("SDC_WinOpenSetRespStruct.RespCode:0");
    gTC_CANTest_SOA_SetSever("SDC_KeyOpenSetRespStruct.RespCode:0");
    gTC_CANTest_SOA_SetSever("LeftRockingDoorCtrlRespStruct.RespCode:0");
    gTC_CANTest_SOA_SetSever("RightRockingDoorCtrlRespStruct.RespCode:0");
    gTC_CANTest_SOA_SetSever("CtrlRoofMovRespStruct.RespCode:0");
    gTC_CANTest_SOA_SetSever("CtrlRoofPosTargtMovRespStruct.RespCode:0");
    gTC_CANTest_SOA_SetSever("CtrlRoofLearnRespStruct.RespCode:0");
}
