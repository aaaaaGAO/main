/*@!Encoding:65001*/
includes
{
  
}

variables
{
  
}

void gTC_SOA_Setserver_Event()
{
    gTC_CANTest_SOA_SetSever("FwiperStStruct.FWiperSpd:0 sleep1");
    gTC_CANTest_SOA_SetSever("FwiperSt2Struct.FWiperMotorAngle:0 sleep1");
    gTC_CANTest_SOA_SetSever("RLSStStruct.RLSRainIntensity:0 sleep0.04");
    gTC_CANTest_SOA_SetSever("PsngrSeatPstStruct.PsngrSeatHorzPos:0 sleep1");
    gTC_CANTest_SOA_SetSever("PsngrSeatFuncStStruct.PsngrSeatEasyEntrySt:0 sleep1");
    gTC_CANTest_SOA_SetSever("SecRowRtSeatPstStruct.SecRowRtSeatTiltingPos:0 sleep1");
    gTC_CANTest_SOA_SetSever("SecRowRtSeatFuncStStruct.SecRowRtSeatAutoAdjEnableSt:0 sleep1");
    gTC_CANTest_SOA_SetSever("FRWindowStStruct.FRWinSwSt:0 sleep0.5");
    gTC_CANTest_SOA_SetSever("FRWindowSt2Struct.FRWinHallCounts:0 sleep1");
    gTC_CANTest_SOA_SetSever("RRWindowStStruct.RRWinSwSt:0 sleep0.5");
    gTC_CANTest_SOA_SetSever("RRWindowSt2Struct.RRWinHallCounts:0 sleep1");
    gTC_CANTest_SOA_SetSever("FRDoorSwSt1Struct.FRDoorReleaseSource:0 sleep0.5");
    gTC_CANTest_SOA_SetSever("RMirrorPosStruct.RMirrorLRCurPos:0 sleep1");
    gTC_CANTest_SOA_SetSever("RMirrorStStruct.RMirrorFoldOutputSt:0 sleep0.5");
    gTC_CANTest_SOA_SetSever("LightsStStruct.LowBeamOutputSt:0 sleep0.5");
    gTC_CANTest_SOA_SetSever("RRDoorSwSt1Struct.RRDoorReleaseSource:0 sleep0.5");
    gTC_CANTest_SOA_SetSever("ChargePortStateStruct.ChrgConnStReq:0 sleep1");
    gTC_CANTest_SOA_SetSever("ChargePortState2Struct.ChargePortSesorPercent:0 sleep1");
    gTC_CANTest_SOA_SetSever("ChargeGunLockStateStruct.ChargeLockType:0 sleep1");
    gTC_CANTest_SOA_SetSever("ACSysStateStruct.AutoSt:0 sleep0.5");
    gTC_CANTest_SOA_SetSever("WindExitSpdStruct.WindExitSpd:0 sleep0.5");
    gTC_CANTest_SOA_SetSever("TempSelectStStruct.DriverTempSelectSt:0 sleep0.5");
    gTC_CANTest_SOA_SetSever("AirDistributionModeStruct.AirDistributionMode:0 sleep0.5");
    gTC_CANTest_SOA_SetSever("AirIntakeStStruct.AirIntakeSt:0 sleep0.5");
    gTC_CANTest_SOA_SetSever("AirCleanStStruct.AirCleanSt:0 sleep0.5");
    gTC_CANTest_SOA_SetSever("TempSensorInfoFBStruct.CorrectedExterTemp:0 sleep0.1");
    gTC_CANTest_SOA_SetSever("TempSensorInfoFB2Struct.WindModeColour:0 sleep0.5");
    gTC_CANTest_SOA_SetSever("TuyereAndModeStStruct.EAVDrvLeftHorzPosFB:0 sleep0.1");
    gTC_CANTest_SOA_SetSever("ThermalSys1Struct.BTMActualWorkSt:0 sleep0.5");
    gTC_CANTest_SOA_SetSever("ThermalSys2Struct.CompComsumePwr:0 sleep0.1");
    gTC_CANTest_SOA_SetSever("ThermalSysSenInfoStruct.RefHPT_Temp:0 sleep0.1");
    gTC_CANTest_SOA_SetSever("ThermalSysActuator1Struct.AM_VolFb_Left:0 sleep0.1");
    gTC_CANTest_SOA_SetSever("ThermalSysActuator2Struct.TS_PwrRelaySt:0 sleep0.1");
    gTC_CANTest_SOA_SetSever("TMC_DTCStruct.LftFaceSe_Sht2GND:0 sleep0.1");
    gTC_CANTest_SOA_SetSever("HcvStStruct.HcvSt:0 sleep0.5");
    gTC_CANTest_SOA_SetSever("FrontMirrorHeatStStruct.FrontMirrorHeatOutputSt:0 sleep0.5");
    gTC_CANTest_SOA_SetSever("Veh_SeatMassageStsStruct.Veh_DrvSeatMassgIntenSts:0 sleep1");
    gTC_CANTest_SOA_SetSever("Veh_SeatLumbStsStruct.Veh_DrvSeatLumbRelaxSts:0 sleep1");
    gTC_CANTest_SOA_SetSever("Veh_SeatLumbRelaxIntenStsStruct.Veh_DrvSeatLumbRelaxIntenSts:0 sleep1");
    gTC_CANTest_SOA_SetSever("SFMStStruct.SFM_State:0 sleep1");
    gTC_CANTest_SOA_SetSever("SFMSt2Struct.SFM_Pos:0 sleep1");
    gTC_CANTest_SOA_SetSever("SWSHeatStStruct.SWSHeatSt:0 sleep1");
    gTC_CANTest_SOA_SetSever("SFSStStruct.SFS_Sw_St:0 sleep0.1");
    gTC_CANTest_SOA_SetSever("Veh_BodySts_DoorStruct.Veh_AlarmSt:0 sleep0.5");
    gTC_CANTest_SOA_SetSever("Veh_BodySts_PwrStruct.Veh_PowerMode:0 sleep0.1");
    gTC_CANTest_SOA_SetSever("Veh_BodySts_SeatStruct.Veh_DrvSeatOccupancySt:0 sleep0.5");
    gTC_CANTest_SOA_SetSever("Veh_BodySts5_PowertrainStruct.Veh_VehSpdVD:0 sleep0.05");
    gTC_CANTest_SOA_SetSever("SOAEngineInterSignalStruct.SOAEngineHVPowerReq:0 sleep1");
    gTC_CANTest_SOA_SetSever("RWiperStStruct.RWiperWashSwSt:0 sleep1");
    gTC_CANTest_SOA_SetSever("HornStStruct.HornActivationSt:0 sleep1");
    gTC_CANTest_SOA_SetSever("ARSSysSt1Struct.ARSModeSt:0 sleep1");
    gTC_CANTest_SOA_SetSever("ARSSysSt2Struct.ARSPstValu:0 sleep1");
    gTC_CANTest_SOA_SetSever("DoorLockSt2Struct.BonnetAjarSt:0 sleep0.5");
    gTC_CANTest_SOA_SetSever("LeftRockingDoorSysSt1Struct.SDC_SysErr:0 sleep0.5");
    gTC_CANTest_SOA_SetSever("RightRockingDoorSysSt2Struct.SDC_SysErr:0 sleep0.5");
    gTC_CANTest_SOA_SetSever("RightRockingDoorRadarInfoStruct.SDC_L_MoveReq:0 sleep0.5");
    gTC_CANTest_SOA_SetSever("RockingDoorSettingFbStruct.SDC_OpenPercentCfgSts:0 sleep0.5");
    gTC_CANTest_SOA_SetSever("ADASMomentSwtStruct.ADASMomentSwt:0 sleep1");
    gTC_CANTest_SOA_SetSever("ADASMomentTripSwtStruct.ADASMomentTripSwt:0 sleep1");
}

void gTC_SOA_Setserver_Method()
{
    gTC_CANTest_SOA_SetSever("FwiperSensitivityCmdRespStruct.RespCode:0");
    gTC_CANTest_SOA_SetSever("FwiperSensitivityCfgRespStruct.RespCode:0");
    gTC_CANTest_SOA_SetSever("FWiperServiceCmdRespStruct.RespCode:0");
    gTC_CANTest_SOA_SetSever("SetFwiperSWStsRespStruct.RespCode:0");
    gTC_CANTest_SOA_SetSever("SetFwiperAutoFuncRespStruct.RespCode:0");
    gTC_CANTest_SOA_SetSever("SetWiperFuncInactiveRespStruct.RespCode:0");
    gTC_CANTest_SOA_SetSever("RecallPsngrSeatPstRespStruct.RespCode:0");
    gTC_CANTest_SOA_SetSever("SyncPsngrSeatPstRespStruct.RespCode:0");
    gTC_CANTest_SOA_SetSever("StopPsngrSeatMovingRespStruct.RespCode:0");
    gTC_CANTest_SOA_SetSever("SetPsngrSeatEasyEntryRespStruct.RespCode:0");
    gTC_CANTest_SOA_SetSever("SetPsngrSeatHeatingRespStruct.RespCode:0");
    gTC_CANTest_SOA_SetSever("SetPsngrSeatVentilationRespStruct.RespCode:0");
    gTC_CANTest_SOA_SetSever("PsngrSeatSplModCtrlRespStruct.RespCode:0");
    gTC_CANTest_SOA_SetSever("RecallPsngrSeatHorzPstRespStruct.RespCode:0");
    gTC_CANTest_SOA_SetSever("RecallPsngrSeatVertPstRespStruct.RespCode:0");
    gTC_CANTest_SOA_SetSever("RecallPsngrSeatTiltPstRespStruct.RespCode:0");
    gTC_CANTest_SOA_SetSever("RecallPsngrSeatLeSuHeigPstRespStruct.RespCode:0");
    gTC_CANTest_SOA_SetSever("RecallPsngrSeatLeSuLengPstRespStruct.RespCode:0");
    gTC_CANTest_SOA_SetSever("RecallPsngrSeatZeroGravPstRespStruct.RespCode:0");
    gTC_CANTest_SOA_SetSever("RecallPsngrSeatCushTiltPstRespStruct.RespCode:0");
    gTC_CANTest_SOA_SetSever("RecallSecRowRtSeatPstRespStruct.RespCode:0");
    gTC_CANTest_SOA_SetSever("StopSecRowRtSeatMovingRespStruct.RespCode:0");
    gTC_CANTest_SOA_SetSever("SetSecRowRtSeatHeatingRespStruct.RespCode:0");
    gTC_CANTest_SOA_SetSever("SetSecRowRtSeatVentilationRespStruct.RespCode:0");
    gTC_CANTest_SOA_SetSever("RecallSecRowRtSeatTiltPstRespStruct.RespCode:0");
    gTC_CANTest_SOA_SetSever("SetSecRowRtSeatEasyEntryRespStruct.RespCode:0");
    gTC_CANTest_SOA_SetSever("FRWinPosCmdRespStruct.RespCode:0");
    gTC_CANTest_SOA_SetSever("RRWinPosCmdRespStruct.RespCode:0");
    gTC_CANTest_SOA_SetSever("CtrlFRWinRespStruct.RespCode:0");
    gTC_CANTest_SOA_SetSever("CtrlRRWinRespStruct.RespCode:0");
    gTC_CANTest_SOA_SetSever("FRDoorPowerReleaseCtrlRespStruct.RespCode:0");
    gTC_CANTest_SOA_SetSever("CtrlRMirrorMoveRespStruct.RespCode:0");
    gTC_CANTest_SOA_SetSever("CtrlRMirrorPosRespStruct.RespCode:0");
    gTC_CANTest_SOA_SetSever("CtrlRMirrorLRPosRespStruct.RespCode:0");
    gTC_CANTest_SOA_SetSever("CtrlRMirrorUDPosRespStruct.RespCode:0");
    gTC_CANTest_SOA_SetSever("SyncRMirrorPosRespStruct.RespCode:0");
    gTC_CANTest_SOA_SetSever("LowbeamCtrlRespStruct.RespCode:0");
    gTC_CANTest_SOA_SetSever("HighbeamCtrlRespStruct.RespCode:0");
    gTC_CANTest_SOA_SetSever("ParkinglightCtrlRespStruct.RespCode:0");
    gTC_CANTest_SOA_SetSever("LTurnLighCtrlRespStruct.RespCode:0");
    gTC_CANTest_SOA_SetSever("RTurnLightCtrlRespStruct.RespCode:0");
    gTC_CANTest_SOA_SetSever("HazardLightCtrlRespStruct.RespCode:0");
    gTC_CANTest_SOA_SetSever("RearFogLampCtrlRespStruct.RespCode:0");
    gTC_CANTest_SOA_SetSever("RRDoorPowerReleaseCtrlRespStruct.RespCode:0");
    gTC_CANTest_SOA_SetSever("ChargePortCtrlRespStruct.RespCode:0");
    gTC_CANTest_SOA_SetSever("ChargePortLockCtrlRespStruct.RespCode:0");
    gTC_CANTest_SOA_SetSever("ChargeGunLockCtrlRespStruct.RespCode:0");
    gTC_CANTest_SOA_SetSever("TurnOnOffFrAutoACRespStruct.RespCode:0");
    gTC_CANTest_SOA_SetSever("TurnOnFrACRespStruct.RespCode:0");
    gTC_CANTest_SOA_SetSever("TurnOffFrACRespStruct.RespCode:0");
    gTC_CANTest_SOA_SetSever("TurnOnOffRrAutoACRespStruct.RespCode:0");
    gTC_CANTest_SOA_SetSever("TurnOnRrACRespStruct.RespCode:0");
    gTC_CANTest_SOA_SetSever("TurnOffRrACRespStruct.RespCode:0");
    gTC_CANTest_SOA_SetSever("SetOnOffDeodorizeRespStruct.RespCode:0");
    gTC_CANTest_SOA_SetSever("TurnOnOffDefrostRespStruct.RespCode:0");
    gTC_CANTest_SOA_SetSever("SetOnOffECOModeRespStruct.RespCode:0");
    gTC_CANTest_SOA_SetSever("TurnOnOffMaxCoolingRespStruct.RespCode:0");
    gTC_CANTest_SOA_SetSever("TurnOnOffMaxHeatingRespStruct.RespCode:0");
    gTC_CANTest_SOA_SetSever("SetACAfterBlowRespStruct.RespCode:0");
    gTC_CANTest_SOA_SetSever("TurnOnOffInsenVentRespStruct.RespCode:0");
    gTC_CANTest_SOA_SetSever("TurnOnOffSterilizationRespStruct.RespCode:0");
    gTC_CANTest_SOA_SetSever("SetACSelfCleanRespStruct.RespCode:0");
    gTC_CANTest_SOA_SetSever("RestoreAcToMemoStRespStruct.RespCode:0");
    gTC_CANTest_SOA_SetSever("SetBlowCompensationRespStruct.RespCode:0");
    gTC_CANTest_SOA_SetSever("CtrlFrWindSpdRespStruct.RespCode:0");
    gTC_CANTest_SOA_SetSever("CtrlRrWindSpdRespStruct.RespCode:0");
    gTC_CANTest_SOA_SetSever("SetDrvTempRespStruct.RespCode:0");
    gTC_CANTest_SOA_SetSever("SetPsnTempRespStruct.RespCode:0");
    gTC_CANTest_SOA_SetSever("SetRLTempRespStruct.RespCode:0");
    gTC_CANTest_SOA_SetSever("SetRRTempRespStruct.RespCode:0");
    gTC_CANTest_SOA_SetSever("Set3rdRowTempRespStruct.RespCode:0");
    gTC_CANTest_SOA_SetSever("SetSyncRespStruct.RespCode:0");
    gTC_CANTest_SOA_SetSever("SetFrAirDisModeRespStruct.RespCode:0");
    gTC_CANTest_SOA_SetSever("SetRrAirDisModeRespStruct.RespCode:0");
    gTC_CANTest_SOA_SetSever("Set3rdRowAirDisModeRespStruct.RespCode:0");
    gTC_CANTest_SOA_SetSever("SetAirIntakeRespStruct.RespCode:0");
    gTC_CANTest_SOA_SetSever("TurnOnOffAQSRespStruct.RespCode:0");
    gTC_CANTest_SOA_SetSever("TurnOnOffAirCleanRespStruct.RespCode:0");
    gTC_CANTest_SOA_SetSever("SetEAVDrvLeftHorzPosRespStruct.RespCode:0");
    gTC_CANTest_SOA_SetSever("SetEAVDrvLeftVertPosRespStruct.RespCode:0");
    gTC_CANTest_SOA_SetSever("SetEAVDrvRightHorzPosRespStruct.RespCode:0");
    gTC_CANTest_SOA_SetSever("SetEAVDrvRightVertPosRespStruct.RespCode:0");
    gTC_CANTest_SOA_SetSever("SetEAVPsnLeftHorzPosRespStruct.RespCode:0");
    gTC_CANTest_SOA_SetSever("SetEAVPsnLeftVertPosRespStruct.RespCode:0");
    gTC_CANTest_SOA_SetSever("SetEAVPsnRightHorzPosRespStruct.RespCode:0");
    gTC_CANTest_SOA_SetSever("SetEAVPsnRightVertPosRespStruct.RespCode:0");
    gTC_CANTest_SOA_SetSever("SetEAVDrvWindModeRespStruct.RespCode:0");
    gTC_CANTest_SOA_SetSever("SetEAVPsnWindModeRespStruct.RespCode:0");
    gTC_CANTest_SOA_SetSever("SetEAVSweepWindRespStruct.RespCode:0");
    gTC_CANTest_SOA_SetSever("SetEAVRLHorzPosRespStruct.RespCode:0");
    gTC_CANTest_SOA_SetSever("SetEAVRLVertPosRespStruct.RespCode:0");
    gTC_CANTest_SOA_SetSever("SetEAVRRHorzPosRespStruct.RespCode:0");
    gTC_CANTest_SOA_SetSever("SetEAVRRVertPosRespStruct.RespCode:0");
    gTC_CANTest_SOA_SetSever("SetEAVRLWindModeRespStruct.RespCode:0");
    gTC_CANTest_SOA_SetSever("SetEAVRRWindModeRespStruct.RespCode:0");
    gTC_CANTest_SOA_SetSever("SetREAVSweepWindRespStruct.RespCode:0");
    gTC_CANTest_SOA_SetSever("TurnOnOFFHCVRespStruct.RespCode:0");
    gTC_CANTest_SOA_SetSever("FrontMirrorHeatCmdRespStruct.RespCode:0");
    gTC_CANTest_SOA_SetSever("Veh_LSlideDoorCtrRespStruct.RespCode:0");
    gTC_CANTest_SOA_SetSever("Veh_LSlideDoorPosCtrRespStruct.RespCode:0");
    gTC_CANTest_SOA_SetSever("Veh_RSlideDoorCtrRespStruct.RespCode:0");
    gTC_CANTest_SOA_SetSever("Veh_RSlideDoorPosCtrRespStruct.RespCode:0");
    gTC_CANTest_SOA_SetSever("Veh_LSlideDoorModeCfgRespStruct.RespCode:0");
    gTC_CANTest_SOA_SetSever("Veh_RSlideDoorModeCfgRespStruct.RespCode:0");
    gTC_CANTest_SOA_SetSever("Veh_SetDrvSeatHeatingRespStruct.RespCode:0");
    gTC_CANTest_SOA_SetSever("Veh_SetDrvSeatVentilationRespStruct.RespCode:0");
    gTC_CANTest_SOA_SetSever("Veh_SetPsngrSeatHeatingRespStruct.RespCode:0");
    gTC_CANTest_SOA_SetSever("Veh_SetPsngrSeatVentilationRespStruct.RespCode:0");
    gTC_CANTest_SOA_SetSever("Veh_SetSecRowLtSeatHeatingRespStruct.RespCode:0");
    gTC_CANTest_SOA_SetSever("Veh_SetSecRowLtSeatVentilationRespStruct.RespCode:0");
    gTC_CANTest_SOA_SetSever("Veh_SetSecRowRtSeatHeatingRespStruct.RespCode:0");
    gTC_CANTest_SOA_SetSever("Veh_SetSecRowRtSeatVentilationRespStruct.RespCode:0");
    gTC_CANTest_SOA_SetSever("Veh_TurnOnDrvSeatMassageRespStruct.RespCode:0");
    gTC_CANTest_SOA_SetSever("Veh_SetDrvSeatMassageIntensityRespStruct.RespCode:0");
    gTC_CANTest_SOA_SetSever("Veh_SetDrvSeatMassageModeRespStruct.RespCode:0");
    gTC_CANTest_SOA_SetSever("Veh_TurnOffDrvSeatMassageRespStruct.RespCode:0");
    gTC_CANTest_SOA_SetSever("Veh_TurnOnPsngrSeatMassageRespStruct.RespCode:0");
    gTC_CANTest_SOA_SetSever("Veh_SetPsngrSeatMassageIntensityRespStruct.RespCode:0");
    gTC_CANTest_SOA_SetSever("Veh_SetPsngrSeatMassageModeRespStruct.RespCode:0");
    gTC_CANTest_SOA_SetSever("Veh_TurnOffPsngrSeatMassageRespStruct.RespCode:0");
    gTC_CANTest_SOA_SetSever("Veh_SetDrvSeatLumbRelaxRespStruct.RespCode:0");
    gTC_CANTest_SOA_SetSever("Veh_SetPsngrSeatLumbRelaxRespStruct.RespCode:0");
    gTC_CANTest_SOA_SetSever("Veh_TurnOnSecRowLtSeatMassageRespStruct.RespCode:0");
    gTC_CANTest_SOA_SetSever("Veh_SetSecRowLtSeatMassageIntensityRespStruct.RespCode:0");
    gTC_CANTest_SOA_SetSever("Veh_SetSecRowLtSeatMassageModeRespStruct.RespCode:0");
    gTC_CANTest_SOA_SetSever("Veh_TurnOffSecRowLtSeatMassageRespStruct.RespCode:0");
    gTC_CANTest_SOA_SetSever("Veh_TurnOnSecRowRtSeatMassageRespStruct.RespCode:0");
    gTC_CANTest_SOA_SetSever("Veh_SetSecRowRtSeatMassageIntensityRespStruct.RespCode:0");
    gTC_CANTest_SOA_SetSever("Veh_SetSecRowRtSeatMassageModeRespStruct.RespCode:0");
    gTC_CANTest_SOA_SetSever("Veh_TurnOffSecRowRtSeatMassageRespStruct.RespCode:0");
    gTC_CANTest_SOA_SetSever("Veh_SetDrvSeatLumbRelaxIntenRespStruct.RespCode:0");
    gTC_CANTest_SOA_SetSever("Veh_SetPsSeatLumbRelaxIntenRespStruct.RespCode:0");
    gTC_CANTest_SOA_SetSever("Veh_SFMOpenCloseCtrRespStruct.RespCode:0");
    gTC_CANTest_SOA_SetSever("Veh_SFMPosCtrRespStruct.RespCode:0");
    gTC_CANTest_SOA_SetSever("Veh_CtrlAllWinUpDownRespStruct.RespCode:0");
    gTC_CANTest_SOA_SetSever("Veh_SetDoorLockStateRespStruct.RespCode:0");
    gTC_CANTest_SOA_SetSever("Veh_SetDoorOriLockStRespStruct.RespCode:0");
    gTC_CANTest_SOA_SetSever("Veh_SetDoorOriUnlockStRespStruct.RespCode:0");
    gTC_CANTest_SOA_SetSever("Veh_TgateMvtCtrlRespStruct.RespCode:0");
    gTC_CANTest_SOA_SetSever("Veh_SWSHeatCmdRespStruct.RespCode:0");
    gTC_CANTest_SOA_SetSever("Veh_TurnOnOffACRespStruct.RespCode:0");
    gTC_CANTest_SOA_SetSever("Veh_TurnOnOffFrACRespStruct.RespCode:0");
    gTC_CANTest_SOA_SetSever("Veh_TurnOnOffRrACRespStruct.RespCode:0");
    gTC_CANTest_SOA_SetSever("Veh_TurnOnOffAutoACRespStruct.RespCode:0");
    gTC_CANTest_SOA_SetSever("Veh_TurnOnOffFrAutoACRespStruct.RespCode:0");
    gTC_CANTest_SOA_SetSever("Veh_TurnOnOffRrAutoACRespStruct.RespCode:0");
    gTC_CANTest_SOA_SetSever("Veh_TurnOnOffInsenVentRespStruct.RespCode:0");
    gTC_CANTest_SOA_SetSever("Veh_TurnOnOffDefrostRespStruct.RespCode:0");
    gTC_CANTest_SOA_SetSever("Veh_TurnOnOffMaxCoolingRespStruct.RespCode:0");
    gTC_CANTest_SOA_SetSever("Veh_TurnOnOffMaxHeatingRespStruct.RespCode:0");
    gTC_CANTest_SOA_SetSever("Veh_TurnOnOffSterilizationRespStruct.RespCode:0");
    gTC_CANTest_SOA_SetSever("Veh_SetACAfterBlowRespStruct.RespCode:0");
    gTC_CANTest_SOA_SetSever("Veh_TurnOnOffACSelfCleanRespStruct.RespCode:0");
    gTC_CANTest_SOA_SetSever("Veh_SetDrvTempRespStruct.RespCode:0");
    gTC_CANTest_SOA_SetSever("Veh_SetPsnTempRespStruct.RespCode:0");
    gTC_CANTest_SOA_SetSever("Veh_SetRLTempRespStruct.RespCode:0");
    gTC_CANTest_SOA_SetSever("Veh_SetRRTempRespStruct.RespCode:0");
    gTC_CANTest_SOA_SetSever("Veh_Set3rdRowTempRespStruct.RespCode:0");
    gTC_CANTest_SOA_SetSever("Veh_SetSyncRespStruct.RespCode:0");
    gTC_CANTest_SOA_SetSever("Veh_CtrlFrWindSpdRespStruct.RespCode:0");
    gTC_CANTest_SOA_SetSever("Veh_CtrlRrWindSpdRespStruct.RespCode:0");
    gTC_CANTest_SOA_SetSever("Veh_SetAirIntakeRespStruct.RespCode:0");
    gTC_CANTest_SOA_SetSever("Veh_SetFrAirDisModeRespStruct.RespCode:0");
    gTC_CANTest_SOA_SetSever("Veh_SetRrAirDisModeRespStruct.RespCode:0");
    gTC_CANTest_SOA_SetSever("Veh_Set3rdRowAirDisModeRespStruct.RespCode:0");
    gTC_CANTest_SOA_SetSever("Veh_SetOnOffECOModeRespStruct.RespCode:0");
    gTC_CANTest_SOA_SetSever("Veh_SetOnOffDeodorizeRespStruct.RespCode:0");
    gTC_CANTest_SOA_SetSever("Veh_SetEAVDrvWindModeRespStruct.RespCode:0");
    gTC_CANTest_SOA_SetSever("Veh_SetEAVPsnWindModeRespStruct.RespCode:0");
    gTC_CANTest_SOA_SetSever("Veh_SetEAVSweepWindRespStruct.RespCode:0");
    gTC_CANTest_SOA_SetSever("Veh_SetEAVDrvLeftHorzPosRespStruct.RespCode:0");
    gTC_CANTest_SOA_SetSever("Veh_SetEAVDrvLeftVertPosRespStruct.RespCode:0");
    gTC_CANTest_SOA_SetSever("Veh_SetEAVDrvRightVertPosRespStruct.RespCode:0");
    gTC_CANTest_SOA_SetSever("Veh_SetEAVDrvRightHorzPosRespStruct.RespCode:0");
    gTC_CANTest_SOA_SetSever("Veh_SetEAVPsnLeftHorzPosRespStruct.RespCode:0");
    gTC_CANTest_SOA_SetSever("Veh_SetEAVPsnLeftVertPosRespStruct.RespCode:0");
    gTC_CANTest_SOA_SetSever("Veh_SetEAVPsnRightVertPosRespStruct.RespCode:0");
    gTC_CANTest_SOA_SetSever("Veh_SetEAVPsnRightHorzPosRespStruct.RespCode:0");
    gTC_CANTest_SOA_SetSever("Veh_TurnOnOffAirCleanRespStruct.RespCode:0");
    gTC_CANTest_SOA_SetSever("Veh_TurnOnOffAQSRespStruct.RespCode:0");
    gTC_CANTest_SOA_SetSever("Veh_TurnOnOFFHCVRespStruct.RespCode:0");
    gTC_CANTest_SOA_SetSever("Veh_DriverTempUpRespStruct.RespCode:0");
    gTC_CANTest_SOA_SetSever("Veh_DriverTempDownRespStruct.RespCode:0");
    gTC_CANTest_SOA_SetSever("Veh_PsnTempUpRespStruct.RespCode:0");
    gTC_CANTest_SOA_SetSever("Veh_PsnTempDownRespStruct.RespCode:0");
    gTC_CANTest_SOA_SetSever("Veh_RLTempUpRespStruct.RespCode:0");
    gTC_CANTest_SOA_SetSever("Veh_RLTempDownRespStruct.RespCode:0");
    gTC_CANTest_SOA_SetSever("Veh_RRTempUpRespStruct.RespCode:0");
    gTC_CANTest_SOA_SetSever("Veh_RRTempDownRespStruct.RespCode:0");
    gTC_CANTest_SOA_SetSever("Veh_3rdRowTempUpRespStruct.RespCode:0");
    gTC_CANTest_SOA_SetSever("Veh_3rdRowTempDownRespStruct.RespCode:0");
    gTC_CANTest_SOA_SetSever("Veh_FrWindSpdUpRespStruct.RespCode:0");
    gTC_CANTest_SOA_SetSever("Veh_FrWindSpdDownRespStruct.RespCode:0");
    gTC_CANTest_SOA_SetSever("Veh_RrWindSpdUpRespStruct.RespCode:0");
    gTC_CANTest_SOA_SetSever("Veh_RrWindSpdDownRespStruct.RespCode:0");
    gTC_CANTest_SOA_SetSever("Veh_FrAirDisModeBtnRespStruct.RespCode:0");
    gTC_CANTest_SOA_SetSever("Veh_RrAirDisModeBtnRespStruct.RespCode:0");
    gTC_CANTest_SOA_SetSever("Veh_3rdRowAirDisModeBtnRespStruct.RespCode:0");
    gTC_CANTest_SOA_SetSever("Veh_SetEAVRLWindModeRespStruct.RespCode:0");
    gTC_CANTest_SOA_SetSever("Veh_SetEAVRRWindModeRespStruct.RespCode:0");
    gTC_CANTest_SOA_SetSever("Veh_SetREAVSweepWindRespStruct.RespCode:0");
    gTC_CANTest_SOA_SetSever("Veh_SetEAVRLHorzPosRespStruct.RespCode:0");
    gTC_CANTest_SOA_SetSever("Veh_SetEAVRLVertPosRespStruct.RespCode:0");
    gTC_CANTest_SOA_SetSever("Veh_SetEAVRRHorzPosRespStruct.RespCode:0");
    gTC_CANTest_SOA_SetSever("Veh_SetEAVRRVertPosRespStruct.RespCode:0");
    gTC_CANTest_SOA_SetSever("Veh_SetBlowCompensationRespStruct.RespCode:0");
    gTC_CANTest_SOA_SetSever("Veh_RearMirrorHeatRespStruct.RespCode:0");
    gTC_CANTest_SOA_SetSever("Veh_TurnOnOffSFSRespStruct.RespCode:0");
    gTC_CANTest_SOA_SetSever("Veh_SetSFSChanelRespStruct.RespCode:0");
    gTC_CANTest_SOA_SetSever("Veh_SetSFSConRespStruct.RespCode:0");
    gTC_CANTest_SOA_SetSever("Veh_SFSCh1ResetRqRespStruct.RespCode:0");
    gTC_CANTest_SOA_SetSever("Veh_SFSCh2ResetRqRespStruct.RespCode:0");
    gTC_CANTest_SOA_SetSever("Veh_SFSCh3ResetRqRespStruct.RespCode:0");
    gTC_CANTest_SOA_SetSever("Veh_FrontMirrorHeatRespStruct.RespCode:0");
    gTC_CANTest_SOA_SetSever("RWiperServiceCmdRespStruct.RespCode:0");
    gTC_CANTest_SOA_SetSever("HornCtrlRespStruct.RespCode:0");
    gTC_CANTest_SOA_SetSever("CtrlARSMovRespStruct.RespCode:0");
    gTC_CANTest_SOA_SetSever("CtrlARSModeRespStruct.RespCode:0");
    gTC_CANTest_SOA_SetSever("CtrlARSLearnRespStruct.RespCode:0");
    gTC_CANTest_SOA_SetSever("CtrlVehLockARSAutoFoldRespStruct.RespCode:0");
    gTC_CANTest_SOA_SetSever("BonnetUnlockCtrRespStruct.RespCode:0");
    gTC_CANTest_SOA_SetSever("CtrlGloveBoxOpenRespStruct.RespCode:0");
    gTC_CANTest_SOA_SetSever("Veh_LeftRockingDoorCtrlRespStruct.RespCode:0");
    gTC_CANTest_SOA_SetSever("Veh_RightRockingDoorCtrlRespStruct.RespCode:0");
    gTC_CANTest_SOA_SetSever("SDC_ManualModeSetRespStruct.RespCode:0");
    gTC_CANTest_SOA_SetSever("SDC_OpenPercentSetRespStruct.RespCode:0");
    gTC_CANTest_SOA_SetSever("SDC_BrakeCloseSetRespStruct.RespCode:0");
    gTC_CANTest_SOA_SetSever("SDC_WinOpenSetRespStruct.RespCode:0");
    gTC_CANTest_SOA_SetSever("SDC_KeyOpenSetRespStruct.RespCode:0");
    gTC_CANTest_SOA_SetSever("LeftRockingDoorCtrlRespStruct.RespCode:0");
    gTC_CANTest_SOA_SetSever("RightRockingDoorCtrlRespStruct.RespCode:0");
}
