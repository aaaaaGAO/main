/*@!Encoding:936*/
includes
{
   // #include "SOA_DataTyp.cin"
}

variables
{
   struct SOA_NodeInfo_Typ soa_nodeinfo[MAX_NODE_NUM] = {
       {0,           "SOAEngine",            0,                        3},
       {1,           "RDCU",                 6,                        3},
       {2,           "LDCU",                 6,                        3},
       {3,           "TBOX",                 6,                        3},
       {4,           "Tester",               0xffffffff,      0xffffffff}
   };

dword soa_subserviceinfo_len = 123;
struct SOA_SubServiceEventInfo_Typ soa_subserviceinfo[123] = {
{0,    0x0041,    0x0001,    "SshdService_ErrGrp",    "LDCU"},
{1,    0x0041,    0x0002,    "SshdSysSt",    "LDCU"},
{2,    0x0050,    0x0001,    "LeftSlideDoorCtrlService_ErrGrp",    "LDCU"},
{3,    0x0050,    0x0002,    "LSlideDoorSt",    "LDCU"},
{4,    0x0051,    0x0001,    "RightSlideDoorCtrlService_ErrGrp",    "LDCU"},
{5,    0x0051,    0x0002,    "RSlideDoorSt",    "LDCU"},
{6,    0x0054,    0x0001,    "FwiperService_ErrGrp",    "RDCU"},
{7,    0x0054,    0x0002,    "FwiperSt",    "RDCU"},
{8,    0x0054,    0x0003,    "RLSSt",    "RDCU"},
{9,    0x0058,    0x0001,    "DrvSeatCtrlService_ErrGrp",    "LDCU"},
{10,    0x0058,    0x0002,    "DrvSeatSystemSt",    "LDCU"},
{11,    0x0059,    0x0001,    "PsngrSeatCtrlService_ErrGrp",    "RDCU"},
{12,    0x0059,    0x0002,    "PsngrSeatSystemSt",    "RDCU"},
{13,    0x005A,    0x0001,    "SecRowLtSeatCtrlService_ErrGrp",    "LDCU"},
{14,    0x005A,    0x0002,    "SecRowLtSeatSystemSt",    "LDCU"},
{15,    0x005B,    0x0001,    "SecRowRtSeatCtrlService_ErrGrp",    "RDCU"},
{16,    0x005B,    0x0002,    "SecRowRtSeatSystemSt",    "RDCU"},
{17,    0x005D,    0x0001,    "ColumnCtrlService_ErrGrp",    "LDCU"},
{18,    0x005D,    0x0002,    "ColumnSystemSt",    "LDCU"},
{19,    0x0060,    0x0001,    "HandleCtr_ErrGrp",    "LDCU"},
{20,    0x0060,    0x0002,    "FourDoorHandleInfoFdb",    "LDCU"},
{21,    0x0061,    0x0001,    "LeftSideWindowService_ErrGrp",    "LDCU"},
{22,    0x0061,    0x0002,    "FLWindowSt",    "LDCU"},
{23,    0x0061,    0x0003,    "RLWindowSt",    "LDCU"},
{24,    0x0062,    0x0001,    "RightSideWindowService_ErrGrp",    "RDCU"},
{25,    0x0062,    0x0002,    "FRWindowSt",    "RDCU"},
{26,    0x0062,    0x0003,    "RRWindowSt",    "RDCU"},
{27,    0x0063,    0x0001,    "DoorLockService_ErrGrp",    "LDCU"},
{28,    0x0063,    0x0002,    "DoorLockStInfoFb",    "LDCU"},
{29,    0x0064,    0x0001,    "FLDoorPowerRelService_ErrGrp",    "LDCU"},
{30,    0x0064,    0x0002,    "FLDoorSwSt",    "LDCU"},
{31,    0x0065,    0x0001,    "FRDoorPowerRelService_ErrGrp",    "RDCU"},
{32,    0x0065,    0x0002,    "FRDoorSwSt",    "RDCU"},
{33,    0x0066,    0x0001,    "DoorChildLockService_ErrGrp",    "LDCU"},
{34,    0x0066,    0x0002,    "DoorChildLockLogicSt",    "LDCU"},
{35,    0x006C,    0x0002,    "TPMSSt",    "LDCU"},
{36,    0x006D,    0x0001,    "LExtMirrorService_ErrGrp",    "LDCU"},
{37,    0x006D,    0x0002,    "LMirrorSt",    "LDCU"},
{38,    0x006E,    0x0001,    "RExtMirrorService_ErrGrp",    "RDCU"},
{39,    0x006E,    0x0002,    "RMirrorSt",    "RDCU"},
{40,    0x0200,    0x0001,    "LightCtrl_ErrGrp",    "RDCU"},
{41,    0x0200,    0x0002,    "LIghtsSt",    "RDCU"},
{42,    0x0300,    0x0001,    "RLDoorPowerRelService_ErrGrp",    "LDCU"},
{43,    0x0300,    0x0002,    "RLDoorSwSt",    "LDCU"},
{44,    0x0301,    0x0001,    "RRDoorPowerRelService_ErrGrp",    "RDCU"},
{45,    0x0301,    0x0002,    "RRDoorSwSt",    "RDCU"},
{46,    0x0400,    0x0001,    "ChargePortCtrlService_ErrGrp",    "RDCU"},
{47,    0x0400,    0x0002,    "ChargePortStateInfoFb",    "RDCU"},
{48,    0x0401,    0x0001,    "ChargeGunLockCtrlService_ErrGrp",    "RDCU"},
{49,    0x0401,    0x0002,    "ChargeGunLockStateInfoFb",    "RDCU"},
{50,    0x0501,    0x0001,    "TailgateControl_ErrGrp",    "LDCU"},
{51,    0x0501,    0x0002,    "TgateStsGroup",    "LDCU"},
{52,    0x1100,    0x0001,    "HighVoltageControlService_ErrGrp",    "LDCU"},
{53,    0x1100,    0x0002,    "HighVoltageSt",    "LDCU"},
{54,    0x1101,    0x0001,    "V2LControlService_ErrGrp",    "LDCU"},
{55,    0x1101,    0x0002,    "V2LDisChrgSt",    "LDCU"},
{56,    0x2001,    0x0001,    "AcSysSt_ErrGrp",    "RDCU"},
{57,    0x2001,    0x0002,    "ACSysState",    "RDCU"},
{58,    0x2002,    0x0001,    "AcBlwCtrl_ErrGrp",    "RDCU"},
{59,    0x2002,    0x0002,    "WindExitSpd",    "RDCU"},
{60,    0x2006,    0x0001,    "AcTempCtrl_ErrGrp",    "RDCU"},
{61,    0x2006,    0x0002,    "TempInfoFB",    "RDCU"},
{62,    0x2007,    0x0001,    "AcDistModeCtrl_ErrGrp",    "RDCU"},
{63,    0x2007,    0x0002,    "OutletPatInfoFB",    "RDCU"},
{64,    0x2008,    0x0001,    "AcIntkModeCtrl_ErrGrp",    "RDCU"},
{65,    0x2008,    0x0002,    "AirCondiCycMoStFB",    "RDCU"},
{66,    0x2009,    0x0001,    "AcAirCleanCtrl_ErrGrp",    "RDCU"},
{67,    0x2009,    0x0002,    "AirCondiPurSt",    "RDCU"},
{68,    0x200A,    0x0002,    "TempSensorInfoFB",    "RDCU"},
{69,    0x200B,    0x0001,    "EAVCtrl_ErrGrp",    "RDCU"},
{70,    0x200B,    0x0002,    "TuyereAndModeSt",    "RDCU"},
{71,    0x200C,    0x0002,    "HVACSysMessage",    "RDCU"},
{72,    0x200E,    0x0001,    "AcHCVCtrl_ErrGrp",    "RDCU"},
{73,    0x200E,    0x0002,    "AitCondiCoWarmVenSt",    "RDCU"},
{74,    0x200F,    0x0001,    "RearMirrorHeatService_ErrGrp",    "LDCU"},
{75,    0x200F,    0x0002,    "RearMirrorHeatSt",    "LDCU"},
{76,    0x2010,    0x0001,    "FrontMirrorHeatService_ErrGrp",    "RDCU"},
{77,    0x2010,    0x0002,    "FrontMirrorHeatSt",    "RDCU"},
{78,    0x0052,    0x0001,    "Veh_SlideDoorCtrlService_ErrGrp",    "SOAEngine"},
{79,    0x0053,    0x0001,    "Veh_SlideDoorModeService_ErrGrp",    "SOAEngine"},
{80,    0x0057,    0x0001,    "Veh_SeatCtrlService_ErrGrp",    "SOAEngine"},
{81,    0x0057,    0x0002,    "Veh_SeatSystemSt",    "SOAEngine"},
{82,    0x005E,    0x0001,    "Veh_SFMService_ErrGrp",    "SOAEngine"},
{83,    0x005E,    0x0002,    "SFMSt",    "SOAEngine"},
{84,    0x0100,    0x0001,    "Veh_WindowService_ErrGrp",    "SOAEngine"},
{85,    0x0103,    0x0001,    "Veh_DoorLockService_ErrGrp",    "SOAEngine"},
{86,    0x0104,    0x0001,    "Veh_TailgateControl_ErrGrp",    "SOAEngine"},
{87,    0x0105,    0x0001,    "Veh_SWSHeatService_ErrGrp",    "SOAEngine"},
{88,    0x0105,    0x0002,    "SWSHeatSt",    "SOAEngine"},
{89,    0x200D,    0x0001,    "Veh_HVACService_ErrGrp",    "SOAEngine"},
{90,    0x200D,    0x0002,    "Veh_HVACPush",    "SOAEngine"},
{91,    0x2011,    0x0001,    "Veh_RearMirrorHeatService_ErrGrp",    "SOAEngine"},
{92,    0x2012,    0x0001,    "Veh_SFSService_ErrGrp",    "SOAEngine"},
{93,    0x2012,    0x0002,    "SFSSt",    "SOAEngine"},
{94,    0x2013,    0x0001,    "Veh_FrontMirrorHeatService_ErrGrp",    "SOAEngine"},
{95,    0x9000,    0x0002,    "Veh_BodySt",    "SOAEngine"},
{96,    0x9000,    0x0003,    "SOAEngineInterState",    "SOAEngine"},
{97,    0x0101,    0x0001,    "EntryExitService_ErrGrp",    "LDCU"},
{98,    0x0101,    0x0002,    "EntryExitSetSt",    "LDCU"},
{99,    0x0088,    0x0001,    "RWiperService_ErrGrp",    "RDCU"},
{100,    0x0088,    0x0002,    "RWiperSt",    "RDCU"},
{101,    0x0110,    0x0002,    "LeadAcidbattState",    "LDCU"},
{102,    0x0110,    0x0003,    "LithiumIonbattState",    "LDCU"},
{103,    0x0136,    0x0001,    "InteriorLightService_ErrGrp",    "LDCU"},
{104,    0x0136,    0x0002,    "InteriorLightState",    "LDCU"},
{105,    0x0185,    0x0001,    "WelCarpetLightService_ErrGrp",    "LDCU"},
{106,    0x0185,    0x0002,    "WelCarpetLightState",    "LDCU"},
{107,    0x0069,    0x0001,    "HornService_ErrGrp",    "RDCU"},
{108,    0x0069,    0x0002,    "HornSt",    "RDCU"},
{109,    0x0093,    0x0001,    "ARSservice_ErrGrp",    "RDCU"},
{110,    0x0093,    0x0002,    "ARSSysSt",    "RDCU"},
{111,    0x0073,    0x0001,    "DoorLockService2_ErrGrp",    "RDCU"},
{112,    0x0073,    0x0002,    "DoorLockSt2InfoFb",    "RDCU"},
{113,    0x0055,    0x0001,    "Veh_RockingDoorCtrlService_ErrGrp",    "SOAEngine"},
{114,    0x0056,    0x0001,    "RockingDoorCtrlService_ErrGrp",    "RDCU"},
{115,    0x0056,    0x0002,    "RockingDoorSysSt",    "RDCU"},
{116,    0x0068,    0x0001,    "RoofService_ErrGrp",    "LDCU"},
{117,    0x0068,    0x0002,    "RoofSysSt",    "LDCU"},
{118,    0x4020,    0x0001,    "TboxImuService_DataGroup",    "TBOX"},
{119,    0x0106,    0x0001,    "ADASMomentService_ErrGrp",    "CDCU_SOC"},
{120,    0x0106,    0x0002,    "ADASMomentDriveSt",    "CDCU_SOC"},
{121,    0x0106,    0x0003,    "ADASMomentParkingSt",    "CDCU_SOC"},
{122,    0x0106,    0x0004,    "ADASMomentSwtSt",    "CDCU_SOC"}
};
dword soa_subservice_len = 478;
struct SOA_SubServiceMethodInfo_Typ soa_subservice_methodinfo[478] = {
{0,    0x0041,    0x8001,    "SshdService_Err",    "LDCU",    0x0001},
{1,    0x0041,    0x8002,    "SshdSysSt1",    "LDCU",    0x0002},
{2,    0x0041,    0x8003,    "SshdSysSt2",    "LDCU",    0x0002},
{3,    0x0041,    0x0001,    "CtrlSshdMov",    "LDCU",    65535},
{4,    0x0041,    0x0002,    "CtrlSshdPosTargtMov",    "LDCU",    65535},
{5,    0x0041,    0x0003,    "CtrlSshdLearn",    "LDCU",    65535},
{6,    0x0050,    0x8001,    "LeftSlideDoorCtrlService_Err",    "LDCU",    0x0001},
{7,    0x0050,    0x8002,    "LSlideDoorSt",    "LDCU",    0x0002},
{8,    0x0050,    0x8003,    "LSlideDoorSt2",    "LDCU",    0x0002},
{9,    0x0050,    0x0001,    "LSlideDoorPosCtr",    "LDCU",    65535},
{10,    0x0050,    0x0002,    "LSlideDoorCtr",    "LDCU",    65535},
{11,    0x0050,    0x0003,    "LSlideDoorLockCtr",    "LDCU",    65535},
{12,    0x0051,    0x8001,    "RightSlideDoorCtrlService_Err",    "LDCU",    0x0001},
{13,    0x0051,    0x8002,    "RSlideDoorSt",    "LDCU",    0x0002},
{14,    0x0051,    0x8003,    "RSlideDoorSt2",    "LDCU",    0x0002},
{15,    0x0051,    0x0001,    "RSlideDoorPosCtr",    "LDCU",    65535},
{16,    0x0051,    0x0002,    "RSlideDoorCtr",    "LDCU",    65535},
{17,    0x0051,    0x0003,    "RSlideDoorLockCtr",    "LDCU",    65535},
{18,    0x0054,    0x8001,    "FwiperService_Err",    "RDCU",    0x0001},
{19,    0x0054,    0x8002,    "FwiperSt",    "RDCU",    0x0002},
{20,    0x0054,    0x8003,    "FwiperSt2",    "RDCU",    0x0002},
{21,    0x0054,    0x8004,    "RLSSt",    "RDCU",    0x0003},
{22,    0x0054,    0x0001,    "FwiperSensitivityCmd",    "RDCU",    65535},
{23,    0x0054,    0x0002,    "FwiperSensitivityCfg",    "RDCU",    65535},
{24,    0x0054,    0x0003,    "FWiperServiceCmd",    "RDCU",    65535},
{25,    0x0054,    0x0004,    "SetFwiperSWSts",    "RDCU",    65535},
{26,    0x0054,    0x0005,    "SetFwiperAutoFunc",    "RDCU",    65535},
{27,    0x0054,    0x0006,    "SetWiperFuncInactive",    "RDCU",    65535},
{28,    0x0058,    0x8001,    "DrvSeatCtrlService_Err",    "LDCU",    0x0001},
{29,    0x0058,    0x8002,    "DrvSeatPst",    "LDCU",    0x0002},
{30,    0x0058,    0x8003,    "DrvSeatFuncSt",    "LDCU",    0x0002},
{31,    0x0058,    0x8004,    "DrvSeatFuncSt_Extend",    "LDCU",    0x0002},
{32,    0x0058,    0x0001,    "RecallDrvSeatPst",    "LDCU",    65535},
{33,    0x0058,    0x0002,    "SyncDrvSeatPst",    "LDCU",    65535},
{34,    0x0058,    0x0003,    "StopDrvSeatMoving",    "LDCU",    65535},
{35,    0x0058,    0x0004,    "SetDrvSeatEasyEntry",    "LDCU",    65535},
{36,    0x0058,    0x0005,    "SetDrvSeatHeating",    "LDCU",    65535},
{37,    0x0058,    0x0006,    "SetDrvSeatVentilation",    "LDCU",    65535},
{38,    0x0058,    0x0007,    "DrvSeatSplModCtrl",    "LDCU",    65535},
{39,    0x0058,    0x0008,    "RecallDrvSeatHorzPst",    "LDCU",    65535},
{40,    0x0058,    0x0009,    "RecallDrvSeatVertPst",    "LDCU",    65535},
{41,    0x0058,    0x000A,    "RecallDrvSeatTiltPst",    "LDCU",    65535},
{42,    0x0058,    0x000B,    "RecallDrvSeatCushExtPst",    "LDCU",    65535},
{43,    0x0058,    0x0010,    "RecallDrvSeatCushTiltPst",    "LDCU",    65535},
{44,    0x0059,    0x8001,    "PsngrSeatCtrlService_Err",    "RDCU",    0x0001},
{45,    0x0059,    0x8002,    "PsngrSeatPst",    "RDCU",    0x0002},
{46,    0x0059,    0x8003,    "PsngrSeatFuncSt",    "RDCU",    0x0002},
{47,    0x0059,    0x0001,    "RecallPsngrSeatPst",    "RDCU",    65535},
{48,    0x0059,    0x0002,    "SyncPsngrSeatPst",    "RDCU",    65535},
{49,    0x0059,    0x0003,    "StopPsngrSeatMoving",    "RDCU",    65535},
{50,    0x0059,    0x0004,    "SetPsngrSeatEasyEntry",    "RDCU",    65535},
{51,    0x0059,    0x0005,    "SetPsngrSeatHeating",    "RDCU",    65535},
{52,    0x0059,    0x0006,    "SetPsngrSeatVentilation",    "RDCU",    65535},
{53,    0x0059,    0x0007,    "PsngrSeatSplModCtrl",    "RDCU",    65535},
{54,    0x0059,    0x0008,    "RecallPsngrSeatHorzPst",    "RDCU",    65535},
{55,    0x0059,    0x0009,    "RecallPsngrSeatVertPst",    "RDCU",    65535},
{56,    0x0059,    0x000A,    "RecallPsngrSeatTiltPst",    "RDCU",    65535},
{57,    0x0059,    0x000B,    "RecallPsngrSeatLeSuHeigPst",    "RDCU",    65535},
{58,    0x0059,    0x000C,    "RecallPsngrSeatLeSuLengPst",    "RDCU",    65535},
{59,    0x0059,    0x000D,    "RecallPsngrSeatZeroGravPst",    "RDCU",    65535},
{60,    0x0059,    0x000E,    "RecallPsngrSeatCushTiltPst",    "RDCU",    65535},
{61,    0x005A,    0x8001,    "SecRowLtSeatCtrlService_Err",    "LDCU",    0x0001},
{62,    0x005A,    0x8002,    "SecRowLtSeatPst",    "LDCU",    0x0002},
{63,    0x005A,    0x8003,    "SecRowLtSeatFuncSt",    "LDCU",    0x0002},
{64,    0x005A,    0x0001,    "RecallSecRowLtSeatPst",    "LDCU",    65535},
{65,    0x005A,    0x0002,    "StopSecRowLtSeatMoving",    "LDCU",    65535},
{66,    0x005A,    0x0003,    "SetSecRowLtSeatHeating",    "LDCU",    65535},
{67,    0x005A,    0x0004,    "SetSecRowLtSeatVentilation",    "LDCU",    65535},
{68,    0x005A,    0x0005,    "RecallSecRowLtSeatTiltPst",    "LDCU",    65535},
{69,    0x005A,    0x0006,    "SetSecRowLtSeatEasyEntry",    "LDCU",    65535},
{70,    0x005B,    0x8001,    "SecRowRtSeatCtrlService_Err",    "RDCU",    0x0001},
{71,    0x005B,    0x8002,    "SecRowRtSeatPst",    "RDCU",    0x0002},
{72,    0x005B,    0x8003,    "SecRowRtSeatFuncSt",    "RDCU",    0x0002},
{73,    0x005B,    0x0001,    "RecallSecRowRtSeatPst",    "RDCU",    65535},
{74,    0x005B,    0x0002,    "StopSecRowRtSeatMoving",    "RDCU",    65535},
{75,    0x005B,    0x0003,    "SetSecRowRtSeatHeating",    "RDCU",    65535},
{76,    0x005B,    0x0004,    "SetSecRowRtSeatVentilation",    "RDCU",    65535},
{77,    0x005B,    0x0005,    "RecallSecRowRtSeatTiltPst",    "RDCU",    65535},
{78,    0x005B,    0x0006,    "SetSecRowRtSeatEasyEntry",    "RDCU",    65535},
{79,    0x005D,    0x8001,    "ColumnCtrlService_Err",    "LDCU",    0x0001},
{80,    0x005D,    0x8002,    "CollumnPst",    "LDCU",    0x0002},
{81,    0x005D,    0x8003,    "ColumnFuncSt",    "LDCU",    0x0002},
{82,    0x005D,    0x0001,    "RecallColumnPst",    "LDCU",    65535},
{83,    0x005D,    0x0002,    "SyncColumnPst",    "LDCU",    65535},
{84,    0x0060,    0x8001,    "HandleCtr_Err",    "LDCU",    0x0001},
{85,    0x0060,    0x8002,    "HandleSt",    "LDCU",    0x0002},
{86,    0x0060,    0x0001,    "AllHandleCtr",    "LDCU",    65535},
{87,    0x0060,    0x0002,    "HandleAUTOSet",    "LDCU",    65535},
{88,    0x0061,    0x8001,    "LeftSideWindowService_Err",    "LDCU",    0x0001},
{89,    0x0061,    0x8002,    "FLWindowSt",    "LDCU",    0x0002},
{90,    0x0061,    0x8003,    "FLWindowSt2",    "LDCU",    0x0002},
{91,    0x0061,    0x8004,    "RLWindowSt",    "LDCU",    0x0003},
{92,    0x0061,    0x8005,    "RLWindowSt2",    "LDCU",    0x0003},
{93,    0x0061,    0x0001,    "FLWinPosCmd",    "LDCU",    65535},
{94,    0x0061,    0x0002,    "RLWinPosCmd",    "LDCU",    65535},
{95,    0x0061,    0x0003,    "CtrlFLWin",    "LDCU",    65535},
{96,    0x0061,    0x0004,    "CtrlRLWin",    "LDCU",    65535},
{97,    0x0061,    0x0005,    "WinLockCtrlReq",    "LDCU",    65535},
{98,    0x0061,    0x0006,    "LockWinCfg",    "LDCU",    65535},
{99,    0x0062,    0x8001,    "RightSideWindowService_Err",    "RDCU",    0x0001},
{100,    0x0062,    0x8002,    "FRWindowSt",    "RDCU",    0x0002},
{101,    0x0062,    0x8003,    "FRWindowSt2",    "RDCU",    0x0002},
{102,    0x0062,    0x8004,    "RRWindowSt",    "RDCU",    0x0003},
{103,    0x0062,    0x8005,    "RRWindowSt2",    "RDCU",    0x0003},
{104,    0x0062,    0x0001,    "FRWinPosCmd",    "RDCU",    65535},
{105,    0x0062,    0x0002,    "RRWinPosCmd",    "RDCU",    65535},
{106,    0x0062,    0x0003,    "CtrlFRWin",    "RDCU",    65535},
{107,    0x0062,    0x0004,    "CtrlRRWin",    "RDCU",    65535},
{108,    0x0063,    0x8001,    "DoorLockService_Err",    "LDCU",    0x0001},
{109,    0x0063,    0x8002,    "DoorLockSt",    "LDCU",    0x0002},
{110,    0x0063,    0x0001,    "SetDoorLockState",    "LDCU",    65535},
{111,    0x0063,    0x0002,    "SetDoorOriLockSt",    "LDCU",    65535},
{112,    0x0063,    0x0003,    "SetDoorOriUnlockSt",    "LDCU",    65535},
{113,    0x0063,    0x0004,    "SetAutoUnlockFunc",    "LDCU",    65535},
{114,    0x0063,    0x0005,    "SetAutoLockFunc",    "LDCU",    65535},
{115,    0x0063,    0x0006,    "SetPollingUnlockFunc",    "LDCU",    65535},
{116,    0x0063,    0x0007,    "SetPollingLockFunc",    "LDCU",    65535},
{117,    0x0064,    0x8001,    "FLDoorPowerRelService_Err",    "LDCU",    0x0001},
{118,    0x0064,    0x8002,    "FLDoorSwSt1",    "LDCU",    0x0002},
{119,    0x0064,    0x0001,    "FLDoorPowerReleaseCtrl",    "LDCU",    65535},
{120,    0x0065,    0x8001,    "FRDoorPowerRelService_Err",    "RDCU",    0x0001},
{121,    0x0065,    0x8002,    "FRDoorSwSt1",    "RDCU",    0x0002},
{122,    0x0065,    0x0001,    "FRDoorPowerReleaseCtrl",    "RDCU",    65535},
{123,    0x0066,    0x8001,    "DoorChildLockService_Err",    "LDCU",    0x0001},
{124,    0x0066,    0x8002,    "DoorChildLockLogicSt",    "LDCU",    0x0002},
{125,    0x0066,    0x0002,    "SetRLDoorChildLock",    "LDCU",    65535},
{126,    0x0066,    0x0003,    "SetRRDoorChildLock",    "LDCU",    65535},
{127,    0x006C,    0x8002,    "TPMSSt",    "LDCU",    0x0002},
{128,    0x006D,    0x8001,    "LExtMirrorService_Err",    "LDCU",    0x0001},
{129,    0x006D,    0x8002,    "LMirrorPos",    "LDCU",    0x0002},
{130,    0x006D,    0x8003,    "LMirrorSt",    "LDCU",    0x0002},
{131,    0x006D,    0x0001,    "CtrlLMirrorMove",    "LDCU",    65535},
{132,    0x006D,    0x0002,    "CtrlLMirrorPos",    "LDCU",    65535},
{133,    0x006D,    0x0003,    "FoldTwoMirror",    "LDCU",    65535},
{134,    0x006D,    0x0004,    "TwoMirrorAutoFoldCfg",    "LDCU",    65535},
{135,    0x006D,    0x0005,    "CtrlLMirrorLRPos",    "LDCU",    65535},
{136,    0x006D,    0x0006,    "CtrlLMirrorUDPos",    "LDCU",    65535},
{137,    0x006D,    0x0007,    "SyncLMirrorPos",    "LDCU",    65535},
{138,    0x006E,    0x8001,    "RExtMirrorService_Err",    "RDCU",    0x0001},
{139,    0x006E,    0x8002,    "RMirrorPos",    "RDCU",    0x0002},
{140,    0x006E,    0x8003,    "RMirrorSt",    "RDCU",    0x0002},
{141,    0x006E,    0x0001,    "CtrlRMirrorMove",    "RDCU",    65535},
{142,    0x006E,    0x0002,    "CtrlRMirrorPos",    "RDCU",    65535},
{143,    0x006E,    0x0003,    "CtrlRMirrorLRPos",    "RDCU",    65535},
{144,    0x006E,    0x0004,    "CtrlRMirrorUDPos",    "RDCU",    65535},
{145,    0x006E,    0x0005,    "SyncRMirrorPos",    "RDCU",    65535},
{146,    0x0200,    0x8001,    "LightCtrl_Err",    "RDCU",    0x0001},
{147,    0x0200,    0x8002,    "LIghtsSt",    "RDCU",    0x0002},
{148,    0x0200,    0x0001,    "LowbeamCtrl",    "RDCU",    65535},
{149,    0x0200,    0x0002,    "HighbeamCtrl",    "RDCU",    65535},
{150,    0x0200,    0x0003,    "ParkinglightCtrl",    "RDCU",    65535},
{151,    0x0200,    0x0004,    "LTurnLighCtrl",    "RDCU",    65535},
{152,    0x0200,    0x0005,    "RTurnLightCtrl",    "RDCU",    65535},
{153,    0x0200,    0x0006,    "HazardLightCtrl",    "RDCU",    65535},
{154,    0x0200,    0x0007,    "RearFogLampCtrl",    "RDCU",    65535},
{155,    0x0300,    0x8001,    "RLDoorPowerRelService_Err",    "LDCU",    0x0001},
{156,    0x0300,    0x8002,    "RLDoorSwSt1",    "LDCU",    0x0002},
{157,    0x0300,    0x0001,    "RLDoorPowerReleaseCtrl",    "LDCU",    65535},
{158,    0x0301,    0x8001,    "RRDoorPowerRelService_Err",    "RDCU",    0x0001},
{159,    0x0301,    0x8002,    "RRDoorSwSt1",    "RDCU",    0x0002},
{160,    0x0301,    0x0001,    "RRDoorPowerReleaseCtrl",    "RDCU",    65535},
{161,    0x0400,    0x8001,    "ChargePortCtrlService_Err",    "RDCU",    0x0001},
{162,    0x0400,    0x8002,    "ChargePortState",    "RDCU",    0x0002},
{163,    0x0400,    0x8003,    "ChargePortState2",    "RDCU",    0x0002},
{164,    0x0400,    0x0001,    "ChargePortCtrl",    "RDCU",    65535},
{165,    0x0400,    0x0002,    "ChargePortLockCtrl",    "RDCU",    65535},
{166,    0x0401,    0x8001,    "ChargeGunLockCtrlService_Err",    "RDCU",    0x0001},
{167,    0x0401,    0x8002,    "ChargeGunLockState",    "RDCU",    0x0002},
{168,    0x0401,    0x0001,    "ChargeGunLockCtrl",    "RDCU",    65535},
{169,    0x0501,    0x8001,    "TailgateControl_Err",    "LDCU",    0x0001},
{170,    0x0501,    0x8002,    "TgateSts",    "LDCU",    0x0002},
{171,    0x0501,    0x8003,    "TgatePosInfo",    "LDCU",    0x0002},
{172,    0x0501,    0x0001,    "TgateMvtCtrl",    "LDCU",    65535},
{173,    0x0501,    0x0002,    "SetTgateMemHtPos",    "LDCU",    65535},
{174,    0x1100,    0x8001,    "HighVoltageControlService_Err",    "LDCU",    0x0001},
{175,    0x1100,    0x8002,    "HighVoltageSt",    "LDCU",    0x0002},
{176,    0x1100,    0x0001,    "HighVoltageCtrl",    "LDCU",    65535},
{177,    0x1101,    0x8001,    "V2LControlService_Err",    "LDCU",    0x0001},
{178,    0x1101,    0x8002,    "V2LDisChrgSt",    "LDCU",    0x0002},
{179,    0x1101,    0x0001,    "V2LCtrl",    "LDCU",    65535},
{180,    0x2001,    0x8001,    "AcSysSt_Err",    "RDCU",    0x0001},
{181,    0x2001,    0x8002,    "ACSysState",    "RDCU",    0x0002},
{182,    0x2001,    0x0001,    "TurnOnOffFrAutoAC",    "RDCU",    65535},
{183,    0x2001,    0x0002,    "TurnOnFrAC",    "RDCU",    65535},
{184,    0x2001,    0x0003,    "TurnOffFrAC",    "RDCU",    65535},
{185,    0x2001,    0x0004,    "TurnOnOffRrAutoAC",    "RDCU",    65535},
{186,    0x2001,    0x0005,    "TurnOnRrAC",    "RDCU",    65535},
{187,    0x2001,    0x0006,    "TurnOffRrAC",    "RDCU",    65535},
{188,    0x2001,    0x0007,    "SetOnOffDeodorize",    "RDCU",    65535},
{189,    0x2001,    0x0008,    "TurnOnOffDefrost",    "RDCU",    65535},
{190,    0x2001,    0x0009,    "SetOnOffECOMode",    "RDCU",    65535},
{191,    0x2001,    0x000A,    "TurnOnOffMaxCooling",    "RDCU",    65535},
{192,    0x2001,    0x000B,    "TurnOnOffMaxHeating",    "RDCU",    65535},
{193,    0x2001,    0x000C,    "SetACAfterBlow",    "RDCU",    65535},
{194,    0x2001,    0x000D,    "TurnOnOffInsenVent",    "RDCU",    65535},
{195,    0x2001,    0x000E,    "TurnOnOffSterilization",    "RDCU",    65535},
{196,    0x2001,    0x000F,    "SetACSelfClean",    "RDCU",    65535},
{197,    0x2001,    0x0011,    "RestoreAcToMemoSt",    "RDCU",    65535},
{198,    0x2001,    0x0012,    "SetBlowCompensation",    "RDCU",    65535},
{199,    0x2002,    0x8001,    "AcBlwCtrl_Err",    "RDCU",    0x0001},
{200,    0x2002,    0x8002,    "WindExitSpd",    "RDCU",    0x0002},
{201,    0x2002,    0x0001,    "CtrlFrWindSpd",    "RDCU",    65535},
{202,    0x2002,    0x0002,    "CtrlRrWindSpd",    "RDCU",    65535},
{203,    0x2006,    0x8001,    "AcTempCtrl_Err",    "RDCU",    0x0001},
{204,    0x2006,    0x8002,    "TempSelectSt",    "RDCU",    0x0002},
{205,    0x2006,    0x0001,    "SetDrvTemp",    "RDCU",    65535},
{206,    0x2006,    0x0002,    "SetPsnTemp",    "RDCU",    65535},
{207,    0x2006,    0x0003,    "SetRLTemp",    "RDCU",    65535},
{208,    0x2006,    0x0004,    "SetRRTemp",    "RDCU",    65535},
{209,    0x2006,    0x0005,    "Set3rdRowTemp",    "RDCU",    65535},
{210,    0x2006,    0x0006,    "SetSync",    "RDCU",    65535},
{211,    0x2007,    0x8001,    "AcDistModeCtrl_Err",    "RDCU",    0x0001},
{212,    0x2007,    0x8002,    "OutletPatInfoFB",    "RDCU",    0x0002},
{213,    0x2007,    0x0001,    "SetFrAirDisMode",    "RDCU",    65535},
{214,    0x2007,    0x0002,    "SetRrAirDisMode",    "RDCU",    65535},
{215,    0x2007,    0x0003,    "Set3rdRowAirDisMode",    "RDCU",    65535},
{216,    0x2008,    0x8001,    "AcIntkModeCtrl_Err",    "RDCU",    0x0001},
{217,    0x2008,    0x8002,    "AirIntakeSt",    "RDCU",    0x0002},
{218,    0x2008,    0x0001,    "SetAirIntake",    "RDCU",    65535},
{219,    0x2009,    0x8001,    "AcAirCleanCtrl_Err",    "RDCU",    0x0001},
{220,    0x2009,    0x8002,    "AirCleanSt",    "RDCU",    0x0002},
{221,    0x2009,    0x0001,    "TurnOnOffAQS",    "RDCU",    65535},
{222,    0x2009,    0x0002,    "TurnOnOffAirClean",    "RDCU",    65535},
{223,    0x200A,    0x8002,    "TempSensorInfoFB",    "RDCU",    0x0002},
{224,    0x200A,    0x8003,    "TempSensorInfoFB2",    "RDCU",    0x0002},
{225,    0x200B,    0x8001,    "EAVCtrl_Err",    "RDCU",    0x0001},
{226,    0x200B,    0x8002,    "TuyereAndModeSt",    "RDCU",    0x0002},
{227,    0x200B,    0x0001,    "SetEAVDrvLeftHorzPos",    "RDCU",    65535},
{228,    0x200B,    0x0002,    "SetEAVDrvLeftVertPos",    "RDCU",    65535},
{229,    0x200B,    0x0003,    "SetEAVDrvRightHorzPos",    "RDCU",    65535},
{230,    0x200B,    0x0004,    "SetEAVDrvRightVertPos",    "RDCU",    65535},
{231,    0x200B,    0x0005,    "SetEAVPsnLeftHorzPos",    "RDCU",    65535},
{232,    0x200B,    0x0006,    "SetEAVPsnLeftVertPos",    "RDCU",    65535},
{233,    0x200B,    0x0007,    "SetEAVPsnRightHorzPos",    "RDCU",    65535},
{234,    0x200B,    0x0008,    "SetEAVPsnRightVertPos",    "RDCU",    65535},
{235,    0x200B,    0x0009,    "SetEAVDrvWindMode",    "RDCU",    65535},
{236,    0x200B,    0x000A,    "SetEAVPsnWindMode",    "RDCU",    65535},
{237,    0x200B,    0x000B,    "SetEAVSweepWind",    "RDCU",    65535},
{238,    0x200B,    0x000C,    "SetEAVRLHorzPos",    "RDCU",    65535},
{239,    0x200B,    0x000D,    "SetEAVRLVertPos",    "RDCU",    65535},
{240,    0x200B,    0x000E,    "SetEAVRRHorzPos",    "RDCU",    65535},
{241,    0x200B,    0x000F,    "SetEAVRRVertPos",    "RDCU",    65535},
{242,    0x200B,    0x0010,    "SetEAVRLWindMode",    "RDCU",    65535},
{243,    0x200B,    0x0011,    "SetEAVRRWindMode",    "RDCU",    65535},
{244,    0x200B,    0x0012,    "SetREAVSweepWind",    "RDCU",    65535},
{245,    0x200C,    0x8002,    "ThermalSys1",    "RDCU",    0x0002},
{246,    0x200C,    0x8003,    "ThermalSys2",    "RDCU",    0x0002},
{247,    0x200C,    0x8004,    "ThermalSysSenInfo",    "RDCU",    0x0002},
{248,    0x200C,    0x8005,    "ThermalSysActuator1",    "RDCU",    0x0002},
{249,    0x200C,    0x8006,    "ThermalSysActuator2",    "RDCU",    0x0002},
{250,    0x200C,    0x8007,    "TMC_DTC",    "RDCU",    0x0002},
{251,    0x200E,    0x8001,    "AcHCVCtrl_Err",    "RDCU",    0x0001},
{252,    0x200E,    0x8002,    "getACSt",    "RDCU",    0x0002},
{253,    0x200E,    0x0001,    "TurnOnOFFHCV",    "RDCU",    65535},
{254,    0x200F,    0x8001,    "RearMirrorHeatService_Err",    "LDCU",    0x0001},
{255,    0x200F,    0x8002,    "RearMirrorHeatSt",    "LDCU",    0x0002},
{256,    0x200F,    0x0001,    "RearMirrorHeatCmd",    "LDCU",    65535},
{257,    0x2010,    0x8001,    "FrontMirrorHeatService_Err",    "RDCU",    0x0001},
{258,    0x2010,    0x8002,    "FrontMirrorHeatSt",    "RDCU",    0x0002},
{259,    0x2010,    0x0001,    "FrontMirrorHeatCmd",    "RDCU",    65535},
{260,    0x0052,    0x8001,    "Veh_SlideDoorCtrlService_Err",    "SOAEngine",    0x0001},
{261,    0x0052,    0x0001,    "Veh_LSlideDoorCtr",    "SOAEngine",    65535},
{262,    0x0052,    0x0002,    "Veh_LSlideDoorPosCtr",    "SOAEngine",    65535},
{263,    0x0052,    0x0003,    "Veh_RSlideDoorCtr",    "SOAEngine",    65535},
{264,    0x0052,    0x0004,    "Veh_RSlideDoorPosCtr",    "SOAEngine",    65535},
{265,    0x0053,    0x8001,    "Veh_SlideDoorModeService_Err",    "SOAEngine",    0x0001},
{266,    0x0053,    0x0001,    "Veh_LSlideDoorModeCfg",    "SOAEngine",    65535},
{267,    0x0053,    0x0002,    "Veh_RSlideDoorModeCfg",    "SOAEngine",    65535},
{268,    0x0057,    0x8001,    "Veh_SeatCtrlService_Err",    "SOAEngine",    0x0001},
{269,    0x0057,    0x8002,    "Veh_SeatMassageSts",    "SOAEngine",    0x0002},
{270,    0x0057,    0x8003,    "Veh_SeatLumbSts",    "SOAEngine",    0x0002},
{271,    0x0057,    0x8004,    "Veh_SeatLumbRelaxIntenSts",    "SOAEngine",    0x0002},
{272,    0x0057,    0x0001,    "Veh_SetDrvSeatHeating",    "SOAEngine",    65535},
{273,    0x0057,    0x0002,    "Veh_SetDrvSeatVentilation",    "SOAEngine",    65535},
{274,    0x0057,    0x0003,    "Veh_SetPsngrSeatHeating",    "SOAEngine",    65535},
{275,    0x0057,    0x0004,    "Veh_SetPsngrSeatVentilation",    "SOAEngine",    65535},
{276,    0x0057,    0x0005,    "Veh_SetSecRowLtSeatHeating",    "SOAEngine",    65535},
{277,    0x0057,    0x0006,    "Veh_SetSecRowLtSeatVentilation",    "SOAEngine",    65535},
{278,    0x0057,    0x0007,    "Veh_SetSecRowRtSeatHeating",    "SOAEngine",    65535},
{279,    0x0057,    0x0008,    "Veh_SetSecRowRtSeatVentilation",    "SOAEngine",    65535},
{280,    0x0057,    0x0009,    "Veh_TurnOnDrvSeatMassage",    "SOAEngine",    65535},
{281,    0x0057,    0x000A,    "Veh_SetDrvSeatMassageIntensity",    "SOAEngine",    65535},
{282,    0x0057,    0x000B,    "Veh_SetDrvSeatMassageMode",    "SOAEngine",    65535},
{283,    0x0057,    0x000C,    "Veh_TurnOffDrvSeatMassage",    "SOAEngine",    65535},
{284,    0x0057,    0x000D,    "Veh_TurnOnPsngrSeatMassage",    "SOAEngine",    65535},
{285,    0x0057,    0x000E,    "Veh_SetPsngrSeatMassageIntensity",    "SOAEngine",    65535},
{286,    0x0057,    0x000F,    "Veh_SetPsngrSeatMassageMode",    "SOAEngine",    65535},
{287,    0x0057,    0x0010,    "Veh_TurnOffPsngrSeatMassage",    "SOAEngine",    65535},
{288,    0x0057,    0x0011,    "Veh_SetDrvSeatLumbRelax",    "SOAEngine",    65535},
{289,    0x0057,    0x0012,    "Veh_SetPsngrSeatLumbRelax",    "SOAEngine",    65535},
{290,    0x0057,    0x0013,    "Veh_TurnOnSecRowLtSeatMassage",    "SOAEngine",    65535},
{291,    0x0057,    0x0014,    "Veh_SetSecRowLtSeatMassageIntensity",    "SOAEngine",    65535},
{292,    0x0057,    0x0015,    "Veh_SetSecRowLtSeatMassageMode",    "SOAEngine",    65535},
{293,    0x0057,    0x0016,    "Veh_TurnOffSecRowLtSeatMassage",    "SOAEngine",    65535},
{294,    0x0057,    0x0017,    "Veh_TurnOnSecRowRtSeatMassage",    "SOAEngine",    65535},
{295,    0x0057,    0x0018,    "Veh_SetSecRowRtSeatMassageIntensity",    "SOAEngine",    65535},
{296,    0x0057,    0x0019,    "Veh_SetSecRowRtSeatMassageMode",    "SOAEngine",    65535},
{297,    0x0057,    0x001A,    "Veh_TurnOffSecRowRtSeatMassage",    "SOAEngine",    65535},
{298,    0x0057,    0x001B,    "Veh_SetDrvSeatLumbRelaxInten",    "SOAEngine",    65535},
{299,    0x0057,    0x001C,    "Veh_SetPsSeatLumbRelaxInten",    "SOAEngine",    65535},
{300,    0x005E,    0x8001,    "Veh_SFMService_Err",    "SOAEngine",    0x0001},
{301,    0x005E,    0x8002,    "SFMSt",    "SOAEngine",    0x0002},
{302,    0x005E,    0x8003,    "SFMSt2",    "SOAEngine",    0x0002},
{303,    0x005E,    0x0001,    "Veh_SFMOpenCloseCtr",    "SOAEngine",    65535},
{304,    0x005E,    0x0002,    "Veh_SFMPosCtr",    "SOAEngine",    65535},
{305,    0x0100,    0x8001,    "Veh_WindowService_Err",    "SOAEngine",    0x0001},
{306,    0x0100,    0x000B,    "Veh_CtrlAllWinUpDown",    "SOAEngine",    65535},
{307,    0x0103,    0x8001,    "Veh_DoorLockService_Err",    "SOAEngine",    0x0001},
{308,    0x0103,    0x0001,    "Veh_SetDoorLockState",    "SOAEngine",    65535},
{309,    0x0103,    0x0002,    "Veh_SetDoorOriLockSt",    "SOAEngine",    65535},
{310,    0x0103,    0x0003,    "Veh_SetDoorOriUnlockSt",    "SOAEngine",    65535},
{311,    0x0104,    0x8001,    "Veh_TailgateControl_Err",    "SOAEngine",    0x0001},
{312,    0x0104,    0x0001,    "Veh_TgateMvtCtrl",    "SOAEngine",    65535},
{313,    0x0105,    0x8001,    "Veh_SWSHeatService_Err",    "SOAEngine",    0x0001},
{314,    0x0105,    0x8002,    "SWSHeatSt",    "SOAEngine",    0x0002},
{315,    0x0105,    0x0001,    "Veh_SWSHeatCmd",    "SOAEngine",    65535},
{316,    0x200D,    0x8001,    "Veh_HVACService_Err",    "SOAEngine",    0x0001},
{317,    0x200D,    0x8002,    "Veh_HVACRemotePush",    "SOAEngine",    0x0002},
{318,    0x200D,    0x0007,    "Veh_TurnOnOffAC",    "SOAEngine",    65535},
{319,    0x200D,    0x0008,    "Veh_TurnOnOffFrAC",    "SOAEngine",    65535},
{320,    0x200D,    0x0009,    "Veh_TurnOnOffRrAC",    "SOAEngine",    65535},
{321,    0x200D,    0x000A,    "Veh_TurnOnOffAutoAC",    "SOAEngine",    65535},
{322,    0x200D,    0x000B,    "Veh_TurnOnOffFrAutoAC",    "SOAEngine",    65535},
{323,    0x200D,    0x000C,    "Veh_TurnOnOffRrAutoAC",    "SOAEngine",    65535},
{324,    0x200D,    0x000D,    "Veh_TurnOnOffInsenVent",    "SOAEngine",    65535},
{325,    0x200D,    0x000E,    "Veh_TurnOnOffDefrost",    "SOAEngine",    65535},
{326,    0x200D,    0x000F,    "Veh_TurnOnOffMaxCooling",    "SOAEngine",    65535},
{327,    0x200D,    0x0010,    "Veh_TurnOnOffMaxHeating",    "SOAEngine",    65535},
{328,    0x200D,    0x0011,    "Veh_TurnOnOffSterilization",    "SOAEngine",    65535},
{329,    0x200D,    0x0012,    "Veh_SetACAfterBlow",    "SOAEngine",    65535},
{330,    0x200D,    0x0013,    "Veh_TurnOnOffACSelfClean",    "SOAEngine",    65535},
{331,    0x200D,    0x0014,    "Veh_SetDrvTemp",    "SOAEngine",    65535},
{332,    0x200D,    0x0015,    "Veh_SetPsnTemp",    "SOAEngine",    65535},
{333,    0x200D,    0x0016,    "Veh_SetRLTemp",    "SOAEngine",    65535},
{334,    0x200D,    0x0017,    "Veh_SetRRTemp",    "SOAEngine",    65535},
{335,    0x200D,    0x0018,    "Veh_Set3rdRowTemp",    "SOAEngine",    65535},
{336,    0x200D,    0x0019,    "Veh_SetSync",    "SOAEngine",    65535},
{337,    0x200D,    0x001A,    "Veh_CtrlFrWindSpd",    "SOAEngine",    65535},
{338,    0x200D,    0x001B,    "Veh_CtrlRrWindSpd",    "SOAEngine",    65535},
{339,    0x200D,    0x001C,    "Veh_SetAirIntake",    "SOAEngine",    65535},
{340,    0x200D,    0x001D,    "Veh_SetFrAirDisMode",    "SOAEngine",    65535},
{341,    0x200D,    0x001E,    "Veh_SetRrAirDisMode",    "SOAEngine",    65535},
{342,    0x200D,    0x001F,    "Veh_Set3rdRowAirDisMode",    "SOAEngine",    65535},
{343,    0x200D,    0x0020,    "Veh_SetOnOffECOMode",    "SOAEngine",    65535},
{344,    0x200D,    0x0021,    "Veh_SetOnOffDeodorize",    "SOAEngine",    65535},
{345,    0x200D,    0x0022,    "Veh_SetEAVDrvWindMode",    "SOAEngine",    65535},
{346,    0x200D,    0x0023,    "Veh_SetEAVPsnWindMode",    "SOAEngine",    65535},
{347,    0x200D,    0x0024,    "Veh_SetEAVSweepWind",    "SOAEngine",    65535},
{348,    0x200D,    0x0025,    "Veh_SetEAVDrvLeftHorzPos",    "SOAEngine",    65535},
{349,    0x200D,    0x0026,    "Veh_SetEAVDrvLeftVertPos",    "SOAEngine",    65535},
{350,    0x200D,    0x0027,    "Veh_SetEAVDrvRightVertPos",    "SOAEngine",    65535},
{351,    0x200D,    0x0028,    "Veh_SetEAVDrvRightHorzPos",    "SOAEngine",    65535},
{352,    0x200D,    0x0029,    "Veh_SetEAVPsnLeftHorzPos",    "SOAEngine",    65535},
{353,    0x200D,    0x002A,    "Veh_SetEAVPsnLeftVertPos",    "SOAEngine",    65535},
{354,    0x200D,    0x002B,    "Veh_SetEAVPsnRightVertPos",    "SOAEngine",    65535},
{355,    0x200D,    0x002C,    "Veh_SetEAVPsnRightHorzPos",    "SOAEngine",    65535},
{356,    0x200D,    0x002D,    "Veh_TurnOnOffAirClean",    "SOAEngine",    65535},
{357,    0x200D,    0x002E,    "Veh_TurnOnOffAQS",    "SOAEngine",    65535},
{358,    0x200D,    0x0032,    "Veh_TurnOnOFFHCV",    "SOAEngine",    65535},
{359,    0x200D,    0x0033,    "Veh_DriverTempUp",    "SOAEngine",    65535},
{360,    0x200D,    0x0034,    "Veh_DriverTempDown",    "SOAEngine",    65535},
{361,    0x200D,    0x0035,    "Veh_PsnTempUp",    "SOAEngine",    65535},
{362,    0x200D,    0x0036,    "Veh_PsnTempDown",    "SOAEngine",    65535},
{363,    0x200D,    0x0037,    "Veh_RLTempUp",    "SOAEngine",    65535},
{364,    0x200D,    0x0038,    "Veh_RLTempDown",    "SOAEngine",    65535},
{365,    0x200D,    0x0039,    "Veh_RRTempUp",    "SOAEngine",    65535},
{366,    0x200D,    0x003A,    "Veh_RRTempDown",    "SOAEngine",    65535},
{367,    0x200D,    0x003B,    "Veh_3rdRowTempUp",    "SOAEngine",    65535},
{368,    0x200D,    0x003C,    "Veh_3rdRowTempDown",    "SOAEngine",    65535},
{369,    0x200D,    0x003D,    "Veh_FrWindSpdUp",    "SOAEngine",    65535},
{370,    0x200D,    0x003E,    "Veh_FrWindSpdDown",    "SOAEngine",    65535},
{371,    0x200D,    0x003F,    "Veh_RrWindSpdUp",    "SOAEngine",    65535},
{372,    0x200D,    0x0040,    "Veh_RrWindSpdDown",    "SOAEngine",    65535},
{373,    0x200D,    0x0041,    "Veh_FrAirDisModeBtn",    "SOAEngine",    65535},
{374,    0x200D,    0x0042,    "Veh_RrAirDisModeBtn",    "SOAEngine",    65535},
{375,    0x200D,    0x0043,    "Veh_3rdRowAirDisModeBtn",    "SOAEngine",    65535},
{376,    0x200D,    0x0044,    "Veh_SetEAVRLWindMode",    "SOAEngine",    65535},
{377,    0x200D,    0x0045,    "Veh_SetEAVRRWindMode",    "SOAEngine",    65535},
{378,    0x200D,    0x0046,    "Veh_SetREAVSweepWind",    "SOAEngine",    65535},
{379,    0x200D,    0x0047,    "Veh_SetEAVRLHorzPos",    "SOAEngine",    65535},
{380,    0x200D,    0x0048,    "Veh_SetEAVRLVertPos",    "SOAEngine",    65535},
{381,    0x200D,    0x0049,    "Veh_SetEAVRRHorzPos",    "SOAEngine",    65535},
{382,    0x200D,    0x0050,    "Veh_SetEAVRRVertPos",    "SOAEngine",    65535},
{383,    0x200D,    0x0052,    "Veh_SetBlowCompensation",    "SOAEngine",    65535},
{384,    0x2011,    0x8001,    "Veh_RearMirrorHeatService_Err",    "SOAEngine",    0x0001},
{385,    0x2011,    0x0001,    "Veh_RearMirrorHeat",    "SOAEngine",    65535},
{386,    0x2012,    0x8001,    "Veh_SFSService_Err",    "SOAEngine",    0x0001},
{387,    0x2012,    0x8002,    "SFSSt",    "SOAEngine",    0x0002},
{388,    0x2012,    0x0001,    "Veh_TurnOnOffSFS",    "SOAEngine",    65535},
{389,    0x2012,    0x0002,    "Veh_SetSFSChanel",    "SOAEngine",    65535},
{390,    0x2012,    0x0003,    "Veh_SetSFSCon",    "SOAEngine",    65535},
{391,    0x2012,    0x0004,    "Veh_SFSCh1ResetRq",    "SOAEngine",    65535},
{392,    0x2012,    0x0005,    "Veh_SFSCh2ResetRq",    "SOAEngine",    65535},
{393,    0x2012,    0x0006,    "Veh_SFSCh3ResetRq",    "SOAEngine",    65535},
{394,    0x2013,    0x8001,    "Veh_FrontMirrorHeatService_Err",    "SOAEngine",    0x0001},
{395,    0x2013,    0x0001,    "Veh_FrontMirrorHeat",    "SOAEngine",    65535},
{396,    0x9000,    0x8002,    "Veh_BodySts_Door",    "SOAEngine",    0x0002},
{397,    0x9000,    0x8003,    "Veh_BodySts_Pwr",    "SOAEngine",    0x0002},
{398,    0x9000,    0x8004,    "Veh_BodySts_Seat",    "SOAEngine",    0x0002},
{399,    0x9000,    0x8005,    "Veh_BodySts5_Powertrain",    "SOAEngine",    0x0002},
{400,    0x9000,    0x8006,    "SOAEngineInterSignal",    "SOAEngine",    0x0003},
{401,    0x0101,    0x8001,    "EntryExitService_Err",    "LDCU",    0x0001},
{402,    0x0101,    0x8002,    "EntryExitSetSt",    "LDCU",    0x0002},
{403,    0x0101,    0x8003,    "EntryExitFuncSt",    "LDCU",    0x0002},
{404,    0x0101,    0x0001,    "UnlockHazardLightSet",    "LDCU",    65535},
{405,    0x0101,    0x0002,    "UnlockHornSet",    "LDCU",    65535},
{406,    0x0101,    0x0003,    "LockHazardLightSet",    "LDCU",    65535},
{407,    0x0101,    0x0004,    "LockHornSet",    "LDCU",    65535},
{408,    0x0101,    0x0005,    "PollingWelcomeSet",    "LDCU",    65535},
{409,    0x0101,    0x0006,    "EntryExitPEFuncSet",    "LDCU",    65535},
{410,    0x0088,    0x8001,    "RWiperService_Err",    "RDCU",    0x0001},
{411,    0x0088,    0x8002,    "RWiperSt",    "RDCU",    0x0002},
{412,    0x0088,    0x0001,    "RWiperServiceCmd",    "RDCU",    65535},
{413,    0x0110,    0x8002,    "LeadAcidbattState1",    "LDCU",    0x0002},
{414,    0x0110,    0x8003,    "LeadAcidbattState2",    "LDCU",    0x0002},
{415,    0x0110,    0x8004,    "LithiumIonbattState1",    "LDCU",    0x0003},
{416,    0x0110,    0x8005,    "LithiumIonbattState2",    "LDCU",    0x0003},
{417,    0x0110,    0x8006,    "LithiumIonbattState3",    "LDCU",    0x0003},
{418,    0x0136,    0x8001,    "InteriorLightService_Err",    "LDCU",    0x0001},
{419,    0x0136,    0x8002,    "InteriorLightState1",    "LDCU",    0x0002},
{420,    0x0136,    0x0001,    "SetDomeLightMode",    "LDCU",    65535},
{421,    0x0136,    0x0002,    "SetDomeLightBright",    "LDCU",    65535},
{422,    0x0136,    0x0003,    "DomeLightCtrl",    "LDCU",    65535},
{423,    0x0136,    0x0004,    "FLDomeLightCtrl",    "LDCU",    65535},
{424,    0x0136,    0x0005,    "FRDomeLightCtrl",    "LDCU",    65535},
{425,    0x0136,    0x0006,    "RLDomeLightCtrl",    "LDCU",    65535},
{426,    0x0136,    0x0007,    "RRDomeLightCtrl",    "LDCU",    65535},
{427,    0x0136,    0x0008,    "TLDomeLightCtrl",    "LDCU",    65535},
{428,    0x0136,    0x0009,    "TRDomeLightCtrl",    "LDCU",    65535},
{429,    0x0136,    0x000A,    "TrunkLightCtrl",    "LDCU",    65535},
{430,    0x0136,    0x000B,    "FLFootLightCtrl",    "LDCU",    65535},
{431,    0x0136,    0x000C,    "FRFootLightCtrl",    "LDCU",    65535},
{432,    0x0185,    0x8001,    "WelCarpetLightService_Err",    "LDCU",    0x0001},
{433,    0x0185,    0x8002,    "WelCarpetLightState1",    "LDCU",    0x0002},
{434,    0x0185,    0x0001,    "WelCarpetLightCfg",    "LDCU",    65535},
{435,    0x0185,    0x0002,    "LWelCarpetLightCtrl",    "LDCU",    65535},
{436,    0x0185,    0x0003,    "RWelCarpetLightCtrl",    "LDCU",    65535},
{437,    0x0069,    0x8001,    "HornService_Err",    "RDCU",    0x0001},
{438,    0x0069,    0x8002,    "HornSt",    "RDCU",    0x0002},
{439,    0x0069,    0x0001,    "HornCtrl",    "RDCU",    65535},
{440,    0x0093,    0x8001,    "ARSservice_Err",    "RDCU",    0x0001},
{441,    0x0093,    0x8002,    "ARSSysSt1",    "RDCU",    0x0002},
{442,    0x0093,    0x8003,    "ARSSysSt2",    "RDCU",    0x0002},
{443,    0x0093,    0x0001,    "CtrlARSMov",    "RDCU",    65535},
{444,    0x0093,    0x0002,    "CtrlARSMode",    "RDCU",    65535},
{445,    0x0093,    0x0003,    "CtrlARSLearn",    "RDCU",    65535},
{446,    0x0093,    0x0004,    "CtrlVehLockARSAutoFold",    "RDCU",    65535},
{447,    0x0073,    0x8001,    "DoorLockService2_Err",    "RDCU",    0x0001},
{448,    0x0073,    0x8002,    "DoorLockSt2",    "RDCU",    0x0002},
{449,    0x0073,    0x0001,    "BonnetUnlockCtr",    "RDCU",    65535},
{450,    0x0073,    0x0002,    "CtrlGloveBoxOpen",    "RDCU",    65535},
{451,    0x0055,    0x8001,    "Veh_RockingDoorCtrlService_Err",    "SOAEngine",    0x0001},
{452,    0x0055,    0x0001,    "Veh_LeftRockingDoorCtrl",    "SOAEngine",    65535},
{453,    0x0055,    0x0002,    "Veh_RightRockingDoorCtrl",    "SOAEngine",    65535},
{454,    0x0056,    0x8001,    "RockingDoorCtrlService_Err",    "RDCU",    0x0001},
{455,    0x0056,    0x8002,    "LeftRockingDoorSysSt1",    "RDCU",    0x0002},
{456,    0x0056,    0x8003,    "RightRockingDoorSysSt2",    "RDCU",    0x0002},
{457,    0x0056,    0x8005,    "RightRockingDoorRadarInfo",    "RDCU",    0x0002},
{458,    0x0056,    0x8004,    "RockingDoorSetFb",    "RDCU",    0x0002},
{459,    0x0056,    0x0001,    "SDC_ManualModeSet",    "RDCU",    65535},
{460,    0x0056,    0x0002,    "SDC_OpenPercentSet",    "RDCU",    65535},
{461,    0x0056,    0x0003,    "SDC_BrakeCloseSet",    "RDCU",    65535},
{462,    0x0056,    0x0004,    "SDC_WinOpenSet",    "RDCU",    65535},
{463,    0x0056,    0x0005,    "SDC_KeyOpenSet",    "RDCU",    65535},
{464,    0x0056,    0x0006,    "LeftRockingDoorCtrl",    "RDCU",    65535},
{465,    0x0056,    0x0007,    "RightRockingDoorCtrl",    "RDCU",    65535},
{466,    0x0068,    0x8001,    "RoofService_Err",    "LDCU",    0x0001},
{467,    0x0068,    0x8002,    "RoofSysSt1",    "LDCU",    0x0002},
{468,    0x0068,    0x8003,    "RoofSysSt2",    "LDCU",    0x0002},
{469,    0x0068,    0x0001,    "CtrlRoofMov",    "LDCU",    65535},
{470,    0x0068,    0x0002,    "CtrlRoofPosTargtMov",    "LDCU",    65535},
{471,    0x0068,    0x0003,    "CtrlRoofLearn",    "LDCU",    65535},
{472,    0x4020,    0x8001,    "TboxImuService_Data",    "TBOX",    0x0001},
{473,    0x0106,    0x8001,    "ADASMomentService_Err",    "CDCU_SOC",    0x0001},
{474,    0x0106,    0x8002,    "CDCU_ADASMomentDriveInfo",    "CDCU_SOC",    0x0002},
{475,    0x0106,    0x8003,    "CDCU_ADASMomentParkingInfo",    "CDCU_SOC",    0x0003},
{476,    0x0106,    0x8004,    "CDCU_ADASMomentSwt",    "CDCU_SOC",    0x0004},
{477,    0x0106,    0x8005,    "CDCU_ADASMomentTripSwt",    "CDCU_SOC",    0x0004}
};
dword soa_signalinfo_len = 6064;
struct SOA_SignalInfo_Typ soa_signalinfo[6064] = {
{1,      0,      "SshdService_ErrStruct",      "SequenceID",      "uint16"},
{2,      0,      "SshdService_ErrStruct",      "Options_8bit",      "uint8"},
{3,      0,      "SshdService_ErrStruct",      "Options_8bit2",      "uint8"},
{4,      0,      "SshdService_ErrStruct",      "UserID",      "uint32"},
{5,      0,      "SshdService_ErrStruct",      "OpeNRC",      "uint32"},
{6,      0,      "SshdService_ErrStruct",      "OpeErrInfo",      "string[16]"},
{7,      1,      "SshdSysSt1Struct",      "SshdMoveStatus",      "uint8"},
{8,      1,      "SshdSysSt1Struct",      "SshdPoslevl",      "uint8"},
{9,      1,      "SshdSysSt1Struct",      "SshdInitializedStatus",      "uint8"},
{10,      1,      "SshdSysSt1Struct",      "SshdHallStatus",      "uint8"},
{11,      1,      "SshdSysSt1Struct",      "SshdAntiPinchStatus",      "uint8"},
{12,      1,      "SshdSysSt1Struct",      "SshdTermalProtec",      "uint8"},
{13,      1,      "SshdSysSt1Struct",      "SshdMotorOutput_P",      "uint8"},
{14,      1,      "SshdSysSt1Struct",      "SshdMotorOutput_N",      "uint8"},
{15,      1,      "SshdSysSt1Struct",      "SsrCtrlSshdMov",      "uint8"},
{16,      1,      "SshdSysSt1Struct",      "SslCtrlSshdMov",      "uint8"},
{17,      2,      "SshdSysSt2Struct",      "SshdPosValue",      "uint8"},
{18,      2,      "SshdSysSt2Struct",      "SshdHallCnt_X",      "uint16"},
{19,      2,      "SshdSysSt2Struct",      "SshdHallCnt_Y",      "uint16"},
{20,      2,      "SshdSysSt2Struct",      "SshdCurtHallCnt",      "uint16"},
{21,      3,      "SshdMovCmdStruct",      "SOAProtocolVersion",      "uint8"},
{22,      3,      "SshdMovCmdStruct",      "SOAHeaderType",      "uint8"},
{23,      3,      "SshdMovCmdStruct",      "SOAHeaderLength",      "uint16"},
{24,      3,      "SshdMovCmdStruct",      "Flag",      "uint16"},
{25,      3,      "SshdMovCmdStruct",      "HeaderCRC16",      "uint16"},
{26,      3,      "SshdMovCmdStruct",      "UserID",      "uint32"},
{27,      3,      "SshdMovCmdStruct",      "ReqTimeOut",      "uint32"},
{28,      3,      "SshdMovCmdStruct",      "RequestPriority",      "uint8"},
{29,      3,      "SshdMovCmdStruct",      "SequenceID",      "uint16"},
{30,      3,      "SshdMovCmdStruct",      "ServiceExecuteFeedbackFlag",      "uint8"},
{31,      3,      "SshdMovCmdStruct",      "Options",      "uint32"},
{32,      3,      "SshdMovCmdStruct",      "SshdMovCmd",      "uint8"},
{33,      3,      "CtrlSshdMovRespStruct",      "RespCode",      "uint32"},
{34,      3,      "CtrlSshdMovRespStruct",      "CtrlSshdMovNRC",      "uint32"},
{35,      4,      "CtrlSshdPosTargtStruct",      "SOAProtocolVersion",      "uint8"},
{36,      4,      "CtrlSshdPosTargtStruct",      "SOAHeaderType",      "uint8"},
{37,      4,      "CtrlSshdPosTargtStruct",      "SOAHeaderLength",      "uint16"},
{38,      4,      "CtrlSshdPosTargtStruct",      "Flag",      "uint16"},
{39,      4,      "CtrlSshdPosTargtStruct",      "HeaderCRC16",      "uint16"},
{40,      4,      "CtrlSshdPosTargtStruct",      "UserID",      "uint32"},
{41,      4,      "CtrlSshdPosTargtStruct",      "ReqTimeOut",      "uint32"},
{42,      4,      "CtrlSshdPosTargtStruct",      "RequestPriority",      "uint8"},
{43,      4,      "CtrlSshdPosTargtStruct",      "SequenceID",      "uint16"},
{44,      4,      "CtrlSshdPosTargtStruct",      "ServiceExecuteFeedbackFlag",      "uint8"},
{45,      4,      "CtrlSshdPosTargtStruct",      "Options",      "uint32"},
{46,      4,      "CtrlSshdPosTargtStruct",      "CtrlSshdPosTargt",      "uint8"},
{47,      4,      "CtrlSshdPosTargtMovRespStruct",      "RespCode",      "uint32"},
{48,      4,      "CtrlSshdPosTargtMovRespStruct",      "CtrlSshdPosTargtMovNRC",      "uint32"},
{49,      5,      "CtrlSshdLearnPerStruct",      "SOAProtocolVersion",      "uint8"},
{50,      5,      "CtrlSshdLearnPerStruct",      "SOAHeaderType",      "uint8"},
{51,      5,      "CtrlSshdLearnPerStruct",      "SOAHeaderLength",      "uint16"},
{52,      5,      "CtrlSshdLearnPerStruct",      "Flag",      "uint16"},
{53,      5,      "CtrlSshdLearnPerStruct",      "HeaderCRC16",      "uint16"},
{54,      5,      "CtrlSshdLearnPerStruct",      "UserID",      "uint32"},
{55,      5,      "CtrlSshdLearnPerStruct",      "ReqTimeOut",      "uint32"},
{56,      5,      "CtrlSshdLearnPerStruct",      "RequestPriority",      "uint8"},
{57,      5,      "CtrlSshdLearnPerStruct",      "SequenceID",      "uint16"},
{58,      5,      "CtrlSshdLearnPerStruct",      "ServiceExecuteFeedbackFlag",      "uint8"},
{59,      5,      "CtrlSshdLearnPerStruct",      "Options",      "uint32"},
{60,      5,      "CtrlSshdLearnPerStruct",      "CtrlSshdLearnPer",      "uint8"},
{61,      5,      "CtrlSshdLearnRespStruct",      "RespCode",      "uint32"},
{62,      5,      "CtrlSshdLearnRespStruct",      "CtrlSshdLearnNRC",      "uint32"},
{63,      6,      "LeftSlideDoorCtrlService_ErrStruct",      "SequenceID",      "uint16"},
{64,      6,      "LeftSlideDoorCtrlService_ErrStruct",      "Options_8bit",      "uint8"},
{65,      6,      "LeftSlideDoorCtrlService_ErrStruct",      "Options_8bit2",      "uint8"},
{66,      6,      "LeftSlideDoorCtrlService_ErrStruct",      "UserID",      "uint32"},
{67,      6,      "LeftSlideDoorCtrlService_ErrStruct",      "OpeNRC",      "uint32"},
{68,      6,      "LeftSlideDoorCtrlService_ErrStruct",      "OpeErrInfo",      "string[16]"},
{69,      7,      "LSlideDoorStStruct",      "PSDL_PSDFaultStatus",      "uint8"},
{70,      7,      "LSlideDoorStStruct",      "PSDL_SlideDoorStatus",      "uint8"},
{71,      7,      "LSlideDoorStStruct",      "PSDL_LatchHeatProtectStatus",      "uint8"},
{72,      7,      "LSlideDoorStStruct",      "PSDL_MotorHeatProtectStatus",      "uint8"},
{73,      7,      "LSlideDoorStStruct",      "PSDL_APSFaultStatus",      "uint8"},
{74,      7,      "LSlideDoorStStruct",      "PSDL_CinchingMotorFault",      "uint8"},
{75,      7,      "LSlideDoorStStruct",      "PSDL_MotorFault",      "uint8"},
{76,      7,      "LSlideDoorStStruct",      "PSDL_SlideDoorOutSw",      "uint8"},
{77,      7,      "LSlideDoorStStruct",      "PSDL_SlideDoorInSw",      "uint8"},
{78,      7,      "LSlideDoorStStruct",      "PSDL_PinchEventStatus",      "uint8"},
{79,      7,      "LSlideDoorStStruct",      "PSDL_StaullEventStatus",      "uint8"},
{80,      7,      "LSlideDoorStStruct",      "PSDL_SpeakerStatus",      "uint8"},
{81,      7,      "LSlideDoorStStruct",      "PSDL_HALLFaultStatus",      "uint8"},
{82,      7,      "LSlideDoorStStruct",      "PSDL_HAF_SW",      "uint8"},
{83,      7,      "LSlideDoorStStruct",      "PSDL_FUL_SW",      "uint8"},
{84,      7,      "LSlideDoorStStruct",      "PSDL_PWL_SW",      "uint8"},
{85,      7,      "LSlideDoorStStruct",      "PSDL_NTRL_SW",      "uint8"},
{86,      7,      "LSlideDoorStStruct",      "PSDL_NPC_SW",      "uint8"},
{87,      7,      "LSlideDoorStStruct",      "PSDL_Motor_status",      "uint8"},
{88,      7,      "LSlideDoorStStruct",      "PSDL_Release_Closure_Status",      "uint8"},
{89,      7,      "LSlideDoorStStruct",      "PSDL_SlideDoorModeFb",      "uint8"},
{90,      7,      "LSlideDoorStStruct",      "PSDL_SlideDoorEmergSt",      "uint8"},
{91,      7,      "LSlideDoorStStruct",      "PSDL_APAReverseStatus",      "uint8"},
{92,      7,      "LSlideDoorStStruct",      "PSDL_VD",      "uint8"},
{93,      7,      "LSlideDoorStStruct",      "LSlideDoorLockSt",      "uint8"},
{94,      7,      "LSlideDoorStStruct",      "LSlideDoorOpenLimit",      "uint8"},
{95,      7,      "LSlideDoorStStruct",      "LSlideDoorOpenSource",      "uint8"},
{96,      7,      "LSlideDoorStStruct",      "LSlideDoorCloseSource",      "uint8"},
{97,      8,      "LSlideDoorSt2Struct",      "PSDL_SlideDoorPosition",      "float32"},
{98,      9,      "LSlideDoorPosCtrStruct",      "SOAProtocolVersion",      "uint8"},
{99,      9,      "LSlideDoorPosCtrStruct",      "SOAHeaderType",      "uint8"},
{100,      9,      "LSlideDoorPosCtrStruct",      "SOAHeaderLength",      "uint16"},
{101,      9,      "LSlideDoorPosCtrStruct",      "Flag",      "uint16"},
{102,      9,      "LSlideDoorPosCtrStruct",      "HeaderCRC16",      "uint16"},
{103,      9,      "LSlideDoorPosCtrStruct",      "UserID",      "uint32"},
{104,      9,      "LSlideDoorPosCtrStruct",      "ReqTimeOut",      "uint32"},
{105,      9,      "LSlideDoorPosCtrStruct",      "RequestPriority",      "uint8"},
{106,      9,      "LSlideDoorPosCtrStruct",      "SequenceID",      "uint16"},
{107,      9,      "LSlideDoorPosCtrStruct",      "ServiceExecuteFeedbackFlag",      "uint8"},
{108,      9,      "LSlideDoorPosCtrStruct",      "Options",      "uint32"},
{109,      9,      "LSlideDoorPosCtrStruct",      "LSlideDoorPosReq",      "uint8"},
{110,      9,      "LSlideDoorPosCtrRespStruct",      "RespCode",      "uint32"},
{111,      9,      "LSlideDoorPosCtrRespStruct",      "LSlideDoorPosCtrNRC",      "uint32"},
{112,      10,      "LSlideDoorCtrStruct",      "SOAProtocolVersion",      "uint8"},
{113,      10,      "LSlideDoorCtrStruct",      "SOAHeaderType",      "uint8"},
{114,      10,      "LSlideDoorCtrStruct",      "SOAHeaderLength",      "uint16"},
{115,      10,      "LSlideDoorCtrStruct",      "Flag",      "uint16"},
{116,      10,      "LSlideDoorCtrStruct",      "HeaderCRC16",      "uint16"},
{117,      10,      "LSlideDoorCtrStruct",      "UserID",      "uint32"},
{118,      10,      "LSlideDoorCtrStruct",      "ReqTimeOut",      "uint32"},
{119,      10,      "LSlideDoorCtrStruct",      "RequestPriority",      "uint8"},
{120,      10,      "LSlideDoorCtrStruct",      "SequenceID",      "uint16"},
{121,      10,      "LSlideDoorCtrStruct",      "ServiceExecuteFeedbackFlag",      "uint8"},
{122,      10,      "LSlideDoorCtrStruct",      "Options",      "uint32"},
{123,      10,      "LSlideDoorCtrStruct",      "LSlideDoorCtr",      "uint8"},
{124,      10,      "LSlideDoorCtrRespStruct",      "RespCode",      "uint32"},
{125,      10,      "LSlideDoorCtrRespStruct",      "LSlideDoorCtrNRC",      "uint32"},
{126,      11,      "LSlideDoorLockCtrStruct",      "SOAProtocolVersion",      "uint8"},
{127,      11,      "LSlideDoorLockCtrStruct",      "SOAHeaderType",      "uint8"},
{128,      11,      "LSlideDoorLockCtrStruct",      "SOAHeaderLength",      "uint16"},
{129,      11,      "LSlideDoorLockCtrStruct",      "Flag",      "uint16"},
{130,      11,      "LSlideDoorLockCtrStruct",      "HeaderCRC16",      "uint16"},
{131,      11,      "LSlideDoorLockCtrStruct",      "UserID",      "uint32"},
{132,      11,      "LSlideDoorLockCtrStruct",      "ReqTimeOut",      "uint32"},
{133,      11,      "LSlideDoorLockCtrStruct",      "RequestPriority",      "uint8"},
{134,      11,      "LSlideDoorLockCtrStruct",      "SequenceID",      "uint16"},
{135,      11,      "LSlideDoorLockCtrStruct",      "ServiceExecuteFeedbackFlag",      "uint8"},
{136,      11,      "LSlideDoorLockCtrStruct",      "Options",      "uint32"},
{137,      11,      "LSlideDoorLockCtrStruct",      "LSlideDoorLockCtr",      "uint8"},
{138,      11,      "LSlideDoorLockCtrRespStruct",      "RespCode",      "uint32"},
{139,      11,      "LSlideDoorLockCtrRespStruct",      "LSlideDoorLockCtrNRC",      "uint32"},
{140,      12,      "RightSlideDoorCtrlService_ErrStruct",      "SequenceID",      "uint16"},
{141,      12,      "RightSlideDoorCtrlService_ErrStruct",      "Options_8bit",      "uint8"},
{142,      12,      "RightSlideDoorCtrlService_ErrStruct",      "Options_8bit2",      "uint8"},
{143,      12,      "RightSlideDoorCtrlService_ErrStruct",      "UserID",      "uint32"},
{144,      12,      "RightSlideDoorCtrlService_ErrStruct",      "OpeNRC",      "uint32"},
{145,      12,      "RightSlideDoorCtrlService_ErrStruct",      "OpeErrInfo",      "string[16]"},
{146,      13,      "RSlideDoorStStruct",      "PSDR_PSDFaultStatus",      "uint8"},
{147,      13,      "RSlideDoorStStruct",      "PSDR_SlideDoorStatus",      "uint8"},
{148,      13,      "RSlideDoorStStruct",      "PSDR_LatchHeatProtectStatus",      "uint8"},
{149,      13,      "RSlideDoorStStruct",      "PSDR_MotorHeatProtectStatus",      "uint8"},
{150,      13,      "RSlideDoorStStruct",      "PSDR_APSFaultStatus",      "uint8"},
{151,      13,      "RSlideDoorStStruct",      "PSDR_CinchingMotorFault",      "uint8"},
{152,      13,      "RSlideDoorStStruct",      "PSDR_MotorFault",      "uint8"},
{153,      13,      "RSlideDoorStStruct",      "PSDR_SlideDoorOutSw",      "uint8"},
{154,      13,      "RSlideDoorStStruct",      "PSDR_SlideDoorInSw",      "uint8"},
{155,      13,      "RSlideDoorStStruct",      "PSDR_PinchEventStatus",      "uint8"},
{156,      13,      "RSlideDoorStStruct",      "PSDR_StaullEventStatus",      "uint8"},
{157,      13,      "RSlideDoorStStruct",      "PSDR_SpeakerStatus",      "uint8"},
{158,      13,      "RSlideDoorStStruct",      "PSDR_HALLFaultStatus",      "uint8"},
{159,      13,      "RSlideDoorStStruct",      "PSDR_HAF_SW",      "uint8"},
{160,      13,      "RSlideDoorStStruct",      "PSDR_FUL_SW",      "uint8"},
{161,      13,      "RSlideDoorStStruct",      "PSDR_PWL_SW",      "uint8"},
{162,      13,      "RSlideDoorStStruct",      "PSDR_NTRL_SW",      "uint8"},
{163,      13,      "RSlideDoorStStruct",      "PSDR_NPC_SW",      "uint8"},
{164,      13,      "RSlideDoorStStruct",      "PSDR_Motor_status",      "uint8"},
{165,      13,      "RSlideDoorStStruct",      "PSDR_Release_Closure_Status",      "uint8"},
{166,      13,      "RSlideDoorStStruct",      "PSDR_SlideDoorModeFb",      "uint8"},
{167,      13,      "RSlideDoorStStruct",      "PSDR_SlideDoorEmergSt",      "uint8"},
{168,      13,      "RSlideDoorStStruct",      "PSDR_APAReverseStatus",      "uint8"},
{169,      13,      "RSlideDoorStStruct",      "PSDR_VD",      "uint8"},
{170,      13,      "RSlideDoorStStruct",      "RSlideDoorLockSt",      "uint8"},
{171,      13,      "RSlideDoorStStruct",      "RSlideDoorOpenLimit",      "uint8"},
{172,      13,      "RSlideDoorStStruct",      "RSlideDoorOpenSource",      "uint8"},
{173,      13,      "RSlideDoorStStruct",      "RSlideDoorCloseSource",      "uint8"},
{174,      14,      "RSlideDoorSt2Struct",      "PSDR_SlideDoorPosition",      "float32"},
{175,      15,      "RSlideDoorPosCtrStruct",      "SOAProtocolVersion",      "uint8"},
{176,      15,      "RSlideDoorPosCtrStruct",      "SOAHeaderType",      "uint8"},
{177,      15,      "RSlideDoorPosCtrStruct",      "SOAHeaderLength",      "uint16"},
{178,      15,      "RSlideDoorPosCtrStruct",      "Flag",      "uint16"},
{179,      15,      "RSlideDoorPosCtrStruct",      "HeaderCRC16",      "uint16"},
{180,      15,      "RSlideDoorPosCtrStruct",      "UserID",      "uint32"},
{181,      15,      "RSlideDoorPosCtrStruct",      "ReqTimeOut",      "uint32"},
{182,      15,      "RSlideDoorPosCtrStruct",      "RequestPriority",      "uint8"},
{183,      15,      "RSlideDoorPosCtrStruct",      "SequenceID",      "uint16"},
{184,      15,      "RSlideDoorPosCtrStruct",      "ServiceExecuteFeedbackFlag",      "uint8"},
{185,      15,      "RSlideDoorPosCtrStruct",      "Options",      "uint32"},
{186,      15,      "RSlideDoorPosCtrStruct",      "RSlideDoorPosReq",      "uint8"},
{187,      15,      "RSlideDoorPosCtrRespStruct",      "RespCode",      "uint32"},
{188,      15,      "RSlideDoorPosCtrRespStruct",      "RSlideDoorPosCtrNRC",      "uint32"},
{189,      16,      "RSlideDoorCtrStruct",      "SOAProtocolVersion",      "uint8"},
{190,      16,      "RSlideDoorCtrStruct",      "SOAHeaderType",      "uint8"},
{191,      16,      "RSlideDoorCtrStruct",      "SOAHeaderLength",      "uint16"},
{192,      16,      "RSlideDoorCtrStruct",      "Flag",      "uint16"},
{193,      16,      "RSlideDoorCtrStruct",      "HeaderCRC16",      "uint16"},
{194,      16,      "RSlideDoorCtrStruct",      "UserID",      "uint32"},
{195,      16,      "RSlideDoorCtrStruct",      "ReqTimeOut",      "uint32"},
{196,      16,      "RSlideDoorCtrStruct",      "RequestPriority",      "uint8"},
{197,      16,      "RSlideDoorCtrStruct",      "SequenceID",      "uint16"},
{198,      16,      "RSlideDoorCtrStruct",      "ServiceExecuteFeedbackFlag",      "uint8"},
{199,      16,      "RSlideDoorCtrStruct",      "Options",      "uint32"},
{200,      16,      "RSlideDoorCtrStruct",      "RSlideDoorCtr",      "uint8"},
{201,      16,      "RSlideDoorCtrRespStruct",      "RespCode",      "uint32"},
{202,      16,      "RSlideDoorCtrRespStruct",      "RSlideDoorCtrNRC",      "uint32"},
{203,      17,      "RSlideDoorLockCtrStruct",      "SOAProtocolVersion",      "uint8"},
{204,      17,      "RSlideDoorLockCtrStruct",      "SOAHeaderType",      "uint8"},
{205,      17,      "RSlideDoorLockCtrStruct",      "SOAHeaderLength",      "uint16"},
{206,      17,      "RSlideDoorLockCtrStruct",      "Flag",      "uint16"},
{207,      17,      "RSlideDoorLockCtrStruct",      "HeaderCRC16",      "uint16"},
{208,      17,      "RSlideDoorLockCtrStruct",      "UserID",      "uint32"},
{209,      17,      "RSlideDoorLockCtrStruct",      "ReqTimeOut",      "uint32"},
{210,      17,      "RSlideDoorLockCtrStruct",      "RequestPriority",      "uint8"},
{211,      17,      "RSlideDoorLockCtrStruct",      "SequenceID",      "uint16"},
{212,      17,      "RSlideDoorLockCtrStruct",      "ServiceExecuteFeedbackFlag",      "uint8"},
{213,      17,      "RSlideDoorLockCtrStruct",      "Options",      "uint32"},
{214,      17,      "RSlideDoorLockCtrStruct",      "RSlideDoorLockCtr",      "uint8"},
{215,      17,      "RSlideDoorLockCtrRespStruct",      "RespCode",      "uint32"},
{216,      17,      "RSlideDoorLockCtrRespStruct",      "RSlideDoorLockCtrNRC",      "uint32"},
{217,      18,      "FwiperService_ErrStruct",      "SequenceID",      "uint16"},
{218,      18,      "FwiperService_ErrStruct",      "Options_8bit",      "uint8"},
{219,      18,      "FwiperService_ErrStruct",      "Options_8bit2",      "uint8"},
{220,      18,      "FwiperService_ErrStruct",      "UserID",      "uint32"},
{221,      18,      "FwiperService_ErrStruct",      "OpeNRC",      "uint32"},
{222,      18,      "FwiperService_ErrStruct",      "OpeErrInfo",      "string[16]"},
{223,      19,      "FwiperStStruct",      "FWiperSpd",      "uint8"},
{224,      19,      "FwiperStStruct",      "FWiperActiveSt",      "uint8"},
{225,      19,      "FwiperStStruct",      "FWiperParkARSt",      "uint8"},
{226,      19,      "FwiperStStruct",      "FWiperServicePosSt",      "uint8"},
{227,      19,      "FwiperStStruct",      "FWiperBlkPosSt",      "uint8"},
{228,      19,      "FwiperStStruct",      "FWiperMoveDir",      "uint8"},
{229,      19,      "FwiperStStruct",      "FWiperVoltErr",      "uint8"},
{230,      19,      "FwiperStStruct",      "FWiperTurnPosSt",      "uint8"},
{231,      19,      "FwiperStStruct",      "FWiperMotorErr",      "uint8"},
{232,      19,      "FwiperStStruct",      "FWiperLinErr",      "uint8"},
{233,      19,      "FwiperStStruct",      "FWiperTempProtectSt",      "uint8"},
{234,      19,      "FwiperStStruct",      "FWiperOverLoadSt",      "uint8"},
{235,      19,      "FwiperStStruct",      "FWiperSwSt",      "uint8"},
{236,      19,      "FwiperStStruct",      "FWashSwSt",      "uint8"},
{237,      19,      "FwiperStStruct",      "FWiperSensitivitySwSts",      "uint8"},
{238,      19,      "FwiperStStruct",      "WashMotorOutputSt",      "uint8"},
{239,      19,      "FwiperStStruct",      "FWiperServiceFB",      "uint8"},
{240,      19,      "FwiperStStruct",      "FWiperSensitivityFB",      "uint8"},
{241,      19,      "FwiperStStruct",      "SFWiperBlkPosSt",      "uint8"},
{242,      19,      "FwiperStStruct",      "SFWiperMotorErr",      "uint8"},
{243,      19,      "FwiperStStruct",      "SFWiperLinErr",      "uint8"},
{244,      19,      "FwiperStStruct",      "SFWiperTempProtectSts",      "uint8"},
{245,      19,      "FwiperStStruct",      "FWiperSysFaultWarning",      "uint8"},
{246,      19,      "FwiperStStruct",      "FwiperAutoFuncSts",      "uint8"},
{247,      19,      "FwiperStStruct",      "WasherFluidWarningSts",      "uint8"},
{248,      19,      "FwiperStStruct",      "SetWiperFuncInactiveFB",      "uint8"},
{249,      20,      "FwiperSt2Struct",      "FWiperMotorAngle",      "float32"},
{250,      21,      "RLSStStruct",      "RLSRainIntensity",      "float32"},
{251,      21,      "RLSStStruct",      "RLSBrightnessFW",      "float32"},
{252,      21,      "RLSStStruct",      "RLSRQWiperSPD",      "uint8"},
{253,      21,      "RLSStStruct",      "RLSFaultRain",      "uint8"},
{254,      21,      "RLSStStruct",      "RLSREPError",      "uint8"},
{255,      21,      "RLSStStruct",      "RLSVOLTError",      "uint8"},
{256,      22,      "FwiperSensitivityCmdStruct",      "SOAProtocolVersion",      "uint8"},
{257,      22,      "FwiperSensitivityCmdStruct",      "SOAHeaderType",      "uint8"},
{258,      22,      "FwiperSensitivityCmdStruct",      "SOAHeaderLength",      "uint16"},
{259,      22,      "FwiperSensitivityCmdStruct",      "Flag",      "uint16"},
{260,      22,      "FwiperSensitivityCmdStruct",      "HeaderCRC16",      "uint16"},
{261,      22,      "FwiperSensitivityCmdStruct",      "UserID",      "uint32"},
{262,      22,      "FwiperSensitivityCmdStruct",      "ReqTimeOut",      "uint32"},
{263,      22,      "FwiperSensitivityCmdStruct",      "RequestPriority",      "uint8"},
{264,      22,      "FwiperSensitivityCmdStruct",      "SequenceID",      "uint16"},
{265,      22,      "FwiperSensitivityCmdStruct",      "ServiceExecuteFeedbackFlag",      "uint8"},
{266,      22,      "FwiperSensitivityCmdStruct",      "Options",      "uint32"},
{267,      22,      "FwiperSensitivityCmdStruct",      "FWiperSensitivityCmd",      "uint8"},
{268,      22,      "FwiperSensitivityCmdRespStruct",      "RespCode",      "uint32"},
{269,      22,      "FwiperSensitivityCmdRespStruct",      "FwiperSensitivityCmdNRC",      "uint32"},
{270,      23,      "FwiperSensitivityCfgStruct",      "SOAProtocolVersion",      "uint8"},
{271,      23,      "FwiperSensitivityCfgStruct",      "SOAHeaderType",      "uint8"},
{272,      23,      "FwiperSensitivityCfgStruct",      "SOAHeaderLength",      "uint16"},
{273,      23,      "FwiperSensitivityCfgStruct",      "Flag",      "uint16"},
{274,      23,      "FwiperSensitivityCfgStruct",      "HeaderCRC16",      "uint16"},
{275,      23,      "FwiperSensitivityCfgStruct",      "UserID",      "uint32"},
{276,      23,      "FwiperSensitivityCfgStruct",      "ReqTimeOut",      "uint32"},
{277,      23,      "FwiperSensitivityCfgStruct",      "RequestPriority",      "uint8"},
{278,      23,      "FwiperSensitivityCfgStruct",      "SequenceID",      "uint16"},
{279,      23,      "FwiperSensitivityCfgStruct",      "ServiceExecuteFeedbackFlag",      "uint8"},
{280,      23,      "FwiperSensitivityCfgStruct",      "Options",      "uint32"},
{281,      23,      "FwiperSensitivityCfgStruct",      "FWiperSensitivityCfg",      "uint8"},
{282,      23,      "FwiperSensitivityCfgRespStruct",      "RespCode",      "uint32"},
{283,      23,      "FwiperSensitivityCfgRespStruct",      "FwiperSensitivityCfgNRC",      "uint32"},
{284,      24,      "FWiperServiceCmdStruct",      "SOAProtocolVersion",      "uint8"},
{285,      24,      "FWiperServiceCmdStruct",      "SOAHeaderType",      "uint8"},
{286,      24,      "FWiperServiceCmdStruct",      "SOAHeaderLength",      "uint16"},
{287,      24,      "FWiperServiceCmdStruct",      "Flag",      "uint16"},
{288,      24,      "FWiperServiceCmdStruct",      "HeaderCRC16",      "uint16"},
{289,      24,      "FWiperServiceCmdStruct",      "UserID",      "uint32"},
{290,      24,      "FWiperServiceCmdStruct",      "ReqTimeOut",      "uint32"},
{291,      24,      "FWiperServiceCmdStruct",      "RequestPriority",      "uint8"},
{292,      24,      "FWiperServiceCmdStruct",      "SequenceID",      "uint16"},
{293,      24,      "FWiperServiceCmdStruct",      "ServiceExecuteFeedbackFlag",      "uint8"},
{294,      24,      "FWiperServiceCmdStruct",      "Options",      "uint32"},
{295,      24,      "FWiperServiceCmdStruct",      "FWiperServiceCmd",      "uint8"},
{296,      24,      "FWiperServiceCmdRespStruct",      "RespCode",      "uint32"},
{297,      24,      "FWiperServiceCmdRespStruct",      "FWiperServiceCmdNRC",      "uint32"},
{298,      25,      "SetFwiperSWStsStruct",      "SOAProtocolVersion",      "uint8"},
{299,      25,      "SetFwiperSWStsStruct",      "SOAHeaderType",      "uint8"},
{300,      25,      "SetFwiperSWStsStruct",      "SOAHeaderLength",      "uint16"},
{301,      25,      "SetFwiperSWStsStruct",      "Flag",      "uint16"},
{302,      25,      "SetFwiperSWStsStruct",      "HeaderCRC16",      "uint16"},
{303,      25,      "SetFwiperSWStsStruct",      "UserID",      "uint32"},
{304,      25,      "SetFwiperSWStsStruct",      "ReqTimeOut",      "uint32"},
{305,      25,      "SetFwiperSWStsStruct",      "RequestPriority",      "uint8"},
{306,      25,      "SetFwiperSWStsStruct",      "SequenceID",      "uint16"},
{307,      25,      "SetFwiperSWStsStruct",      "ServiceExecuteFeedbackFlag",      "uint8"},
{308,      25,      "SetFwiperSWStsStruct",      "Options",      "uint32"},
{309,      25,      "SetFwiperSWStsStruct",      "FWiperSWReq",      "uint8"},
{310,      25,      "SetFwiperSWStsRespStruct",      "RespCode",      "uint32"},
{311,      25,      "SetFwiperSWStsRespStruct",      "SetFwiperSWStsNRC",      "uint32"},
{312,      26,      "SetFwiperAutoFuncStruct",      "SOAProtocolVersion",      "uint8"},
{313,      26,      "SetFwiperAutoFuncStruct",      "SOAHeaderType",      "uint8"},
{314,      26,      "SetFwiperAutoFuncStruct",      "SOAHeaderLength",      "uint16"},
{315,      26,      "SetFwiperAutoFuncStruct",      "Flag",      "uint16"},
{316,      26,      "SetFwiperAutoFuncStruct",      "HeaderCRC16",      "uint16"},
{317,      26,      "SetFwiperAutoFuncStruct",      "UserID",      "uint32"},
{318,      26,      "SetFwiperAutoFuncStruct",      "ReqTimeOut",      "uint32"},
{319,      26,      "SetFwiperAutoFuncStruct",      "RequestPriority",      "uint8"},
{320,      26,      "SetFwiperAutoFuncStruct",      "SequenceID",      "uint16"},
{321,      26,      "SetFwiperAutoFuncStruct",      "ServiceExecuteFeedbackFlag",      "uint8"},
{322,      26,      "SetFwiperAutoFuncStruct",      "Options",      "uint32"},
{323,      26,      "SetFwiperAutoFuncStruct",      "SetFwiperAutoFunc",      "uint8"},
{324,      26,      "SetFwiperAutoFuncRespStruct",      "RespCode",      "uint32"},
{325,      26,      "SetFwiperAutoFuncRespStruct",      "SetFwiperAutoFuncNRC",      "uint32"},
{326,      27,      "SetWiperFuncInactiveStruct",      "SOAProtocolVersion",      "uint8"},
{327,      27,      "SetWiperFuncInactiveStruct",      "SOAHeaderType",      "uint8"},
{328,      27,      "SetWiperFuncInactiveStruct",      "SOAHeaderLength",      "uint16"},
{329,      27,      "SetWiperFuncInactiveStruct",      "Flag",      "uint16"},
{330,      27,      "SetWiperFuncInactiveStruct",      "HeaderCRC16",      "uint16"},
{331,      27,      "SetWiperFuncInactiveStruct",      "UserID",      "uint32"},
{332,      27,      "SetWiperFuncInactiveStruct",      "ReqTimeOut",      "uint32"},
{333,      27,      "SetWiperFuncInactiveStruct",      "RequestPriority",      "uint8"},
{334,      27,      "SetWiperFuncInactiveStruct",      "SequenceID",      "uint16"},
{335,      27,      "SetWiperFuncInactiveStruct",      "ServiceExecuteFeedbackFlag",      "uint8"},
{336,      27,      "SetWiperFuncInactiveStruct",      "Options",      "uint32"},
{337,      27,      "SetWiperFuncInactiveStruct",      "SetWiperFuncInactive",      "uint8"},
{338,      27,      "SetWiperFuncInactiveRespStruct",      "RespCode",      "uint32"},
{339,      27,      "SetWiperFuncInactiveRespStruct",      "SetWiperFuncInactiveNRC",      "uint32"},
{340,      28,      "DrvSeatCtrlService_ErrStruct",      "SequenceID",      "uint16"},
{341,      28,      "DrvSeatCtrlService_ErrStruct",      "Options_8bit",      "uint8"},
{342,      28,      "DrvSeatCtrlService_ErrStruct",      "Options_8bit2",      "uint8"},
{343,      28,      "DrvSeatCtrlService_ErrStruct",      "UserID",      "uint32"},
{344,      28,      "DrvSeatCtrlService_ErrStruct",      "OpeNRC",      "uint32"},
{345,      28,      "DrvSeatCtrlService_ErrStruct",      "OpeErrInfo",      "string[16]"},
{346,      29,      "DrvSeatPstStruct",      "DrvSeatHorzPos",      "uint8"},
{347,      29,      "DrvSeatPstStruct",      "DrvSeatVerticalPos",      "uint8"},
{348,      29,      "DrvSeatPstStruct",      "DrvSeatTiltingPos",      "uint8"},
{349,      29,      "DrvSeatPstStruct",      "DrvSeatCushTiltPos",      "uint8"},
{350,      29,      "DrvSeatPstStruct",      "DrvSeatCushionExtPos",      "uint8"},
{351,      30,      "DrvSeatFuncStStruct",      "DrvSeatEasyEntrySt",      "uint8"},
{352,      30,      "DrvSeatFuncStStruct",      "DrvSeatEasyEntryCfgSt",      "uint8"},
{353,      30,      "DrvSeatFuncStStruct",      "DrvSeatAutoAdjEnableSt",      "uint8"},
{354,      30,      "DrvSeatFuncStStruct",      "DrvSeatAdjMoveSt",      "uint8"},
{355,      30,      "DrvSeatFuncStStruct",      "DrvSeatHeatSt",      "uint8"},
{356,      30,      "DrvSeatFuncStStruct",      "DrvSeatVentilationSt",      "uint8"},
{357,      30,      "DrvSeatFuncStStruct",      "DrvSeatDenormalizeSt",      "uint8"},
{358,      30,      "DrvSeatFuncStStruct",      "DrvSeatSplModSts",      "uint8"},
{359,      30,      "DrvSeatFuncStStruct",      "DrvSeatMassgSwSts",      "uint8"},
{360,      30,      "DrvSeatFuncStStruct",      "DrvSeatPosSts",      "uint8"},
{361,      31,      "DrvSeatOccupancyStStruct",      "DrvSeatOccupancySt",      "unit8"},
{362,      32,      "RecallDrvSeatPstStruct",      "SOAProtocolVersion",      "uint8"},
{363,      32,      "RecallDrvSeatPstStruct",      "SOAHeaderType",      "uint8"},
{364,      32,      "RecallDrvSeatPstStruct",      "SOAHeaderLength",      "uint16"},
{365,      32,      "RecallDrvSeatPstStruct",      "Flag",      "uint16"},
{366,      32,      "RecallDrvSeatPstStruct",      "HeaderCRC16",      "uint16"},
{367,      32,      "RecallDrvSeatPstStruct",      "UserID",      "uint32"},
{368,      32,      "RecallDrvSeatPstStruct",      "ReqTimeOut",      "uint32"},
{369,      32,      "RecallDrvSeatPstStruct",      "RequestPriority",      "uint8"},
{370,      32,      "RecallDrvSeatPstStruct",      "SequenceID",      "uint16"},
{371,      32,      "RecallDrvSeatPstStruct",      "ServiceExecuteFeedbackFlag",      "uint8"},
{372,      32,      "RecallDrvSeatPstStruct",      "Options",      "uint32"},
{373,      32,      "RecallDrvSeatPstStruct",      "DrvSeatHorzTrgtPst",      "uint8"},
{374,      32,      "RecallDrvSeatPstStruct",      "DrvSeatVertTrgtPst",      "uint8"},
{375,      32,      "RecallDrvSeatPstStruct",      "DrvSeatTiltTrgtPst",      "uint8"},
{376,      32,      "RecallDrvSeatPstStruct",      "DrvSeatCushTiltTrgtPst",      "uint8"},
{377,      32,      "RecallDrvSeatPstStruct",      "DrvSeatCushExtTrgtPst",      "uint8"},
{378,      32,      "RecallDrvSeatPstRespStruct",      "RespCode",      "uint32"},
{379,      32,      "RecallDrvSeatPstRespStruct",      "RecallDrvSeatPstNRC",      "uint32"},
{380,      33,      "SyncDrvSeatPstStruct",      "SOAProtocolVersion",      "uint8"},
{381,      33,      "SyncDrvSeatPstStruct",      "SOAHeaderType",      "uint8"},
{382,      33,      "SyncDrvSeatPstStruct",      "SOAHeaderLength",      "uint16"},
{383,      33,      "SyncDrvSeatPstStruct",      "Flag",      "uint16"},
{384,      33,      "SyncDrvSeatPstStruct",      "HeaderCRC16",      "uint16"},
{385,      33,      "SyncDrvSeatPstStruct",      "UserID",      "uint32"},
{386,      33,      "SyncDrvSeatPstStruct",      "ReqTimeOut",      "uint32"},
{387,      33,      "SyncDrvSeatPstStruct",      "RequestPriority",      "uint8"},
{388,      33,      "SyncDrvSeatPstStruct",      "SequenceID",      "uint16"},
{389,      33,      "SyncDrvSeatPstStruct",      "ServiceExecuteFeedbackFlag",      "uint8"},
{390,      33,      "SyncDrvSeatPstStruct",      "Options",      "uint32"},
{391,      33,      "SyncDrvSeatPstStruct",      "DrvSeatHorzTrgtPst",      "uint8"},
{392,      33,      "SyncDrvSeatPstStruct",      "DrvSeatVertTrgtPst",      "uint8"},
{393,      33,      "SyncDrvSeatPstStruct",      "DrvSeatTiltTrgtPst",      "uint8"},
{394,      33,      "SyncDrvSeatPstStruct",      "DrvSeatCushTiltTrgtPst",      "uint8"},
{395,      33,      "SyncDrvSeatPstStruct",      "DrvSeatCushExtTrgtPst",      "uint8"},
{396,      33,      "SyncDrvSeatPstRespStruct",      "RespCode",      "uint32"},
{397,      33,      "SyncDrvSeatPstRespStruct",      "SyncDrvSeatPstNRC",      "uint32"},
{398,      34,      "StopDrvSeatMovingStruct",      "SOAProtocolVersion",      "uint8"},
{399,      34,      "StopDrvSeatMovingStruct",      "SOAHeaderType",      "uint8"},
{400,      34,      "StopDrvSeatMovingStruct",      "SOAHeaderLength",      "uint16"},
{401,      34,      "StopDrvSeatMovingStruct",      "Flag",      "uint16"},
{402,      34,      "StopDrvSeatMovingStruct",      "HeaderCRC16",      "uint16"},
{403,      34,      "StopDrvSeatMovingStruct",      "UserID",      "uint32"},
{404,      34,      "StopDrvSeatMovingStruct",      "ReqTimeOut",      "uint32"},
{405,      34,      "StopDrvSeatMovingStruct",      "RequestPriority",      "uint8"},
{406,      34,      "StopDrvSeatMovingStruct",      "SequenceID",      "uint16"},
{407,      34,      "StopDrvSeatMovingStruct",      "ServiceExecuteFeedbackFlag",      "uint8"},
{408,      34,      "StopDrvSeatMovingStruct",      "Options",      "uint32"},
{409,      34,      "StopDrvSeatMovingStruct",      "DrvSeatStopMovingCmd",      "uint8"},
{410,      34,      "StopDrvSeatMovingRespStruct",      "RespCode",      "uint32"},
{411,      34,      "StopDrvSeatMovingRespStruct",      "StopDrvSeatMovingNRC",      "uint32"},
{412,      35,      "SetDrvSeatEasyEntryStruct",      "SOAProtocolVersion",      "uint8"},
{413,      35,      "SetDrvSeatEasyEntryStruct",      "SOAHeaderType",      "uint8"},
{414,      35,      "SetDrvSeatEasyEntryStruct",      "SOAHeaderLength",      "uint16"},
{415,      35,      "SetDrvSeatEasyEntryStruct",      "Flag",      "uint16"},
{416,      35,      "SetDrvSeatEasyEntryStruct",      "HeaderCRC16",      "uint16"},
{417,      35,      "SetDrvSeatEasyEntryStruct",      "UserID",      "uint32"},
{418,      35,      "SetDrvSeatEasyEntryStruct",      "ReqTimeOut",      "uint32"},
{419,      35,      "SetDrvSeatEasyEntryStruct",      "RequestPriority",      "uint8"},
{420,      35,      "SetDrvSeatEasyEntryStruct",      "SequenceID",      "uint16"},
{421,      35,      "SetDrvSeatEasyEntryStruct",      "ServiceExecuteFeedbackFlag",      "uint8"},
{422,      35,      "SetDrvSeatEasyEntryStruct",      "Options",      "uint32"},
{423,      35,      "SetDrvSeatEasyEntryStruct",      "DrvSeatEasyEntryCfgReq",      "uint8"},
{424,      35,      "SetDrvSeatEasyEntryRespStruct",      "RespCode",      "uint32"},
{425,      35,      "SetDrvSeatEasyEntryRespStruct",      "SetDrvSeatEasyEntryNRC",      "uint32"},
{426,      36,      "SetDrvSeatHeatingStruct",      "SOAProtocolVersion",      "uint8"},
{427,      36,      "SetDrvSeatHeatingStruct",      "SOAHeaderType",      "uint8"},
{428,      36,      "SetDrvSeatHeatingStruct",      "SOAHeaderLength",      "uint16"},
{429,      36,      "SetDrvSeatHeatingStruct",      "Flag",      "uint16"},
{430,      36,      "SetDrvSeatHeatingStruct",      "HeaderCRC16",      "uint16"},
{431,      36,      "SetDrvSeatHeatingStruct",      "UserID",      "uint32"},
{432,      36,      "SetDrvSeatHeatingStruct",      "ReqTimeOut",      "uint32"},
{433,      36,      "SetDrvSeatHeatingStruct",      "RequestPriority",      "uint8"},
{434,      36,      "SetDrvSeatHeatingStruct",      "SequenceID",      "uint16"},
{435,      36,      "SetDrvSeatHeatingStruct",      "ServiceExecuteFeedbackFlag",      "uint8"},
{436,      36,      "SetDrvSeatHeatingStruct",      "Options",      "uint32"},
{437,      36,      "SetDrvSeatHeatingStruct",      "DrvSeatHeatingReq",      "uint8"},
{438,      36,      "SetDrvSeatHeatingRespStruct",      "RespCode",      "uint32"},
{439,      36,      "SetDrvSeatHeatingRespStruct",      "SetDrvSeatHeatingNRC",      "uint32"},
{440,      37,      "SetDrvSeatVentilationStruct",      "SOAProtocolVersion",      "uint8"},
{441,      37,      "SetDrvSeatVentilationStruct",      "SOAHeaderType",      "uint8"},
{442,      37,      "SetDrvSeatVentilationStruct",      "SOAHeaderLength",      "uint16"},
{443,      37,      "SetDrvSeatVentilationStruct",      "Flag",      "uint16"},
{444,      37,      "SetDrvSeatVentilationStruct",      "HeaderCRC16",      "uint16"},
{445,      37,      "SetDrvSeatVentilationStruct",      "UserID",      "uint32"},
{446,      37,      "SetDrvSeatVentilationStruct",      "ReqTimeOut",      "uint32"},
{447,      37,      "SetDrvSeatVentilationStruct",      "RequestPriority",      "uint8"},
{448,      37,      "SetDrvSeatVentilationStruct",      "SequenceID",      "uint16"},
{449,      37,      "SetDrvSeatVentilationStruct",      "ServiceExecuteFeedbackFlag",      "uint8"},
{450,      37,      "SetDrvSeatVentilationStruct",      "Options",      "uint32"},
{451,      37,      "SetDrvSeatVentilationStruct",      "DrvSeatVentilationReq",      "uint8"},
{452,      37,      "SetDrvSeatVentilationRespStruct",      "RespCode",      "uint32"},
{453,      37,      "SetDrvSeatVentilationRespStruct",      "SetDrvSeatVentilationNRC",      "uint32"},
{454,      38,      "DrvSeatSplModCtrlStruct",      "SOAProtocolVersion",      "uint8"},
{455,      38,      "DrvSeatSplModCtrlStruct",      "SOAHeaderType",      "uint8"},
{456,      38,      "DrvSeatSplModCtrlStruct",      "SOAHeaderLength",      "uint16"},
{457,      38,      "DrvSeatSplModCtrlStruct",      "Flag",      "uint16"},
{458,      38,      "DrvSeatSplModCtrlStruct",      "HeaderCRC16",      "uint16"},
{459,      38,      "DrvSeatSplModCtrlStruct",      "UserID",      "uint32"},
{460,      38,      "DrvSeatSplModCtrlStruct",      "ReqTimeOut",      "uint32"},
{461,      38,      "DrvSeatSplModCtrlStruct",      "RequestPriority",      "uint8"},
{462,      38,      "DrvSeatSplModCtrlStruct",      "SequenceID",      "uint16"},
{463,      38,      "DrvSeatSplModCtrlStruct",      "ServiceExecuteFeedbackFlag",      "uint8"},
{464,      38,      "DrvSeatSplModCtrlStruct",      "Options",      "uint32"},
{465,      38,      "DrvSeatSplModCtrlStruct",      "DrvSeatSplModReq",      "uint8"},
{466,      38,      "DrvSeatSplModCtrlRespStruct",      "RespCode",      "uint32"},
{467,      38,      "DrvSeatSplModCtrlRespStruct",      "DrvSeatSplModCtrlNRC",      "uint32"},
{468,      39,      "RecallDrvSeatHorzPstStruct",      "SOAProtocolVersion",      "uint8"},
{469,      39,      "RecallDrvSeatHorzPstStruct",      "SOAHeaderType",      "uint8"},
{470,      39,      "RecallDrvSeatHorzPstStruct",      "SOAHeaderLength",      "uint16"},
{471,      39,      "RecallDrvSeatHorzPstStruct",      "Flag",      "uint16"},
{472,      39,      "RecallDrvSeatHorzPstStruct",      "HeaderCRC16",      "uint16"},
{473,      39,      "RecallDrvSeatHorzPstStruct",      "UserID",      "uint32"},
{474,      39,      "RecallDrvSeatHorzPstStruct",      "ReqTimeOut",      "uint32"},
{475,      39,      "RecallDrvSeatHorzPstStruct",      "RequestPriority",      "uint8"},
{476,      39,      "RecallDrvSeatHorzPstStruct",      "SequenceID",      "uint16"},
{477,      39,      "RecallDrvSeatHorzPstStruct",      "ServiceExecuteFeedbackFlag",      "uint8"},
{478,      39,      "RecallDrvSeatHorzPstStruct",      "Options",      "uint32"},
{479,      39,      "RecallDrvSeatHorzPstStruct",      "DrvSeatHorzTrgtPst",      "uint8"},
{480,      39,      "RecallDrvSeatHorzPstRespStruct",      "RespCode",      "uint32"},
{481,      39,      "RecallDrvSeatHorzPstRespStruct",      "RecallDrvSeatHorzPstNRC",      "uint32"},
{482,      40,      "RecallDrvSeatVertPstStruct",      "SOAProtocolVersion",      "uint8"},
{483,      40,      "RecallDrvSeatVertPstStruct",      "SOAHeaderType",      "uint8"},
{484,      40,      "RecallDrvSeatVertPstStruct",      "SOAHeaderLength",      "uint16"},
{485,      40,      "RecallDrvSeatVertPstStruct",      "Flag",      "uint16"},
{486,      40,      "RecallDrvSeatVertPstStruct",      "HeaderCRC16",      "uint16"},
{487,      40,      "RecallDrvSeatVertPstStruct",      "UserID",      "uint32"},
{488,      40,      "RecallDrvSeatVertPstStruct",      "ReqTimeOut",      "uint32"},
{489,      40,      "RecallDrvSeatVertPstStruct",      "RequestPriority",      "uint8"},
{490,      40,      "RecallDrvSeatVertPstStruct",      "SequenceID",      "uint16"},
{491,      40,      "RecallDrvSeatVertPstStruct",      "ServiceExecuteFeedbackFlag",      "uint8"},
{492,      40,      "RecallDrvSeatVertPstStruct",      "Options",      "uint32"},
{493,      40,      "RecallDrvSeatVertPstStruct",      "DrvSeatVertTrgtPst",      "uint8"},
{494,      40,      "RecallDrvSeatVertPstRespStruct",      "RespCode",      "uint32"},
{495,      40,      "RecallDrvSeatVertPstRespStruct",      "RecallDrvSeatVertPstNRC",      "uint32"},
{496,      41,      "RecallDrvSeatTiltPstStruct",      "SOAProtocolVersion",      "uint8"},
{497,      41,      "RecallDrvSeatTiltPstStruct",      "SOAHeaderType",      "uint8"},
{498,      41,      "RecallDrvSeatTiltPstStruct",      "SOAHeaderLength",      "uint16"},
{499,      41,      "RecallDrvSeatTiltPstStruct",      "Flag",      "uint16"},
{500,      41,      "RecallDrvSeatTiltPstStruct",      "HeaderCRC16",      "uint16"},
{501,      41,      "RecallDrvSeatTiltPstStruct",      "UserID",      "uint32"},
{502,      41,      "RecallDrvSeatTiltPstStruct",      "ReqTimeOut",      "uint32"},
{503,      41,      "RecallDrvSeatTiltPstStruct",      "RequestPriority",      "uint8"},
{504,      41,      "RecallDrvSeatTiltPstStruct",      "SequenceID",      "uint16"},
{505,      41,      "RecallDrvSeatTiltPstStruct",      "ServiceExecuteFeedbackFlag",      "uint8"},
{506,      41,      "RecallDrvSeatTiltPstStruct",      "Options",      "uint32"},
{507,      41,      "RecallDrvSeatTiltPstStruct",      "DrvSeatTiltTrgtPst",      "uint8"},
{508,      41,      "RecallDrvSeatTiltPstRespStruct",      "RespCode",      "uint32"},
{509,      41,      "RecallDrvSeatTiltPstRespStruct",      "RecallDrvSeatTiltPstNRC",      "uint32"},
{510,      42,      "RecallDrvSeatCushExtPstStruct",      "SOAProtocolVersion",      "uint8"},
{511,      42,      "RecallDrvSeatCushExtPstStruct",      "SOAHeaderType",      "uint8"},
{512,      42,      "RecallDrvSeatCushExtPstStruct",      "SOAHeaderLength",      "uint16"},
{513,      42,      "RecallDrvSeatCushExtPstStruct",      "Flag",      "uint16"},
{514,      42,      "RecallDrvSeatCushExtPstStruct",      "HeaderCRC16",      "uint16"},
{515,      42,      "RecallDrvSeatCushExtPstStruct",      "UserID",      "uint32"},
{516,      42,      "RecallDrvSeatCushExtPstStruct",      "ReqTimeOut",      "uint32"},
{517,      42,      "RecallDrvSeatCushExtPstStruct",      "RequestPriority",      "uint8"},
{518,      42,      "RecallDrvSeatCushExtPstStruct",      "SequenceID",      "uint16"},
{519,      42,      "RecallDrvSeatCushExtPstStruct",      "ServiceExecuteFeedbackFlag",      "uint8"},
{520,      42,      "RecallDrvSeatCushExtPstStruct",      "Options",      "uint32"},
{521,      42,      "RecallDrvSeatCushExtPstStruct",      "DrvSeatCushExtTrgtPst",      "uint8"},
{522,      42,      "RecallDrvSeatCushExtPstRespStruct",      "RespCode",      "uint32"},
{523,      42,      "RecallDrvSeatCushExtPstRespStruct",      "RecallDrvSeatCushExtPstNRC",      "uint32"},
{524,      43,      "RecallDrvSeatCushTiltPstStruct",      "SOAProtocolVersion",      "uint8"},
{525,      43,      "RecallDrvSeatCushTiltPstStruct",      "SOAHeaderType",      "uint8"},
{526,      43,      "RecallDrvSeatCushTiltPstStruct",      "SOAHeaderLength",      "uint16"},
{527,      43,      "RecallDrvSeatCushTiltPstStruct",      "Flag",      "uint16"},
{528,      43,      "RecallDrvSeatCushTiltPstStruct",      "HeaderCRC16",      "uint16"},
{529,      43,      "RecallDrvSeatCushTiltPstStruct",      "UserID",      "uint32"},
{530,      43,      "RecallDrvSeatCushTiltPstStruct",      "ReqTimeOut",      "uint32"},
{531,      43,      "RecallDrvSeatCushTiltPstStruct",      "RequestPriority",      "uint8"},
{532,      43,      "RecallDrvSeatCushTiltPstStruct",      "SequenceID",      "uint16"},
{533,      43,      "RecallDrvSeatCushTiltPstStruct",      "ServiceExecuteFeedbackFlag",      "uint8"},
{534,      43,      "RecallDrvSeatCushTiltPstStruct",      "Options",      "uint32"},
{535,      43,      "RecallDrvSeatCushTiltPstStruct",      "DrvSeatCushTiltTrgtPst",      "uint8"},
{536,      43,      "RecallDrvSeatCushTiltPstRespStruct",      "RespCode",      "uint32"},
{537,      43,      "RecallDrvSeatCushTiltPstRespStruct",      "RecallDrvSeatCushTiltPstNRC",      "uint32"},
{538,      44,      "PsngrSeatCtrlService_ErrStruct",      "SequenceID",      "uint16"},
{539,      44,      "PsngrSeatCtrlService_ErrStruct",      "Options_8bit",      "uint8"},
{540,      44,      "PsngrSeatCtrlService_ErrStruct",      "Options_8bit2",      "uint8"},
{541,      44,      "PsngrSeatCtrlService_ErrStruct",      "UserID",      "uint32"},
{542,      44,      "PsngrSeatCtrlService_ErrStruct",      "OpeNRC",      "uint32"},
{543,      44,      "PsngrSeatCtrlService_ErrStruct",      "OpeErrInfo",      "string[16]"},
{544,      45,      "PsngrSeatPstStruct",      "PsngrSeatHorzPos",      "uint8"},
{545,      45,      "PsngrSeatPstStruct",      "PsngrSeatVerticalPos",      "uint8"},
{546,      45,      "PsngrSeatPstStruct",      "PsngrSeatTiltingPos",      "uint8"},
{547,      45,      "PsngrSeatPstStruct",      "PsngrSeatLeSuHeigPos",      "uint8"},
{548,      45,      "PsngrSeatPstStruct",      "PsngrSeatLeSuLengPos",      "uint8"},
{549,      45,      "PsngrSeatPstStruct",      "PsngrSeatZeroGravPos",      "uint8"},
{550,      45,      "PsngrSeatPstStruct",      "PsngrSeatCushTiltPos",      "uint8"},
{551,      46,      "PsngrSeatFuncStStruct",      "PsngrSeatEasyEntrySt",      "uint8"},
{552,      46,      "PsngrSeatFuncStStruct",      "PsngrSeatEasyEntryCfgSt",      "uint8"},
{553,      46,      "PsngrSeatFuncStStruct",      "PsngrSeatAutoAdjEnableSt",      "uint8"},
{554,      46,      "PsngrSeatFuncStStruct",      "PsngrSeatAdjMoveSt",      "uint8"},
{555,      46,      "PsngrSeatFuncStStruct",      "PsngrSeatHeatSt",      "uint8"},
{556,      46,      "PsngrSeatFuncStStruct",      "PsngrSeatVentilationSt",      "uint8"},
{557,      46,      "PsngrSeatFuncStStruct",      "PsngrSeatDenormalizeSt",      "uint8"},
{558,      46,      "PsngrSeatFuncStStruct",      "PsngrSeatSplModSts",      "uint8"},
{559,      46,      "PsngrSeatFuncStStruct",      "PsngrSeatMassgSwSts",      "uint8"},
{560,      46,      "PsngrSeatFuncStStruct",      "PsngrSeatZeroGravEnterSwSts",      "uint8"},
{561,      46,      "PsngrSeatFuncStStruct",      "PsngrSeatZeroGravRcvSwSts",      "uint8"},
{562,      46,      "PsngrSeatFuncStStruct",      "PsngrSeatPosSts",      "uint8"},
{563,      47,      "RecallPsngrSeatPstStruct",      "SOAProtocolVersion",      "uint8"},
{564,      47,      "RecallPsngrSeatPstStruct",      "SOAHeaderType",      "uint8"},
{565,      47,      "RecallPsngrSeatPstStruct",      "SOAHeaderLength",      "uint16"},
{566,      47,      "RecallPsngrSeatPstStruct",      "Flag",      "uint16"},
{567,      47,      "RecallPsngrSeatPstStruct",      "HeaderCRC16",      "uint16"},
{568,      47,      "RecallPsngrSeatPstStruct",      "UserID",      "uint32"},
{569,      47,      "RecallPsngrSeatPstStruct",      "ReqTimeOut",      "uint32"},
{570,      47,      "RecallPsngrSeatPstStruct",      "RequestPriority",      "uint8"},
{571,      47,      "RecallPsngrSeatPstStruct",      "SequenceID",      "uint16"},
{572,      47,      "RecallPsngrSeatPstStruct",      "ServiceExecuteFeedbackFlag",      "uint8"},
{573,      47,      "RecallPsngrSeatPstStruct",      "Options",      "uint32"},
{574,      47,      "RecallPsngrSeatPstStruct",      "PsngrSeatHorzTrgtPst",      "uint8"},
{575,      47,      "RecallPsngrSeatPstStruct",      "PsngrSeatVertTrgtPst",      "uint8"},
{576,      47,      "RecallPsngrSeatPstStruct",      "PsngrSeatTiltTrgtPst",      "uint8"},
{577,      47,      "RecallPsngrSeatPstStruct",      "PsngrSeatLeSuHeigTrgtPst",      "uint8"},
{578,      47,      "RecallPsngrSeatPstStruct",      "PsngrSeatLeSuLengTrgtPst",      "uint8"},
{579,      47,      "RecallPsngrSeatPstStruct",      "PsngrSeatZeroGravPos",      "uint8"},
{580,      47,      "RecallPsngrSeatPstStruct",      "PsngrSeatCushTiltTrgtPst",      "uint8"},
{581,      47,      "RecallPsngrSeatPstRespStruct",      "RespCode",      "uint32"},
{582,      47,      "RecallPsngrSeatPstRespStruct",      "RecallPsngrSeatPstNRC",      "uint32"},
{583,      48,      "SyncPsngrSeatPstStruct",      "SOAProtocolVersion",      "uint8"},
{584,      48,      "SyncPsngrSeatPstStruct",      "SOAHeaderType",      "uint8"},
{585,      48,      "SyncPsngrSeatPstStruct",      "SOAHeaderLength",      "uint16"},
{586,      48,      "SyncPsngrSeatPstStruct",      "Flag",      "uint16"},
{587,      48,      "SyncPsngrSeatPstStruct",      "HeaderCRC16",      "uint16"},
{588,      48,      "SyncPsngrSeatPstStruct",      "UserID",      "uint32"},
{589,      48,      "SyncPsngrSeatPstStruct",      "ReqTimeOut",      "uint32"},
{590,      48,      "SyncPsngrSeatPstStruct",      "RequestPriority",      "uint8"},
{591,      48,      "SyncPsngrSeatPstStruct",      "SequenceID",      "uint16"},
{592,      48,      "SyncPsngrSeatPstStruct",      "ServiceExecuteFeedbackFlag",      "uint8"},
{593,      48,      "SyncPsngrSeatPstStruct",      "Options",      "uint32"},
{594,      48,      "SyncPsngrSeatPstStruct",      "PsngrSeatHorzTrgtPst",      "uint8"},
{595,      48,      "SyncPsngrSeatPstStruct",      "PsngrSeatVertTrgtPst",      "uint8"},
{596,      48,      "SyncPsngrSeatPstStruct",      "PsngrSeatTiltTrgtPst",      "uint8"},
{597,      48,      "SyncPsngrSeatPstStruct",      "PsngrSeatLeSuHeigTrgtPst",      "uint8"},
{598,      48,      "SyncPsngrSeatPstStruct",      "PsngrSeatLeSuLengTrgtPst",      "uint8"},
{599,      48,      "SyncPsngrSeatPstStruct",      "PsngrSeatZeroGravPos",      "uint8"},
{600,      48,      "SyncPsngrSeatPstStruct",      "PsngrSeatCushTiltTrgtPst",      "uint8"},
{601,      48,      "SyncPsngrSeatPstRespStruct",      "RespCode",      "uint32"},
{602,      48,      "SyncPsngrSeatPstRespStruct",      "SyncPsngrSeatPstNRC",      "uint32"},
{603,      49,      "StopPsngrSeatMovingStruct",      "SOAProtocolVersion",      "uint8"},
{604,      49,      "StopPsngrSeatMovingStruct",      "SOAHeaderType",      "uint8"},
{605,      49,      "StopPsngrSeatMovingStruct",      "SOAHeaderLength",      "uint16"},
{606,      49,      "StopPsngrSeatMovingStruct",      "Flag",      "uint16"},
{607,      49,      "StopPsngrSeatMovingStruct",      "HeaderCRC16",      "uint16"},
{608,      49,      "StopPsngrSeatMovingStruct",      "UserID",      "uint32"},
{609,      49,      "StopPsngrSeatMovingStruct",      "ReqTimeOut",      "uint32"},
{610,      49,      "StopPsngrSeatMovingStruct",      "RequestPriority",      "uint8"},
{611,      49,      "StopPsngrSeatMovingStruct",      "SequenceID",      "uint16"},
{612,      49,      "StopPsngrSeatMovingStruct",      "ServiceExecuteFeedbackFlag",      "uint8"},
{613,      49,      "StopPsngrSeatMovingStruct",      "Options",      "uint32"},
{614,      49,      "StopPsngrSeatMovingStruct",      "PsngrSeatStopMovingCmd",      "uint8"},
{615,      49,      "StopPsngrSeatMovingRespStruct",      "RespCode",      "uint32"},
{616,      49,      "StopPsngrSeatMovingRespStruct",      "StopPsngrSeatMovingNRC",      "uint32"},
{617,      50,      "SetPsngrSeatEasyEntryStruct",      "SOAProtocolVersion",      "uint8"},
{618,      50,      "SetPsngrSeatEasyEntryStruct",      "SOAHeaderType",      "uint8"},
{619,      50,      "SetPsngrSeatEasyEntryStruct",      "SOAHeaderLength",      "uint16"},
{620,      50,      "SetPsngrSeatEasyEntryStruct",      "Flag",      "uint16"},
{621,      50,      "SetPsngrSeatEasyEntryStruct",      "HeaderCRC16",      "uint16"},
{622,      50,      "SetPsngrSeatEasyEntryStruct",      "UserID",      "uint32"},
{623,      50,      "SetPsngrSeatEasyEntryStruct",      "ReqTimeOut",      "uint32"},
{624,      50,      "SetPsngrSeatEasyEntryStruct",      "RequestPriority",      "uint8"},
{625,      50,      "SetPsngrSeatEasyEntryStruct",      "SequenceID",      "uint16"},
{626,      50,      "SetPsngrSeatEasyEntryStruct",      "ServiceExecuteFeedbackFlag",      "uint8"},
{627,      50,      "SetPsngrSeatEasyEntryStruct",      "Options",      "uint32"},
{628,      50,      "SetPsngrSeatEasyEntryStruct",      "PsngrSeatEasyEntryCfgReq",      "uint8"},
{629,      50,      "SetPsngrSeatEasyEntryRespStruct",      "RespCode",      "uint32"},
{630,      50,      "SetPsngrSeatEasyEntryRespStruct",      "SetPsngrSeatEasyEntryNRC",      "uint32"},
{631,      51,      "SetPsngrSeatHeatingStruct",      "SOAProtocolVersion",      "uint8"},
{632,      51,      "SetPsngrSeatHeatingStruct",      "SOAHeaderType",      "uint8"},
{633,      51,      "SetPsngrSeatHeatingStruct",      "SOAHeaderLength",      "uint16"},
{634,      51,      "SetPsngrSeatHeatingStruct",      "Flag",      "uint16"},
{635,      51,      "SetPsngrSeatHeatingStruct",      "HeaderCRC16",      "uint16"},
{636,      51,      "SetPsngrSeatHeatingStruct",      "UserID",      "uint32"},
{637,      51,      "SetPsngrSeatHeatingStruct",      "ReqTimeOut",      "uint32"},
{638,      51,      "SetPsngrSeatHeatingStruct",      "RequestPriority",      "uint8"},
{639,      51,      "SetPsngrSeatHeatingStruct",      "SequenceID",      "uint16"},
{640,      51,      "SetPsngrSeatHeatingStruct",      "ServiceExecuteFeedbackFlag",      "uint8"},
{641,      51,      "SetPsngrSeatHeatingStruct",      "Options",      "uint32"},
{642,      51,      "SetPsngrSeatHeatingStruct",      "PsngrSeatHeatingReq",      "uint8"},
{643,      51,      "SetPsngrSeatHeatingRespStruct",      "RespCode",      "uint32"},
{644,      51,      "SetPsngrSeatHeatingRespStruct",      "SetPsngrSeatHeatingNRC",      "uint32"},
{645,      52,      "SetPsngrSeatVentilationStruct",      "SOAProtocolVersion",      "uint8"},
{646,      52,      "SetPsngrSeatVentilationStruct",      "SOAHeaderType",      "uint8"},
{647,      52,      "SetPsngrSeatVentilationStruct",      "SOAHeaderLength",      "uint16"},
{648,      52,      "SetPsngrSeatVentilationStruct",      "Flag",      "uint16"},
{649,      52,      "SetPsngrSeatVentilationStruct",      "HeaderCRC16",      "uint16"},
{650,      52,      "SetPsngrSeatVentilationStruct",      "UserID",      "uint32"},
{651,      52,      "SetPsngrSeatVentilationStruct",      "ReqTimeOut",      "uint32"},
{652,      52,      "SetPsngrSeatVentilationStruct",      "RequestPriority",      "uint8"},
{653,      52,      "SetPsngrSeatVentilationStruct",      "SequenceID",      "uint16"},
{654,      52,      "SetPsngrSeatVentilationStruct",      "ServiceExecuteFeedbackFlag",      "uint8"},
{655,      52,      "SetPsngrSeatVentilationStruct",      "Options",      "uint32"},
{656,      52,      "SetPsngrSeatVentilationStruct",      "PsngrSeatVentilationReq",      "uint8"},
{657,      52,      "SetPsngrSeatVentilationRespStruct",      "RespCode",      "uint32"},
{658,      52,      "SetPsngrSeatVentilationRespStruct",      "SetPsngrSeatVentilationNRC",      "uint32"},
{659,      53,      "PsngrSeatSplModCtrlStruct",      "SOAProtocolVersion",      "uint8"},
{660,      53,      "PsngrSeatSplModCtrlStruct",      "SOAHeaderType",      "uint8"},
{661,      53,      "PsngrSeatSplModCtrlStruct",      "SOAHeaderLength",      "uint16"},
{662,      53,      "PsngrSeatSplModCtrlStruct",      "Flag",      "uint16"},
{663,      53,      "PsngrSeatSplModCtrlStruct",      "HeaderCRC16",      "uint16"},
{664,      53,      "PsngrSeatSplModCtrlStruct",      "UserID",      "uint32"},
{665,      53,      "PsngrSeatSplModCtrlStruct",      "ReqTimeOut",      "uint32"},
{666,      53,      "PsngrSeatSplModCtrlStruct",      "RequestPriority",      "uint8"},
{667,      53,      "PsngrSeatSplModCtrlStruct",      "SequenceID",      "uint16"},
{668,      53,      "PsngrSeatSplModCtrlStruct",      "ServiceExecuteFeedbackFlag",      "uint8"},
{669,      53,      "PsngrSeatSplModCtrlStruct",      "Options",      "uint32"},
{670,      53,      "PsngrSeatSplModCtrlStruct",      "PsngrSeatSplModReq",      "uint8"},
{671,      53,      "PsngrSeatSplModCtrlRespStruct",      "RespCode",      "uint32"},
{672,      53,      "PsngrSeatSplModCtrlRespStruct",      "PsngrSeatSplModCtrlNRC",      "uint32"},
{673,      54,      "RecallPsngrSeatHorzPstStruct",      "SOAProtocolVersion",      "uint8"},
{674,      54,      "RecallPsngrSeatHorzPstStruct",      "SOAHeaderType",      "uint8"},
{675,      54,      "RecallPsngrSeatHorzPstStruct",      "SOAHeaderLength",      "uint16"},
{676,      54,      "RecallPsngrSeatHorzPstStruct",      "Flag",      "uint16"},
{677,      54,      "RecallPsngrSeatHorzPstStruct",      "HeaderCRC16",      "uint16"},
{678,      54,      "RecallPsngrSeatHorzPstStruct",      "UserID",      "uint32"},
{679,      54,      "RecallPsngrSeatHorzPstStruct",      "ReqTimeOut",      "uint32"},
{680,      54,      "RecallPsngrSeatHorzPstStruct",      "RequestPriority",      "uint8"},
{681,      54,      "RecallPsngrSeatHorzPstStruct",      "SequenceID",      "uint16"},
{682,      54,      "RecallPsngrSeatHorzPstStruct",      "ServiceExecuteFeedbackFlag",      "uint8"},
{683,      54,      "RecallPsngrSeatHorzPstStruct",      "Options",      "uint32"},
{684,      54,      "RecallPsngrSeatHorzPstStruct",      "PsngrSeatHorzTrgtPst",      "uint8"},
{685,      54,      "RecallPsngrSeatHorzPstRespStruct",      "RespCode",      "uint32"},
{686,      54,      "RecallPsngrSeatHorzPstRespStruct",      "RecallPsngrSeatHorzPstNRC",      "uint32"},
{687,      55,      "RecallPsngrSeatVertPstStruct",      "SOAProtocolVersion",      "uint8"},
{688,      55,      "RecallPsngrSeatVertPstStruct",      "SOAHeaderType",      "uint8"},
{689,      55,      "RecallPsngrSeatVertPstStruct",      "SOAHeaderLength",      "uint16"},
{690,      55,      "RecallPsngrSeatVertPstStruct",      "Flag",      "uint16"},
{691,      55,      "RecallPsngrSeatVertPstStruct",      "HeaderCRC16",      "uint16"},
{692,      55,      "RecallPsngrSeatVertPstStruct",      "UserID",      "uint32"},
{693,      55,      "RecallPsngrSeatVertPstStruct",      "ReqTimeOut",      "uint32"},
{694,      55,      "RecallPsngrSeatVertPstStruct",      "RequestPriority",      "uint8"},
{695,      55,      "RecallPsngrSeatVertPstStruct",      "SequenceID",      "uint16"},
{696,      55,      "RecallPsngrSeatVertPstStruct",      "ServiceExecuteFeedbackFlag",      "uint8"},
{697,      55,      "RecallPsngrSeatVertPstStruct",      "Options",      "uint32"},
{698,      55,      "RecallPsngrSeatVertPstStruct",      "PsngrSeatVertTrgtPst",      "uint8"},
{699,      55,      "RecallPsngrSeatVertPstRespStruct",      "RespCode",      "uint32"},
{700,      55,      "RecallPsngrSeatVertPstRespStruct",      "RecallPsngrSeatVertPstNRC",      "uint32"},
{701,      56,      "RecallPsngrSeatTiltPstStruct",      "SOAProtocolVersion",      "uint8"},
{702,      56,      "RecallPsngrSeatTiltPstStruct",      "SOAHeaderType",      "uint8"},
{703,      56,      "RecallPsngrSeatTiltPstStruct",      "SOAHeaderLength",      "uint16"},
{704,      56,      "RecallPsngrSeatTiltPstStruct",      "Flag",      "uint16"},
{705,      56,      "RecallPsngrSeatTiltPstStruct",      "HeaderCRC16",      "uint16"},
{706,      56,      "RecallPsngrSeatTiltPstStruct",      "UserID",      "uint32"},
{707,      56,      "RecallPsngrSeatTiltPstStruct",      "ReqTimeOut",      "uint32"},
{708,      56,      "RecallPsngrSeatTiltPstStruct",      "RequestPriority",      "uint8"},
{709,      56,      "RecallPsngrSeatTiltPstStruct",      "SequenceID",      "uint16"},
{710,      56,      "RecallPsngrSeatTiltPstStruct",      "ServiceExecuteFeedbackFlag",      "uint8"},
{711,      56,      "RecallPsngrSeatTiltPstStruct",      "Options",      "uint32"},
{712,      56,      "RecallPsngrSeatTiltPstStruct",      "PsngrSeatTiltTrgtPst",      "uint8"},
{713,      56,      "RecallPsngrSeatTiltPstRespStruct",      "RespCode",      "uint32"},
{714,      56,      "RecallPsngrSeatTiltPstRespStruct",      "RecallPsngrSeatTiltPstNRC",      "uint32"},
{715,      57,      "RecallPsngrSeatLeSuHeigPstStruct",      "SOAProtocolVersion",      "uint8"},
{716,      57,      "RecallPsngrSeatLeSuHeigPstStruct",      "SOAHeaderType",      "uint8"},
{717,      57,      "RecallPsngrSeatLeSuHeigPstStruct",      "SOAHeaderLength",      "uint16"},
{718,      57,      "RecallPsngrSeatLeSuHeigPstStruct",      "Flag",      "uint16"},
{719,      57,      "RecallPsngrSeatLeSuHeigPstStruct",      "HeaderCRC16",      "uint16"},
{720,      57,      "RecallPsngrSeatLeSuHeigPstStruct",      "UserID",      "uint32"},
{721,      57,      "RecallPsngrSeatLeSuHeigPstStruct",      "ReqTimeOut",      "uint32"},
{722,      57,      "RecallPsngrSeatLeSuHeigPstStruct",      "RequestPriority",      "uint8"},
{723,      57,      "RecallPsngrSeatLeSuHeigPstStruct",      "SequenceID",      "uint16"},
{724,      57,      "RecallPsngrSeatLeSuHeigPstStruct",      "ServiceExecuteFeedbackFlag",      "uint8"},
{725,      57,      "RecallPsngrSeatLeSuHeigPstStruct",      "Options",      "uint32"},
{726,      57,      "RecallPsngrSeatLeSuHeigPstStruct",      "PsngrSeatLeSuHeigTrgtPst",      "uint8"},
{727,      57,      "RecallPsngrSeatLeSuHeigPstRespStruct",      "RespCode",      "uint32"},
{728,      57,      "RecallPsngrSeatLeSuHeigPstRespStruct",      "RecallPsngrSeatLeSuHeigPstNRC",      "uint32"},
{729,      58,      "RecallPsngrSeatLeSuLengPstStruct",      "SOAProtocolVersion",      "uint8"},
{730,      58,      "RecallPsngrSeatLeSuLengPstStruct",      "SOAHeaderType",      "uint8"},
{731,      58,      "RecallPsngrSeatLeSuLengPstStruct",      "SOAHeaderLength",      "uint16"},
{732,      58,      "RecallPsngrSeatLeSuLengPstStruct",      "Flag",      "uint16"},
{733,      58,      "RecallPsngrSeatLeSuLengPstStruct",      "HeaderCRC16",      "uint16"},
{734,      58,      "RecallPsngrSeatLeSuLengPstStruct",      "UserID",      "uint32"},
{735,      58,      "RecallPsngrSeatLeSuLengPstStruct",      "ReqTimeOut",      "uint32"},
{736,      58,      "RecallPsngrSeatLeSuLengPstStruct",      "RequestPriority",      "uint8"},
{737,      58,      "RecallPsngrSeatLeSuLengPstStruct",      "SequenceID",      "uint16"},
{738,      58,      "RecallPsngrSeatLeSuLengPstStruct",      "ServiceExecuteFeedbackFlag",      "uint8"},
{739,      58,      "RecallPsngrSeatLeSuLengPstStruct",      "Options",      "uint32"},
{740,      58,      "RecallPsngrSeatLeSuLengPstStruct",      "PsngrSeatLeSuLengTrgtPst",      "uint8"},
{741,      58,      "RecallPsngrSeatLeSuLengPstRespStruct",      "RespCode",      "uint32"},
{742,      58,      "RecallPsngrSeatLeSuLengPstRespStruct",      "RecallPsngrSeatLeSuLengPstNRC",      "uint32"},
{743,      59,      "RecallPsngrSeatZeroGravPstStruct",      "SOAProtocolVersion",      "uint8"},
{744,      59,      "RecallPsngrSeatZeroGravPstStruct",      "SOAHeaderType",      "uint8"},
{745,      59,      "RecallPsngrSeatZeroGravPstStruct",      "SOAHeaderLength",      "uint16"},
{746,      59,      "RecallPsngrSeatZeroGravPstStruct",      "Flag",      "uint16"},
{747,      59,      "RecallPsngrSeatZeroGravPstStruct",      "HeaderCRC16",      "uint16"},
{748,      59,      "RecallPsngrSeatZeroGravPstStruct",      "UserID",      "uint32"},
{749,      59,      "RecallPsngrSeatZeroGravPstStruct",      "ReqTimeOut",      "uint32"},
{750,      59,      "RecallPsngrSeatZeroGravPstStruct",      "RequestPriority",      "uint8"},
{751,      59,      "RecallPsngrSeatZeroGravPstStruct",      "SequenceID",      "uint16"},
{752,      59,      "RecallPsngrSeatZeroGravPstStruct",      "ServiceExecuteFeedbackFlag",      "uint8"},
{753,      59,      "RecallPsngrSeatZeroGravPstStruct",      "Options",      "uint32"},
{754,      59,      "RecallPsngrSeatZeroGravPstStruct",      "PsngrSeatZeroGravPos",      "uint8"},
{755,      59,      "RecallPsngrSeatZeroGravPstRespStruct",      "RespCode",      "uint32"},
{756,      59,      "RecallPsngrSeatZeroGravPstRespStruct",      "RecallPsngrSeatZeroGravPstNRC",      "uint32"},
{757,      60,      "RecallPsngrSeatCushTiltPstStruct",      "SOAProtocolVersion",      "uint8"},
{758,      60,      "RecallPsngrSeatCushTiltPstStruct",      "SOAHeaderType",      "uint8"},
{759,      60,      "RecallPsngrSeatCushTiltPstStruct",      "SOAHeaderLength",      "uint16"},
{760,      60,      "RecallPsngrSeatCushTiltPstStruct",      "Flag",      "uint16"},
{761,      60,      "RecallPsngrSeatCushTiltPstStruct",      "HeaderCRC16",      "uint16"},
{762,      60,      "RecallPsngrSeatCushTiltPstStruct",      "UserID",      "uint32"},
{763,      60,      "RecallPsngrSeatCushTiltPstStruct",      "ReqTimeOut",      "uint32"},
{764,      60,      "RecallPsngrSeatCushTiltPstStruct",      "RequestPriority",      "uint8"},
{765,      60,      "RecallPsngrSeatCushTiltPstStruct",      "SequenceID",      "uint16"},
{766,      60,      "RecallPsngrSeatCushTiltPstStruct",      "ServiceExecuteFeedbackFlag",      "uint8"},
{767,      60,      "RecallPsngrSeatCushTiltPstStruct",      "Options",      "uint32"},
{768,      60,      "RecallPsngrSeatCushTiltPstStruct",      "PsngrSeatCushTiltTrgtPst",      "uint8"},
{769,      60,      "RecallPsngrSeatCushTiltPstRespStruct",      "RespCode",      "uint32"},
{770,      60,      "RecallPsngrSeatCushTiltPstRespStruct",      "RecallPsngrSeatCushTiltPstNRC",      "uint32"},
{771,      61,      "SecRowLtSeatCtrlService_ErrStruct",      "SequenceID",      "uint16"},
{772,      61,      "SecRowLtSeatCtrlService_ErrStruct",      "Options_8bit",      "uint8"},
{773,      61,      "SecRowLtSeatCtrlService_ErrStruct",      "Options_8bit2",      "uint8"},
{774,      61,      "SecRowLtSeatCtrlService_ErrStruct",      "UserID",      "uint32"},
{775,      61,      "SecRowLtSeatCtrlService_ErrStruct",      "OpeNRC",      "uint32"},
{776,      61,      "SecRowLtSeatCtrlService_ErrStruct",      "OpeErrInfo",      "string[16]"},
{777,      62,      "SecRowLtSeatPstStruct",      "SecRowLtSeatTiltingPos",      "uint8"},
{778,      63,      "SecRowLtSeatFuncStStruct",      "SecRowLtSeatAutoAdjEnableSt",      "uint8"},
{779,      63,      "SecRowLtSeatFuncStStruct",      "SecRowLtSeatMoveSt",      "uint8"},
{780,      63,      "SecRowLtSeatFuncStStruct",      "SecRowLtSeatHeatSt",      "uint8"},
{781,      63,      "SecRowLtSeatFuncStStruct",      "SecRowLtSeatVentilationSt",      "uint8"},
{782,      63,      "SecRowLtSeatFuncStStruct",      "SecRowLtSeatDenormalizeSt",      "uint8"},
{783,      63,      "SecRowLtSeatFuncStStruct",      "SecRowLtSeatEasyEntryCfgSt",      "uint8"},
{784,      63,      "SecRowLtSeatFuncStStruct",      "SecRowLtSeatEasyEntrySt",      "uint8"},
{785,      63,      "SecRowLtSeatFuncStStruct",      "SecRowLtSeatBackUnLockSwSts",      "uint8"},
{786,      63,      "SecRowLtSeatFuncStStruct",      "SecRowLtSeatSeatPosSts",      "uint8"},
{787,      64,      "SetSecRowLtSeatPstStruct",      "SOAProtocolVersion",      "uint8"},
{788,      64,      "SetSecRowLtSeatPstStruct",      "SOAHeaderType",      "uint8"},
{789,      64,      "SetSecRowLtSeatPstStruct",      "SOAHeaderLength",      "uint16"},
{790,      64,      "SetSecRowLtSeatPstStruct",      "Flag",      "uint16"},
{791,      64,      "SetSecRowLtSeatPstStruct",      "HeaderCRC16",      "uint16"},
{792,      64,      "SetSecRowLtSeatPstStruct",      "UserID",      "uint32"},
{793,      64,      "SetSecRowLtSeatPstStruct",      "ReqTimeOut",      "uint32"},
{794,      64,      "SetSecRowLtSeatPstStruct",      "RequestPriority",      "uint8"},
{795,      64,      "SetSecRowLtSeatPstStruct",      "SequenceID",      "uint16"},
{796,      64,      "SetSecRowLtSeatPstStruct",      "ServiceExecuteFeedbackFlag",      "uint8"},
{797,      64,      "SetSecRowLtSeatPstStruct",      "Options",      "uint32"},
{798,      64,      "SetSecRowLtSeatPstStruct",      "SecRowLtSeatTiltTrgtPst",      "uint8"},
{799,      64,      "RecallSecRowLtSeatPstRespStruct",      "RespCode",      "uint32"},
{800,      64,      "RecallSecRowLtSeatPstRespStruct",      "RecallSecRowLtSeatPstNRC",      "uint32"},
{801,      65,      "StopSecRowLtSeatMovingStruct",      "SOAProtocolVersion",      "uint8"},
{802,      65,      "StopSecRowLtSeatMovingStruct",      "SOAHeaderType",      "uint8"},
{803,      65,      "StopSecRowLtSeatMovingStruct",      "SOAHeaderLength",      "uint16"},
{804,      65,      "StopSecRowLtSeatMovingStruct",      "Flag",      "uint16"},
{805,      65,      "StopSecRowLtSeatMovingStruct",      "HeaderCRC16",      "uint16"},
{806,      65,      "StopSecRowLtSeatMovingStruct",      "UserID",      "uint32"},
{807,      65,      "StopSecRowLtSeatMovingStruct",      "ReqTimeOut",      "uint32"},
{808,      65,      "StopSecRowLtSeatMovingStruct",      "RequestPriority",      "uint8"},
{809,      65,      "StopSecRowLtSeatMovingStruct",      "SequenceID",      "uint16"},
{810,      65,      "StopSecRowLtSeatMovingStruct",      "ServiceExecuteFeedbackFlag",      "uint8"},
{811,      65,      "StopSecRowLtSeatMovingStruct",      "Options",      "uint32"},
{812,      65,      "StopSecRowLtSeatMovingStruct",      "SecRowLtSeatStopMovingCmd",      "uint8"},
{813,      65,      "StopSecRowLtSeatMovingRespStruct",      "RespCode",      "uint32"},
{814,      65,      "StopSecRowLtSeatMovingRespStruct",      "StopSecRowLtSeatMovingNRC",      "uint32"},
{815,      66,      "SetSecRowLtSeatHeatingStruct",      "SOAProtocolVersion",      "uint8"},
{816,      66,      "SetSecRowLtSeatHeatingStruct",      "SOAHeaderType",      "uint8"},
{817,      66,      "SetSecRowLtSeatHeatingStruct",      "SOAHeaderLength",      "uint16"},
{818,      66,      "SetSecRowLtSeatHeatingStruct",      "Flag",      "uint16"},
{819,      66,      "SetSecRowLtSeatHeatingStruct",      "HeaderCRC16",      "uint16"},
{820,      66,      "SetSecRowLtSeatHeatingStruct",      "UserID",      "uint32"},
{821,      66,      "SetSecRowLtSeatHeatingStruct",      "ReqTimeOut",      "uint32"},
{822,      66,      "SetSecRowLtSeatHeatingStruct",      "RequestPriority",      "uint8"},
{823,      66,      "SetSecRowLtSeatHeatingStruct",      "SequenceID",      "uint16"},
{824,      66,      "SetSecRowLtSeatHeatingStruct",      "ServiceExecuteFeedbackFlag",      "uint8"},
{825,      66,      "SetSecRowLtSeatHeatingStruct",      "Options",      "uint32"},
{826,      66,      "SetSecRowLtSeatHeatingStruct",      "SecRowLtSeatHeatingReq",      "uint8"},
{827,      66,      "SetSecRowLtSeatHeatingRespStruct",      "RespCode",      "uint32"},
{828,      66,      "SetSecRowLtSeatHeatingRespStruct",      "SetSecRowLtSeatHeatingNRC",      "uint32"},
{829,      67,      "SetSecRowLtSeatVentilationStruct",      "SOAProtocolVersion",      "uint8"},
{830,      67,      "SetSecRowLtSeatVentilationStruct",      "SOAHeaderType",      "uint8"},
{831,      67,      "SetSecRowLtSeatVentilationStruct",      "SOAHeaderLength",      "uint16"},
{832,      67,      "SetSecRowLtSeatVentilationStruct",      "Flag",      "uint16"},
{833,      67,      "SetSecRowLtSeatVentilationStruct",      "HeaderCRC16",      "uint16"},
{834,      67,      "SetSecRowLtSeatVentilationStruct",      "UserID",      "uint32"},
{835,      67,      "SetSecRowLtSeatVentilationStruct",      "ReqTimeOut",      "uint32"},
{836,      67,      "SetSecRowLtSeatVentilationStruct",      "RequestPriority",      "uint8"},
{837,      67,      "SetSecRowLtSeatVentilationStruct",      "SequenceID",      "uint16"},
{838,      67,      "SetSecRowLtSeatVentilationStruct",      "ServiceExecuteFeedbackFlag",      "uint8"},
{839,      67,      "SetSecRowLtSeatVentilationStruct",      "Options",      "uint32"},
{840,      67,      "SetSecRowLtSeatVentilationStruct",      "SecRowLtSeatVentilationReq",      "uint8"},
{841,      67,      "SetSecRowLtSeatVentilationRespStruct",      "RespCode",      "uint32"},
{842,      67,      "SetSecRowLtSeatVentilationRespStruct",      "SetSecRowLtSeatVentilationNRC",      "uint32"},
{843,      68,      "RecallSecRowLtSeatTiltPstStruct",      "SOAProtocolVersion",      "uint8"},
{844,      68,      "RecallSecRowLtSeatTiltPstStruct",      "SOAHeaderType",      "uint8"},
{845,      68,      "RecallSecRowLtSeatTiltPstStruct",      "SOAHeaderLength",      "uint16"},
{846,      68,      "RecallSecRowLtSeatTiltPstStruct",      "Flag",      "uint16"},
{847,      68,      "RecallSecRowLtSeatTiltPstStruct",      "HeaderCRC16",      "uint16"},
{848,      68,      "RecallSecRowLtSeatTiltPstStruct",      "UserID",      "uint32"},
{849,      68,      "RecallSecRowLtSeatTiltPstStruct",      "ReqTimeOut",      "uint32"},
{850,      68,      "RecallSecRowLtSeatTiltPstStruct",      "RequestPriority",      "uint8"},
{851,      68,      "RecallSecRowLtSeatTiltPstStruct",      "SequenceID",      "uint16"},
{852,      68,      "RecallSecRowLtSeatTiltPstStruct",      "ServiceExecuteFeedbackFlag",      "uint8"},
{853,      68,      "RecallSecRowLtSeatTiltPstStruct",      "Options",      "uint32"},
{854,      68,      "RecallSecRowLtSeatTiltPstStruct",      "SecRowLtSeatTiltTrgtPst",      "uint8"},
{855,      68,      "RecallSecRowLtSeatTiltPstRespStruct",      "RespCode",      "uint32"},
{856,      68,      "RecallSecRowLtSeatTiltPstRespStruct",      "RecallSecRowLtSeatTiltPstNRC",      "uint32"},
{857,      69,      "SetSecRowLtSeatEasyEntryStruct",      "SOAProtocolVersion",      "uint8"},
{858,      69,      "SetSecRowLtSeatEasyEntryStruct",      "SOAHeaderType",      "uint8"},
{859,      69,      "SetSecRowLtSeatEasyEntryStruct",      "SOAHeaderLength",      "uint16"},
{860,      69,      "SetSecRowLtSeatEasyEntryStruct",      "Flag",      "uint16"},
{861,      69,      "SetSecRowLtSeatEasyEntryStruct",      "HeaderCRC16",      "uint16"},
{862,      69,      "SetSecRowLtSeatEasyEntryStruct",      "UserID",      "uint32"},
{863,      69,      "SetSecRowLtSeatEasyEntryStruct",      "ReqTimeOut",      "uint32"},
{864,      69,      "SetSecRowLtSeatEasyEntryStruct",      "RequestPriority",      "uint8"},
{865,      69,      "SetSecRowLtSeatEasyEntryStruct",      "SequenceID",      "uint16"},
{866,      69,      "SetSecRowLtSeatEasyEntryStruct",      "ServiceExecuteFeedbackFlag",      "uint8"},
{867,      69,      "SetSecRowLtSeatEasyEntryStruct",      "Options",      "uint32"},
{868,      69,      "SetSecRowLtSeatEasyEntryStruct",      "SetSecRowLtSeatEasyEntryCfgReq",      "uint8"},
{869,      69,      "SetSecRowLtSeatEasyEntryRespStruct",      "RespCode",      "uint32"},
{870,      69,      "SetSecRowLtSeatEasyEntryRespStruct",      "SetSecRowLtSeatEasyEntryNRC",      "uint32"},
{871,      70,      "SecRowRtSeatCtrlService_ErrStruct",      "SequenceID",      "uint16"},
{872,      70,      "SecRowRtSeatCtrlService_ErrStruct",      "Options_8bit",      "uint8"},
{873,      70,      "SecRowRtSeatCtrlService_ErrStruct",      "Options_8bit2",      "uint8"},
{874,      70,      "SecRowRtSeatCtrlService_ErrStruct",      "UserID",      "uint32"},
{875,      70,      "SecRowRtSeatCtrlService_ErrStruct",      "OpeNRC",      "uint32"},
{876,      70,      "SecRowRtSeatCtrlService_ErrStruct",      "OpeErrInfo",      "string[16]"},
{877,      71,      "SecRowRtSeatPstStruct",      "SecRowRtSeatTiltingPos",      "uint8"},
{878,      72,      "SecRowRtSeatFuncStStruct",      "SecRowRtSeatAutoAdjEnableSt",      "uint8"},
{879,      72,      "SecRowRtSeatFuncStStruct",      "SecRowRtSeatMoveSt",      "uint8"},
{880,      72,      "SecRowRtSeatFuncStStruct",      "SecRowRtSeatHeatSt",      "uint8"},
{881,      72,      "SecRowRtSeatFuncStStruct",      "SecRowRtSeatVentilationSt",      "uint8"},
{882,      72,      "SecRowRtSeatFuncStStruct",      "SecRowRtSeatDenormalizeSt",      "uint8"},
{883,      72,      "SecRowRtSeatFuncStStruct",      "SecRowRtSeatEasyEntryCfgSt",      "uint8"},
{884,      72,      "SecRowRtSeatFuncStStruct",      "SecRowRtSeatEasyEntrySt",      "uint8"},
{885,      72,      "SecRowRtSeatFuncStStruct",      "SecRowRtSeatBackUnLockSwSts",      "uint8"},
{886,      72,      "SecRowRtSeatFuncStStruct",      "SecRowRtSeatSeatPosSts",      "uint8"},
{887,      73,      "SetSecRowRtSeatPstStruct",      "SOAProtocolVersion",      "uint8"},
{888,      73,      "SetSecRowRtSeatPstStruct",      "SOAHeaderType",      "uint8"},
{889,      73,      "SetSecRowRtSeatPstStruct",      "SOAHeaderLength",      "uint16"},
{890,      73,      "SetSecRowRtSeatPstStruct",      "Flag",      "uint16"},
{891,      73,      "SetSecRowRtSeatPstStruct",      "HeaderCRC16",      "uint16"},
{892,      73,      "SetSecRowRtSeatPstStruct",      "UserID",      "uint32"},
{893,      73,      "SetSecRowRtSeatPstStruct",      "ReqTimeOut",      "uint32"},
{894,      73,      "SetSecRowRtSeatPstStruct",      "RequestPriority",      "uint8"},
{895,      73,      "SetSecRowRtSeatPstStruct",      "SequenceID",      "uint16"},
{896,      73,      "SetSecRowRtSeatPstStruct",      "ServiceExecuteFeedbackFlag",      "uint8"},
{897,      73,      "SetSecRowRtSeatPstStruct",      "Options",      "uint32"},
{898,      73,      "SetSecRowRtSeatPstStruct",      "SecRowRtSeatTiltTrgtPst",      "uint8"},
{899,      73,      "RecallSecRowRtSeatPstRespStruct",      "RespCode",      "uint32"},
{900,      73,      "RecallSecRowRtSeatPstRespStruct",      "RecallSecRowRtSeatPstNRC",      "uint32"},
{901,      74,      "StopSecRowRtSeatMovingStruct",      "SOAProtocolVersion",      "uint8"},
{902,      74,      "StopSecRowRtSeatMovingStruct",      "SOAHeaderType",      "uint8"},
{903,      74,      "StopSecRowRtSeatMovingStruct",      "SOAHeaderLength",      "uint16"},
{904,      74,      "StopSecRowRtSeatMovingStruct",      "Flag",      "uint16"},
{905,      74,      "StopSecRowRtSeatMovingStruct",      "HeaderCRC16",      "uint16"},
{906,      74,      "StopSecRowRtSeatMovingStruct",      "UserID",      "uint32"},
{907,      74,      "StopSecRowRtSeatMovingStruct",      "ReqTimeOut",      "uint32"},
{908,      74,      "StopSecRowRtSeatMovingStruct",      "RequestPriority",      "uint8"},
{909,      74,      "StopSecRowRtSeatMovingStruct",      "SequenceID",      "uint16"},
{910,      74,      "StopSecRowRtSeatMovingStruct",      "ServiceExecuteFeedbackFlag",      "uint8"},
{911,      74,      "StopSecRowRtSeatMovingStruct",      "Options",      "uint32"},
{912,      74,      "StopSecRowRtSeatMovingStruct",      "SecRowRtSeatStopMovingCmd",      "uint8"},
{913,      74,      "StopSecRowRtSeatMovingRespStruct",      "RespCode",      "uint32"},
{914,      74,      "StopSecRowRtSeatMovingRespStruct",      "StopSecRowRtSeatMovingNRC",      "uint32"},
{915,      75,      "SetSecRowRtSeatHeatingStruct",      "SOAProtocolVersion",      "uint8"},
{916,      75,      "SetSecRowRtSeatHeatingStruct",      "SOAHeaderType",      "uint8"},
{917,      75,      "SetSecRowRtSeatHeatingStruct",      "SOAHeaderLength",      "uint16"},
{918,      75,      "SetSecRowRtSeatHeatingStruct",      "Flag",      "uint16"},
{919,      75,      "SetSecRowRtSeatHeatingStruct",      "HeaderCRC16",      "uint16"},
{920,      75,      "SetSecRowRtSeatHeatingStruct",      "UserID",      "uint32"},
{921,      75,      "SetSecRowRtSeatHeatingStruct",      "ReqTimeOut",      "uint32"},
{922,      75,      "SetSecRowRtSeatHeatingStruct",      "RequestPriority",      "uint8"},
{923,      75,      "SetSecRowRtSeatHeatingStruct",      "SequenceID",      "uint16"},
{924,      75,      "SetSecRowRtSeatHeatingStruct",      "ServiceExecuteFeedbackFlag",      "uint8"},
{925,      75,      "SetSecRowRtSeatHeatingStruct",      "Options",      "uint32"},
{926,      75,      "SetSecRowRtSeatHeatingStruct",      "SecRowRtSeatHeatingReq",      "uint8"},
{927,      75,      "SetSecRowRtSeatHeatingRespStruct",      "RespCode",      "uint32"},
{928,      75,      "SetSecRowRtSeatHeatingRespStruct",      "SetSecRowRtSeatHeatingNRC",      "uint32"},
{929,      76,      "SetSecRowRtSeatVentilationStruct",      "SOAProtocolVersion",      "uint8"},
{930,      76,      "SetSecRowRtSeatVentilationStruct",      "SOAHeaderType",      "uint8"},
{931,      76,      "SetSecRowRtSeatVentilationStruct",      "SOAHeaderLength",      "uint16"},
{932,      76,      "SetSecRowRtSeatVentilationStruct",      "Flag",      "uint16"},
{933,      76,      "SetSecRowRtSeatVentilationStruct",      "HeaderCRC16",      "uint16"},
{934,      76,      "SetSecRowRtSeatVentilationStruct",      "UserID",      "uint32"},
{935,      76,      "SetSecRowRtSeatVentilationStruct",      "ReqTimeOut",      "uint32"},
{936,      76,      "SetSecRowRtSeatVentilationStruct",      "RequestPriority",      "uint8"},
{937,      76,      "SetSecRowRtSeatVentilationStruct",      "SequenceID",      "uint16"},
{938,      76,      "SetSecRowRtSeatVentilationStruct",      "ServiceExecuteFeedbackFlag",      "uint8"},
{939,      76,      "SetSecRowRtSeatVentilationStruct",      "Options",      "uint32"},
{940,      76,      "SetSecRowRtSeatVentilationStruct",      "SecRowRtSeatVentilationReq",      "uint8"},
{941,      76,      "SetSecRowRtSeatVentilationRespStruct",      "RespCode",      "uint32"},
{942,      76,      "SetSecRowRtSeatVentilationRespStruct",      "SetSecRowRtSeatVentilationNRC",      "uint32"},
{943,      77,      "RecallSecRowRtSeatTiltPstStruct",      "SOAProtocolVersion",      "uint8"},
{944,      77,      "RecallSecRowRtSeatTiltPstStruct",      "SOAHeaderType",      "uint8"},
{945,      77,      "RecallSecRowRtSeatTiltPstStruct",      "SOAHeaderLength",      "uint16"},
{946,      77,      "RecallSecRowRtSeatTiltPstStruct",      "Flag",      "uint16"},
{947,      77,      "RecallSecRowRtSeatTiltPstStruct",      "HeaderCRC16",      "uint16"},
{948,      77,      "RecallSecRowRtSeatTiltPstStruct",      "UserID",      "uint32"},
{949,      77,      "RecallSecRowRtSeatTiltPstStruct",      "ReqTimeOut",      "uint32"},
{950,      77,      "RecallSecRowRtSeatTiltPstStruct",      "RequestPriority",      "uint8"},
{951,      77,      "RecallSecRowRtSeatTiltPstStruct",      "SequenceID",      "uint16"},
{952,      77,      "RecallSecRowRtSeatTiltPstStruct",      "ServiceExecuteFeedbackFlag",      "uint8"},
{953,      77,      "RecallSecRowRtSeatTiltPstStruct",      "Options",      "uint32"},
{954,      77,      "RecallSecRowRtSeatTiltPstStruct",      "SecRowRtSeatTiltTrgtPst",      "uint8"},
{955,      77,      "RecallSecRowRtSeatTiltPstRespStruct",      "RespCode",      "uint32"},
{956,      77,      "RecallSecRowRtSeatTiltPstRespStruct",      "RecallSecRowRtSeatTiltPstNRC",      "uint32"},
{957,      78,      "SetSecRowRtSeatEasyEntryStruct",      "SOAProtocolVersion",      "uint8"},
{958,      78,      "SetSecRowRtSeatEasyEntryStruct",      "SOAHeaderType",      "uint8"},
{959,      78,      "SetSecRowRtSeatEasyEntryStruct",      "SOAHeaderLength",      "uint16"},
{960,      78,      "SetSecRowRtSeatEasyEntryStruct",      "Flag",      "uint16"},
{961,      78,      "SetSecRowRtSeatEasyEntryStruct",      "HeaderCRC16",      "uint16"},
{962,      78,      "SetSecRowRtSeatEasyEntryStruct",      "UserID",      "uint32"},
{963,      78,      "SetSecRowRtSeatEasyEntryStruct",      "ReqTimeOut",      "uint32"},
{964,      78,      "SetSecRowRtSeatEasyEntryStruct",      "RequestPriority",      "uint8"},
{965,      78,      "SetSecRowRtSeatEasyEntryStruct",      "SequenceID",      "uint16"},
{966,      78,      "SetSecRowRtSeatEasyEntryStruct",      "ServiceExecuteFeedbackFlag",      "uint8"},
{967,      78,      "SetSecRowRtSeatEasyEntryStruct",      "Options",      "uint32"},
{968,      78,      "SetSecRowRtSeatEasyEntryStruct",      "SetSecRowRtSeatEasyEntryCfgReq",      "uint8"},
{969,      78,      "SetSecRowRtSeatEasyEntryRespStruct",      "RespCode",      "uint32"},
{970,      78,      "SetSecRowRtSeatEasyEntryRespStruct",      "SetSecRowRtSeatEasyEntryNRC",      "uint32"},
{971,      79,      "ColumnCtrlService_ErrStruct",      "SequenceID",      "uint16"},
{972,      79,      "ColumnCtrlService_ErrStruct",      "Options_8bit",      "uint8"},
{973,      79,      "ColumnCtrlService_ErrStruct",      "Options_8bit2",      "uint8"},
{974,      79,      "ColumnCtrlService_ErrStruct",      "UserID",      "uint32"},
{975,      79,      "ColumnCtrlService_ErrStruct",      "OpeNRC",      "uint32"},
{976,      79,      "ColumnCtrlService_ErrStruct",      "OpeErrInfo",      "string[16]"},
{977,      80,      "CollumnPstStruct",      "ColumnHorizonalPos",      "uint8"},
{978,      80,      "CollumnPstStruct",      "ColumnVerticalPos",      "uint8"},
{979,      80,      "CollumnPstStruct",      "ColumnMoveSt",      "uint8"},
{980,      80,      "CollumnPstStruct",      "hColumnVerticalPst",      "uint8"},
{981,      80,      "CollumnPstStruct",      "hColumnHorizonalPst",      "uint8"},
{982,      81,      "CollumnFuncStStruct",      "ColumnLowTempCompensationSt",      "uint8"},
{983,      81,      "CollumnFuncStStruct",      "ColumnMotSoftStartEnable",      "uint8"},
{984,      81,      "CollumnFuncStStruct",      "ColumnMotSoftStopEnable",      "uint8"},
{985,      81,      "CollumnFuncStStruct",      "ColumnSpeedControlEnable",      "uint8"},
{986,      81,      "CollumnFuncStStruct",      "ColumnVerticalMotMoveSt",      "uint8"},
{987,      81,      "CollumnFuncStStruct",      "ColumnHorizonalMotMoveSt",      "uint8"},
{988,      81,      "CollumnFuncStStruct",      "ColumnVerticalMotStallSt",      "uint8"},
{989,      81,      "CollumnFuncStStruct",      "ColumnHorizonalMotStallSt",      "uint8"},
{990,      81,      "CollumnFuncStStruct",      "ColumnVerticalHallErrSt",      "uint8"},
{991,      81,      "CollumnFuncStStruct",      "ColumnHorizonalHallErrSt",      "uint8"},
{992,      81,      "CollumnFuncStStruct",      "ColumnVerticalMotIntSt",      "uint8"},
{993,      81,      "CollumnFuncStStruct",      "ColumnHorizonalMotIntSt",      "uint8"},
{994,      82,      "RecallColumnPstStruct",      "SOAProtocolVersion",      "uint8"},
{995,      82,      "RecallColumnPstStruct",      "SOAHeaderType",      "uint8"},
{996,      82,      "RecallColumnPstStruct",      "SOAHeaderLength",      "uint16"},
{997,      82,      "RecallColumnPstStruct",      "Flag",      "uint16"},
{998,      82,      "RecallColumnPstStruct",      "HeaderCRC16",      "uint16"},
{999,      82,      "RecallColumnPstStruct",      "UserID",      "uint32"},
{1000,      82,      "RecallColumnPstStruct",      "ReqTimeOut",      "uint32"},
{1001,      82,      "RecallColumnPstStruct",      "RequestPriority",      "uint8"},
{1002,      82,      "RecallColumnPstStruct",      "SequenceID",      "uint16"},
{1003,      82,      "RecallColumnPstStruct",      "ServiceExecuteFeedbackFlag",      "uint8"},
{1004,      82,      "RecallColumnPstStruct",      "Options",      "uint32"},
{1005,      82,      "RecallColumnPstStruct",      "ColumnHorzTrgtPst",      "uint8"},
{1006,      82,      "RecallColumnPstStruct",      "ColumnVertTrgtPst",      "uint8"},
{1007,      82,      "RecallColumnPstRespStruct",      "RespCode",      "uint32"},
{1008,      82,      "RecallColumnPstRespStruct",      "RecallColumnPstNRC",      "uint32"},
{1009,      83,      "SyncColumnPstStruct",      "SOAProtocolVersion",      "uint8"},
{1010,      83,      "SyncColumnPstStruct",      "SOAHeaderType",      "uint8"},
{1011,      83,      "SyncColumnPstStruct",      "SOAHeaderLength",      "uint16"},
{1012,      83,      "SyncColumnPstStruct",      "Flag",      "uint16"},
{1013,      83,      "SyncColumnPstStruct",      "HeaderCRC16",      "uint16"},
{1014,      83,      "SyncColumnPstStruct",      "UserID",      "uint32"},
{1015,      83,      "SyncColumnPstStruct",      "ReqTimeOut",      "uint32"},
{1016,      83,      "SyncColumnPstStruct",      "RequestPriority",      "uint8"},
{1017,      83,      "SyncColumnPstStruct",      "SequenceID",      "uint16"},
{1018,      83,      "SyncColumnPstStruct",      "ServiceExecuteFeedbackFlag",      "uint8"},
{1019,      83,      "SyncColumnPstStruct",      "Options",      "uint32"},
{1020,      83,      "SyncColumnPstStruct",      "ColumnHorzTrgtPst",      "uint8"},
{1021,      83,      "SyncColumnPstStruct",      "ColumnVertTrgtPst",      "uint8"},
{1022,      83,      "SyncColumnPstRespStruct",      "RespCode",      "uint32"},
{1023,      83,      "SyncColumnPstRespStruct",      "SyncColumnPstNRC",      "uint32"},
{1024,      84,      "HandleCtr_ErrStruct",      "SequenceID",      "uint16"},
{1025,      84,      "HandleCtr_ErrStruct",      "Options_8bit",      "uint8"},
{1026,      84,      "HandleCtr_ErrStruct",      "Options_8bit2",      "uint8"},
{1027,      84,      "HandleCtr_ErrStruct",      "UserID",      "uint32"},
{1028,      84,      "HandleCtr_ErrStruct",      "OpeNRC",      "uint32"},
{1029,      84,      "HandleCtr_ErrStruct",      "OpeErrInfo",      "string[16]"},
{1030,      85,      "HandleStStruct",      "FLHandlePos",      "uint8"},
{1031,      85,      "HandleStStruct",      "FLHandleMovSt",      "uint8"},
{1032,      85,      "HandleStStruct",      "FLHandleLampSt",      "uint8"},
{1033,      85,      "HandleStStruct",      "FRHandlePos",      "uint8"},
{1034,      85,      "HandleStStruct",      "FRHandleMovSt",      "uint8"},
{1035,      85,      "HandleStStruct",      "FRHandleLampSt",      "uint8"},
{1036,      85,      "HandleStStruct",      "RLHandlePos",      "uint8"},
{1037,      85,      "HandleStStruct",      "RLHandleMovSt",      "uint8"},
{1038,      85,      "HandleStStruct",      "RLHandleLampSt",      "uint8"},
{1039,      85,      "HandleStStruct",      "RRHandlePos",      "uint8"},
{1040,      85,      "HandleStStruct",      "RRHandleMovSt",      "uint8"},
{1041,      85,      "HandleStStruct",      "RRHandleLampSt",      "uint8"},
{1042,      85,      "HandleStStruct",      "HandleAUTOCfgFb",      "uint8"},
{1043,      86,      "AllHandleCtrStruct",      "SOAProtocolVersion",      "uint8"},
{1044,      86,      "AllHandleCtrStruct",      "SOAHeaderType",      "uint8"},
{1045,      86,      "AllHandleCtrStruct",      "SOAHeaderLength",      "uint16"},
{1046,      86,      "AllHandleCtrStruct",      "Flag",      "uint16"},
{1047,      86,      "AllHandleCtrStruct",      "HeaderCRC16",      "uint16"},
{1048,      86,      "AllHandleCtrStruct",      "UserID",      "uint32"},
{1049,      86,      "AllHandleCtrStruct",      "ReqTimeOut",      "uint32"},
{1050,      86,      "AllHandleCtrStruct",      "RequestPriority",      "uint8"},
{1051,      86,      "AllHandleCtrStruct",      "SequenceID",      "uint16"},
{1052,      86,      "AllHandleCtrStruct",      "ServiceExecuteFeedbackFlag",      "uint8"},
{1053,      86,      "AllHandleCtrStruct",      "Options",      "uint32"},
{1054,      86,      "AllHandleCtrStruct",      "AllHandleCtr",      "uint8"},
{1055,      86,      "AllHandleCtrRespStruct",      "RespCode",      "uint32"},
{1056,      86,      "AllHandleCtrRespStruct",      "AllHandleCtrNRC",      "uint32"},
{1057,      87,      "HandleAUTOSetStruct",      "SOAProtocolVersion",      "uint8"},
{1058,      87,      "HandleAUTOSetStruct",      "SOAHeaderType",      "uint8"},
{1059,      87,      "HandleAUTOSetStruct",      "SOAHeaderLength",      "uint16"},
{1060,      87,      "HandleAUTOSetStruct",      "Flag",      "uint16"},
{1061,      87,      "HandleAUTOSetStruct",      "HeaderCRC16",      "uint16"},
{1062,      87,      "HandleAUTOSetStruct",      "UserID",      "uint32"},
{1063,      87,      "HandleAUTOSetStruct",      "ReqTimeOut",      "uint32"},
{1064,      87,      "HandleAUTOSetStruct",      "RequestPriority",      "uint8"},
{1065,      87,      "HandleAUTOSetStruct",      "SequenceID",      "uint16"},
{1066,      87,      "HandleAUTOSetStruct",      "ServiceExecuteFeedbackFlag",      "uint8"},
{1067,      87,      "HandleAUTOSetStruct",      "Options",      "uint32"},
{1068,      87,      "HandleAUTOSetStruct",      "HandleAUTOSet",      "uint8"},
{1069,      87,      "HandleAUTOSetRespStruct",      "RespCode",      "uint32"},
{1070,      87,      "HandleAUTOSetRespStruct",      "HandleAUTOSetNRC",      "uint32"},
{1071,      88,      "LeftSideWindowService_ErrStruct",      "SequenceID",      "uint16"},
{1072,      88,      "LeftSideWindowService_ErrStruct",      "Options_8bit",      "uint8"},
{1073,      88,      "LeftSideWindowService_ErrStruct",      "Options_8bit2",      "uint8"},
{1074,      88,      "LeftSideWindowService_ErrStruct",      "UserID",      "uint32"},
{1075,      88,      "LeftSideWindowService_ErrStruct",      "OpeNRC",      "uint32"},
{1076,      88,      "LeftSideWindowService_ErrStruct",      "OpeErrInfo",      "string[16]"},
{1077,      89,      "FLWindowStStruct",      "DFLWinSwSt",      "uint8"},
{1078,      89,      "FLWindowStStruct",      "DFRWinSwSt",      "uint8"},
{1079,      89,      "FLWindowStStruct",      "DRLWinSwSt",      "uint8"},
{1080,      89,      "FLWindowStStruct",      "DRRWinSwSt",      "uint8"},
{1081,      89,      "FLWindowStStruct",      "WinLockSwSt",      "uint8"},
{1082,      89,      "FLWindowStStruct",      "WinLockworkSt",      "uint8"},
{1083,      89,      "FLWindowStStruct",      "DrvWinActionSts",      "uint8"},
{1084,      89,      "FLWindowStStruct",      "FLWinThemoProtectStFB",      "uint8"},
{1085,      89,      "FLWindowStStruct",      "FLWinLowBattFaultFB",      "uint8"},
{1086,      89,      "FLWindowStStruct",      "FLWinHighBattFaultFB",      "uint8"},
{1087,      89,      "FLWindowStStruct",      "FLhallSensorErrFB",      "uint8"},
{1088,      89,      "FLWindowStStruct",      "FLWinAPStFB",      "uint8"},
{1089,      89,      "FLWindowStStruct",      "FLWinOverRideFB",      "uint8"},
{1090,      89,      "FLWindowStStruct",      "FLDenormalizeFB",      "uint8"},
{1091,      89,      "FLWindowStStruct",      "FLWinNotInitReason",      "uint8"},
{1092,      89,      "FLWindowStStruct",      "FLWinActSource",      "uint8"},
{1093,      89,      "FLWindowStStruct",      "FLWinHallStallFB",      "uint8"},
{1094,      89,      "FLWindowStStruct",      "FLWindPosErrFB",      "uint8"},
{1095,      89,      "FLWindowStStruct",      "LockWinCfgFB",      "uint8"},
{1096,      90,      "FLWindowSt2Struct",      "FLWinHallCounts",      "uint16"},
{1097,      90,      "FLWindowSt2Struct",      "FLWinPosStFB",      "float32"},
{1098,      91,      "RLWindowStStruct",      "RLWinSwSt",      "uint8"},
{1099,      91,      "RLWindowStStruct",      "RLWinActionSts",      "uint8"},
{1100,      91,      "RLWindowStStruct",      "RLWinThemoProtectStFB",      "uint8"},
{1101,      91,      "RLWindowStStruct",      "RLWinLowBattFaultFB",      "uint8"},
{1102,      91,      "RLWindowStStruct",      "RLWinHighBattFaultFB",      "uint8"},
{1103,      91,      "RLWindowStStruct",      "RLhallSensorErrFB",      "uint8"},
{1104,      91,      "RLWindowStStruct",      "RLWinAPStFB",      "uint8"},
{1105,      91,      "RLWindowStStruct",      "RLWinOverRideFB",      "uint8"},
{1106,      91,      "RLWindowStStruct",      "RLDenormalizeFB",      "uint8"},
{1107,      91,      "RLWindowStStruct",      "RLWinNotInitReason",      "uint8"},
{1108,      91,      "RLWindowStStruct",      "RLWinActSource",      "uint8"},
{1109,      91,      "RLWindowStStruct",      "RLWinHallStallFB",      "uint8"},
{1110,      91,      "RLWindowStStruct",      "RLWindPosErrFB",      "uint8"},
{1111,      92,      "RLWindowSt2Struct",      "RLWinHallCounts",      "uint16"},
{1112,      92,      "RLWindowSt2Struct",      "RLWinPosStFB",      "float32"},
{1113,      93,      "FLWinPosCmdStruct",      "SOAProtocolVersion",      "uint8"},
{1114,      93,      "FLWinPosCmdStruct",      "SOAHeaderType",      "uint8"},
{1115,      93,      "FLWinPosCmdStruct",      "SOAHeaderLength",      "uint16"},
{1116,      93,      "FLWinPosCmdStruct",      "Flag",      "uint16"},
{1117,      93,      "FLWinPosCmdStruct",      "HeaderCRC16",      "uint16"},
{1118,      93,      "FLWinPosCmdStruct",      "UserID",      "uint32"},
{1119,      93,      "FLWinPosCmdStruct",      "ReqTimeOut",      "uint32"},
{1120,      93,      "FLWinPosCmdStruct",      "RequestPriority",      "uint8"},
{1121,      93,      "FLWinPosCmdStruct",      "SequenceID",      "uint16"},
{1122,      93,      "FLWinPosCmdStruct",      "ServiceExecuteFeedbackFlag",      "uint8"},
{1123,      93,      "FLWinPosCmdStruct",      "Options",      "uint32"},
{1124,      93,      "FLWinPosCmdStruct",      "FLWinPos",      "float32"},
{1125,      93,      "FLWinPosCmdRespStruct",      "RespCode",      "uint32"},
{1126,      93,      "FLWinPosCmdRespStruct",      "FLWinPosCmdNRC",      "uint32"},
{1127,      94,      "RLWinPosCmdStruct",      "SOAProtocolVersion",      "uint8"},
{1128,      94,      "RLWinPosCmdStruct",      "SOAHeaderType",      "uint8"},
{1129,      94,      "RLWinPosCmdStruct",      "SOAHeaderLength",      "uint16"},
{1130,      94,      "RLWinPosCmdStruct",      "Flag",      "uint16"},
{1131,      94,      "RLWinPosCmdStruct",      "HeaderCRC16",      "uint16"},
{1132,      94,      "RLWinPosCmdStruct",      "UserID",      "uint32"},
{1133,      94,      "RLWinPosCmdStruct",      "ReqTimeOut",      "uint32"},
{1134,      94,      "RLWinPosCmdStruct",      "RequestPriority",      "uint8"},
{1135,      94,      "RLWinPosCmdStruct",      "SequenceID",      "uint16"},
{1136,      94,      "RLWinPosCmdStruct",      "ServiceExecuteFeedbackFlag",      "uint8"},
{1137,      94,      "RLWinPosCmdStruct",      "Options",      "uint32"},
{1138,      94,      "RLWinPosCmdStruct",      "RLWinPos",      "float32"},
{1139,      94,      "RLWinPosCmdRespStruct",      "RespCode",      "uint32"},
{1140,      94,      "RLWinPosCmdRespStruct",      "RLWinPosCmdNRC",      "uint32"},
{1141,      95,      "CtrlFLWinStruct",      "SOAProtocolVersion",      "uint8"},
{1142,      95,      "CtrlFLWinStruct",      "SOAHeaderType",      "uint8"},
{1143,      95,      "CtrlFLWinStruct",      "SOAHeaderLength",      "uint16"},
{1144,      95,      "CtrlFLWinStruct",      "Flag",      "uint16"},
{1145,      95,      "CtrlFLWinStruct",      "HeaderCRC16",      "uint16"},
{1146,      95,      "CtrlFLWinStruct",      "UserID",      "uint32"},
{1147,      95,      "CtrlFLWinStruct",      "ReqTimeOut",      "uint32"},
{1148,      95,      "CtrlFLWinStruct",      "RequestPriority",      "uint8"},
{1149,      95,      "CtrlFLWinStruct",      "SequenceID",      "uint16"},
{1150,      95,      "CtrlFLWinStruct",      "ServiceExecuteFeedbackFlag",      "uint8"},
{1151,      95,      "CtrlFLWinStruct",      "Options",      "uint32"},
{1152,      95,      "CtrlFLWinStruct",      "CtrlFLWin",      "uint8"},
{1153,      95,      "CtrlFLWinRespStruct",      "RespCode",      "uint32"},
{1154,      95,      "CtrlFLWinRespStruct",      "CtrlFLWinNRC",      "uint32"},
{1155,      96,      "CtrlRLWinStruct",      "SOAProtocolVersion",      "uint8"},
{1156,      96,      "CtrlRLWinStruct",      "SOAHeaderType",      "uint8"},
{1157,      96,      "CtrlRLWinStruct",      "SOAHeaderLength",      "uint16"},
{1158,      96,      "CtrlRLWinStruct",      "Flag",      "uint16"},
{1159,      96,      "CtrlRLWinStruct",      "HeaderCRC16",      "uint16"},
{1160,      96,      "CtrlRLWinStruct",      "UserID",      "uint32"},
{1161,      96,      "CtrlRLWinStruct",      "ReqTimeOut",      "uint32"},
{1162,      96,      "CtrlRLWinStruct",      "RequestPriority",      "uint8"},
{1163,      96,      "CtrlRLWinStruct",      "SequenceID",      "uint16"},
{1164,      96,      "CtrlRLWinStruct",      "ServiceExecuteFeedbackFlag",      "uint8"},
{1165,      96,      "CtrlRLWinStruct",      "Options",      "uint32"},
{1166,      96,      "CtrlRLWinStruct",      "CtrlRLWin",      "uint8"},
{1167,      96,      "CtrlRLWinRespStruct",      "RespCode",      "uint32"},
{1168,      96,      "CtrlRLWinRespStruct",      "CtrlRLWinNRC",      "uint32"},
{1169,      97,      "WinLockCtrlReqStruct",      "SOAProtocolVersion",      "uint8"},
{1170,      97,      "WinLockCtrlReqStruct",      "SOAHeaderType",      "uint8"},
{1171,      97,      "WinLockCtrlReqStruct",      "SOAHeaderLength",      "uint16"},
{1172,      97,      "WinLockCtrlReqStruct",      "Flag",      "uint16"},
{1173,      97,      "WinLockCtrlReqStruct",      "HeaderCRC16",      "uint16"},
{1174,      97,      "WinLockCtrlReqStruct",      "UserID",      "uint32"},
{1175,      97,      "WinLockCtrlReqStruct",      "ReqTimeOut",      "uint32"},
{1176,      97,      "WinLockCtrlReqStruct",      "RequestPriority",      "uint8"},
{1177,      97,      "WinLockCtrlReqStruct",      "SequenceID",      "uint16"},
{1178,      97,      "WinLockCtrlReqStruct",      "ServiceExecuteFeedbackFlag",      "uint8"},
{1179,      97,      "WinLockCtrlReqStruct",      "Options",      "uint32"},
{1180,      97,      "WinLockCtrlReqStruct",      "WinLockCtrlReq",      "uint8"},
{1181,      97,      "WinLockCtrlReqRespStruct",      "RespCode",      "uint32"},
{1182,      97,      "WinLockCtrlReqRespStruct",      "WinLockCtrlReqNRC",      "uint32"},
{1183,      98,      "LockWinCfgStruct",      "SOAProtocolVersion",      "uint8"},
{1184,      98,      "LockWinCfgStruct",      "SOAHeaderType",      "uint8"},
{1185,      98,      "LockWinCfgStruct",      "SOAHeaderLength",      "uint16"},
{1186,      98,      "LockWinCfgStruct",      "Flag",      "uint16"},
{1187,      98,      "LockWinCfgStruct",      "HeaderCRC16",      "uint16"},
{1188,      98,      "LockWinCfgStruct",      "UserID",      "uint32"},
{1189,      98,      "LockWinCfgStruct",      "ReqTimeOut",      "uint32"},
{1190,      98,      "LockWinCfgStruct",      "RequestPriority",      "uint8"},
{1191,      98,      "LockWinCfgStruct",      "SequenceID",      "uint16"},
{1192,      98,      "LockWinCfgStruct",      "ServiceExecuteFeedbackFlag",      "uint8"},
{1193,      98,      "LockWinCfgStruct",      "Options",      "uint32"},
{1194,      98,      "LockWinCfgStruct",      "LockWinCfg",      "uint8"},
{1195,      98,      "LockWinCfgRespStruct",      "RespCode",      "uint32"},
{1196,      98,      "LockWinCfgRespStruct",      "LockWinCfgNRC",      "uint32"},
{1197,      99,      "RightSideWindowService_ErrStruct",      "SequenceID",      "uint16"},
{1198,      99,      "RightSideWindowService_ErrStruct",      "Options_8bit",      "uint8"},
{1199,      99,      "RightSideWindowService_ErrStruct",      "Options_8bit2",      "uint8"},
{1200,      99,      "RightSideWindowService_ErrStruct",      "UserID",      "uint32"},
{1201,      99,      "RightSideWindowService_ErrStruct",      "OpeNRC",      "uint32"},
{1202,      99,      "RightSideWindowService_ErrStruct",      "OpeErrInfo",      "string[16]"},
{1203,      100,      "FRWindowStStruct",      "FRWinSwSt",      "uint8"},
{1204,      100,      "FRWindowStStruct",      "PsngrWinActionSts",      "uint8"},
{1205,      100,      "FRWindowStStruct",      "FRWinThemoProtectStFB",      "uint8"},
{1206,      100,      "FRWindowStStruct",      "FRWinLowBattFaultFB",      "uint8"},
{1207,      100,      "FRWindowStStruct",      "FRWinHighBattFaultFB",      "uint8"},
{1208,      100,      "FRWindowStStruct",      "FRhallSensorErrFB",      "uint8"},
{1209,      100,      "FRWindowStStruct",      "FRWinAPStFB",      "uint8"},
{1210,      100,      "FRWindowStStruct",      "FRWinOverRideFB",      "uint8"},
{1211,      100,      "FRWindowStStruct",      "FRDenormalizeFB",      "uint8"},
{1212,      100,      "FRWindowStStruct",      "FRWinNotInitReason",      "uint8"},
{1213,      100,      "FRWindowStStruct",      "FRWinActSource",      "uint8"},
{1214,      100,      "FRWindowStStruct",      "FRWinHallStallFB",      "uint8"},
{1215,      100,      "FRWindowStStruct",      "FRWindPosErrFB",      "uint8"},
{1216,      101,      "FRWindowSt2Struct",      "FRWinHallCounts",      "uint16"},
{1217,      101,      "FRWindowSt2Struct",      "FRWinPosStFB",      "float32"},
{1218,      102,      "RRWindowStStruct",      "RRWinSwSt",      "uint8"},
{1219,      102,      "RRWindowStStruct",      "RRWinActionSts",      "uint8"},
{1220,      102,      "RRWindowStStruct",      "RRWinThemoProtectStFB",      "uint8"},
{1221,      102,      "RRWindowStStruct",      "RRWinLowBattFaultFB",      "uint8"},
{1222,      102,      "RRWindowStStruct",      "RRWinHighBattFaultFB",      "uint8"},
{1223,      102,      "RRWindowStStruct",      "RRhallSensorErrFB",      "uint8"},
{1224,      102,      "RRWindowStStruct",      "RRWinAPStFB",      "uint8"},
{1225,      102,      "RRWindowStStruct",      "RRWinOverRideFB",      "uint8"},
{1226,      102,      "RRWindowStStruct",      "RRDenormalizeFB",      "uint8"},
{1227,      102,      "RRWindowStStruct",      "RRWinNotInitReason",      "uint8"},
{1228,      102,      "RRWindowStStruct",      "RRWinActSource",      "uint8"},
{1229,      102,      "RRWindowStStruct",      "RRWinHallStallFB",      "uint8"},
{1230,      102,      "RRWindowStStruct",      "RRWindPosErrFB",      "uint8"},
{1231,      103,      "RRWindowSt2Struct",      "RRWinHallCounts",      "uint16"},
{1232,      103,      "RRWindowSt2Struct",      "RRWinPosStFB",      "float32"},
{1233,      104,      "FRWinPosCmdStruct",      "SOAProtocolVersion",      "uint8"},
{1234,      104,      "FRWinPosCmdStruct",      "SOAHeaderType",      "uint8"},
{1235,      104,      "FRWinPosCmdStruct",      "SOAHeaderLength",      "uint16"},
{1236,      104,      "FRWinPosCmdStruct",      "Flag",      "uint16"},
{1237,      104,      "FRWinPosCmdStruct",      "HeaderCRC16",      "uint16"},
{1238,      104,      "FRWinPosCmdStruct",      "UserID",      "uint32"},
{1239,      104,      "FRWinPosCmdStruct",      "ReqTimeOut",      "uint32"},
{1240,      104,      "FRWinPosCmdStruct",      "RequestPriority",      "uint8"},
{1241,      104,      "FRWinPosCmdStruct",      "SequenceID",      "uint16"},
{1242,      104,      "FRWinPosCmdStruct",      "ServiceExecuteFeedbackFlag",      "uint8"},
{1243,      104,      "FRWinPosCmdStruct",      "Options",      "uint32"},
{1244,      104,      "FRWinPosCmdStruct",      "FRWinPos",      "float32"},
{1245,      104,      "FRWinPosCmdRespStruct",      "RespCode",      "uint32"},
{1246,      104,      "FRWinPosCmdRespStruct",      "FRWinPosCmdNRC",      "uint32"},
{1247,      105,      "RRWinPosCmdStruct",      "SOAProtocolVersion",      "uint8"},
{1248,      105,      "RRWinPosCmdStruct",      "SOAHeaderType",      "uint8"},
{1249,      105,      "RRWinPosCmdStruct",      "SOAHeaderLength",      "uint16"},
{1250,      105,      "RRWinPosCmdStruct",      "Flag",      "uint16"},
{1251,      105,      "RRWinPosCmdStruct",      "HeaderCRC16",      "uint16"},
{1252,      105,      "RRWinPosCmdStruct",      "UserID",      "uint32"},
{1253,      105,      "RRWinPosCmdStruct",      "ReqTimeOut",      "uint32"},
{1254,      105,      "RRWinPosCmdStruct",      "RequestPriority",      "uint8"},
{1255,      105,      "RRWinPosCmdStruct",      "SequenceID",      "uint16"},
{1256,      105,      "RRWinPosCmdStruct",      "ServiceExecuteFeedbackFlag",      "uint8"},
{1257,      105,      "RRWinPosCmdStruct",      "Options",      "uint32"},
{1258,      105,      "RRWinPosCmdStruct",      "RRWinPos",      "float32"},
{1259,      105,      "RRWinPosCmdRespStruct",      "RespCode",      "uint32"},
{1260,      105,      "RRWinPosCmdRespStruct",      "RRWinPosCmdNRC",      "uint32"},
{1261,      106,      "CtrlFRWinStruct",      "SOAProtocolVersion",      "uint8"},
{1262,      106,      "CtrlFRWinStruct",      "SOAHeaderType",      "uint8"},
{1263,      106,      "CtrlFRWinStruct",      "SOAHeaderLength",      "uint16"},
{1264,      106,      "CtrlFRWinStruct",      "Flag",      "uint16"},
{1265,      106,      "CtrlFRWinStruct",      "HeaderCRC16",      "uint16"},
{1266,      106,      "CtrlFRWinStruct",      "UserID",      "uint32"},
{1267,      106,      "CtrlFRWinStruct",      "ReqTimeOut",      "uint32"},
{1268,      106,      "CtrlFRWinStruct",      "RequestPriority",      "uint8"},
{1269,      106,      "CtrlFRWinStruct",      "SequenceID",      "uint16"},
{1270,      106,      "CtrlFRWinStruct",      "ServiceExecuteFeedbackFlag",      "uint8"},
{1271,      106,      "CtrlFRWinStruct",      "Options",      "uint32"},
{1272,      106,      "CtrlFRWinStruct",      "CtrlFRWin",      "uint8"},
{1273,      106,      "CtrlFRWinRespStruct",      "RespCode",      "uint32"},
{1274,      106,      "CtrlFRWinRespStruct",      "CtrlFRWinNRC",      "uint32"},
{1275,      107,      "CtrlRRWinStruct",      "SOAProtocolVersion",      "uint8"},
{1276,      107,      "CtrlRRWinStruct",      "SOAHeaderType",      "uint8"},
{1277,      107,      "CtrlRRWinStruct",      "SOAHeaderLength",      "uint16"},
{1278,      107,      "CtrlRRWinStruct",      "Flag",      "uint16"},
{1279,      107,      "CtrlRRWinStruct",      "HeaderCRC16",      "uint16"},
{1280,      107,      "CtrlRRWinStruct",      "UserID",      "uint32"},
{1281,      107,      "CtrlRRWinStruct",      "ReqTimeOut",      "uint32"},
{1282,      107,      "CtrlRRWinStruct",      "RequestPriority",      "uint8"},
{1283,      107,      "CtrlRRWinStruct",      "SequenceID",      "uint16"},
{1284,      107,      "CtrlRRWinStruct",      "ServiceExecuteFeedbackFlag",      "uint8"},
{1285,      107,      "CtrlRRWinStruct",      "Options",      "uint32"},
{1286,      107,      "CtrlRRWinStruct",      "CtrlRRWin",      "uint8"},
{1287,      107,      "CtrlRRWinRespStruct",      "RespCode",      "uint32"},
{1288,      107,      "CtrlRRWinRespStruct",      "CtrlRRWinNRC",      "uint32"},
{1289,      108,      "DoorLockService_ErrStruct",      "SequenceID",      "uint16"},
{1290,      108,      "DoorLockService_ErrStruct",      "Options_8bit",      "uint8"},
{1291,      108,      "DoorLockService_ErrStruct",      "Options_8bit2",      "uint8"},
{1292,      108,      "DoorLockService_ErrStruct",      "UserID",      "uint32"},
{1293,      108,      "DoorLockService_ErrStruct",      "OpeNRC",      "uint32"},
{1294,      108,      "DoorLockService_ErrStruct",      "OpeErrInfo",      "string[16]"},
{1295,      109,      "DoorLockStStruct",      "LockLogicSt",      "uint8"},
{1296,      109,      "DoorLockStStruct",      "DoorLockEvent",      "uint8"},
{1297,      109,      "DoorLockStStruct",      "DoorUnlockSource",      "uint8"},
{1298,      109,      "DoorLockStStruct",      "DoorLockSource",      "uint8"},
{1299,      109,      "DoorLockStStruct",      "DoorLockSourceType",      "uint8"},
{1300,      109,      "DoorLockStStruct",      "DoorUnlockSourceType",      "uint8"},
{1301,      109,      "DoorLockStStruct",      "TemporaryLockFB",      "uint8"},
{1302,      109,      "DoorLockStStruct",      "LockFailSt",      "uint8"},
{1303,      109,      "DoorLockStStruct",      "PollingUnlockCfgSt",      "uint8"},
{1304,      109,      "DoorLockStStruct",      "PollingLockCfgSt",      "uint8"},
{1305,      109,      "DoorLockStStruct",      "AutoUnlockCfgFBSt",      "uint8"},
{1306,      109,      "DoorLockStStruct",      "AutoLockCfgFBSt",      "uint8"},
{1307,      110,      "SetDoorLockStateStruct",      "SOAProtocolVersion",      "uint8"},
{1308,      110,      "SetDoorLockStateStruct",      "SOAHeaderType",      "uint8"},
{1309,      110,      "SetDoorLockStateStruct",      "SOAHeaderLength",      "uint16"},
{1310,      110,      "SetDoorLockStateStruct",      "Flag",      "uint16"},
{1311,      110,      "SetDoorLockStateStruct",      "HeaderCRC16",      "uint16"},
{1312,      110,      "SetDoorLockStateStruct",      "UserID",      "uint32"},
{1313,      110,      "SetDoorLockStateStruct",      "ReqTimeOut",      "uint32"},
{1314,      110,      "SetDoorLockStateStruct",      "RequestPriority",      "uint8"},
{1315,      110,      "SetDoorLockStateStruct",      "SequenceID",      "uint16"},
{1316,      110,      "SetDoorLockStateStruct",      "ServiceExecuteFeedbackFlag",      "uint8"},
{1317,      110,      "SetDoorLockStateStruct",      "Options",      "uint32"},
{1318,      110,      "SetDoorLockStateStruct",      "SetDoorLockStateCtr",      "uint8"},
{1319,      110,      "SetDoorLockStateRespStruct",      "RespCode",      "uint32"},
{1320,      110,      "SetDoorLockStateRespStruct",      "SetDoorLockStateNRC",      "uint32"},
{1321,      111,      "SetDoorOriLockStCmdStruct",      "SOAProtocolVersion",      "uint8"},
{1322,      111,      "SetDoorOriLockStCmdStruct",      "SOAHeaderType",      "uint8"},
{1323,      111,      "SetDoorOriLockStCmdStruct",      "SOAHeaderLength",      "uint16"},
{1324,      111,      "SetDoorOriLockStCmdStruct",      "Flag",      "uint16"},
{1325,      111,      "SetDoorOriLockStCmdStruct",      "HeaderCRC16",      "uint16"},
{1326,      111,      "SetDoorOriLockStCmdStruct",      "UserID",      "uint32"},
{1327,      111,      "SetDoorOriLockStCmdStruct",      "ReqTimeOut",      "uint32"},
{1328,      111,      "SetDoorOriLockStCmdStruct",      "RequestPriority",      "uint8"},
{1329,      111,      "SetDoorOriLockStCmdStruct",      "SequenceID",      "uint16"},
{1330,      111,      "SetDoorOriLockStCmdStruct",      "ServiceExecuteFeedbackFlag",      "uint8"},
{1331,      111,      "SetDoorOriLockStCmdStruct",      "Options",      "uint32"},
{1332,      111,      "SetDoorOriLockStCmdStruct",      "SetDoorOriLockStCmd",      "uint8"},
{1333,      111,      "SetDoorOriLockStRespStruct",      "RespCode",      "uint32"},
{1334,      111,      "SetDoorOriLockStRespStruct",      "SetDoorOriLockStNRC",      "uint32"},
{1335,      112,      "SetDoorOriUnlockStCmdStruct",      "SOAProtocolVersion",      "uint8"},
{1336,      112,      "SetDoorOriUnlockStCmdStruct",      "SOAHeaderType",      "uint8"},
{1337,      112,      "SetDoorOriUnlockStCmdStruct",      "SOAHeaderLength",      "uint16"},
{1338,      112,      "SetDoorOriUnlockStCmdStruct",      "Flag",      "uint16"},
{1339,      112,      "SetDoorOriUnlockStCmdStruct",      "HeaderCRC16",      "uint16"},
{1340,      112,      "SetDoorOriUnlockStCmdStruct",      "UserID",      "uint32"},
{1341,      112,      "SetDoorOriUnlockStCmdStruct",      "ReqTimeOut",      "uint32"},
{1342,      112,      "SetDoorOriUnlockStCmdStruct",      "RequestPriority",      "uint8"},
{1343,      112,      "SetDoorOriUnlockStCmdStruct",      "SequenceID",      "uint16"},
{1344,      112,      "SetDoorOriUnlockStCmdStruct",      "ServiceExecuteFeedbackFlag",      "uint8"},
{1345,      112,      "SetDoorOriUnlockStCmdStruct",      "Options",      "uint32"},
{1346,      112,      "SetDoorOriUnlockStCmdStruct",      "SetDoorOriUnlockStCmd",      "uint8"},
{1347,      112,      "SetDoorOriUnlockStRespStruct",      "RespCode",      "uint32"},
{1348,      112,      "SetDoorOriUnlockStRespStruct",      "SetDoorOriUnlockStNRC",      "uint32"},
{1349,      113,      "SetAutoUnlockFuncStruct",      "SOAProtocolVersion",      "uint8"},
{1350,      113,      "SetAutoUnlockFuncStruct",      "SOAHeaderType",      "uint8"},
{1351,      113,      "SetAutoUnlockFuncStruct",      "SOAHeaderLength",      "uint16"},
{1352,      113,      "SetAutoUnlockFuncStruct",      "Flag",      "uint16"},
{1353,      113,      "SetAutoUnlockFuncStruct",      "HeaderCRC16",      "uint16"},
{1354,      113,      "SetAutoUnlockFuncStruct",      "UserID",      "uint32"},
{1355,      113,      "SetAutoUnlockFuncStruct",      "ReqTimeOut",      "uint32"},
{1356,      113,      "SetAutoUnlockFuncStruct",      "RequestPriority",      "uint8"},
{1357,      113,      "SetAutoUnlockFuncStruct",      "SequenceID",      "uint16"},
{1358,      113,      "SetAutoUnlockFuncStruct",      "ServiceExecuteFeedbackFlag",      "uint8"},
{1359,      113,      "SetAutoUnlockFuncStruct",      "Options",      "uint32"},
{1360,      113,      "SetAutoUnlockFuncStruct",      "SetAutoUnlockCfg",      "uint8"},
{1361,      113,      "SetAutoUnlockFuncRespStruct",      "RespCode",      "uint32"},
{1362,      113,      "SetAutoUnlockFuncRespStruct",      "SetAutoUnlockFuncNRC",      "uint32"},
{1363,      114,      "SetAutoLockFuncStruct",      "SOAProtocolVersion",      "uint8"},
{1364,      114,      "SetAutoLockFuncStruct",      "SOAHeaderType",      "uint8"},
{1365,      114,      "SetAutoLockFuncStruct",      "SOAHeaderLength",      "uint16"},
{1366,      114,      "SetAutoLockFuncStruct",      "Flag",      "uint16"},
{1367,      114,      "SetAutoLockFuncStruct",      "HeaderCRC16",      "uint16"},
{1368,      114,      "SetAutoLockFuncStruct",      "UserID",      "uint32"},
{1369,      114,      "SetAutoLockFuncStruct",      "ReqTimeOut",      "uint32"},
{1370,      114,      "SetAutoLockFuncStruct",      "RequestPriority",      "uint8"},
{1371,      114,      "SetAutoLockFuncStruct",      "SequenceID",      "uint16"},
{1372,      114,      "SetAutoLockFuncStruct",      "ServiceExecuteFeedbackFlag",      "uint8"},
{1373,      114,      "SetAutoLockFuncStruct",      "Options",      "uint32"},
{1374,      114,      "SetAutoLockFuncStruct",      "SetAutoLockCfg",      "uint8"},
{1375,      114,      "SetAutoLockFuncRespStruct",      "RespCode",      "uint32"},
{1376,      114,      "SetAutoLockFuncRespStruct",      "SetAutoLockFuncNRC",      "uint32"},
{1377,      115,      "SetPollingUnlockFuncStruct",      "SOAProtocolVersion",      "uint8"},
{1378,      115,      "SetPollingUnlockFuncStruct",      "SOAHeaderType",      "uint8"},
{1379,      115,      "SetPollingUnlockFuncStruct",      "SOAHeaderLength",      "uint16"},
{1380,      115,      "SetPollingUnlockFuncStruct",      "Flag",      "uint16"},
{1381,      115,      "SetPollingUnlockFuncStruct",      "HeaderCRC16",      "uint16"},
{1382,      115,      "SetPollingUnlockFuncStruct",      "UserID",      "uint32"},
{1383,      115,      "SetPollingUnlockFuncStruct",      "ReqTimeOut",      "uint32"},
{1384,      115,      "SetPollingUnlockFuncStruct",      "RequestPriority",      "uint8"},
{1385,      115,      "SetPollingUnlockFuncStruct",      "SequenceID",      "uint16"},
{1386,      115,      "SetPollingUnlockFuncStruct",      "ServiceExecuteFeedbackFlag",      "uint8"},
{1387,      115,      "SetPollingUnlockFuncStruct",      "Options",      "uint32"},
{1388,      115,      "SetPollingUnlockFuncStruct",      "SetPollingUnlockCfg",      "uint8"},
{1389,      115,      "SetPollingUnlockFuncRespStruct",      "RespCode",      "uint32"},
{1390,      115,      "SetPollingUnlockFuncRespStruct",      "SetPollingUnlockFuncNRC",      "uint32"},
{1391,      116,      "SetPollingLockFuncStruct",      "SOAProtocolVersion",      "uint8"},
{1392,      116,      "SetPollingLockFuncStruct",      "SOAHeaderType",      "uint8"},
{1393,      116,      "SetPollingLockFuncStruct",      "SOAHeaderLength",      "uint16"},
{1394,      116,      "SetPollingLockFuncStruct",      "Flag",      "uint16"},
{1395,      116,      "SetPollingLockFuncStruct",      "HeaderCRC16",      "uint16"},
{1396,      116,      "SetPollingLockFuncStruct",      "UserID",      "uint32"},
{1397,      116,      "SetPollingLockFuncStruct",      "ReqTimeOut",      "uint32"},
{1398,      116,      "SetPollingLockFuncStruct",      "RequestPriority",      "uint8"},
{1399,      116,      "SetPollingLockFuncStruct",      "SequenceID",      "uint16"},
{1400,      116,      "SetPollingLockFuncStruct",      "ServiceExecuteFeedbackFlag",      "uint8"},
{1401,      116,      "SetPollingLockFuncStruct",      "Options",      "uint32"},
{1402,      116,      "SetPollingLockFuncStruct",      "SetPollingLockCfg",      "uint8"},
{1403,      116,      "SetPollingLockFuncRespStruct",      "RespCode",      "uint32"},
{1404,      116,      "SetPollingLockFuncRespStruct",      "SetPollingLockFuncNRC",      "uint32"},
{1405,      117,      "FLDoorPowerRelService_ErrStruct",      "SequenceID",      "uint16"},
{1406,      117,      "FLDoorPowerRelService_ErrStruct",      "Options_8bit",      "uint8"},
{1407,      117,      "FLDoorPowerRelService_ErrStruct",      "Options_8bit2",      "uint8"},
{1408,      117,      "FLDoorPowerRelService_ErrStruct",      "UserID",      "uint32"},
{1409,      117,      "FLDoorPowerRelService_ErrStruct",      "OpeNRC",      "uint32"},
{1410,      117,      "FLDoorPowerRelService_ErrStruct",      "OpeErrInfo",      "string[16]"},
{1411,      118,      "FLDoorSwSt1Struct",      "FLDoorReleaseSource",      "uint8"},
{1412,      118,      "FLDoorSwSt1Struct",      "FLDoorReleaseEvent",      "uint8"},
{1413,      118,      "FLDoorSwSt1Struct",      "FLDoorCinchEvent",      "uint8"},
{1414,      118,      "FLDoorSwSt1Struct",      "DriverDoorAjarSt",      "uint8"},
{1415,      118,      "FLDoorSwSt1Struct",      "DriverDoorOpenSt",      "uint8"},
{1416,      118,      "FLDoorSwSt1Struct",      "DriveDoorReleaseSWSt",      "uint8"},
{1417,      118,      "FLDoorSwSt1Struct",      "DriveLockOrHandleSt",      "uint8"},
{1418,      118,      "FLDoorSwSt1Struct",      "CentralLockCtrlSwSt",      "uint8"},
{1419,      118,      "FLDoorSwSt1Struct",      "DriveDoorPawlSt",      "uint8"},
{1420,      118,      "FLDoorSwSt1Struct",      "DriveDoorCinchHomeSt",      "uint8"},
{1421,      118,      "FLDoorSwSt1Struct",      "DriverDoorUnlockSwSt",      "uint8"},
{1422,      118,      "FLDoorSwSt1Struct",      "DriverDoorGearUnlockSwSt",      "uint8"},
{1423,      118,      "FLDoorSwSt1Struct",      "FLCinchMotorOutput",      "uint8"},
{1424,      118,      "FLDoorSwSt1Struct",      "FLReleaseMotorOutput",      "uint8"},
{1425,      118,      "FLDoorSwSt1Struct",      "FLDoorReleaseActSt",      "uint8"},
{1426,      118,      "FLDoorSwSt1Struct",      "FLDoorCinchActSt",      "uint8"},
{1427,      118,      "FLDoorSwSt1Struct",      "FLDoorARAActSt",      "uint8"},
{1428,      118,      "FLDoorSwSt1Struct",      "DriverDoorReleaseWarming",      "uint8"},
{1429,      118,      "FLDoorSwSt1Struct",      "DriverDoorCinchWarming",      "uint8"},
{1430,      118,      "FLDoorSwSt1Struct",      "FLDoorCrashUnlockWarn",      "uint8"},
{1431,      118,      "FLDoorSwSt1Struct",      "FLDoorGULSwWarn",      "uint8"},
{1432,      118,      "FLDoorSwSt1Struct",      "FLDoorULSwWarn",      "uint8"},
{1433,      119,      "FLDoorPowerReleaseCtrlStruct",      "SOAProtocolVersion",      "uint8"},
{1434,      119,      "FLDoorPowerReleaseCtrlStruct",      "SOAHeaderType",      "uint8"},
{1435,      119,      "FLDoorPowerReleaseCtrlStruct",      "SOAHeaderLength",      "uint16"},
{1436,      119,      "FLDoorPowerReleaseCtrlStruct",      "Flag",      "uint16"},
{1437,      119,      "FLDoorPowerReleaseCtrlStruct",      "HeaderCRC16",      "uint16"},
{1438,      119,      "FLDoorPowerReleaseCtrlStruct",      "UserID",      "uint32"},
{1439,      119,      "FLDoorPowerReleaseCtrlStruct",      "ReqTimeOut",      "uint32"},
{1440,      119,      "FLDoorPowerReleaseCtrlStruct",      "RequestPriority",      "uint8"},
{1441,      119,      "FLDoorPowerReleaseCtrlStruct",      "SequenceID",      "uint16"},
{1442,      119,      "FLDoorPowerReleaseCtrlStruct",      "ServiceExecuteFeedbackFlag",      "uint8"},
{1443,      119,      "FLDoorPowerReleaseCtrlStruct",      "Options",      "uint32"},
{1444,      119,      "FLDoorPowerReleaseCtrlStruct",      "FLDoorPowerReleaseCmd",      "uint8"},
{1445,      119,      "FLDoorPowerReleaseCtrlRespStruct",      "RespCode",      "uint32"},
{1446,      119,      "FLDoorPowerReleaseCtrlRespStruct",      "FLDoorPowerReleaseCtrlNRC",      "uint32"},
{1447,      120,      "FRDoorPowerRelService_ErrStruct",      "SequenceID",      "uint16"},
{1448,      120,      "FRDoorPowerRelService_ErrStruct",      "Options_8bit",      "uint8"},
{1449,      120,      "FRDoorPowerRelService_ErrStruct",      "Options_8bit2",      "uint8"},
{1450,      120,      "FRDoorPowerRelService_ErrStruct",      "UserID",      "uint32"},
{1451,      120,      "FRDoorPowerRelService_ErrStruct",      "OpeNRC",      "uint32"},
{1452,      120,      "FRDoorPowerRelService_ErrStruct",      "OpeErrInfo",      "string[16]"},
{1453,      121,      "FRDoorSwSt1Struct",      "FRDoorReleaseSource",      "uint8"},
{1454,      121,      "FRDoorSwSt1Struct",      "FRDoorReleaseEvent",      "uint8"},
{1455,      121,      "FRDoorSwSt1Struct",      "FRDoorCinchEvent",      "uint8"},
{1456,      121,      "FRDoorSwSt1Struct",      "PsngrDoorAjarSt",      "uint8"},
{1457,      121,      "FRDoorSwSt1Struct",      "PsngrDoorOpenSt",      "uint8"},
{1458,      121,      "FRDoorSwSt1Struct",      "PsngrDoorReleaseSWSt",      "uint8"},
{1459,      121,      "FRDoorSwSt1Struct",      "PsngrHandleSt",      "uint8"},
{1460,      121,      "FRDoorSwSt1Struct",      "PsngrDoorPawlSt",      "uint8"},
{1461,      121,      "FRDoorSwSt1Struct",      "PsngrDoorCinchHomeSt",      "uint8"},
{1462,      121,      "FRDoorSwSt1Struct",      "PsngrDoorUnlockSwSt",      "uint8"},
{1463,      121,      "FRDoorSwSt1Struct",      "PsngrDoorGearUnlockSwSt",      "uint8"},
{1464,      121,      "FRDoorSwSt1Struct",      "BonnetAjarSt",      "uint8"},
{1465,      121,      "FRDoorSwSt1Struct",      "FRCinchMotorOutput",      "uint8"},
{1466,      121,      "FRDoorSwSt1Struct",      "FRReleaseMotorOutput",      "uint8"},
{1467,      121,      "FRDoorSwSt1Struct",      "FRDoorReleaseActSt",      "uint8"},
{1468,      121,      "FRDoorSwSt1Struct",      "FRDoorCinchActSt",      "uint8"},
{1469,      121,      "FRDoorSwSt1Struct",      "FRDoorARAActSt",      "uint8"},
{1470,      121,      "FRDoorSwSt1Struct",      "PsngrDoorReleaseWarming",      "uint8"},
{1471,      121,      "FRDoorSwSt1Struct",      "PsngrDoorCinchWarming",      "uint8"},
{1472,      121,      "FRDoorSwSt1Struct",      "FRDoorCrashUnlockWarn",      "uint8"},
{1473,      121,      "FRDoorSwSt1Struct",      "FRDoorGULSwWarn",      "uint8"},
{1474,      121,      "FRDoorSwSt1Struct",      "FRDoorULSwWarn",      "uint8"},
{1475,      122,      "FRDoorPowerReleaseCtrlStruct",      "SOAProtocolVersion",      "uint8"},
{1476,      122,      "FRDoorPowerReleaseCtrlStruct",      "SOAHeaderType",      "uint8"},
{1477,      122,      "FRDoorPowerReleaseCtrlStruct",      "SOAHeaderLength",      "uint16"},
{1478,      122,      "FRDoorPowerReleaseCtrlStruct",      "Flag",      "uint16"},
{1479,      122,      "FRDoorPowerReleaseCtrlStruct",      "HeaderCRC16",      "uint16"},
{1480,      122,      "FRDoorPowerReleaseCtrlStruct",      "UserID",      "uint32"},
{1481,      122,      "FRDoorPowerReleaseCtrlStruct",      "ReqTimeOut",      "uint32"},
{1482,      122,      "FRDoorPowerReleaseCtrlStruct",      "RequestPriority",      "uint8"},
{1483,      122,      "FRDoorPowerReleaseCtrlStruct",      "SequenceID",      "uint16"},
{1484,      122,      "FRDoorPowerReleaseCtrlStruct",      "ServiceExecuteFeedbackFlag",      "uint8"},
{1485,      122,      "FRDoorPowerReleaseCtrlStruct",      "Options",      "uint32"},
{1486,      122,      "FRDoorPowerReleaseCtrlStruct",      "FRDoorPowerReleaseCmd",      "uint8"},
{1487,      122,      "FRDoorPowerReleaseCtrlRespStruct",      "RespCode",      "uint32"},
{1488,      122,      "FRDoorPowerReleaseCtrlRespStruct",      "FRDoorPowerReleaseCtrlNRC",      "uint32"},
{1489,      123,      "DoorChildLockService_ErrStruct",      "SequenceID",      "uint16"},
{1490,      123,      "DoorChildLockService_ErrStruct",      "Options_8bit",      "uint8"},
{1491,      123,      "DoorChildLockService_ErrStruct",      "Options_8bit2",      "uint8"},
{1492,      123,      "DoorChildLockService_ErrStruct",      "UserID",      "uint32"},
{1493,      123,      "DoorChildLockService_ErrStruct",      "OpeNRC",      "uint32"},
{1494,      123,      "DoorChildLockService_ErrStruct",      "OpeErrInfo",      "string[16]"},
{1495,      124,      "DoorChildLockLogicStStruct",      "LChildLockLogicSt",      "uint8"},
{1496,      124,      "DoorChildLockLogicStStruct",      "RChildLockLogicSt",      "uint8"},
{1497,      125,      "SetRLDoorChildLockStruct",      "SOAProtocolVersion",      "uint8"},
{1498,      125,      "SetRLDoorChildLockStruct",      "SOAHeaderType",      "uint8"},
{1499,      125,      "SetRLDoorChildLockStruct",      "SOAHeaderLength",      "uint16"},
{1500,      125,      "SetRLDoorChildLockStruct",      "Flag",      "uint16"},
{1501,      125,      "SetRLDoorChildLockStruct",      "HeaderCRC16",      "uint16"},
{1502,      125,      "SetRLDoorChildLockStruct",      "UserID",      "uint32"},
{1503,      125,      "SetRLDoorChildLockStruct",      "ReqTimeOut",      "uint32"},
{1504,      125,      "SetRLDoorChildLockStruct",      "RequestPriority",      "uint8"},
{1505,      125,      "SetRLDoorChildLockStruct",      "SequenceID",      "uint16"},
{1506,      125,      "SetRLDoorChildLockStruct",      "ServiceExecuteFeedbackFlag",      "uint8"},
{1507,      125,      "SetRLDoorChildLockStruct",      "Options",      "uint32"},
{1508,      125,      "SetRLDoorChildLockStruct",      "RLDoorChildLockCtr",      "uint8"},
{1509,      125,      "SetRLDoorChildLockRespStruct",      "RespCode",      "uint32"},
{1510,      125,      "SetRLDoorChildLockRespStruct",      "SetRLDoorChildLockNRC",      "uint32"},
{1511,      126,      "SetRRDoorChildLockStruct",      "SOAProtocolVersion",      "uint8"},
{1512,      126,      "SetRRDoorChildLockStruct",      "SOAHeaderType",      "uint8"},
{1513,      126,      "SetRRDoorChildLockStruct",      "SOAHeaderLength",      "uint16"},
{1514,      126,      "SetRRDoorChildLockStruct",      "Flag",      "uint16"},
{1515,      126,      "SetRRDoorChildLockStruct",      "HeaderCRC16",      "uint16"},
{1516,      126,      "SetRRDoorChildLockStruct",      "UserID",      "uint32"},
{1517,      126,      "SetRRDoorChildLockStruct",      "ReqTimeOut",      "uint32"},
{1518,      126,      "SetRRDoorChildLockStruct",      "RequestPriority",      "uint8"},
{1519,      126,      "SetRRDoorChildLockStruct",      "SequenceID",      "uint16"},
{1520,      126,      "SetRRDoorChildLockStruct",      "ServiceExecuteFeedbackFlag",      "uint8"},
{1521,      126,      "SetRRDoorChildLockStruct",      "Options",      "uint32"},
{1522,      126,      "SetRRDoorChildLockStruct",      "RRDoorChildLockCtr",      "uint8"},
{1523,      126,      "SetRRDoorChildLockRespStruct",      "RespCode",      "uint32"},
{1524,      126,      "SetRRDoorChildLockRespStruct",      "SetRRDoorChildLockNRC",      "uint32"},
{1525,      127,      "TPMSStStruct",      "TPMSFaultWarn",      "uint8"},
{1526,      127,      "TPMSStStruct",      "TPMSAbnormalPrWarn",      "uint8"},
{1527,      127,      "TPMSStStruct",      "TPMSSensorResetSt",      "uint8"},
{1528,      127,      "TPMSStStruct",      "TPMSPrWarnFL",      "uint8"},
{1529,      127,      "TPMSStStruct",      "TPMSTempWarnFL",      "uint8"},
{1530,      127,      "TPMSStStruct",      "TPMSSensorStFL",      "uint8"},
{1531,      127,      "TPMSStStruct",      "TPMSSensorVoltWarnFL",      "uint8"},
{1532,      127,      "TPMSStStruct",      "TPMSFLSensorLossTime",      "uint8"},
{1533,      127,      "TPMSStStruct",      "TPMSPrWarnFR",      "uint8"},
{1534,      127,      "TPMSStStruct",      "TPMSTempWarnFR",      "uint8"},
{1535,      127,      "TPMSStStruct",      "TPMSSensorStFR",      "uint8"},
{1536,      127,      "TPMSStStruct",      "TPMSSensorVoltWarnFR",      "uint8"},
{1537,      127,      "TPMSStStruct",      "TPMSFRSensorLossTime",      "uint8"},
{1538,      127,      "TPMSStStruct",      "TPMSPrWarnRL",      "uint8"},
{1539,      127,      "TPMSStStruct",      "TPMSTempWarnRL",      "uint8"},
{1540,      127,      "TPMSStStruct",      "TPMSSensorStRL",      "uint8"},
{1541,      127,      "TPMSStStruct",      "TPMSSensorVoltWarnRL",      "uint8"},
{1542,      127,      "TPMSStStruct",      "TPMSRLSensorLossTime",      "uint8"},
{1543,      127,      "TPMSStStruct",      "TPMSPrWarnRR",      "uint8"},
{1544,      127,      "TPMSStStruct",      "TPMSTempWarnRR",      "uint8"},
{1545,      127,      "TPMSStStruct",      "TPMSSensorStRR",      "uint8"},
{1546,      127,      "TPMSStStruct",      "TPMSSensorVoltWarnRR",      "uint8"},
{1547,      127,      "TPMSStStruct",      "TPMSRRSensorLossTime",      "uint8"},
{1548,      127,      "TPMSStStruct",      "TPMSTempFL",      "sint16"},
{1549,      127,      "TPMSStStruct",      "TPMSTempFR",      "sint16"},
{1550,      127,      "TPMSStStruct",      "TPMSTempRL",      "sint16"},
{1551,      127,      "TPMSStStruct",      "TPMSTempRR",      "sint16"},
{1552,      127,      "TPMSStStruct",      "TPMSPrFL",      "float32"},
{1553,      127,      "TPMSStStruct",      "TPMSPrFR",      "float32"},
{1554,      127,      "TPMSStStruct",      "TPMSPrRL",      "float32"},
{1555,      127,      "TPMSStStruct",      "TPMSPrRR",      "float32"},
{1556,      127,      "TPMSStStruct",      "TPMSFrPrStd",      "uint16"},
{1557,      127,      "TPMSStStruct",      "TPMSRePrStd",      "uint16"},
{1558,      128,      "LExtMirrorService_ErrStruct",      "SequenceID",      "uint16"},
{1559,      128,      "LExtMirrorService_ErrStruct",      "Options_8bit",      "uint8"},
{1560,      128,      "LExtMirrorService_ErrStruct",      "Options_8bit2",      "uint8"},
{1561,      128,      "LExtMirrorService_ErrStruct",      "UserID",      "uint32"},
{1562,      128,      "LExtMirrorService_ErrStruct",      "OpeNRC",      "uint32"},
{1563,      128,      "LExtMirrorService_ErrStruct",      "OpeErrInfo",      "string[16]"},
{1564,      129,      "LMirrorPosStruct",      "LMirrorLRCurPos",      "float32"},
{1565,      129,      "LMirrorPosStruct",      "LMirrorUDCurPos",      "float32"},
{1566,      129,      "LMirrorPosStruct",      "LMirrorLRMemVoltFB",      "float32"},
{1567,      129,      "LMirrorPosStruct",      "LMirrorUDMemVoltFB",      "float32"},
{1568,      130,      "LMirrorStStruct",      "LMirrorFoldOutputSt",      "uint8"},
{1569,      130,      "LMirrorStStruct",      "LMirrorLRMotorOutput",      "uint8"},
{1570,      130,      "LMirrorStStruct",      "LMirrorUDMotorOutput",      "uint8"},
{1571,      130,      "LMirrorStStruct",      "TwoMirrorAutoFoldFB",      "uint8"},
{1572,      131,      "LMirrorDirCtrlStruct",      "SOAProtocolVersion",      "uint8"},
{1573,      131,      "LMirrorDirCtrlStruct",      "SOAHeaderType",      "uint8"},
{1574,      131,      "LMirrorDirCtrlStruct",      "SOAHeaderLength",      "uint16"},
{1575,      131,      "LMirrorDirCtrlStruct",      "Flag",      "uint16"},
{1576,      131,      "LMirrorDirCtrlStruct",      "HeaderCRC16",      "uint16"},
{1577,      131,      "LMirrorDirCtrlStruct",      "UserID",      "uint32"},
{1578,      131,      "LMirrorDirCtrlStruct",      "ReqTimeOut",      "uint32"},
{1579,      131,      "LMirrorDirCtrlStruct",      "RequestPriority",      "uint8"},
{1580,      131,      "LMirrorDirCtrlStruct",      "SequenceID",      "uint16"},
{1581,      131,      "LMirrorDirCtrlStruct",      "ServiceExecuteFeedbackFlag",      "uint8"},
{1582,      131,      "LMirrorDirCtrlStruct",      "Options",      "uint32"},
{1583,      131,      "LMirrorDirCtrlStruct",      "LMirrorDirCtrl",      "uint8"},
{1584,      131,      "CtrlLMirrorMoveRespStruct",      "RespCode",      "uint32"},
{1585,      131,      "CtrlLMirrorMoveRespStruct",      "CtrlLMirrorMoveNRC",      "uint32"},
{1586,      132,      "CtrlLMirrorPosStruct",      "SOAProtocolVersion",      "uint8"},
{1587,      132,      "CtrlLMirrorPosStruct",      "SOAHeaderType",      "uint8"},
{1588,      132,      "CtrlLMirrorPosStruct",      "SOAHeaderLength",      "uint16"},
{1589,      132,      "CtrlLMirrorPosStruct",      "Flag",      "uint16"},
{1590,      132,      "CtrlLMirrorPosStruct",      "HeaderCRC16",      "uint16"},
{1591,      132,      "CtrlLMirrorPosStruct",      "UserID",      "uint32"},
{1592,      132,      "CtrlLMirrorPosStruct",      "ReqTimeOut",      "uint32"},
{1593,      132,      "CtrlLMirrorPosStruct",      "RequestPriority",      "uint8"},
{1594,      132,      "CtrlLMirrorPosStruct",      "SequenceID",      "uint16"},
{1595,      132,      "CtrlLMirrorPosStruct",      "ServiceExecuteFeedbackFlag",      "uint8"},
{1596,      132,      "CtrlLMirrorPosStruct",      "Options",      "uint32"},
{1597,      132,      "CtrlLMirrorPosStruct",      "LMirrorLRDesPos",      "float32"},
{1598,      132,      "CtrlLMirrorPosStruct",      "LMirrorUDDesPos",      "float32"},
{1599,      132,      "CtrlLMirrorPosRespStruct",      "RespCode",      "uint32"},
{1600,      132,      "CtrlLMirrorPosRespStruct",      "CtrlLMirrorPosNRC",      "uint32"},
{1601,      133,      "TwoMirrorFoldStruct",      "SOAProtocolVersion",      "uint8"},
{1602,      133,      "TwoMirrorFoldStruct",      "SOAHeaderType",      "uint8"},
{1603,      133,      "TwoMirrorFoldStruct",      "SOAHeaderLength",      "uint16"},
{1604,      133,      "TwoMirrorFoldStruct",      "Flag",      "uint16"},
{1605,      133,      "TwoMirrorFoldStruct",      "HeaderCRC16",      "uint16"},
{1606,      133,      "TwoMirrorFoldStruct",      "UserID",      "uint32"},
{1607,      133,      "TwoMirrorFoldStruct",      "ReqTimeOut",      "uint32"},
{1608,      133,      "TwoMirrorFoldStruct",      "RequestPriority",      "uint8"},
{1609,      133,      "TwoMirrorFoldStruct",      "SequenceID",      "uint16"},
{1610,      133,      "TwoMirrorFoldStruct",      "ServiceExecuteFeedbackFlag",      "uint8"},
{1611,      133,      "TwoMirrorFoldStruct",      "Options",      "uint32"},
{1612,      133,      "TwoMirrorFoldStruct",      "TwoMirrorFold",      "uint8"},
{1613,      133,      "FoldTwoMirrorRespStruct",      "RespCode",      "uint32"},
{1614,      133,      "FoldTwoMirrorRespStruct",      "FoldTwoMirrorNRC",      "uint32"},
{1615,      134,      "TwoMirrorAutoFoldReqStruct",      "SOAProtocolVersion",      "uint8"},
{1616,      134,      "TwoMirrorAutoFoldReqStruct",      "SOAHeaderType",      "uint8"},
{1617,      134,      "TwoMirrorAutoFoldReqStruct",      "SOAHeaderLength",      "uint16"},
{1618,      134,      "TwoMirrorAutoFoldReqStruct",      "Flag",      "uint16"},
{1619,      134,      "TwoMirrorAutoFoldReqStruct",      "HeaderCRC16",      "uint16"},
{1620,      134,      "TwoMirrorAutoFoldReqStruct",      "UserID",      "uint32"},
{1621,      134,      "TwoMirrorAutoFoldReqStruct",      "ReqTimeOut",      "uint32"},
{1622,      134,      "TwoMirrorAutoFoldReqStruct",      "RequestPriority",      "uint8"},
{1623,      134,      "TwoMirrorAutoFoldReqStruct",      "SequenceID",      "uint16"},
{1624,      134,      "TwoMirrorAutoFoldReqStruct",      "ServiceExecuteFeedbackFlag",      "uint8"},
{1625,      134,      "TwoMirrorAutoFoldReqStruct",      "Options",      "uint32"},
{1626,      134,      "TwoMirrorAutoFoldReqStruct",      "TwoMirrorAutoFoldReq",      "uint8"},
{1627,      134,      "TwoMirrorAutoFoldCfgRespStruct",      "RespCode",      "uint32"},
{1628,      134,      "TwoMirrorAutoFoldCfgRespStruct",      "TwoMirrorAutoFoldCfgNRC",      "uint32"},
{1629,      135,      "CtrlLMirrorLRPosStruct",      "SOAProtocolVersion",      "uint8"},
{1630,      135,      "CtrlLMirrorLRPosStruct",      "SOAHeaderType",      "uint8"},
{1631,      135,      "CtrlLMirrorLRPosStruct",      "SOAHeaderLength",      "uint16"},
{1632,      135,      "CtrlLMirrorLRPosStruct",      "Flag",      "uint16"},
{1633,      135,      "CtrlLMirrorLRPosStruct",      "HeaderCRC16",      "uint16"},
{1634,      135,      "CtrlLMirrorLRPosStruct",      "UserID",      "uint32"},
{1635,      135,      "CtrlLMirrorLRPosStruct",      "ReqTimeOut",      "uint32"},
{1636,      135,      "CtrlLMirrorLRPosStruct",      "RequestPriority",      "uint8"},
{1637,      135,      "CtrlLMirrorLRPosStruct",      "SequenceID",      "uint16"},
{1638,      135,      "CtrlLMirrorLRPosStruct",      "ServiceExecuteFeedbackFlag",      "uint8"},
{1639,      135,      "CtrlLMirrorLRPosStruct",      "Options",      "uint32"},
{1640,      135,      "CtrlLMirrorLRPosStruct",      "LMirrorLRDesPos",      "float32"},
{1641,      135,      "CtrlLMirrorLRPosRespStruct",      "RespCode",      "uint32"},
{1642,      135,      "CtrlLMirrorLRPosRespStruct",      "CtrlLMirrorLRPosNRC",      "uint32"},
{1643,      136,      "CtrlLMirrorUDPosStruct",      "SOAProtocolVersion",      "uint8"},
{1644,      136,      "CtrlLMirrorUDPosStruct",      "SOAHeaderType",      "uint8"},
{1645,      136,      "CtrlLMirrorUDPosStruct",      "SOAHeaderLength",      "uint16"},
{1646,      136,      "CtrlLMirrorUDPosStruct",      "Flag",      "uint16"},
{1647,      136,      "CtrlLMirrorUDPosStruct",      "HeaderCRC16",      "uint16"},
{1648,      136,      "CtrlLMirrorUDPosStruct",      "UserID",      "uint32"},
{1649,      136,      "CtrlLMirrorUDPosStruct",      "ReqTimeOut",      "uint32"},
{1650,      136,      "CtrlLMirrorUDPosStruct",      "RequestPriority",      "uint8"},
{1651,      136,      "CtrlLMirrorUDPosStruct",      "SequenceID",      "uint16"},
{1652,      136,      "CtrlLMirrorUDPosStruct",      "ServiceExecuteFeedbackFlag",      "uint8"},
{1653,      136,      "CtrlLMirrorUDPosStruct",      "Options",      "uint32"},
{1654,      136,      "CtrlLMirrorUDPosStruct",      "LMirrorUDDesPos",      "float32"},
{1655,      136,      "CtrlLMirrorUDPosRespStruct",      "RespCode",      "uint32"},
{1656,      136,      "CtrlLMirrorUDPosRespStruct",      "CtrlLMirrorUDPosNRC",      "uint32"},
{1657,      137,      "SyncLMirrorPosStruct",      "SOAProtocolVersion",      "uint8"},
{1658,      137,      "SyncLMirrorPosStruct",      "SOAHeaderType",      "uint8"},
{1659,      137,      "SyncLMirrorPosStruct",      "SOAHeaderLength",      "uint16"},
{1660,      137,      "SyncLMirrorPosStruct",      "Flag",      "uint16"},
{1661,      137,      "SyncLMirrorPosStruct",      "HeaderCRC16",      "uint16"},
{1662,      137,      "SyncLMirrorPosStruct",      "UserID",      "uint32"},
{1663,      137,      "SyncLMirrorPosStruct",      "ReqTimeOut",      "uint32"},
{1664,      137,      "SyncLMirrorPosStruct",      "RequestPriority",      "uint8"},
{1665,      137,      "SyncLMirrorPosStruct",      "SequenceID",      "uint16"},
{1666,      137,      "SyncLMirrorPosStruct",      "ServiceExecuteFeedbackFlag",      "uint8"},
{1667,      137,      "SyncLMirrorPosStruct",      "Options",      "uint32"},
{1668,      137,      "SyncLMirrorPosStruct",      "LMirrorLRDesPos",      "float32"},
{1669,      137,      "SyncLMirrorPosRespStruct",      "RespCode",      "uint32"},
{1670,      137,      "SyncLMirrorPosRespStruct",      "SyncLMirrorPosNRC",      "uint32"},
{1671,      138,      "RExtMirrorService_ErrStruct",      "SequenceID",      "uint16"},
{1672,      138,      "RExtMirrorService_ErrStruct",      "Options_8bit",      "uint8"},
{1673,      138,      "RExtMirrorService_ErrStruct",      "Options_8bit2",      "uint8"},
{1674,      138,      "RExtMirrorService_ErrStruct",      "UserID",      "uint32"},
{1675,      138,      "RExtMirrorService_ErrStruct",      "OpeNRC",      "uint32"},
{1676,      138,      "RExtMirrorService_ErrStruct",      "OpeErrInfo",      "string[16]"},
{1677,      139,      "RMirrorPosStruct",      "RMirrorLRCurPos",      "float32"},
{1678,      139,      "RMirrorPosStruct",      "RMirrorUDCurPos",      "float32"},
{1679,      139,      "RMirrorPosStruct",      "RMirrorLRMemVoltFB",      "float32"},
{1680,      139,      "RMirrorPosStruct",      "RMirrorUDMemVoltFB",      "float32"},
{1681,      140,      "RMirrorStStruct",      "RMirrorFoldOutputSt",      "uint8"},
{1682,      140,      "RMirrorStStruct",      "RMirrorLRMotorOutput",      "uint8"},
{1683,      140,      "RMirrorStStruct",      "RMirrorUDMotorOutput",      "uint8"},
{1684,      141,      "RMirrorDirCtrlStruct",      "SOAProtocolVersion",      "uint8"},
{1685,      141,      "RMirrorDirCtrlStruct",      "SOAHeaderType",      "uint8"},
{1686,      141,      "RMirrorDirCtrlStruct",      "SOAHeaderLength",      "uint16"},
{1687,      141,      "RMirrorDirCtrlStruct",      "Flag",      "uint16"},
{1688,      141,      "RMirrorDirCtrlStruct",      "HeaderCRC16",      "uint16"},
{1689,      141,      "RMirrorDirCtrlStruct",      "UserID",      "uint32"},
{1690,      141,      "RMirrorDirCtrlStruct",      "ReqTimeOut",      "uint32"},
{1691,      141,      "RMirrorDirCtrlStruct",      "RequestPriority",      "uint8"},
{1692,      141,      "RMirrorDirCtrlStruct",      "SequenceID",      "uint16"},
{1693,      141,      "RMirrorDirCtrlStruct",      "ServiceExecuteFeedbackFlag",      "uint8"},
{1694,      141,      "RMirrorDirCtrlStruct",      "Options",      "uint32"},
{1695,      141,      "RMirrorDirCtrlStruct",      "RMirrorDirCtrl",      "uint8"},
{1696,      141,      "CtrlRMirrorMoveRespStruct",      "RespCode",      "uint32"},
{1697,      141,      "CtrlRMirrorMoveRespStruct",      "CtrlRMirrorMoveNRC",      "uint32"},
{1698,      142,      "CtrlRMirrorPosStruct",      "SOAProtocolVersion",      "uint8"},
{1699,      142,      "CtrlRMirrorPosStruct",      "SOAHeaderType",      "uint8"},
{1700,      142,      "CtrlRMirrorPosStruct",      "SOAHeaderLength",      "uint16"},
{1701,      142,      "CtrlRMirrorPosStruct",      "Flag",      "uint16"},
{1702,      142,      "CtrlRMirrorPosStruct",      "HeaderCRC16",      "uint16"},
{1703,      142,      "CtrlRMirrorPosStruct",      "UserID",      "uint32"},
{1704,      142,      "CtrlRMirrorPosStruct",      "ReqTimeOut",      "uint32"},
{1705,      142,      "CtrlRMirrorPosStruct",      "RequestPriority",      "uint8"},
{1706,      142,      "CtrlRMirrorPosStruct",      "SequenceID",      "uint16"},
{1707,      142,      "CtrlRMirrorPosStruct",      "ServiceExecuteFeedbackFlag",      "uint8"},
{1708,      142,      "CtrlRMirrorPosStruct",      "Options",      "uint32"},
{1709,      142,      "CtrlRMirrorPosStruct",      "RMirrorLRDesPos",      "float32"},
{1710,      142,      "CtrlRMirrorPosStruct",      "RMirrorUDDesPos",      "float32"},
{1711,      142,      "CtrlRMirrorPosRespStruct",      "RespCode",      "uint32"},
{1712,      142,      "CtrlRMirrorPosRespStruct",      "CtrlRMirrorPosNRC",      "uint32"},
{1713,      143,      "CtrlRMirrorLRPosStruct",      "SOAProtocolVersion",      "uint8"},
{1714,      143,      "CtrlRMirrorLRPosStruct",      "SOAHeaderType",      "uint8"},
{1715,      143,      "CtrlRMirrorLRPosStruct",      "SOAHeaderLength",      "uint16"},
{1716,      143,      "CtrlRMirrorLRPosStruct",      "Flag",      "uint16"},
{1717,      143,      "CtrlRMirrorLRPosStruct",      "HeaderCRC16",      "uint16"},
{1718,      143,      "CtrlRMirrorLRPosStruct",      "UserID",      "uint32"},
{1719,      143,      "CtrlRMirrorLRPosStruct",      "ReqTimeOut",      "uint32"},
{1720,      143,      "CtrlRMirrorLRPosStruct",      "RequestPriority",      "uint8"},
{1721,      143,      "CtrlRMirrorLRPosStruct",      "SequenceID",      "uint16"},
{1722,      143,      "CtrlRMirrorLRPosStruct",      "ServiceExecuteFeedbackFlag",      "uint8"},
{1723,      143,      "CtrlRMirrorLRPosStruct",      "Options",      "uint32"},
{1724,      143,      "CtrlRMirrorLRPosStruct",      "RMirrorLRDesPos",      "float32"},
{1725,      143,      "CtrlRMirrorLRPosRespStruct",      "RespCode",      "uint32"},
{1726,      143,      "CtrlRMirrorLRPosRespStruct",      "CtrlRMirrorLRPosNRC",      "uint32"},
{1727,      144,      "CtrlRMirrorUDPosStruct",      "SOAProtocolVersion",      "uint8"},
{1728,      144,      "CtrlRMirrorUDPosStruct",      "SOAHeaderType",      "uint8"},
{1729,      144,      "CtrlRMirrorUDPosStruct",      "SOAHeaderLength",      "uint16"},
{1730,      144,      "CtrlRMirrorUDPosStruct",      "Flag",      "uint16"},
{1731,      144,      "CtrlRMirrorUDPosStruct",      "HeaderCRC16",      "uint16"},
{1732,      144,      "CtrlRMirrorUDPosStruct",      "UserID",      "uint32"},
{1733,      144,      "CtrlRMirrorUDPosStruct",      "ReqTimeOut",      "uint32"},
{1734,      144,      "CtrlRMirrorUDPosStruct",      "RequestPriority",      "uint8"},
{1735,      144,      "CtrlRMirrorUDPosStruct",      "SequenceID",      "uint16"},
{1736,      144,      "CtrlRMirrorUDPosStruct",      "ServiceExecuteFeedbackFlag",      "uint8"},
{1737,      144,      "CtrlRMirrorUDPosStruct",      "Options",      "uint32"},
{1738,      144,      "CtrlRMirrorUDPosStruct",      "RMirrorUDDesPos",      "float32"},
{1739,      144,      "CtrlRMirrorUDPosRespStruct",      "RespCode",      "uint32"},
{1740,      144,      "CtrlRMirrorUDPosRespStruct",      "CtrlRMirrorUDPosNRC",      "uint32"},
{1741,      145,      "SyncRMirrorPosStruct",      "SOAProtocolVersion",      "uint8"},
{1742,      145,      "SyncRMirrorPosStruct",      "SOAHeaderType",      "uint8"},
{1743,      145,      "SyncRMirrorPosStruct",      "SOAHeaderLength",      "uint16"},
{1744,      145,      "SyncRMirrorPosStruct",      "Flag",      "uint16"},
{1745,      145,      "SyncRMirrorPosStruct",      "HeaderCRC16",      "uint16"},
{1746,      145,      "SyncRMirrorPosStruct",      "UserID",      "uint32"},
{1747,      145,      "SyncRMirrorPosStruct",      "ReqTimeOut",      "uint32"},
{1748,      145,      "SyncRMirrorPosStruct",      "RequestPriority",      "uint8"},
{1749,      145,      "SyncRMirrorPosStruct",      "SequenceID",      "uint16"},
{1750,      145,      "SyncRMirrorPosStruct",      "ServiceExecuteFeedbackFlag",      "uint8"},
{1751,      145,      "SyncRMirrorPosStruct",      "Options",      "uint32"},
{1752,      145,      "SyncRMirrorPosStruct",      "RMirrorLRDesPos",      "float32"},
{1753,      145,      "SyncRMirrorPosRespStruct",      "RespCode",      "uint32"},
{1754,      145,      "SyncRMirrorPosRespStruct",      "SyncRMirrorPosNRC",      "uint32"},
{1755,      146,      "LightCtrl_ErrStruct",      "SequenceID",      "uint16"},
{1756,      146,      "LightCtrl_ErrStruct",      "Options_8bit",      "uint8"},
{1757,      146,      "LightCtrl_ErrStruct",      "Options_8bit2",      "uint8"},
{1758,      146,      "LightCtrl_ErrStruct",      "UserID",      "uint32"},
{1759,      146,      "LightCtrl_ErrStruct",      "OpeNRC",      "uint32"},
{1760,      146,      "LightCtrl_ErrStruct",      "OpeErrInfo",      "string[16]"},
{1761,      147,      "LightsStStruct",      "LowBeamOutputSt",      "uint8"},
{1762,      147,      "LightsStStruct",      "HighBeamOutputSt",      "uint8"},
{1763,      147,      "LightsStStruct",      "ParkinglightOutputSt",      "uint8"},
{1764,      147,      "LightsStStruct",      "LTurnLampOutputSt",      "uint8"},
{1765,      147,      "LightsStStruct",      "RTurnLampOutputSt",      "uint8"},
{1766,      147,      "LightsStStruct",      "RearFogLampOutputSt",      "uint8"},
{1767,      147,      "LightsStStruct",      "ReversinglampOutputSt",      "uint8"},
{1768,      147,      "LightsStStruct",      "BrkLightOutputSt",      "uint8"},
{1769,      148,      "LowbeamCmdStruct",      "SOAProtocolVersion",      "uint8"},
{1770,      148,      "LowbeamCmdStruct",      "SOAHeaderType",      "uint8"},
{1771,      148,      "LowbeamCmdStruct",      "SOAHeaderLength",      "uint16"},
{1772,      148,      "LowbeamCmdStruct",      "Flag",      "uint16"},
{1773,      148,      "LowbeamCmdStruct",      "HeaderCRC16",      "uint16"},
{1774,      148,      "LowbeamCmdStruct",      "UserID",      "uint32"},
{1775,      148,      "LowbeamCmdStruct",      "ReqTimeOut",      "uint32"},
{1776,      148,      "LowbeamCmdStruct",      "RequestPriority",      "uint8"},
{1777,      148,      "LowbeamCmdStruct",      "SequenceID",      "uint16"},
{1778,      148,      "LowbeamCmdStruct",      "ServiceExecuteFeedbackFlag",      "uint8"},
{1779,      148,      "LowbeamCmdStruct",      "Options",      "uint32"},
{1780,      148,      "LowbeamCmdStruct",      "LowbeamCmd",      "uint8"},
{1781,      148,      "LowbeamCtrlRespStruct",      "RespCode",      "uint32"},
{1782,      148,      "LowbeamCtrlRespStruct",      "LowbeamCtrlNRC",      "uint32"},
{1783,      149,      "HighbeamCmdStruct",      "SOAProtocolVersion",      "uint8"},
{1784,      149,      "HighbeamCmdStruct",      "SOAHeaderType",      "uint8"},
{1785,      149,      "HighbeamCmdStruct",      "SOAHeaderLength",      "uint16"},
{1786,      149,      "HighbeamCmdStruct",      "Flag",      "uint16"},
{1787,      149,      "HighbeamCmdStruct",      "HeaderCRC16",      "uint16"},
{1788,      149,      "HighbeamCmdStruct",      "UserID",      "uint32"},
{1789,      149,      "HighbeamCmdStruct",      "ReqTimeOut",      "uint32"},
{1790,      149,      "HighbeamCmdStruct",      "RequestPriority",      "uint8"},
{1791,      149,      "HighbeamCmdStruct",      "SequenceID",      "uint16"},
{1792,      149,      "HighbeamCmdStruct",      "ServiceExecuteFeedbackFlag",      "uint8"},
{1793,      149,      "HighbeamCmdStruct",      "Options",      "uint32"},
{1794,      149,      "HighbeamCmdStruct",      "HighbeamCmd",      "uint8"},
{1795,      149,      "HighbeamCtrlRespStruct",      "RespCode",      "uint32"},
{1796,      149,      "HighbeamCtrlRespStruct",      "HighbeamCtrlNRC",      "uint32"},
{1797,      150,      "ParkingLightCmdStruct",      "SOAProtocolVersion",      "uint8"},
{1798,      150,      "ParkingLightCmdStruct",      "SOAHeaderType",      "uint8"},
{1799,      150,      "ParkingLightCmdStruct",      "SOAHeaderLength",      "uint16"},
{1800,      150,      "ParkingLightCmdStruct",      "Flag",      "uint16"},
{1801,      150,      "ParkingLightCmdStruct",      "HeaderCRC16",      "uint16"},
{1802,      150,      "ParkingLightCmdStruct",      "UserID",      "uint32"},
{1803,      150,      "ParkingLightCmdStruct",      "ReqTimeOut",      "uint32"},
{1804,      150,      "ParkingLightCmdStruct",      "RequestPriority",      "uint8"},
{1805,      150,      "ParkingLightCmdStruct",      "SequenceID",      "uint16"},
{1806,      150,      "ParkingLightCmdStruct",      "ServiceExecuteFeedbackFlag",      "uint8"},
{1807,      150,      "ParkingLightCmdStruct",      "Options",      "uint32"},
{1808,      150,      "ParkingLightCmdStruct",      "ParkingLightCmd",      "uint8"},
{1809,      150,      "ParkinglightCtrlRespStruct",      "RespCode",      "uint32"},
{1810,      150,      "ParkinglightCtrlRespStruct",      "ParkinglightCtrlNRC",      "uint32"},
{1811,      151,      "LTurnLightCmdStruct",      "SOAProtocolVersion",      "uint8"},
{1812,      151,      "LTurnLightCmdStruct",      "SOAHeaderType",      "uint8"},
{1813,      151,      "LTurnLightCmdStruct",      "SOAHeaderLength",      "uint16"},
{1814,      151,      "LTurnLightCmdStruct",      "Flag",      "uint16"},
{1815,      151,      "LTurnLightCmdStruct",      "HeaderCRC16",      "uint16"},
{1816,      151,      "LTurnLightCmdStruct",      "UserID",      "uint32"},
{1817,      151,      "LTurnLightCmdStruct",      "ReqTimeOut",      "uint32"},
{1818,      151,      "LTurnLightCmdStruct",      "RequestPriority",      "uint8"},
{1819,      151,      "LTurnLightCmdStruct",      "SequenceID",      "uint16"},
{1820,      151,      "LTurnLightCmdStruct",      "ServiceExecuteFeedbackFlag",      "uint8"},
{1821,      151,      "LTurnLightCmdStruct",      "Options",      "uint32"},
{1822,      151,      "LTurnLightCmdStruct",      "LTurnLightCmd",      "uint8"},
{1823,      151,      "LTurnLighCtrlRespStruct",      "RespCode",      "uint32"},
{1824,      151,      "LTurnLighCtrlRespStruct",      "LTurnLighCtrlNRC",      "uint32"},
{1825,      152,      "RTurnLightCmdStruct",      "SOAProtocolVersion",      "uint8"},
{1826,      152,      "RTurnLightCmdStruct",      "SOAHeaderType",      "uint8"},
{1827,      152,      "RTurnLightCmdStruct",      "SOAHeaderLength",      "uint16"},
{1828,      152,      "RTurnLightCmdStruct",      "Flag",      "uint16"},
{1829,      152,      "RTurnLightCmdStruct",      "HeaderCRC16",      "uint16"},
{1830,      152,      "RTurnLightCmdStruct",      "UserID",      "uint32"},
{1831,      152,      "RTurnLightCmdStruct",      "ReqTimeOut",      "uint32"},
{1832,      152,      "RTurnLightCmdStruct",      "RequestPriority",      "uint8"},
{1833,      152,      "RTurnLightCmdStruct",      "SequenceID",      "uint16"},
{1834,      152,      "RTurnLightCmdStruct",      "ServiceExecuteFeedbackFlag",      "uint8"},
{1835,      152,      "RTurnLightCmdStruct",      "Options",      "uint32"},
{1836,      152,      "RTurnLightCmdStruct",      "RTurnLightCmd",      "uint8"},
{1837,      152,      "RTurnLightCtrlRespStruct",      "RespCode",      "uint32"},
{1838,      152,      "RTurnLightCtrlRespStruct",      "RTurnLightCtrlNRC",      "uint32"},
{1839,      153,      "HazardLightCmdStruct",      "SOAProtocolVersion",      "uint8"},
{1840,      153,      "HazardLightCmdStruct",      "SOAHeaderType",      "uint8"},
{1841,      153,      "HazardLightCmdStruct",      "SOAHeaderLength",      "uint16"},
{1842,      153,      "HazardLightCmdStruct",      "Flag",      "uint16"},
{1843,      153,      "HazardLightCmdStruct",      "HeaderCRC16",      "uint16"},
{1844,      153,      "HazardLightCmdStruct",      "UserID",      "uint32"},
{1845,      153,      "HazardLightCmdStruct",      "ReqTimeOut",      "uint32"},
{1846,      153,      "HazardLightCmdStruct",      "RequestPriority",      "uint8"},
{1847,      153,      "HazardLightCmdStruct",      "SequenceID",      "uint16"},
{1848,      153,      "HazardLightCmdStruct",      "ServiceExecuteFeedbackFlag",      "uint8"},
{1849,      153,      "HazardLightCmdStruct",      "Options",      "uint32"},
{1850,      153,      "HazardLightCmdStruct",      "HazardLightCmd",      "uint8"},
{1851,      153,      "HazardLightCmdStruct",      "FLashtimes",      "uint8"},
{1852,      153,      "HazardLightCmdStruct",      "FlashMandatory",      "uint8"},
{1853,      153,      "HazardLightCmdStruct",      "PeriodDouble",      "uint8"},
{1854,      153,      "HazardLightCtrlRespStruct",      "RespCode",      "uint32"},
{1855,      153,      "HazardLightCtrlRespStruct",      "HazardLightCtrlNRC",      "uint32"},
{1856,      154,      "RearFogLampCmdStruct",      "SOAProtocolVersion",      "uint8"},
{1857,      154,      "RearFogLampCmdStruct",      "SOAHeaderType",      "uint8"},
{1858,      154,      "RearFogLampCmdStruct",      "SOAHeaderLength",      "uint16"},
{1859,      154,      "RearFogLampCmdStruct",      "Flag",      "uint16"},
{1860,      154,      "RearFogLampCmdStruct",      "HeaderCRC16",      "uint16"},
{1861,      154,      "RearFogLampCmdStruct",      "UserID",      "uint32"},
{1862,      154,      "RearFogLampCmdStruct",      "ReqTimeOut",      "uint32"},
{1863,      154,      "RearFogLampCmdStruct",      "RequestPriority",      "uint8"},
{1864,      154,      "RearFogLampCmdStruct",      "SequenceID",      "uint16"},
{1865,      154,      "RearFogLampCmdStruct",      "ServiceExecuteFeedbackFlag",      "uint8"},
{1866,      154,      "RearFogLampCmdStruct",      "Options",      "uint32"},
{1867,      154,      "RearFogLampCmdStruct",      "RearFogLampCmd",      "uint8"},
{1868,      154,      "RearFogLampCtrlRespStruct",      "RespCode",      "uint32"},
{1869,      154,      "RearFogLampCtrlRespStruct",      "RearFogLampCtrlNRC",      "uint32"},
{1870,      155,      "RLDoorPowerRelService_ErrStruct",      "SequenceID",      "uint16"},
{1871,      155,      "RLDoorPowerRelService_ErrStruct",      "Options_8bit",      "uint8"},
{1872,      155,      "RLDoorPowerRelService_ErrStruct",      "Options_8bit2",      "uint8"},
{1873,      155,      "RLDoorPowerRelService_ErrStruct",      "UserID",      "uint32"},
{1874,      155,      "RLDoorPowerRelService_ErrStruct",      "OpeNRC",      "uint32"},
{1875,      155,      "RLDoorPowerRelService_ErrStruct",      "OpeErrInfo",      "string[16]"},
{1876,      156,      "RLDoorSwSt1Struct",      "RLDoorReleaseSource",      "uint8"},
{1877,      156,      "RLDoorSwSt1Struct",      "RLDoorReleaseEvent",      "uint8"},
{1878,      156,      "RLDoorSwSt1Struct",      "RLDoorCinchEvent",      "uint8"},
{1879,      156,      "RLDoorSwSt1Struct",      "RLDoorAjarSt",      "uint8"},
{1880,      156,      "RLDoorSwSt1Struct",      "RLChildLockOrDoorOpenSt",      "uint8"},
{1881,      156,      "RLDoorSwSt1Struct",      "RLDoorReleaseSWSt",      "uint8"},
{1882,      156,      "RLDoorSwSt1Struct",      "RLHandleSt",      "uint8"},
{1883,      156,      "RLDoorSwSt1Struct",      "RLDoorPawlSt",      "uint8"},
{1884,      156,      "RLDoorSwSt1Struct",      "RLDoorCinchHomeSt",      "uint8"},
{1885,      156,      "RLDoorSwSt1Struct",      "RLDoorUnlockSwSt",      "uint8"},
{1886,      156,      "RLDoorSwSt1Struct",      "RLDoorGearUnlockSwSt",      "uint8"},
{1887,      156,      "RLDoorSwSt1Struct",      "RLCinchMotorOutput",      "uint8"},
{1888,      156,      "RLDoorSwSt1Struct",      "RLReleaseMotorOutput",      "uint8"},
{1889,      156,      "RLDoorSwSt1Struct",      "RLDoorReleaseActSt",      "uint8"},
{1890,      156,      "RLDoorSwSt1Struct",      "RLDoorCinchActSt",      "uint8"},
{1891,      156,      "RLDoorSwSt1Struct",      "RLDoorARAActSt",      "uint8"},
{1892,      156,      "RLDoorSwSt1Struct",      "RLDoorReleaseWarming",      "uint8"},
{1893,      156,      "RLDoorSwSt1Struct",      "RLDoorCinchWarming",      "uint8"},
{1894,      156,      "RLDoorSwSt1Struct",      "RLDoorCrashUnlockWarn",      "uint8"},
{1895,      156,      "RLDoorSwSt1Struct",      "RLDoorGULSwWarn",      "uint8"},
{1896,      156,      "RLDoorSwSt1Struct",      "RLDoorULSwWarn",      "uint8"},
{1897,      157,      "RLDoorPowerReleaseCtrlStruct",      "SOAProtocolVersion",      "uint8"},
{1898,      157,      "RLDoorPowerReleaseCtrlStruct",      "SOAHeaderType",      "uint8"},
{1899,      157,      "RLDoorPowerReleaseCtrlStruct",      "SOAHeaderLength",      "uint16"},
{1900,      157,      "RLDoorPowerReleaseCtrlStruct",      "Flag",      "uint16"},
{1901,      157,      "RLDoorPowerReleaseCtrlStruct",      "HeaderCRC16",      "uint16"},
{1902,      157,      "RLDoorPowerReleaseCtrlStruct",      "UserID",      "uint32"},
{1903,      157,      "RLDoorPowerReleaseCtrlStruct",      "ReqTimeOut",      "uint32"},
{1904,      157,      "RLDoorPowerReleaseCtrlStruct",      "RequestPriority",      "uint8"},
{1905,      157,      "RLDoorPowerReleaseCtrlStruct",      "SequenceID",      "uint16"},
{1906,      157,      "RLDoorPowerReleaseCtrlStruct",      "ServiceExecuteFeedbackFlag",      "uint8"},
{1907,      157,      "RLDoorPowerReleaseCtrlStruct",      "Options",      "uint32"},
{1908,      157,      "RLDoorPowerReleaseCtrlStruct",      "RLDoorPowerReleaseCmd",      "uint8"},
{1909,      157,      "RLDoorPowerReleaseCtrlRespStruct",      "RespCode",      "uint32"},
{1910,      157,      "RLDoorPowerReleaseCtrlRespStruct",      "RLDoorPowerReleaseCtrlNRC",      "uint32"},
{1911,      158,      "RRDoorPowerRelService_ErrStruct",      "SequenceID",      "uint16"},
{1912,      158,      "RRDoorPowerRelService_ErrStruct",      "Options_8bit",      "uint8"},
{1913,      158,      "RRDoorPowerRelService_ErrStruct",      "Options_8bit2",      "uint8"},
{1914,      158,      "RRDoorPowerRelService_ErrStruct",      "UserID",      "uint32"},
{1915,      158,      "RRDoorPowerRelService_ErrStruct",      "OpeNRC",      "uint32"},
{1916,      158,      "RRDoorPowerRelService_ErrStruct",      "OpeErrInfo",      "string[16]"},
{1917,      159,      "RRDoorSwSt1Struct",      "RRDoorReleaseSource",      "uint8"},
{1918,      159,      "RRDoorSwSt1Struct",      "RRDoorReleaseEvent",      "uint8"},
{1919,      159,      "RRDoorSwSt1Struct",      "RRDoorCinchEvent",      "uint8"},
{1920,      159,      "RRDoorSwSt1Struct",      "RRDoorAjarSt",      "uint8"},
{1921,      159,      "RRDoorSwSt1Struct",      "RRDoorOpenSt",      "uint8"},
{1922,      159,      "RRDoorSwSt1Struct",      "RRDoorReleaseSWSt",      "uint8"},
{1923,      159,      "RRDoorSwSt1Struct",      "RRHandleSt",      "uint8"},
{1924,      159,      "RRDoorSwSt1Struct",      "RRDoorPawlSt",      "uint8"},
{1925,      159,      "RRDoorSwSt1Struct",      "RRDoorCinchHomeSt",      "uint8"},
{1926,      159,      "RRDoorSwSt1Struct",      "RRDoorUnlockSwSt",      "uint8"},
{1927,      159,      "RRDoorSwSt1Struct",      "RRDoorGearUnlockSwSt",      "uint8"},
{1928,      159,      "RRDoorSwSt1Struct",      "RRCinchMotorOutput",      "uint8"},
{1929,      159,      "RRDoorSwSt1Struct",      "RRReleaseMotorOutput",      "uint8"},
{1930,      159,      "RRDoorSwSt1Struct",      "RRDoorReleaseActSt",      "uint8"},
{1931,      159,      "RRDoorSwSt1Struct",      "RRDoorCinchActSt",      "uint8"},
{1932,      159,      "RRDoorSwSt1Struct",      "RRDoorARAActSt",      "uint8"},
{1933,      159,      "RRDoorSwSt1Struct",      "RRDoorReleaseWarming",      "uint8"},
{1934,      159,      "RRDoorSwSt1Struct",      "RRDoorCinchWarming",      "uint8"},
{1935,      159,      "RRDoorSwSt1Struct",      "RRDoorCrashUnlockWarn",      "uint8"},
{1936,      159,      "RRDoorSwSt1Struct",      "RRDoorGULSwWarn",      "uint8"},
{1937,      159,      "RRDoorSwSt1Struct",      "RRDoorULSwWarn",      "uint8"},
{1938,      160,      "RRDoorPowerReleaseCtrlStruct",      "SOAProtocolVersion",      "uint8"},
{1939,      160,      "RRDoorPowerReleaseCtrlStruct",      "SOAHeaderType",      "uint8"},
{1940,      160,      "RRDoorPowerReleaseCtrlStruct",      "SOAHeaderLength",      "uint16"},
{1941,      160,      "RRDoorPowerReleaseCtrlStruct",      "Flag",      "uint16"},
{1942,      160,      "RRDoorPowerReleaseCtrlStruct",      "HeaderCRC16",      "uint16"},
{1943,      160,      "RRDoorPowerReleaseCtrlStruct",      "UserID",      "uint32"},
{1944,      160,      "RRDoorPowerReleaseCtrlStruct",      "ReqTimeOut",      "uint32"},
{1945,      160,      "RRDoorPowerReleaseCtrlStruct",      "RequestPriority",      "uint8"},
{1946,      160,      "RRDoorPowerReleaseCtrlStruct",      "SequenceID",      "uint16"},
{1947,      160,      "RRDoorPowerReleaseCtrlStruct",      "ServiceExecuteFeedbackFlag",      "uint8"},
{1948,      160,      "RRDoorPowerReleaseCtrlStruct",      "Options",      "uint32"},
{1949,      160,      "RRDoorPowerReleaseCtrlStruct",      "RRDoorPowerReleaseCmd",      "uint8"},
{1950,      160,      "RRDoorPowerReleaseCtrlRespStruct",      "RespCode",      "uint32"},
{1951,      160,      "RRDoorPowerReleaseCtrlRespStruct",      "RRDoorPowerReleaseCtrlNRC",      "uint32"},
{1952,      161,      "ChargePortCtrlService_ErrStruct",      "SequenceID",      "uint16"},
{1953,      161,      "ChargePortCtrlService_ErrStruct",      "Options_8bit",      "uint8"},
{1954,      161,      "ChargePortCtrlService_ErrStruct",      "Options_8bit2",      "uint8"},
{1955,      161,      "ChargePortCtrlService_ErrStruct",      "UserID",      "uint32"},
{1956,      161,      "ChargePortCtrlService_ErrStruct",      "OpeNRC",      "uint32"},
{1957,      161,      "ChargePortCtrlService_ErrStruct",      "OpeErrInfo",      "string[16]"},
{1958,      162,      "ChargePortStateStruct",      "ChrgConnStReq",      "uint8"},
{1959,      162,      "ChargePortStateStruct",      "ChargePortOpenZone",      "uint8"},
{1960,      162,      "ChargePortStateStruct",      "ChargePortPos",      "uint8"},
{1961,      162,      "ChargePortStateStruct",      "ChrgPortLockSt",      "uint8"},
{1962,      162,      "ChargePortStateStruct",      "ChrgPortLockOutputSt",      "uint8"},
{1963,      162,      "ChargePortStateStruct",      "ChrgConnSt_Disp",      "uint8"},
{1964,      162,      "ChargePortStateStruct",      "ChargePortcloseSource",      "uint8"},
{1965,      162,      "ChargePortStateStruct",      "ChargePortActSt",      "uint8"},
{1966,      162,      "ChargePortStateStruct",      "ChargePortopenSource",      "uint8"},
{1967,      163,      "ChargePortState2Struct",      "ChargePortSesorPercent",      "float32"},
{1968,      163,      "ChargePortState2Struct",      "ChargePortOpenAngle",      "float32"},
{1969,      164,      "ChargePortCtrlStruct",      "SOAProtocolVersion",      "uint8"},
{1970,      164,      "ChargePortCtrlStruct",      "SOAHeaderType",      "uint8"},
{1971,      164,      "ChargePortCtrlStruct",      "SOAHeaderLength",      "uint16"},
{1972,      164,      "ChargePortCtrlStruct",      "Flag",      "uint16"},
{1973,      164,      "ChargePortCtrlStruct",      "HeaderCRC16",      "uint16"},
{1974,      164,      "ChargePortCtrlStruct",      "UserID",      "uint32"},
{1975,      164,      "ChargePortCtrlStruct",      "ReqTimeOut",      "uint32"},
{1976,      164,      "ChargePortCtrlStruct",      "RequestPriority",      "uint8"},
{1977,      164,      "ChargePortCtrlStruct",      "SequenceID",      "uint16"},
{1978,      164,      "ChargePortCtrlStruct",      "ServiceExecuteFeedbackFlag",      "uint8"},
{1979,      164,      "ChargePortCtrlStruct",      "Options",      "uint32"},
{1980,      164,      "ChargePortCtrlStruct",      "ChargePortCmd",      "uint8"},
{1981,      164,      "ChargePortCtrlRespStruct",      "RespCode",      "uint32"},
{1982,      164,      "ChargePortCtrlRespStruct",      "ChargePortCtrlNRC",      "uint32"},
{1983,      165,      "ChargePortLockCtrlStruct",      "SOAProtocolVersion",      "uint8"},
{1984,      165,      "ChargePortLockCtrlStruct",      "SOAHeaderType",      "uint8"},
{1985,      165,      "ChargePortLockCtrlStruct",      "SOAHeaderLength",      "uint16"},
{1986,      165,      "ChargePortLockCtrlStruct",      "Flag",      "uint16"},
{1987,      165,      "ChargePortLockCtrlStruct",      "HeaderCRC16",      "uint16"},
{1988,      165,      "ChargePortLockCtrlStruct",      "UserID",      "uint32"},
{1989,      165,      "ChargePortLockCtrlStruct",      "ReqTimeOut",      "uint32"},
{1990,      165,      "ChargePortLockCtrlStruct",      "RequestPriority",      "uint8"},
{1991,      165,      "ChargePortLockCtrlStruct",      "SequenceID",      "uint16"},
{1992,      165,      "ChargePortLockCtrlStruct",      "ServiceExecuteFeedbackFlag",      "uint8"},
{1993,      165,      "ChargePortLockCtrlStruct",      "Options",      "uint32"},
{1994,      165,      "ChargePortLockCtrlStruct",      "ChargePortLockCmd",      "uint8"},
{1995,      165,      "ChargePortLockCtrlRespStruct",      "RespCode",      "uint32"},
{1996,      165,      "ChargePortLockCtrlRespStruct",      "ChargePortLockCtrlNRC",      "uint32"},
{1997,      166,      "ChargeGunLockCtrlService_ErrStruct",      "SequenceID",      "uint16"},
{1998,      166,      "ChargeGunLockCtrlService_ErrStruct",      "Options_8bit",      "uint8"},
{1999,      166,      "ChargeGunLockCtrlService_ErrStruct",      "Options_8bit2",      "uint8"},
{2000,      166,      "ChargeGunLockCtrlService_ErrStruct",      "UserID",      "uint32"},
{2001,      166,      "ChargeGunLockCtrlService_ErrStruct",      "OpeNRC",      "uint32"},
{2002,      166,      "ChargeGunLockCtrlService_ErrStruct",      "OpeErrInfo",      "string[16]"},
{2003,      167,      "ChargeGunLockStateStruct",      "ChargeLockType",      "uint8"},
{2004,      167,      "ChargeGunLockStateStruct",      "ChrgGunLockSt",      "uint8"},
{2005,      167,      "ChargeGunLockStateStruct",      "ChrgGunUnlockSource",      "uint8"},
{2006,      167,      "ChargeGunLockStateStruct",      "ChargeLockOutputSt",      "uint8"},
{2007,      167,      "ChargeGunLockStateStruct",      "ChrgGunLockSource",      "uint8"},
{2008,      167,      "ChargeGunLockStateStruct",      "BatChrgSt_Disp",      "uint8"},
{2009,      167,      "ChargeGunLockStateStruct",      "ChrgGunLockALLStatus",      "uint8"},
{2010,      167,      "ChargeGunLockStateStruct",      "ChargeLockOperateFailSt",      "uint8"},
{2011,      168,      "ChargeGunLockCtrlStruct",      "SOAProtocolVersion",      "uint8"},
{2012,      168,      "ChargeGunLockCtrlStruct",      "SOAHeaderType",      "uint8"},
{2013,      168,      "ChargeGunLockCtrlStruct",      "SOAHeaderLength",      "uint16"},
{2014,      168,      "ChargeGunLockCtrlStruct",      "Flag",      "uint16"},
{2015,      168,      "ChargeGunLockCtrlStruct",      "HeaderCRC16",      "uint16"},
{2016,      168,      "ChargeGunLockCtrlStruct",      "UserID",      "uint32"},
{2017,      168,      "ChargeGunLockCtrlStruct",      "ReqTimeOut",      "uint32"},
{2018,      168,      "ChargeGunLockCtrlStruct",      "RequestPriority",      "uint8"},
{2019,      168,      "ChargeGunLockCtrlStruct",      "SequenceID",      "uint16"},
{2020,      168,      "ChargeGunLockCtrlStruct",      "ServiceExecuteFeedbackFlag",      "uint8"},
{2021,      168,      "ChargeGunLockCtrlStruct",      "Options",      "uint32"},
{2022,      168,      "ChargeGunLockCtrlStruct",      "ChargeGunLockCmd",      "uint8"},
{2023,      168,      "ChargeGunLockCtrlRespStruct",      "RespCode",      "uint32"},
{2024,      168,      "ChargeGunLockCtrlRespStruct",      "ChargeGunLockCtrlNRC",      "uint32"},
{2025,      169,      "TailgateControl_ErrStruct",      "SequenceID",      "uint16"},
{2026,      169,      "TailgateControl_ErrStruct",      "Options_8bit",      "uint8"},
{2027,      169,      "TailgateControl_ErrStruct",      "Options_8bit2",      "uint8"},
{2028,      169,      "TailgateControl_ErrStruct",      "UserID",      "uint32"},
{2029,      169,      "TailgateControl_ErrStruct",      "OpeNRC",      "uint32"},
{2030,      169,      "TailgateControl_ErrStruct",      "OpeErrInfo",      "string[16]"},
{2031,      170,      "TgateStsStruct",      "TgateMvtSts",      "uint8"},
{2032,      170,      "TgateStsStruct",      "TgatePosSts",      "uint8"},
{2033,      170,      "TgateStsStruct",      "TgateSectPos",      "uint8"},
{2034,      170,      "TgateStsStruct",      "TgateAntiMislockTrigSts",      "uint8"},
{2035,      170,      "TgateStsStruct",      "TgateMemHtPos",      "uint8"},
{2036,      170,      "TgateStsStruct",      "TrOpenerSts",      "uint8"},
{2037,      171,      "TgatePosInfoStruct",      "TgatePos",      "uint8"},
{2038,      172,      "TgateMvtCtrlStruct",      "SOAProtocolVersion",      "uint8"},
{2039,      172,      "TgateMvtCtrlStruct",      "SOAHeaderType",      "uint8"},
{2040,      172,      "TgateMvtCtrlStruct",      "SOAHeaderLength",      "uint16"},
{2041,      172,      "TgateMvtCtrlStruct",      "Flag",      "uint16"},
{2042,      172,      "TgateMvtCtrlStruct",      "HeaderCRC16",      "uint16"},
{2043,      172,      "TgateMvtCtrlStruct",      "UserID",      "uint32"},
{2044,      172,      "TgateMvtCtrlStruct",      "ReqTimeOut",      "uint32"},
{2045,      172,      "TgateMvtCtrlStruct",      "RequestPriority",      "uint8"},
{2046,      172,      "TgateMvtCtrlStruct",      "SequenceID",      "uint16"},
{2047,      172,      "TgateMvtCtrlStruct",      "ServiceExecuteFeedbackFlag",      "uint8"},
{2048,      172,      "TgateMvtCtrlStruct",      "Options",      "uint32"},
{2049,      172,      "TgateMvtCtrlStruct",      "TgateMvtReq",      "uint8"},
{2050,      172,      "TgateMvtCtrlRespStruct",      "RespCode",      "uint32"},
{2051,      172,      "TgateMvtCtrlRespStruct",      "TgateMvtCtrlNRC",      "uint32"},
{2052,      173,      "SetTgateMemHtPosStruct",      "SOAProtocolVersion",      "uint8"},
{2053,      173,      "SetTgateMemHtPosStruct",      "SOAHeaderType",      "uint8"},
{2054,      173,      "SetTgateMemHtPosStruct",      "SOAHeaderLength",      "uint16"},
{2055,      173,      "SetTgateMemHtPosStruct",      "Flag",      "uint16"},
{2056,      173,      "SetTgateMemHtPosStruct",      "HeaderCRC16",      "uint16"},
{2057,      173,      "SetTgateMemHtPosStruct",      "UserID",      "uint32"},
{2058,      173,      "SetTgateMemHtPosStruct",      "ReqTimeOut",      "uint32"},
{2059,      173,      "SetTgateMemHtPosStruct",      "RequestPriority",      "uint8"},
{2060,      173,      "SetTgateMemHtPosStruct",      "SequenceID",      "uint16"},
{2061,      173,      "SetTgateMemHtPosStruct",      "ServiceExecuteFeedbackFlag",      "uint8"},
{2062,      173,      "SetTgateMemHtPosStruct",      "Options",      "uint32"},
{2063,      173,      "SetTgateMemHtPosStruct",      "TgateMemHtPos",      "uint8"},
{2064,      173,      "SetTgateMemHtPosRespStruct",      "RespCode",      "uint32"},
{2065,      173,      "SetTgateMemHtPosRespStruct",      "SetTgateMemHtPosNRC",      "uint32"},
{2066,      174,      "HighVoltageControlService_ErrStruct",      "SequenceID",      "uint16"},
{2067,      174,      "HighVoltageControlService_ErrStruct",      "Options_8bit",      "uint8"},
{2068,      174,      "HighVoltageControlService_ErrStruct",      "Options_8bit2",      "uint8"},
{2069,      174,      "HighVoltageControlService_ErrStruct",      "UserID",      "uint32"},
{2070,      174,      "HighVoltageControlService_ErrStruct",      "OpeNRC",      "uint32"},
{2071,      174,      "HighVoltageControlService_ErrStruct",      "OpeErrInfo",      "string[16]"},
{2072,      175,      "HighVoltageStStruct",      "HighVolSt",      "uint8"},
{2073,      175,      "HighVoltageStStruct",      "HighVoltFaultFB",      "uint16"},
{2074,      176,      "HighVoltageCtrlStruct",      "SOAProtocolVersion",      "uint8"},
{2075,      176,      "HighVoltageCtrlStruct",      "SOAHeaderType",      "uint8"},
{2076,      176,      "HighVoltageCtrlStruct",      "SOAHeaderLength",      "uint16"},
{2077,      176,      "HighVoltageCtrlStruct",      "Flag",      "uint16"},
{2078,      176,      "HighVoltageCtrlStruct",      "HeaderCRC16",      "uint16"},
{2079,      176,      "HighVoltageCtrlStruct",      "UserID",      "uint32"},
{2080,      176,      "HighVoltageCtrlStruct",      "ReqTimeOut",      "uint32"},
{2081,      176,      "HighVoltageCtrlStruct",      "RequestPriority",      "uint8"},
{2082,      176,      "HighVoltageCtrlStruct",      "SequenceID",      "uint16"},
{2083,      176,      "HighVoltageCtrlStruct",      "ServiceExecuteFeedbackFlag",      "uint8"},
{2084,      176,      "HighVoltageCtrlStruct",      "Options",      "uint32"},
{2085,      176,      "HighVoltageCtrlStruct",      "HighVoltageCtrl",      "uint8"},
{2086,      176,      "HighVoltageCtrlRespStruct",      "RespCode",      "uint32"},
{2087,      176,      "HighVoltageCtrlRespStruct",      "HighVoltageCtrlNRC",      "uint32"},
{2088,      177,      "V2LControlService_ErrStruct",      "SequenceID",      "uint16"},
{2089,      177,      "V2LControlService_ErrStruct",      "Options_8bit",      "uint8"},
{2090,      177,      "V2LControlService_ErrStruct",      "Options_8bit2",      "uint8"},
{2091,      177,      "V2LControlService_ErrStruct",      "UserID",      "uint32"},
{2092,      177,      "V2LControlService_ErrStruct",      "OpeNRC",      "uint32"},
{2093,      177,      "V2LControlService_ErrStruct",      "OpeErrInfo",      "string[16]"},
{2094,      178,      "V2LDisChrgStStruct",      "DisChrgSt",      "uint8"},
{2095,      178,      "V2LDisChrgStStruct",      "DisChrgStFaultFB",      "uint16"},
{2096,      179,      "V2LCtrlStruct",      "SOAProtocolVersion",      "uint8"},
{2097,      179,      "V2LCtrlStruct",      "SOAHeaderType",      "uint8"},
{2098,      179,      "V2LCtrlStruct",      "SOAHeaderLength",      "uint16"},
{2099,      179,      "V2LCtrlStruct",      "Flag",      "uint16"},
{2100,      179,      "V2LCtrlStruct",      "HeaderCRC16",      "uint16"},
{2101,      179,      "V2LCtrlStruct",      "UserID",      "uint32"},
{2102,      179,      "V2LCtrlStruct",      "ReqTimeOut",      "uint32"},
{2103,      179,      "V2LCtrlStruct",      "RequestPriority",      "uint8"},
{2104,      179,      "V2LCtrlStruct",      "SequenceID",      "uint16"},
{2105,      179,      "V2LCtrlStruct",      "ServiceExecuteFeedbackFlag",      "uint8"},
{2106,      179,      "V2LCtrlStruct",      "Options",      "uint32"},
{2107,      179,      "V2LCtrlStruct",      "V2LCtrl",      "uint8"},
{2108,      179,      "V2LCtrlRespStruct",      "RespCode",      "uint32"},
{2109,      179,      "V2LCtrlRespStruct",      "V2LCtrlNRC",      "uint32"},
{2110,      180,      "AcSysSt_ErrStruct",      "SequenceID",      "uint16"},
{2111,      180,      "AcSysSt_ErrStruct",      "Options_8bit",      "uint8"},
{2112,      180,      "AcSysSt_ErrStruct",      "Options_8bit2",      "uint8"},
{2113,      180,      "AcSysSt_ErrStruct",      "UserID",      "uint32"},
{2114,      180,      "AcSysSt_ErrStruct",      "OpeNRC",      "uint32"},
{2115,      180,      "AcSysSt_ErrStruct",      "OpeErrInfo",      "string[16]"},
{2116,      181,      "ACSysStateStruct",      "AutoSt",      "uint8"},
{2117,      181,      "ACSysStateStruct",      "ACPowerSt",      "uint8"},
{2118,      181,      "ACSysStateStruct",      "RAutoSt",      "uint8"},
{2119,      181,      "ACSysStateStruct",      "RACPowerSt",      "uint8"},
{2120,      181,      "ACSysStateStruct",      "AfterblowCfgSt",      "uint8"},
{2121,      181,      "ACSysStateStruct",      "ECOSt",      "uint8"},
{2122,      181,      "ACSysStateStruct",      "DeodorizeSt",      "uint8"},
{2123,      181,      "ACSysStateStruct",      "FDefrostSt",      "uint8"},
{2124,      181,      "ACSysStateStruct",      "MaxCoolingSt",      "uint8"},
{2125,      181,      "ACSysStateStruct",      "MaxWarmingSt",      "uint8"},
{2126,      181,      "ACSysStateStruct",      "InsenVentSt",      "uint8"},
{2127,      181,      "ACSysStateStruct",      "DisinfSt",      "uint8"},
{2128,      181,      "ACSysStateStruct",      "AcClrSt",      "uint8"},
{2129,      181,      "ACSysStateStruct",      "BlowCompensationSt",      "uint8"},
{2130,      182,      "TurnOnOffFrAutoACStruct",      "SOAProtocolVersion",      "uint8"},
{2131,      182,      "TurnOnOffFrAutoACStruct",      "SOAHeaderType",      "uint8"},
{2132,      182,      "TurnOnOffFrAutoACStruct",      "SOAHeaderLength",      "uint16"},
{2133,      182,      "TurnOnOffFrAutoACStruct",      "Flag",      "uint16"},
{2134,      182,      "TurnOnOffFrAutoACStruct",      "HeaderCRC16",      "uint16"},
{2135,      182,      "TurnOnOffFrAutoACStruct",      "UserID",      "uint32"},
{2136,      182,      "TurnOnOffFrAutoACStruct",      "ReqTimeOut",      "uint32"},
{2137,      182,      "TurnOnOffFrAutoACStruct",      "RequestPriority",      "uint8"},
{2138,      182,      "TurnOnOffFrAutoACStruct",      "SequenceID",      "uint16"},
{2139,      182,      "TurnOnOffFrAutoACStruct",      "ServiceExecuteFeedbackFlag",      "uint8"},
{2140,      182,      "TurnOnOffFrAutoACStruct",      "Options",      "uint32"},
{2141,      182,      "TurnOnOffFrAutoACStruct",      "TurnOnOffFrAutoAC",      "uint8"},
{2142,      182,      "TurnOnOffFrAutoACStruct",      "MemoryReq",      "uint8"},
{2143,      182,      "TurnOnOffFrAutoACRespStruct",      "RespCode",      "uint32"},
{2144,      182,      "TurnOnOffFrAutoACRespStruct",      "TurnOnOffFrAutoACNRC",      "uint32"},
{2145,      183,      "TurnOnFrACStruct",      "SOAProtocolVersion",      "uint8"},
{2146,      183,      "TurnOnFrACStruct",      "SOAHeaderType",      "uint8"},
{2147,      183,      "TurnOnFrACStruct",      "SOAHeaderLength",      "uint16"},
{2148,      183,      "TurnOnFrACStruct",      "Flag",      "uint16"},
{2149,      183,      "TurnOnFrACStruct",      "HeaderCRC16",      "uint16"},
{2150,      183,      "TurnOnFrACStruct",      "UserID",      "uint32"},
{2151,      183,      "TurnOnFrACStruct",      "ReqTimeOut",      "uint32"},
{2152,      183,      "TurnOnFrACStruct",      "RequestPriority",      "uint8"},
{2153,      183,      "TurnOnFrACStruct",      "SequenceID",      "uint16"},
{2154,      183,      "TurnOnFrACStruct",      "ServiceExecuteFeedbackFlag",      "uint8"},
{2155,      183,      "TurnOnFrACStruct",      "Options",      "uint32"},
{2156,      183,      "TurnOnFrACStruct",      "TurnOnFrAC",      "uint8"},
{2157,      183,      "TurnOnFrACRespStruct",      "RespCode",      "uint32"},
{2158,      183,      "TurnOnFrACRespStruct",      "TurnOnFrACNRC",      "uint32"},
{2159,      184,      "TurnOffFrACStruct",      "SOAProtocolVersion",      "uint8"},
{2160,      184,      "TurnOffFrACStruct",      "SOAHeaderType",      "uint8"},
{2161,      184,      "TurnOffFrACStruct",      "SOAHeaderLength",      "uint16"},
{2162,      184,      "TurnOffFrACStruct",      "Flag",      "uint16"},
{2163,      184,      "TurnOffFrACStruct",      "HeaderCRC16",      "uint16"},
{2164,      184,      "TurnOffFrACStruct",      "UserID",      "uint32"},
{2165,      184,      "TurnOffFrACStruct",      "ReqTimeOut",      "uint32"},
{2166,      184,      "TurnOffFrACStruct",      "RequestPriority",      "uint8"},
{2167,      184,      "TurnOffFrACStruct",      "SequenceID",      "uint16"},
{2168,      184,      "TurnOffFrACStruct",      "ServiceExecuteFeedbackFlag",      "uint8"},
{2169,      184,      "TurnOffFrACStruct",      "Options",      "uint32"},
{2170,      184,      "TurnOffFrACStruct",      "TurnOffFrAC",      "uint8"},
{2171,      184,      "TurnOffFrACStruct",      "MemoryReq",      "uint8"},
{2172,      184,      "TurnOffFrACRespStruct",      "RespCode",      "uint32"},
{2173,      184,      "TurnOffFrACRespStruct",      "TurnOffFrACNRC",      "uint32"},
{2174,      185,      "TurnOnOffRrAutoACStruct",      "SOAProtocolVersion",      "uint8"},
{2175,      185,      "TurnOnOffRrAutoACStruct",      "SOAHeaderType",      "uint8"},
{2176,      185,      "TurnOnOffRrAutoACStruct",      "SOAHeaderLength",      "uint16"},
{2177,      185,      "TurnOnOffRrAutoACStruct",      "Flag",      "uint16"},
{2178,      185,      "TurnOnOffRrAutoACStruct",      "HeaderCRC16",      "uint16"},
{2179,      185,      "TurnOnOffRrAutoACStruct",      "UserID",      "uint32"},
{2180,      185,      "TurnOnOffRrAutoACStruct",      "ReqTimeOut",      "uint32"},
{2181,      185,      "TurnOnOffRrAutoACStruct",      "RequestPriority",      "uint8"},
{2182,      185,      "TurnOnOffRrAutoACStruct",      "SequenceID",      "uint16"},
{2183,      185,      "TurnOnOffRrAutoACStruct",      "ServiceExecuteFeedbackFlag",      "uint8"},
{2184,      185,      "TurnOnOffRrAutoACStruct",      "Options",      "uint32"},
{2185,      185,      "TurnOnOffRrAutoACStruct",      "TurnOnOffRrAutoAC",      "uint8"},
{2186,      185,      "TurnOnOffRrAutoACStruct",      "MemoryReq",      "uint8"},
{2187,      185,      "TurnOnOffRrAutoACRespStruct",      "RespCode",      "uint32"},
{2188,      185,      "TurnOnOffRrAutoACRespStruct",      "TurnOnOffRrAutoACNRC",      "uint32"},
{2189,      186,      "TurnOnRrACStruct",      "SOAProtocolVersion",      "uint8"},
{2190,      186,      "TurnOnRrACStruct",      "SOAHeaderType",      "uint8"},
{2191,      186,      "TurnOnRrACStruct",      "SOAHeaderLength",      "uint16"},
{2192,      186,      "TurnOnRrACStruct",      "Flag",      "uint16"},
{2193,      186,      "TurnOnRrACStruct",      "HeaderCRC16",      "uint16"},
{2194,      186,      "TurnOnRrACStruct",      "UserID",      "uint32"},
{2195,      186,      "TurnOnRrACStruct",      "ReqTimeOut",      "uint32"},
{2196,      186,      "TurnOnRrACStruct",      "RequestPriority",      "uint8"},
{2197,      186,      "TurnOnRrACStruct",      "SequenceID",      "uint16"},
{2198,      186,      "TurnOnRrACStruct",      "ServiceExecuteFeedbackFlag",      "uint8"},
{2199,      186,      "TurnOnRrACStruct",      "Options",      "uint32"},
{2200,      186,      "TurnOnRrACStruct",      "TurnOnRrAC",      "uint8"},
{2201,      186,      "TurnOnRrACRespStruct",      "RespCode",      "uint32"},
{2202,      186,      "TurnOnRrACRespStruct",      "TurnOnRrACNRC",      "uint32"},
{2203,      187,      "TurnOffRrACStruct",      "SOAProtocolVersion",      "uint8"},
{2204,      187,      "TurnOffRrACStruct",      "SOAHeaderType",      "uint8"},
{2205,      187,      "TurnOffRrACStruct",      "SOAHeaderLength",      "uint16"},
{2206,      187,      "TurnOffRrACStruct",      "Flag",      "uint16"},
{2207,      187,      "TurnOffRrACStruct",      "HeaderCRC16",      "uint16"},
{2208,      187,      "TurnOffRrACStruct",      "UserID",      "uint32"},
{2209,      187,      "TurnOffRrACStruct",      "ReqTimeOut",      "uint32"},
{2210,      187,      "TurnOffRrACStruct",      "RequestPriority",      "uint8"},
{2211,      187,      "TurnOffRrACStruct",      "SequenceID",      "uint16"},
{2212,      187,      "TurnOffRrACStruct",      "ServiceExecuteFeedbackFlag",      "uint8"},
{2213,      187,      "TurnOffRrACStruct",      "Options",      "uint32"},
{2214,      187,      "TurnOffRrACStruct",      "TurnOffRrAC",      "uint8"},
{2215,      187,      "TurnOffRrACStruct",      "MemoryReq",      "uint8"},
{2216,      187,      "TurnOffRrACRespStruct",      "RespCode",      "uint32"},
{2217,      187,      "TurnOffRrACRespStruct",      "TurnOffRrACNRC",      "uint32"},
{2218,      188,      "SetOnOffDeodorizeStruct",      "SOAProtocolVersion",      "uint8"},
{2219,      188,      "SetOnOffDeodorizeStruct",      "SOAHeaderType",      "uint8"},
{2220,      188,      "SetOnOffDeodorizeStruct",      "SOAHeaderLength",      "uint16"},
{2221,      188,      "SetOnOffDeodorizeStruct",      "Flag",      "uint16"},
{2222,      188,      "SetOnOffDeodorizeStruct",      "HeaderCRC16",      "uint16"},
{2223,      188,      "SetOnOffDeodorizeStruct",      "UserID",      "uint32"},
{2224,      188,      "SetOnOffDeodorizeStruct",      "ReqTimeOut",      "uint32"},
{2225,      188,      "SetOnOffDeodorizeStruct",      "RequestPriority",      "uint8"},
{2226,      188,      "SetOnOffDeodorizeStruct",      "SequenceID",      "uint16"},
{2227,      188,      "SetOnOffDeodorizeStruct",      "ServiceExecuteFeedbackFlag",      "uint8"},
{2228,      188,      "SetOnOffDeodorizeStruct",      "Options",      "uint32"},
{2229,      188,      "SetOnOffDeodorizeStruct",      "SetOnOffDeodorize",      "uint8"},
{2230,      188,      "SetOnOffDeodorizeStruct",      "Type",      "uint8"},
{2231,      188,      "SetOnOffDeodorizeStruct",      "MemoryReq",      "uint8"},
{2232,      188,      "SetOnOffDeodorizeRespStruct",      "RespCode",      "uint32"},
{2233,      188,      "SetOnOffDeodorizeRespStruct",      "SetOnOffDeodorizeNRC",      "uint32"},
{2234,      189,      "TurnOnOffDefrostStruct",      "SOAProtocolVersion",      "uint8"},
{2235,      189,      "TurnOnOffDefrostStruct",      "SOAHeaderType",      "uint8"},
{2236,      189,      "TurnOnOffDefrostStruct",      "SOAHeaderLength",      "uint16"},
{2237,      189,      "TurnOnOffDefrostStruct",      "Flag",      "uint16"},
{2238,      189,      "TurnOnOffDefrostStruct",      "HeaderCRC16",      "uint16"},
{2239,      189,      "TurnOnOffDefrostStruct",      "UserID",      "uint32"},
{2240,      189,      "TurnOnOffDefrostStruct",      "ReqTimeOut",      "uint32"},
{2241,      189,      "TurnOnOffDefrostStruct",      "RequestPriority",      "uint8"},
{2242,      189,      "TurnOnOffDefrostStruct",      "SequenceID",      "uint16"},
{2243,      189,      "TurnOnOffDefrostStruct",      "ServiceExecuteFeedbackFlag",      "uint8"},
{2244,      189,      "TurnOnOffDefrostStruct",      "Options",      "uint32"},
{2245,      189,      "TurnOnOffDefrostStruct",      "TurnOnOffDefrost",      "uint8"},
{2246,      189,      "TurnOnOffDefrostStruct",      "Type",      "uint8"},
{2247,      189,      "TurnOnOffDefrostStruct",      "MemoryReq",      "uint8"},
{2248,      189,      "TurnOnOffDefrostRespStruct",      "RespCode",      "uint32"},
{2249,      189,      "TurnOnOffDefrostRespStruct",      "TurnOnOffDefrostNRC",      "uint32"},
{2250,      190,      "setOnOffECOModeStruct",      "SOAProtocolVersion",      "uint8"},
{2251,      190,      "setOnOffECOModeStruct",      "SOAHeaderType",      "uint8"},
{2252,      190,      "setOnOffECOModeStruct",      "SOAHeaderLength",      "uint16"},
{2253,      190,      "setOnOffECOModeStruct",      "Flag",      "uint16"},
{2254,      190,      "setOnOffECOModeStruct",      "HeaderCRC16",      "uint16"},
{2255,      190,      "setOnOffECOModeStruct",      "UserID",      "uint32"},
{2256,      190,      "setOnOffECOModeStruct",      "ReqTimeOut",      "uint32"},
{2257,      190,      "setOnOffECOModeStruct",      "RequestPriority",      "uint8"},
{2258,      190,      "setOnOffECOModeStruct",      "SequenceID",      "uint16"},
{2259,      190,      "setOnOffECOModeStruct",      "ServiceExecuteFeedbackFlag",      "uint8"},
{2260,      190,      "setOnOffECOModeStruct",      "Options",      "uint32"},
{2261,      190,      "setOnOffECOModeStruct",      "setOnOffECOMode",      "uint8"},
{2262,      190,      "setOnOffECOModeStruct",      "MemoryReq",      "uint8"},
{2263,      190,      "SetOnOffECOModeRespStruct",      "RespCode",      "uint32"},
{2264,      190,      "SetOnOffECOModeRespStruct",      "SetOnOffECOModeNRC",      "uint32"},
{2265,      191,      "TurnOnOffMaxCoolingStruct",      "SOAProtocolVersion",      "uint8"},
{2266,      191,      "TurnOnOffMaxCoolingStruct",      "SOAHeaderType",      "uint8"},
{2267,      191,      "TurnOnOffMaxCoolingStruct",      "SOAHeaderLength",      "uint16"},
{2268,      191,      "TurnOnOffMaxCoolingStruct",      "Flag",      "uint16"},
{2269,      191,      "TurnOnOffMaxCoolingStruct",      "HeaderCRC16",      "uint16"},
{2270,      191,      "TurnOnOffMaxCoolingStruct",      "UserID",      "uint32"},
{2271,      191,      "TurnOnOffMaxCoolingStruct",      "ReqTimeOut",      "uint32"},
{2272,      191,      "TurnOnOffMaxCoolingStruct",      "RequestPriority",      "uint8"},
{2273,      191,      "TurnOnOffMaxCoolingStruct",      "SequenceID",      "uint16"},
{2274,      191,      "TurnOnOffMaxCoolingStruct",      "ServiceExecuteFeedbackFlag",      "uint8"},
{2275,      191,      "TurnOnOffMaxCoolingStruct",      "Options",      "uint32"},
{2276,      191,      "TurnOnOffMaxCoolingStruct",      "TurnOnOffMaxCooling",      "uint8"},
{2277,      191,      "TurnOnOffMaxCoolingStruct",      "Type",      "uint8"},
{2278,      191,      "TurnOnOffMaxCoolingStruct",      "MemoryReq",      "uint8"},
{2279,      191,      "TurnOnOffMaxCoolingRespStruct",      "RespCode",      "uint32"},
{2280,      191,      "TurnOnOffMaxCoolingRespStruct",      "TurnOnOffMaxCoolingNRC",      "uint32"},
{2281,      192,      "TurnOnOffMaxHeatingStruct",      "SOAProtocolVersion",      "uint8"},
{2282,      192,      "TurnOnOffMaxHeatingStruct",      "SOAHeaderType",      "uint8"},
{2283,      192,      "TurnOnOffMaxHeatingStruct",      "SOAHeaderLength",      "uint16"},
{2284,      192,      "TurnOnOffMaxHeatingStruct",      "Flag",      "uint16"},
{2285,      192,      "TurnOnOffMaxHeatingStruct",      "HeaderCRC16",      "uint16"},
{2286,      192,      "TurnOnOffMaxHeatingStruct",      "UserID",      "uint32"},
{2287,      192,      "TurnOnOffMaxHeatingStruct",      "ReqTimeOut",      "uint32"},
{2288,      192,      "TurnOnOffMaxHeatingStruct",      "RequestPriority",      "uint8"},
{2289,      192,      "TurnOnOffMaxHeatingStruct",      "SequenceID",      "uint16"},
{2290,      192,      "TurnOnOffMaxHeatingStruct",      "ServiceExecuteFeedbackFlag",      "uint8"},
{2291,      192,      "TurnOnOffMaxHeatingStruct",      "Options",      "uint32"},
{2292,      192,      "TurnOnOffMaxHeatingStruct",      "TurnOnOffMaxHeating",      "uint8"},
{2293,      192,      "TurnOnOffMaxHeatingStruct",      "Type",      "uint8"},
{2294,      192,      "TurnOnOffMaxHeatingStruct",      "MemoryReq",      "uint8"},
{2295,      192,      "TurnOnOffMaxHeatingRespStruct",      "RespCode",      "uint32"},
{2296,      192,      "TurnOnOffMaxHeatingRespStruct",      "TurnOnOffMaxHeatingNRC",      "uint32"},
{2297,      193,      "SetACAfterBlowStruct",      "SOAProtocolVersion",      "uint8"},
{2298,      193,      "SetACAfterBlowStruct",      "SOAHeaderType",      "uint8"},
{2299,      193,      "SetACAfterBlowStruct",      "SOAHeaderLength",      "uint16"},
{2300,      193,      "SetACAfterBlowStruct",      "Flag",      "uint16"},
{2301,      193,      "SetACAfterBlowStruct",      "HeaderCRC16",      "uint16"},
{2302,      193,      "SetACAfterBlowStruct",      "UserID",      "uint32"},
{2303,      193,      "SetACAfterBlowStruct",      "ReqTimeOut",      "uint32"},
{2304,      193,      "SetACAfterBlowStruct",      "RequestPriority",      "uint8"},
{2305,      193,      "SetACAfterBlowStruct",      "SequenceID",      "uint16"},
{2306,      193,      "SetACAfterBlowStruct",      "ServiceExecuteFeedbackFlag",      "uint8"},
{2307,      193,      "SetACAfterBlowStruct",      "Options",      "uint32"},
{2308,      193,      "SetACAfterBlowStruct",      "SetACAfterBlow",      "uint8"},
{2309,      193,      "SetACAfterBlowStruct",      "MemoryReq",      "uint8"},
{2310,      193,      "SetACAfterBlowRespStruct",      "RespCode",      "uint32"},
{2311,      193,      "SetACAfterBlowRespStruct",      "SetACAfterBlowNRC",      "uint32"},
{2312,      194,      "TurnOnOffInsenVentStruct",      "SOAProtocolVersion",      "uint8"},
{2313,      194,      "TurnOnOffInsenVentStruct",      "SOAHeaderType",      "uint8"},
{2314,      194,      "TurnOnOffInsenVentStruct",      "SOAHeaderLength",      "uint16"},
{2315,      194,      "TurnOnOffInsenVentStruct",      "Flag",      "uint16"},
{2316,      194,      "TurnOnOffInsenVentStruct",      "HeaderCRC16",      "uint16"},
{2317,      194,      "TurnOnOffInsenVentStruct",      "UserID",      "uint32"},
{2318,      194,      "TurnOnOffInsenVentStruct",      "ReqTimeOut",      "uint32"},
{2319,      194,      "TurnOnOffInsenVentStruct",      "RequestPriority",      "uint8"},
{2320,      194,      "TurnOnOffInsenVentStruct",      "SequenceID",      "uint16"},
{2321,      194,      "TurnOnOffInsenVentStruct",      "ServiceExecuteFeedbackFlag",      "uint8"},
{2322,      194,      "TurnOnOffInsenVentStruct",      "Options",      "uint32"},
{2323,      194,      "TurnOnOffInsenVentStruct",      "TurnOnOffInsenVent",      "uint8"},
{2324,      194,      "TurnOnOffInsenVentStruct",      "MemoryReq",      "uint8"},
{2325,      194,      "TurnOnOffInsenVentRespStruct",      "RespCode",      "uint32"},
{2326,      194,      "TurnOnOffInsenVentRespStruct",      "TurnOnOffInsenVentNRC",      "uint32"},
{2327,      195,      "TurnOnOffSterilizationStruct",      "SOAProtocolVersion",      "uint8"},
{2328,      195,      "TurnOnOffSterilizationStruct",      "SOAHeaderType",      "uint8"},
{2329,      195,      "TurnOnOffSterilizationStruct",      "SOAHeaderLength",      "uint16"},
{2330,      195,      "TurnOnOffSterilizationStruct",      "Flag",      "uint16"},
{2331,      195,      "TurnOnOffSterilizationStruct",      "HeaderCRC16",      "uint16"},
{2332,      195,      "TurnOnOffSterilizationStruct",      "UserID",      "uint32"},
{2333,      195,      "TurnOnOffSterilizationStruct",      "ReqTimeOut",      "uint32"},
{2334,      195,      "TurnOnOffSterilizationStruct",      "RequestPriority",      "uint8"},
{2335,      195,      "TurnOnOffSterilizationStruct",      "SequenceID",      "uint16"},
{2336,      195,      "TurnOnOffSterilizationStruct",      "ServiceExecuteFeedbackFlag",      "uint8"},
{2337,      195,      "TurnOnOffSterilizationStruct",      "Options",      "uint32"},
{2338,      195,      "TurnOnOffSterilizationStruct",      "TurnOnOffSterilization",      "uint8"},
{2339,      195,      "TurnOnOffSterilizationRespStruct",      "RespCode",      "uint32"},
{2340,      195,      "TurnOnOffSterilizationRespStruct",      "TurnOnOffSterilizationNRC",      "uint32"},
{2341,      196,      "SetACSelfCleanStruct",      "SOAProtocolVersion",      "uint8"},
{2342,      196,      "SetACSelfCleanStruct",      "SOAHeaderType",      "uint8"},
{2343,      196,      "SetACSelfCleanStruct",      "SOAHeaderLength",      "uint16"},
{2344,      196,      "SetACSelfCleanStruct",      "Flag",      "uint16"},
{2345,      196,      "SetACSelfCleanStruct",      "HeaderCRC16",      "uint16"},
{2346,      196,      "SetACSelfCleanStruct",      "UserID",      "uint32"},
{2347,      196,      "SetACSelfCleanStruct",      "ReqTimeOut",      "uint32"},
{2348,      196,      "SetACSelfCleanStruct",      "RequestPriority",      "uint8"},
{2349,      196,      "SetACSelfCleanStruct",      "SequenceID",      "uint16"},
{2350,      196,      "SetACSelfCleanStruct",      "ServiceExecuteFeedbackFlag",      "uint8"},
{2351,      196,      "SetACSelfCleanStruct",      "Options",      "uint32"},
{2352,      196,      "SetACSelfCleanStruct",      "SetACSelfClean",      "uint8"},
{2353,      196,      "SetACSelfCleanRespStruct",      "RespCode",      "uint32"},
{2354,      196,      "SetACSelfCleanRespStruct",      "SetACSelfCleanNRC",      "uint32"},
{2355,      197,      "RestoreAcToMemoStStruct",      "SOAProtocolVersion",      "uint8"},
{2356,      197,      "RestoreAcToMemoStStruct",      "SOAHeaderType",      "uint8"},
{2357,      197,      "RestoreAcToMemoStStruct",      "SOAHeaderLength",      "uint16"},
{2358,      197,      "RestoreAcToMemoStStruct",      "Flag",      "uint16"},
{2359,      197,      "RestoreAcToMemoStStruct",      "HeaderCRC16",      "uint16"},
{2360,      197,      "RestoreAcToMemoStStruct",      "UserID",      "uint32"},
{2361,      197,      "RestoreAcToMemoStStruct",      "ReqTimeOut",      "uint32"},
{2362,      197,      "RestoreAcToMemoStStruct",      "RequestPriority",      "uint8"},
{2363,      197,      "RestoreAcToMemoStStruct",      "SequenceID",      "uint16"},
{2364,      197,      "RestoreAcToMemoStStruct",      "ServiceExecuteFeedbackFlag",      "uint8"},
{2365,      197,      "RestoreAcToMemoStStruct",      "Options",      "uint32"},
{2366,      197,      "RestoreAcToMemoStStruct",      "RestoreAcToMemoSt",      "uint8"},
{2367,      197,      "RestoreAcToMemoStRespStruct",      "RespCode",      "uint32"},
{2368,      197,      "RestoreAcToMemoStRespStruct",      "RestoreAcToMemoStNRC",      "uint32"},
{2369,      198,      "SetBlowCompensationStruct",      "SOAProtocolVersion",      "uint8"},
{2370,      198,      "SetBlowCompensationStruct",      "SOAHeaderType",      "uint8"},
{2371,      198,      "SetBlowCompensationStruct",      "SOAHeaderLength",      "uint16"},
{2372,      198,      "SetBlowCompensationStruct",      "Flag",      "uint16"},
{2373,      198,      "SetBlowCompensationStruct",      "HeaderCRC16",      "uint16"},
{2374,      198,      "SetBlowCompensationStruct",      "UserID",      "uint32"},
{2375,      198,      "SetBlowCompensationStruct",      "ReqTimeOut",      "uint32"},
{2376,      198,      "SetBlowCompensationStruct",      "RequestPriority",      "uint8"},
{2377,      198,      "SetBlowCompensationStruct",      "SequenceID",      "uint16"},
{2378,      198,      "SetBlowCompensationStruct",      "ServiceExecuteFeedbackFlag",      "uint8"},
{2379,      198,      "SetBlowCompensationStruct",      "Options",      "uint32"},
{2380,      198,      "SetBlowCompensationStruct",      "SetBlowCompensation",      "uint8"},
{2381,      198,      "SetBlowCompensationRespStruct",      "RespCode",      "uint32"},
{2382,      198,      "SetBlowCompensationRespStruct",      "SetBlowCompensationNRC",      "uint32"},
{2383,      199,      "AcBlwCtrl_ErrStruct",      "SequenceID",      "uint16"},
{2384,      199,      "AcBlwCtrl_ErrStruct",      "Options_8bit",      "uint8"},
{2385,      199,      "AcBlwCtrl_ErrStruct",      "Options_8bit2",      "uint8"},
{2386,      199,      "AcBlwCtrl_ErrStruct",      "UserID",      "uint32"},
{2387,      199,      "AcBlwCtrl_ErrStruct",      "OpeNRC",      "uint32"},
{2388,      199,      "AcBlwCtrl_ErrStruct",      "OpeErrInfo",      "string[16]"},
{2389,      200,      "WindExitSpdStruct",      "WindExitSpd",      "uint8"},
{2390,      200,      "WindExitSpdStruct",      "WindExitAutoSt",      "uint8"},
{2391,      200,      "WindExitSpdStruct",      "RWindExitSpd",      "uint8"},
{2392,      200,      "WindExitSpdStruct",      "RWindExitAutoSt",      "uint8"},
{2393,      201,      "CtrlFrWindSpdStruct",      "SOAProtocolVersion",      "uint8"},
{2394,      201,      "CtrlFrWindSpdStruct",      "SOAHeaderType",      "uint8"},
{2395,      201,      "CtrlFrWindSpdStruct",      "SOAHeaderLength",      "uint16"},
{2396,      201,      "CtrlFrWindSpdStruct",      "Flag",      "uint16"},
{2397,      201,      "CtrlFrWindSpdStruct",      "HeaderCRC16",      "uint16"},
{2398,      201,      "CtrlFrWindSpdStruct",      "UserID",      "uint32"},
{2399,      201,      "CtrlFrWindSpdStruct",      "ReqTimeOut",      "uint32"},
{2400,      201,      "CtrlFrWindSpdStruct",      "RequestPriority",      "uint8"},
{2401,      201,      "CtrlFrWindSpdStruct",      "SequenceID",      "uint16"},
{2402,      201,      "CtrlFrWindSpdStruct",      "ServiceExecuteFeedbackFlag",      "uint8"},
{2403,      201,      "CtrlFrWindSpdStruct",      "Options",      "uint32"},
{2404,      201,      "CtrlFrWindSpdStruct",      "CtrlFrWindSpd",      "uint8"},
{2405,      201,      "CtrlFrWindSpdStruct",      "MemoryReq",      "uint8"},
{2406,      201,      "CtrlFrWindSpdRespStruct",      "RespCode",      "uint32"},
{2407,      201,      "CtrlFrWindSpdRespStruct",      "CtrlFrWindSpdNRC",      "uint32"},
{2408,      202,      "CtrlRrWindSpdStruct",      "SOAProtocolVersion",      "uint8"},
{2409,      202,      "CtrlRrWindSpdStruct",      "SOAHeaderType",      "uint8"},
{2410,      202,      "CtrlRrWindSpdStruct",      "SOAHeaderLength",      "uint16"},
{2411,      202,      "CtrlRrWindSpdStruct",      "Flag",      "uint16"},
{2412,      202,      "CtrlRrWindSpdStruct",      "HeaderCRC16",      "uint16"},
{2413,      202,      "CtrlRrWindSpdStruct",      "UserID",      "uint32"},
{2414,      202,      "CtrlRrWindSpdStruct",      "ReqTimeOut",      "uint32"},
{2415,      202,      "CtrlRrWindSpdStruct",      "RequestPriority",      "uint8"},
{2416,      202,      "CtrlRrWindSpdStruct",      "SequenceID",      "uint16"},
{2417,      202,      "CtrlRrWindSpdStruct",      "ServiceExecuteFeedbackFlag",      "uint8"},
{2418,      202,      "CtrlRrWindSpdStruct",      "Options",      "uint32"},
{2419,      202,      "CtrlRrWindSpdStruct",      "CtrlRrWindSpd",      "uint8"},
{2420,      202,      "CtrlRrWindSpdStruct",      "MemoryReq",      "uint8"},
{2421,      202,      "CtrlRrWindSpdRespStruct",      "RespCode",      "uint32"},
{2422,      202,      "CtrlRrWindSpdRespStruct",      "CtrlRrWindSpdNRC",      "uint32"},
{2423,      203,      "AcTempCtrl_ErrStruct",      "SequenceID",      "uint16"},
{2424,      203,      "AcTempCtrl_ErrStruct",      "Options_8bit",      "uint8"},
{2425,      203,      "AcTempCtrl_ErrStruct",      "Options_8bit2",      "uint8"},
{2426,      203,      "AcTempCtrl_ErrStruct",      "UserID",      "uint32"},
{2427,      203,      "AcTempCtrl_ErrStruct",      "OpeNRC",      "uint32"},
{2428,      203,      "AcTempCtrl_ErrStruct",      "OpeErrInfo",      "string[16]"},
{2429,      204,      "TempSelectStStruct",      "DriverTempSelectSt",      "float32"},
{2430,      204,      "TempSelectStStruct",      "PsnTempSelectSt",      "float32"},
{2431,      204,      "TempSelectStStruct",      "TempSyncSt",      "uint8"},
{2432,      204,      "TempSelectStStruct",      "RLTempSelectSt",      "float32"},
{2433,      204,      "TempSelectStStruct",      "RRTempSelectSt",      "float32"},
{2434,      204,      "TempSelectStStruct",      "ThirdRowTempSelectSt",      "float32"},
{2435,      205,      "SetDrvTempStruct",      "SOAProtocolVersion",      "uint8"},
{2436,      205,      "SetDrvTempStruct",      "SOAHeaderType",      "uint8"},
{2437,      205,      "SetDrvTempStruct",      "SOAHeaderLength",      "uint16"},
{2438,      205,      "SetDrvTempStruct",      "Flag",      "uint16"},
{2439,      205,      "SetDrvTempStruct",      "HeaderCRC16",      "uint16"},
{2440,      205,      "SetDrvTempStruct",      "UserID",      "uint32"},
{2441,      205,      "SetDrvTempStruct",      "ReqTimeOut",      "uint32"},
{2442,      205,      "SetDrvTempStruct",      "RequestPriority",      "uint8"},
{2443,      205,      "SetDrvTempStruct",      "SequenceID",      "uint16"},
{2444,      205,      "SetDrvTempStruct",      "ServiceExecuteFeedbackFlag",      "uint8"},
{2445,      205,      "SetDrvTempStruct",      "Options",      "uint32"},
{2446,      205,      "SetDrvTempStruct",      "SetDrvTemp",      "float32"},
{2447,      205,      "SetDrvTempStruct",      "Type",      "uint8"},
{2448,      205,      "SetDrvTempStruct",      "MemoryReq",      "uint8"},
{2449,      205,      "SetDrvTempRespStruct",      "RespCode",      "uint32"},
{2450,      205,      "SetDrvTempRespStruct",      "SetDrvTempNRC",      "uint32"},
{2451,      206,      "SetPsnTempStruct",      "SOAProtocolVersion",      "uint8"},
{2452,      206,      "SetPsnTempStruct",      "SOAHeaderType",      "uint8"},
{2453,      206,      "SetPsnTempStruct",      "SOAHeaderLength",      "uint16"},
{2454,      206,      "SetPsnTempStruct",      "Flag",      "uint16"},
{2455,      206,      "SetPsnTempStruct",      "HeaderCRC16",      "uint16"},
{2456,      206,      "SetPsnTempStruct",      "UserID",      "uint32"},
{2457,      206,      "SetPsnTempStruct",      "ReqTimeOut",      "uint32"},
{2458,      206,      "SetPsnTempStruct",      "RequestPriority",      "uint8"},
{2459,      206,      "SetPsnTempStruct",      "SequenceID",      "uint16"},
{2460,      206,      "SetPsnTempStruct",      "ServiceExecuteFeedbackFlag",      "uint8"},
{2461,      206,      "SetPsnTempStruct",      "Options",      "uint32"},
{2462,      206,      "SetPsnTempStruct",      "SetPsnTemp",      "float32"},
{2463,      206,      "SetPsnTempStruct",      "MemoryReq",      "uint8"},
{2464,      206,      "SetPsnTempRespStruct",      "RespCode",      "uint32"},
{2465,      206,      "SetPsnTempRespStruct",      "SetPsnTempNRC",      "uint32"},
{2466,      207,      "SetRLTempStruct",      "SOAProtocolVersion",      "uint8"},
{2467,      207,      "SetRLTempStruct",      "SOAHeaderType",      "uint8"},
{2468,      207,      "SetRLTempStruct",      "SOAHeaderLength",      "uint16"},
{2469,      207,      "SetRLTempStruct",      "Flag",      "uint16"},
{2470,      207,      "SetRLTempStruct",      "HeaderCRC16",      "uint16"},
{2471,      207,      "SetRLTempStruct",      "UserID",      "uint32"},
{2472,      207,      "SetRLTempStruct",      "ReqTimeOut",      "uint32"},
{2473,      207,      "SetRLTempStruct",      "RequestPriority",      "uint8"},
{2474,      207,      "SetRLTempStruct",      "SequenceID",      "uint16"},
{2475,      207,      "SetRLTempStruct",      "ServiceExecuteFeedbackFlag",      "uint8"},
{2476,      207,      "SetRLTempStruct",      "Options",      "uint32"},
{2477,      207,      "SetRLTempStruct",      "SetRLTemp",      "float32"},
{2478,      207,      "SetRLTempStruct",      "MemoryReq",      "uint8"},
{2479,      207,      "SetRLTempRespStruct",      "RespCode",      "uint32"},
{2480,      207,      "SetRLTempRespStruct",      "SetRLTempNRC",      "uint32"},
{2481,      208,      "SetRRTempStruct",      "SOAProtocolVersion",      "uint8"},
{2482,      208,      "SetRRTempStruct",      "SOAHeaderType",      "uint8"},
{2483,      208,      "SetRRTempStruct",      "SOAHeaderLength",      "uint16"},
{2484,      208,      "SetRRTempStruct",      "Flag",      "uint16"},
{2485,      208,      "SetRRTempStruct",      "HeaderCRC16",      "uint16"},
{2486,      208,      "SetRRTempStruct",      "UserID",      "uint32"},
{2487,      208,      "SetRRTempStruct",      "ReqTimeOut",      "uint32"},
{2488,      208,      "SetRRTempStruct",      "RequestPriority",      "uint8"},
{2489,      208,      "SetRRTempStruct",      "SequenceID",      "uint16"},
{2490,      208,      "SetRRTempStruct",      "ServiceExecuteFeedbackFlag",      "uint8"},
{2491,      208,      "SetRRTempStruct",      "Options",      "uint32"},
{2492,      208,      "SetRRTempStruct",      "SetRRTemp",      "float32"},
{2493,      208,      "SetRRTempStruct",      "MemoryReq",      "uint8"},
{2494,      208,      "SetRRTempRespStruct",      "RespCode",      "uint32"},
{2495,      208,      "SetRRTempRespStruct",      "SetRRTempNRC",      "uint32"},
{2496,      209,      "Set3rdRowTempStruct",      "SOAProtocolVersion",      "uint8"},
{2497,      209,      "Set3rdRowTempStruct",      "SOAHeaderType",      "uint8"},
{2498,      209,      "Set3rdRowTempStruct",      "SOAHeaderLength",      "uint16"},
{2499,      209,      "Set3rdRowTempStruct",      "Flag",      "uint16"},
{2500,      209,      "Set3rdRowTempStruct",      "HeaderCRC16",      "uint16"},
{2501,      209,      "Set3rdRowTempStruct",      "UserID",      "uint32"},
{2502,      209,      "Set3rdRowTempStruct",      "ReqTimeOut",      "uint32"},
{2503,      209,      "Set3rdRowTempStruct",      "RequestPriority",      "uint8"},
{2504,      209,      "Set3rdRowTempStruct",      "SequenceID",      "uint16"},
{2505,      209,      "Set3rdRowTempStruct",      "ServiceExecuteFeedbackFlag",      "uint8"},
{2506,      209,      "Set3rdRowTempStruct",      "Options",      "uint32"},
{2507,      209,      "Set3rdRowTempStruct",      "Set3rdRowTemp",      "float32"},
{2508,      209,      "Set3rdRowTempStruct",      "MemoryReq",      "uint8"},
{2509,      209,      "Set3rdRowTempRespStruct",      "RespCode",      "uint32"},
{2510,      209,      "Set3rdRowTempRespStruct",      "Set3rdRowTempNRC",      "uint32"},
{2511,      210,      "SetSyncStruct",      "SOAProtocolVersion",      "uint8"},
{2512,      210,      "SetSyncStruct",      "SOAHeaderType",      "uint8"},
{2513,      210,      "SetSyncStruct",      "SOAHeaderLength",      "uint16"},
{2514,      210,      "SetSyncStruct",      "Flag",      "uint16"},
{2515,      210,      "SetSyncStruct",      "HeaderCRC16",      "uint16"},
{2516,      210,      "SetSyncStruct",      "UserID",      "uint32"},
{2517,      210,      "SetSyncStruct",      "ReqTimeOut",      "uint32"},
{2518,      210,      "SetSyncStruct",      "RequestPriority",      "uint8"},
{2519,      210,      "SetSyncStruct",      "SequenceID",      "uint16"},
{2520,      210,      "SetSyncStruct",      "ServiceExecuteFeedbackFlag",      "uint8"},
{2521,      210,      "SetSyncStruct",      "Options",      "uint32"},
{2522,      210,      "SetSyncStruct",      "SetSync",      "uint8"},
{2523,      210,      "SetSyncStruct",      "MemoryReq",      "uint8"},
{2524,      210,      "SetSyncRespStruct",      "RespCode",      "uint32"},
{2525,      210,      "SetSyncRespStruct",      "SetSyncNRC",      "uint32"},
{2526,      211,      "AcDistModeCtrl_ErrStruct",      "SequenceID",      "uint16"},
{2527,      211,      "AcDistModeCtrl_ErrStruct",      "Options_8bit",      "uint8"},
{2528,      211,      "AcDistModeCtrl_ErrStruct",      "Options_8bit2",      "uint8"},
{2529,      211,      "AcDistModeCtrl_ErrStruct",      "UserID",      "uint32"},
{2530,      211,      "AcDistModeCtrl_ErrStruct",      "OpeNRC",      "uint32"},
{2531,      211,      "AcDistModeCtrl_ErrStruct",      "OpeErrInfo",      "string[16]"},
{2532,      212,      "AirDistributionModeStruct",      "AirDistributionMode",      "uint8"},
{2533,      212,      "AirDistributionModeStruct",      "AirDistributionAutoSt",      "uint8"},
{2534,      212,      "AirDistributionModeStruct",      "RAirDistributionAutoSt",      "uint8"},
{2535,      212,      "AirDistributionModeStruct",      "RearAirDistributionMode",      "uint8"},
{2536,      212,      "AirDistributionModeStruct",      "ThirdRowAirDisModeSelectSt",      "uint8"},
{2537,      213,      "SetFrAirDisModeStruct",      "SOAProtocolVersion",      "uint8"},
{2538,      213,      "SetFrAirDisModeStruct",      "SOAHeaderType",      "uint8"},
{2539,      213,      "SetFrAirDisModeStruct",      "SOAHeaderLength",      "uint16"},
{2540,      213,      "SetFrAirDisModeStruct",      "Flag",      "uint16"},
{2541,      213,      "SetFrAirDisModeStruct",      "HeaderCRC16",      "uint16"},
{2542,      213,      "SetFrAirDisModeStruct",      "UserID",      "uint32"},
{2543,      213,      "SetFrAirDisModeStruct",      "ReqTimeOut",      "uint32"},
{2544,      213,      "SetFrAirDisModeStruct",      "RequestPriority",      "uint8"},
{2545,      213,      "SetFrAirDisModeStruct",      "SequenceID",      "uint16"},
{2546,      213,      "SetFrAirDisModeStruct",      "ServiceExecuteFeedbackFlag",      "uint8"},
{2547,      213,      "SetFrAirDisModeStruct",      "Options",      "uint32"},
{2548,      213,      "SetFrAirDisModeStruct",      "SetFrAirDisMode",      "uint8"},
{2549,      213,      "SetFrAirDisModeStruct",      "MemoryReq",      "uint8"},
{2550,      213,      "SetFrAirDisModeRespStruct",      "RespCode",      "uint32"},
{2551,      213,      "SetFrAirDisModeRespStruct",      "SetFrAirDisModeNRC",      "uint32"},
{2552,      214,      "SetRrAirDisModeStruct",      "SOAProtocolVersion",      "uint8"},
{2553,      214,      "SetRrAirDisModeStruct",      "SOAHeaderType",      "uint8"},
{2554,      214,      "SetRrAirDisModeStruct",      "SOAHeaderLength",      "uint16"},
{2555,      214,      "SetRrAirDisModeStruct",      "Flag",      "uint16"},
{2556,      214,      "SetRrAirDisModeStruct",      "HeaderCRC16",      "uint16"},
{2557,      214,      "SetRrAirDisModeStruct",      "UserID",      "uint32"},
{2558,      214,      "SetRrAirDisModeStruct",      "ReqTimeOut",      "uint32"},
{2559,      214,      "SetRrAirDisModeStruct",      "RequestPriority",      "uint8"},
{2560,      214,      "SetRrAirDisModeStruct",      "SequenceID",      "uint16"},
{2561,      214,      "SetRrAirDisModeStruct",      "ServiceExecuteFeedbackFlag",      "uint8"},
{2562,      214,      "SetRrAirDisModeStruct",      "Options",      "uint32"},
{2563,      214,      "SetRrAirDisModeStruct",      "SetRrAirDisMode",      "uint8"},
{2564,      214,      "SetRrAirDisModeStruct",      "MemoryReq",      "uint8"},
{2565,      214,      "SetRrAirDisModeRespStruct",      "RespCode",      "uint32"},
{2566,      214,      "SetRrAirDisModeRespStruct",      "SetRrAirDisModeNRC",      "uint32"},
{2567,      215,      "Set3rdRowAirDisModeStruct",      "SOAProtocolVersion",      "uint8"},
{2568,      215,      "Set3rdRowAirDisModeStruct",      "SOAHeaderType",      "uint8"},
{2569,      215,      "Set3rdRowAirDisModeStruct",      "SOAHeaderLength",      "uint16"},
{2570,      215,      "Set3rdRowAirDisModeStruct",      "Flag",      "uint16"},
{2571,      215,      "Set3rdRowAirDisModeStruct",      "HeaderCRC16",      "uint16"},
{2572,      215,      "Set3rdRowAirDisModeStruct",      "UserID",      "uint32"},
{2573,      215,      "Set3rdRowAirDisModeStruct",      "ReqTimeOut",      "uint32"},
{2574,      215,      "Set3rdRowAirDisModeStruct",      "RequestPriority",      "uint8"},
{2575,      215,      "Set3rdRowAirDisModeStruct",      "SequenceID",      "uint16"},
{2576,      215,      "Set3rdRowAirDisModeStruct",      "ServiceExecuteFeedbackFlag",      "uint8"},
{2577,      215,      "Set3rdRowAirDisModeStruct",      "Options",      "uint32"},
{2578,      215,      "Set3rdRowAirDisModeStruct",      "Set3rdRowAirDisMode",      "uint8"},
{2579,      215,      "Set3rdRowAirDisModeStruct",      "MemoryReq",      "uint8"},
{2580,      215,      "Set3rdRowAirDisModeRespStruct",      "RespCode",      "uint32"},
{2581,      215,      "Set3rdRowAirDisModeRespStruct",      "Set3rdRowAirDisModeNRC",      "uint32"},
{2582,      216,      "AcIntkModeCtrl_ErrStruct",      "SequenceID",      "uint16"},
{2583,      216,      "AcIntkModeCtrl_ErrStruct",      "Options_8bit",      "uint8"},
{2584,      216,      "AcIntkModeCtrl_ErrStruct",      "Options_8bit2",      "uint8"},
{2585,      216,      "AcIntkModeCtrl_ErrStruct",      "UserID",      "uint32"},
{2586,      216,      "AcIntkModeCtrl_ErrStruct",      "OpeNRC",      "uint32"},
{2587,      216,      "AcIntkModeCtrl_ErrStruct",      "OpeErrInfo",      "string[16]"},
{2588,      217,      "AirIntakeStStruct",      "AirIntakeSt",      "uint8"},
{2589,      217,      "AirIntakeStStruct",      "AirIntakeAutoSt",      "uint8"},
{2590,      218,      "SetAirIntakeStruct",      "SOAProtocolVersion",      "uint8"},
{2591,      218,      "SetAirIntakeStruct",      "SOAHeaderType",      "uint8"},
{2592,      218,      "SetAirIntakeStruct",      "SOAHeaderLength",      "uint16"},
{2593,      218,      "SetAirIntakeStruct",      "Flag",      "uint16"},
{2594,      218,      "SetAirIntakeStruct",      "HeaderCRC16",      "uint16"},
{2595,      218,      "SetAirIntakeStruct",      "UserID",      "uint32"},
{2596,      218,      "SetAirIntakeStruct",      "ReqTimeOut",      "uint32"},
{2597,      218,      "SetAirIntakeStruct",      "RequestPriority",      "uint8"},
{2598,      218,      "SetAirIntakeStruct",      "SequenceID",      "uint16"},
{2599,      218,      "SetAirIntakeStruct",      "ServiceExecuteFeedbackFlag",      "uint8"},
{2600,      218,      "SetAirIntakeStruct",      "Options",      "uint32"},
{2601,      218,      "SetAirIntakeStruct",      "SetAirIntake",      "uint8"},
{2602,      218,      "SetAirIntakeStruct",      "MemoryReq",      "uint8"},
{2603,      218,      "SetAirIntakeRespStruct",      "RespCode",      "uint32"},
{2604,      218,      "SetAirIntakeRespStruct",      "SetAirIntakeNRC",      "uint32"},
{2605,      219,      "AcAirCleanCtrl_ErrStruct",      "SequenceID",      "uint16"},
{2606,      219,      "AcAirCleanCtrl_ErrStruct",      "Options_8bit",      "uint8"},
{2607,      219,      "AcAirCleanCtrl_ErrStruct",      "Options_8bit2",      "uint8"},
{2608,      219,      "AcAirCleanCtrl_ErrStruct",      "UserID",      "uint32"},
{2609,      219,      "AcAirCleanCtrl_ErrStruct",      "OpeNRC",      "uint32"},
{2610,      219,      "AcAirCleanCtrl_ErrStruct",      "OpeErrInfo",      "string[16]"},
{2611,      220,      "AirCleanStStruct",      "AirCleanSt",      "uint8"},
{2612,      220,      "AirCleanStStruct",      "AQSSt",      "uint8"},
{2613,      221,      "TurnOnOffAQSStruct",      "SOAProtocolVersion",      "uint8"},
{2614,      221,      "TurnOnOffAQSStruct",      "SOAHeaderType",      "uint8"},
{2615,      221,      "TurnOnOffAQSStruct",      "SOAHeaderLength",      "uint16"},
{2616,      221,      "TurnOnOffAQSStruct",      "Flag",      "uint16"},
{2617,      221,      "TurnOnOffAQSStruct",      "HeaderCRC16",      "uint16"},
{2618,      221,      "TurnOnOffAQSStruct",      "UserID",      "uint32"},
{2619,      221,      "TurnOnOffAQSStruct",      "ReqTimeOut",      "uint32"},
{2620,      221,      "TurnOnOffAQSStruct",      "RequestPriority",      "uint8"},
{2621,      221,      "TurnOnOffAQSStruct",      "SequenceID",      "uint16"},
{2622,      221,      "TurnOnOffAQSStruct",      "ServiceExecuteFeedbackFlag",      "uint8"},
{2623,      221,      "TurnOnOffAQSStruct",      "Options",      "uint32"},
{2624,      221,      "TurnOnOffAQSStruct",      "TurnOnOffAQS",      "uint8"},
{2625,      221,      "TurnOnOffAQSStruct",      "MemoryReq",      "uint8"},
{2626,      221,      "TurnOnOffAQSRespStruct",      "RespCode",      "uint32"},
{2627,      221,      "TurnOnOffAQSRespStruct",      "TurnOnOffAQSNRC",      "uint32"},
{2628,      222,      "TurnOnOffAirCleanStruct",      "SOAProtocolVersion",      "uint8"},
{2629,      222,      "TurnOnOffAirCleanStruct",      "SOAHeaderType",      "uint8"},
{2630,      222,      "TurnOnOffAirCleanStruct",      "SOAHeaderLength",      "uint16"},
{2631,      222,      "TurnOnOffAirCleanStruct",      "Flag",      "uint16"},
{2632,      222,      "TurnOnOffAirCleanStruct",      "HeaderCRC16",      "uint16"},
{2633,      222,      "TurnOnOffAirCleanStruct",      "UserID",      "uint32"},
{2634,      222,      "TurnOnOffAirCleanStruct",      "ReqTimeOut",      "uint32"},
{2635,      222,      "TurnOnOffAirCleanStruct",      "RequestPriority",      "uint8"},
{2636,      222,      "TurnOnOffAirCleanStruct",      "SequenceID",      "uint16"},
{2637,      222,      "TurnOnOffAirCleanStruct",      "ServiceExecuteFeedbackFlag",      "uint8"},
{2638,      222,      "TurnOnOffAirCleanStruct",      "Options",      "uint32"},
{2639,      222,      "TurnOnOffAirCleanStruct",      "TurnOnOffAirClean",      "uint8"},
{2640,      222,      "TurnOnOffAirCleanStruct",      "MemoryReq",      "uint8"},
{2641,      222,      "TurnOnOffAirCleanRespStruct",      "RespCode",      "uint32"},
{2642,      222,      "TurnOnOffAirCleanRespStruct",      "TurnOnOffAirCleanNRC",      "uint32"},
{2643,      223,      "TempSensorInfoFBStruct",      "CorrectedExterTemp",      "float32"},
{2644,      223,      "TempSensorInfoFBStruct",      "RCorrectedCabinTemp",      "float32"},
{2645,      223,      "TempSensorInfoFBStruct",      "CorrectedCabinTemp",      "float32"},
{2646,      223,      "TempSensorInfoFBStruct",      "PM25St",      "float32"},
{2647,      223,      "TempSensorInfoFBStruct",      "DefSe_RH",      "float32"},
{2648,      223,      "TempSensorInfoFBStruct",      "DefSe_T_air",      "float32"},
{2649,      223,      "TempSensorInfoFBStruct",      "DefSe_T_glass",      "float32"},
{2650,      224,      "TempSensorInfoFB2Struct",      "WindModeColour",      "uint8"},
{2651,      224,      "TempSensorInfoFB2Struct",      "IonizerSt",      "uint8"},
{2652,      225,      "EAVCtrl_ErrStruct",      "SequenceID",      "uint16"},
{2653,      225,      "EAVCtrl_ErrStruct",      "Options_8bit",      "uint8"},
{2654,      225,      "EAVCtrl_ErrStruct",      "Options_8bit2",      "uint8"},
{2655,      225,      "EAVCtrl_ErrStruct",      "UserID",      "uint32"},
{2656,      225,      "EAVCtrl_ErrStruct",      "OpeNRC",      "uint32"},
{2657,      225,      "EAVCtrl_ErrStruct",      "OpeErrInfo",      "string[16]"},
{2658,      226,      "TuyereAndModeStStruct",      "EAVDrvLeftHorzPosFB",      "uint8"},
{2659,      226,      "TuyereAndModeStStruct",      "EAVDrvLeftVertPosFB",      "uint8"},
{2660,      226,      "TuyereAndModeStStruct",      "EAVDrvRightHorzPosFB",      "uint8"},
{2661,      226,      "TuyereAndModeStStruct",      "EAVDrvRightVertPosFB",      "uint8"},
{2662,      226,      "TuyereAndModeStStruct",      "EAVPsnLeftHorzPosFB",      "uint8"},
{2663,      226,      "TuyereAndModeStStruct",      "EAVPsnLeftVertPosFB",      "uint8"},
{2664,      226,      "TuyereAndModeStStruct",      "EAVPsnRightHorzPosFB",      "uint8"},
{2665,      226,      "TuyereAndModeStStruct",      "EAVPsnRightVertPosFB",      "uint8"},
{2666,      226,      "TuyereAndModeStStruct",      "EAVDriverWindModeSt",      "uint8"},
{2667,      226,      "TuyereAndModeStStruct",      "EAVPsnWindModeSt",      "uint8"},
{2668,      226,      "TuyereAndModeStStruct",      "EAVSweepWindSt",      "uint8"},
{2669,      226,      "TuyereAndModeStStruct",      "VGA1_Sts",      "uint8"},
{2670,      226,      "TuyereAndModeStStruct",      "VGA2_Sts",      "uint8"},
{2671,      226,      "TuyereAndModeStStruct",      "VGA3_Sts",      "uint8"},
{2672,      226,      "TuyereAndModeStStruct",      "VGA4_Sts",      "uint8"},
{2673,      226,      "TuyereAndModeStStruct",      "VGA5_Sts",      "uint8"},
{2674,      226,      "TuyereAndModeStStruct",      "VGA6_Sts",      "uint8"},
{2675,      226,      "TuyereAndModeStStruct",      "VGA7_Sts",      "uint8"},
{2676,      226,      "TuyereAndModeStStruct",      "VGA8_Sts",      "uint8"},
{2677,      226,      "TuyereAndModeStStruct",      "EAVRLHorzPosFB",      "uint8"},
{2678,      226,      "TuyereAndModeStStruct",      "EAVRLVertPosFB",      "uint8"},
{2679,      226,      "TuyereAndModeStStruct",      "EAVRRHorzPosFB",      "uint8"},
{2680,      226,      "TuyereAndModeStStruct",      "EAVRRVertPosFB",      "uint8"},
{2681,      226,      "TuyereAndModeStStruct",      "EAVRLWindModeSt",      "uint8"},
{2682,      226,      "TuyereAndModeStStruct",      "EAVRRWindModeSt",      "uint8"},
{2683,      226,      "TuyereAndModeStStruct",      "EAVRSweepWindSt",      "uint8"},
{2684,      226,      "TuyereAndModeStStruct",      "RVGA1_Sts",      "uint8"},
{2685,      226,      "TuyereAndModeStStruct",      "RVGA2_Sts",      "uint8"},
{2686,      226,      "TuyereAndModeStStruct",      "RVGA3_Sts",      "uint8"},
{2687,      226,      "TuyereAndModeStStruct",      "RVGA4_Sts",      "uint8"},
{2688,      227,      "SetEAVDrvLeftHorzPosStruct",      "SOAProtocolVersion",      "uint8"},
{2689,      227,      "SetEAVDrvLeftHorzPosStruct",      "SOAHeaderType",      "uint8"},
{2690,      227,      "SetEAVDrvLeftHorzPosStruct",      "SOAHeaderLength",      "uint16"},
{2691,      227,      "SetEAVDrvLeftHorzPosStruct",      "Flag",      "uint16"},
{2692,      227,      "SetEAVDrvLeftHorzPosStruct",      "HeaderCRC16",      "uint16"},
{2693,      227,      "SetEAVDrvLeftHorzPosStruct",      "UserID",      "uint32"},
{2694,      227,      "SetEAVDrvLeftHorzPosStruct",      "ReqTimeOut",      "uint32"},
{2695,      227,      "SetEAVDrvLeftHorzPosStruct",      "RequestPriority",      "uint8"},
{2696,      227,      "SetEAVDrvLeftHorzPosStruct",      "SequenceID",      "uint16"},
{2697,      227,      "SetEAVDrvLeftHorzPosStruct",      "ServiceExecuteFeedbackFlag",      "uint8"},
{2698,      227,      "SetEAVDrvLeftHorzPosStruct",      "Options",      "uint32"},
{2699,      227,      "SetEAVDrvLeftHorzPosStruct",      "SetEAVDrvLeftHorzPos",      "uint8"},
{2700,      227,      "SetEAVDrvLeftHorzPosStruct",      "MemoryReq",      "uint8"},
{2701,      227,      "SetEAVDrvLeftHorzPosRespStruct",      "RespCode",      "uint32"},
{2702,      227,      "SetEAVDrvLeftHorzPosRespStruct",      "SetEAVDrvLeftHorzPosNRC",      "uint32"},
{2703,      228,      "SetEAVDrvLeftVertPosStruct",      "SOAProtocolVersion",      "uint8"},
{2704,      228,      "SetEAVDrvLeftVertPosStruct",      "SOAHeaderType",      "uint8"},
{2705,      228,      "SetEAVDrvLeftVertPosStruct",      "SOAHeaderLength",      "uint16"},
{2706,      228,      "SetEAVDrvLeftVertPosStruct",      "Flag",      "uint16"},
{2707,      228,      "SetEAVDrvLeftVertPosStruct",      "HeaderCRC16",      "uint16"},
{2708,      228,      "SetEAVDrvLeftVertPosStruct",      "UserID",      "uint32"},
{2709,      228,      "SetEAVDrvLeftVertPosStruct",      "ReqTimeOut",      "uint32"},
{2710,      228,      "SetEAVDrvLeftVertPosStruct",      "RequestPriority",      "uint8"},
{2711,      228,      "SetEAVDrvLeftVertPosStruct",      "SequenceID",      "uint16"},
{2712,      228,      "SetEAVDrvLeftVertPosStruct",      "ServiceExecuteFeedbackFlag",      "uint8"},
{2713,      228,      "SetEAVDrvLeftVertPosStruct",      "Options",      "uint32"},
{2714,      228,      "SetEAVDrvLeftVertPosStruct",      "SetEAVDrvLeftVertPos",      "uint8"},
{2715,      228,      "SetEAVDrvLeftVertPosStruct",      "MemoryReq",      "uint8"},
{2716,      228,      "SetEAVDrvLeftVertPosRespStruct",      "RespCode",      "uint32"},
{2717,      228,      "SetEAVDrvLeftVertPosRespStruct",      "SetEAVDrvLeftVertPosNRC",      "uint32"},
{2718,      229,      "SetEAVDrvRightHorzPosStruct",      "SOAProtocolVersion",      "uint8"},
{2719,      229,      "SetEAVDrvRightHorzPosStruct",      "SOAHeaderType",      "uint8"},
{2720,      229,      "SetEAVDrvRightHorzPosStruct",      "SOAHeaderLength",      "uint16"},
{2721,      229,      "SetEAVDrvRightHorzPosStruct",      "Flag",      "uint16"},
{2722,      229,      "SetEAVDrvRightHorzPosStruct",      "HeaderCRC16",      "uint16"},
{2723,      229,      "SetEAVDrvRightHorzPosStruct",      "UserID",      "uint32"},
{2724,      229,      "SetEAVDrvRightHorzPosStruct",      "ReqTimeOut",      "uint32"},
{2725,      229,      "SetEAVDrvRightHorzPosStruct",      "RequestPriority",      "uint8"},
{2726,      229,      "SetEAVDrvRightHorzPosStruct",      "SequenceID",      "uint16"},
{2727,      229,      "SetEAVDrvRightHorzPosStruct",      "ServiceExecuteFeedbackFlag",      "uint8"},
{2728,      229,      "SetEAVDrvRightHorzPosStruct",      "Options",      "uint32"},
{2729,      229,      "SetEAVDrvRightHorzPosStruct",      "SetEAVDrvRightHorzPos",      "uint8"},
{2730,      229,      "SetEAVDrvRightHorzPosStruct",      "MemoryReq",      "uint8"},
{2731,      229,      "SetEAVDrvRightHorzPosRespStruct",      "RespCode",      "uint32"},
{2732,      229,      "SetEAVDrvRightHorzPosRespStruct",      "SetEAVDrvRightHorzPosNRC",      "uint32"},
{2733,      230,      "SetEAVDrvRightVertPosStruct",      "SOAProtocolVersion",      "uint8"},
{2734,      230,      "SetEAVDrvRightVertPosStruct",      "SOAHeaderType",      "uint8"},
{2735,      230,      "SetEAVDrvRightVertPosStruct",      "SOAHeaderLength",      "uint16"},
{2736,      230,      "SetEAVDrvRightVertPosStruct",      "Flag",      "uint16"},
{2737,      230,      "SetEAVDrvRightVertPosStruct",      "HeaderCRC16",      "uint16"},
{2738,      230,      "SetEAVDrvRightVertPosStruct",      "UserID",      "uint32"},
{2739,      230,      "SetEAVDrvRightVertPosStruct",      "ReqTimeOut",      "uint32"},
{2740,      230,      "SetEAVDrvRightVertPosStruct",      "RequestPriority",      "uint8"},
{2741,      230,      "SetEAVDrvRightVertPosStruct",      "SequenceID",      "uint16"},
{2742,      230,      "SetEAVDrvRightVertPosStruct",      "ServiceExecuteFeedbackFlag",      "uint8"},
{2743,      230,      "SetEAVDrvRightVertPosStruct",      "Options",      "uint32"},
{2744,      230,      "SetEAVDrvRightVertPosStruct",      "SetEAVDrvRightVertPos",      "uint8"},
{2745,      230,      "SetEAVDrvRightVertPosStruct",      "MemoryReq",      "uint8"},
{2746,      230,      "SetEAVDrvRightVertPosRespStruct",      "RespCode",      "uint32"},
{2747,      230,      "SetEAVDrvRightVertPosRespStruct",      "SetEAVDrvRightVertPosNRC",      "uint32"},
{2748,      231,      "SetEAVPsnLeftHorzPosStruct",      "SOAProtocolVersion",      "uint8"},
{2749,      231,      "SetEAVPsnLeftHorzPosStruct",      "SOAHeaderType",      "uint8"},
{2750,      231,      "SetEAVPsnLeftHorzPosStruct",      "SOAHeaderLength",      "uint16"},
{2751,      231,      "SetEAVPsnLeftHorzPosStruct",      "Flag",      "uint16"},
{2752,      231,      "SetEAVPsnLeftHorzPosStruct",      "HeaderCRC16",      "uint16"},
{2753,      231,      "SetEAVPsnLeftHorzPosStruct",      "UserID",      "uint32"},
{2754,      231,      "SetEAVPsnLeftHorzPosStruct",      "ReqTimeOut",      "uint32"},
{2755,      231,      "SetEAVPsnLeftHorzPosStruct",      "RequestPriority",      "uint8"},
{2756,      231,      "SetEAVPsnLeftHorzPosStruct",      "SequenceID",      "uint16"},
{2757,      231,      "SetEAVPsnLeftHorzPosStruct",      "ServiceExecuteFeedbackFlag",      "uint8"},
{2758,      231,      "SetEAVPsnLeftHorzPosStruct",      "Options",      "uint32"},
{2759,      231,      "SetEAVPsnLeftHorzPosStruct",      "SetEAVPsnLeftHorzPos",      "uint8"},
{2760,      231,      "SetEAVPsnLeftHorzPosStruct",      "MemoryReq",      "uint8"},
{2761,      231,      "SetEAVPsnLeftHorzPosRespStruct",      "RespCode",      "uint32"},
{2762,      231,      "SetEAVPsnLeftHorzPosRespStruct",      "SetEAVPsnLeftHorzPosNRC",      "uint32"},
{2763,      232,      "SetEAVPsnLeftVertPosStruct",      "SOAProtocolVersion",      "uint8"},
{2764,      232,      "SetEAVPsnLeftVertPosStruct",      "SOAHeaderType",      "uint8"},
{2765,      232,      "SetEAVPsnLeftVertPosStruct",      "SOAHeaderLength",      "uint16"},
{2766,      232,      "SetEAVPsnLeftVertPosStruct",      "Flag",      "uint16"},
{2767,      232,      "SetEAVPsnLeftVertPosStruct",      "HeaderCRC16",      "uint16"},
{2768,      232,      "SetEAVPsnLeftVertPosStruct",      "UserID",      "uint32"},
{2769,      232,      "SetEAVPsnLeftVertPosStruct",      "ReqTimeOut",      "uint32"},
{2770,      232,      "SetEAVPsnLeftVertPosStruct",      "RequestPriority",      "uint8"},
{2771,      232,      "SetEAVPsnLeftVertPosStruct",      "SequenceID",      "uint16"},
{2772,      232,      "SetEAVPsnLeftVertPosStruct",      "ServiceExecuteFeedbackFlag",      "uint8"},
{2773,      232,      "SetEAVPsnLeftVertPosStruct",      "Options",      "uint32"},
{2774,      232,      "SetEAVPsnLeftVertPosStruct",      "SetEAVPsnLeftVertPos",      "uint8"},
{2775,      232,      "SetEAVPsnLeftVertPosStruct",      "MemoryReq",      "uint8"},
{2776,      232,      "SetEAVPsnLeftVertPosRespStruct",      "RespCode",      "uint32"},
{2777,      232,      "SetEAVPsnLeftVertPosRespStruct",      "SetEAVPsnLeftVertPosNRC",      "uint32"},
{2778,      233,      "SetEAVPsnRightHorzPosStruct",      "SOAProtocolVersion",      "uint8"},
{2779,      233,      "SetEAVPsnRightHorzPosStruct",      "SOAHeaderType",      "uint8"},
{2780,      233,      "SetEAVPsnRightHorzPosStruct",      "SOAHeaderLength",      "uint16"},
{2781,      233,      "SetEAVPsnRightHorzPosStruct",      "Flag",      "uint16"},
{2782,      233,      "SetEAVPsnRightHorzPosStruct",      "HeaderCRC16",      "uint16"},
{2783,      233,      "SetEAVPsnRightHorzPosStruct",      "UserID",      "uint32"},
{2784,      233,      "SetEAVPsnRightHorzPosStruct",      "ReqTimeOut",      "uint32"},
{2785,      233,      "SetEAVPsnRightHorzPosStruct",      "RequestPriority",      "uint8"},
{2786,      233,      "SetEAVPsnRightHorzPosStruct",      "SequenceID",      "uint16"},
{2787,      233,      "SetEAVPsnRightHorzPosStruct",      "ServiceExecuteFeedbackFlag",      "uint8"},
{2788,      233,      "SetEAVPsnRightHorzPosStruct",      "Options",      "uint32"},
{2789,      233,      "SetEAVPsnRightHorzPosStruct",      "SetEAVPsnRightHorzPos",      "uint8"},
{2790,      233,      "SetEAVPsnRightHorzPosStruct",      "MemoryReq",      "uint8"},
{2791,      233,      "SetEAVPsnRightHorzPosRespStruct",      "RespCode",      "uint32"},
{2792,      233,      "SetEAVPsnRightHorzPosRespStruct",      "SetEAVPsnRightHorzPosNRC",      "uint32"},
{2793,      234,      "SetEAVPsnRightVertPosStruct",      "SOAProtocolVersion",      "uint8"},
{2794,      234,      "SetEAVPsnRightVertPosStruct",      "SOAHeaderType",      "uint8"},
{2795,      234,      "SetEAVPsnRightVertPosStruct",      "SOAHeaderLength",      "uint16"},
{2796,      234,      "SetEAVPsnRightVertPosStruct",      "Flag",      "uint16"},
{2797,      234,      "SetEAVPsnRightVertPosStruct",      "HeaderCRC16",      "uint16"},
{2798,      234,      "SetEAVPsnRightVertPosStruct",      "UserID",      "uint32"},
{2799,      234,      "SetEAVPsnRightVertPosStruct",      "ReqTimeOut",      "uint32"},
{2800,      234,      "SetEAVPsnRightVertPosStruct",      "RequestPriority",      "uint8"},
{2801,      234,      "SetEAVPsnRightVertPosStruct",      "SequenceID",      "uint16"},
{2802,      234,      "SetEAVPsnRightVertPosStruct",      "ServiceExecuteFeedbackFlag",      "uint8"},
{2803,      234,      "SetEAVPsnRightVertPosStruct",      "Options",      "uint32"},
{2804,      234,      "SetEAVPsnRightVertPosStruct",      "SetEAVPsnRightVertPos",      "uint8"},
{2805,      234,      "SetEAVPsnRightVertPosStruct",      "MemoryReq",      "uint8"},
{2806,      234,      "SetEAVPsnRightVertPosRespStruct",      "RespCode",      "uint32"},
{2807,      234,      "SetEAVPsnRightVertPosRespStruct",      "SetEAVPsnRightVertPosNRC",      "uint32"},
{2808,      235,      "SetEAVDrvWindModeStruct",      "SOAProtocolVersion",      "uint8"},
{2809,      235,      "SetEAVDrvWindModeStruct",      "SOAHeaderType",      "uint8"},
{2810,      235,      "SetEAVDrvWindModeStruct",      "SOAHeaderLength",      "uint16"},
{2811,      235,      "SetEAVDrvWindModeStruct",      "Flag",      "uint16"},
{2812,      235,      "SetEAVDrvWindModeStruct",      "HeaderCRC16",      "uint16"},
{2813,      235,      "SetEAVDrvWindModeStruct",      "UserID",      "uint32"},
{2814,      235,      "SetEAVDrvWindModeStruct",      "ReqTimeOut",      "uint32"},
{2815,      235,      "SetEAVDrvWindModeStruct",      "RequestPriority",      "uint8"},
{2816,      235,      "SetEAVDrvWindModeStruct",      "SequenceID",      "uint16"},
{2817,      235,      "SetEAVDrvWindModeStruct",      "ServiceExecuteFeedbackFlag",      "uint8"},
{2818,      235,      "SetEAVDrvWindModeStruct",      "Options",      "uint32"},
{2819,      235,      "SetEAVDrvWindModeStruct",      "SetEAVDrvWindMode",      "uint8"},
{2820,      235,      "SetEAVDrvWindModeStruct",      "MemoryReq",      "uint8"},
{2821,      235,      "SetEAVDrvWindModeRespStruct",      "RespCode",      "uint32"},
{2822,      235,      "SetEAVDrvWindModeRespStruct",      "SetEAVDrvWindModeNRC",      "uint32"},
{2823,      236,      "SetEAVPsnWindModeStruct",      "SOAProtocolVersion",      "uint8"},
{2824,      236,      "SetEAVPsnWindModeStruct",      "SOAHeaderType",      "uint8"},
{2825,      236,      "SetEAVPsnWindModeStruct",      "SOAHeaderLength",      "uint16"},
{2826,      236,      "SetEAVPsnWindModeStruct",      "Flag",      "uint16"},
{2827,      236,      "SetEAVPsnWindModeStruct",      "HeaderCRC16",      "uint16"},
{2828,      236,      "SetEAVPsnWindModeStruct",      "UserID",      "uint32"},
{2829,      236,      "SetEAVPsnWindModeStruct",      "ReqTimeOut",      "uint32"},
{2830,      236,      "SetEAVPsnWindModeStruct",      "RequestPriority",      "uint8"},
{2831,      236,      "SetEAVPsnWindModeStruct",      "SequenceID",      "uint16"},
{2832,      236,      "SetEAVPsnWindModeStruct",      "ServiceExecuteFeedbackFlag",      "uint8"},
{2833,      236,      "SetEAVPsnWindModeStruct",      "Options",      "uint32"},
{2834,      236,      "SetEAVPsnWindModeStruct",      "SetEAVPsnWindMode",      "uint8"},
{2835,      236,      "SetEAVPsnWindModeStruct",      "MemoryReq",      "uint8"},
{2836,      236,      "SetEAVPsnWindModeRespStruct",      "RespCode",      "uint32"},
{2837,      236,      "SetEAVPsnWindModeRespStruct",      "SetEAVPsnWindModeNRC",      "uint32"},
{2838,      237,      "SetEAVSweepWindStruct",      "SOAProtocolVersion",      "uint8"},
{2839,      237,      "SetEAVSweepWindStruct",      "SOAHeaderType",      "uint8"},
{2840,      237,      "SetEAVSweepWindStruct",      "SOAHeaderLength",      "uint16"},
{2841,      237,      "SetEAVSweepWindStruct",      "Flag",      "uint16"},
{2842,      237,      "SetEAVSweepWindStruct",      "HeaderCRC16",      "uint16"},
{2843,      237,      "SetEAVSweepWindStruct",      "UserID",      "uint32"},
{2844,      237,      "SetEAVSweepWindStruct",      "ReqTimeOut",      "uint32"},
{2845,      237,      "SetEAVSweepWindStruct",      "RequestPriority",      "uint8"},
{2846,      237,      "SetEAVSweepWindStruct",      "SequenceID",      "uint16"},
{2847,      237,      "SetEAVSweepWindStruct",      "ServiceExecuteFeedbackFlag",      "uint8"},
{2848,      237,      "SetEAVSweepWindStruct",      "Options",      "uint32"},
{2849,      237,      "SetEAVSweepWindStruct",      "SetEAVSweepWind",      "uint8"},
{2850,      237,      "SetEAVSweepWindStruct",      "MemoryReq",      "uint8"},
{2851,      237,      "SetEAVSweepWindRespStruct",      "RespCode",      "uint32"},
{2852,      237,      "SetEAVSweepWindRespStruct",      "SetEAVSweepWindNRC",      "uint32"},
{2853,      238,      "SetEAVRLHorzPosStruct",      "SOAProtocolVersion",      "uint8"},
{2854,      238,      "SetEAVRLHorzPosStruct",      "SOAHeaderType",      "uint8"},
{2855,      238,      "SetEAVRLHorzPosStruct",      "SOAHeaderLength",      "uint16"},
{2856,      238,      "SetEAVRLHorzPosStruct",      "Flag",      "uint16"},
{2857,      238,      "SetEAVRLHorzPosStruct",      "HeaderCRC16",      "uint16"},
{2858,      238,      "SetEAVRLHorzPosStruct",      "UserID",      "uint32"},
{2859,      238,      "SetEAVRLHorzPosStruct",      "ReqTimeOut",      "uint32"},
{2860,      238,      "SetEAVRLHorzPosStruct",      "RequestPriority",      "uint8"},
{2861,      238,      "SetEAVRLHorzPosStruct",      "SequenceID",      "uint16"},
{2862,      238,      "SetEAVRLHorzPosStruct",      "ServiceExecuteFeedbackFlag",      "uint8"},
{2863,      238,      "SetEAVRLHorzPosStruct",      "Options",      "uint32"},
{2864,      238,      "SetEAVRLHorzPosStruct",      "SetEAVRLHorzPos",      "uint8"},
{2865,      238,      "SetEAVRLHorzPosStruct",      "MemoryReq",      "uint8"},
{2866,      238,      "SetEAVRLHorzPosRespStruct",      "RespCode",      "uint32"},
{2867,      238,      "SetEAVRLHorzPosRespStruct",      "SetEAVRLHorzPosNRC",      "uint32"},
{2868,      239,      "SetEAVRLVertPosStruct",      "SOAProtocolVersion",      "uint8"},
{2869,      239,      "SetEAVRLVertPosStruct",      "SOAHeaderType",      "uint8"},
{2870,      239,      "SetEAVRLVertPosStruct",      "SOAHeaderLength",      "uint16"},
{2871,      239,      "SetEAVRLVertPosStruct",      "Flag",      "uint16"},
{2872,      239,      "SetEAVRLVertPosStruct",      "HeaderCRC16",      "uint16"},
{2873,      239,      "SetEAVRLVertPosStruct",      "UserID",      "uint32"},
{2874,      239,      "SetEAVRLVertPosStruct",      "ReqTimeOut",      "uint32"},
{2875,      239,      "SetEAVRLVertPosStruct",      "RequestPriority",      "uint8"},
{2876,      239,      "SetEAVRLVertPosStruct",      "SequenceID",      "uint16"},
{2877,      239,      "SetEAVRLVertPosStruct",      "ServiceExecuteFeedbackFlag",      "uint8"},
{2878,      239,      "SetEAVRLVertPosStruct",      "Options",      "uint32"},
{2879,      239,      "SetEAVRLVertPosStruct",      "SetEAVRLVertPos",      "uint8"},
{2880,      239,      "SetEAVRLVertPosStruct",      "MemoryReq",      "uint8"},
{2881,      239,      "SetEAVRLVertPosRespStruct",      "RespCode",      "uint32"},
{2882,      239,      "SetEAVRLVertPosRespStruct",      "SetEAVRLVertPosNRC",      "uint32"},
{2883,      240,      "SetEAVRRHorzPosStruct",      "SOAProtocolVersion",      "uint8"},
{2884,      240,      "SetEAVRRHorzPosStruct",      "SOAHeaderType",      "uint8"},
{2885,      240,      "SetEAVRRHorzPosStruct",      "SOAHeaderLength",      "uint16"},
{2886,      240,      "SetEAVRRHorzPosStruct",      "Flag",      "uint16"},
{2887,      240,      "SetEAVRRHorzPosStruct",      "HeaderCRC16",      "uint16"},
{2888,      240,      "SetEAVRRHorzPosStruct",      "UserID",      "uint32"},
{2889,      240,      "SetEAVRRHorzPosStruct",      "ReqTimeOut",      "uint32"},
{2890,      240,      "SetEAVRRHorzPosStruct",      "RequestPriority",      "uint8"},
{2891,      240,      "SetEAVRRHorzPosStruct",      "SequenceID",      "uint16"},
{2892,      240,      "SetEAVRRHorzPosStruct",      "ServiceExecuteFeedbackFlag",      "uint8"},
{2893,      240,      "SetEAVRRHorzPosStruct",      "Options",      "uint32"},
{2894,      240,      "SetEAVRRHorzPosStruct",      "SetEAVRRHorzPos",      "uint8"},
{2895,      240,      "SetEAVRRHorzPosStruct",      "MemoryReq",      "uint8"},
{2896,      240,      "SetEAVRRHorzPosRespStruct",      "RespCode",      "uint32"},
{2897,      240,      "SetEAVRRHorzPosRespStruct",      "SetEAVRRHorzPosNRC",      "uint32"},
{2898,      241,      "SetEAVRRVertPosStruct",      "SOAProtocolVersion",      "uint8"},
{2899,      241,      "SetEAVRRVertPosStruct",      "SOAHeaderType",      "uint8"},
{2900,      241,      "SetEAVRRVertPosStruct",      "SOAHeaderLength",      "uint16"},
{2901,      241,      "SetEAVRRVertPosStruct",      "Flag",      "uint16"},
{2902,      241,      "SetEAVRRVertPosStruct",      "HeaderCRC16",      "uint16"},
{2903,      241,      "SetEAVRRVertPosStruct",      "UserID",      "uint32"},
{2904,      241,      "SetEAVRRVertPosStruct",      "ReqTimeOut",      "uint32"},
{2905,      241,      "SetEAVRRVertPosStruct",      "RequestPriority",      "uint8"},
{2906,      241,      "SetEAVRRVertPosStruct",      "SequenceID",      "uint16"},
{2907,      241,      "SetEAVRRVertPosStruct",      "ServiceExecuteFeedbackFlag",      "uint8"},
{2908,      241,      "SetEAVRRVertPosStruct",      "Options",      "uint32"},
{2909,      241,      "SetEAVRRVertPosStruct",      "SetEAVRRVertPos",      "uint8"},
{2910,      241,      "SetEAVRRVertPosStruct",      "MemoryReq",      "uint8"},
{2911,      241,      "SetEAVRRVertPosRespStruct",      "RespCode",      "uint32"},
{2912,      241,      "SetEAVRRVertPosRespStruct",      "SetEAVRRVertPosNRC",      "uint32"},
{2913,      242,      "SetEAVRLWindModeStruct",      "SOAProtocolVersion",      "uint8"},
{2914,      242,      "SetEAVRLWindModeStruct",      "SOAHeaderType",      "uint8"},
{2915,      242,      "SetEAVRLWindModeStruct",      "SOAHeaderLength",      "uint16"},
{2916,      242,      "SetEAVRLWindModeStruct",      "Flag",      "uint16"},
{2917,      242,      "SetEAVRLWindModeStruct",      "HeaderCRC16",      "uint16"},
{2918,      242,      "SetEAVRLWindModeStruct",      "UserID",      "uint32"},
{2919,      242,      "SetEAVRLWindModeStruct",      "ReqTimeOut",      "uint32"},
{2920,      242,      "SetEAVRLWindModeStruct",      "RequestPriority",      "uint8"},
{2921,      242,      "SetEAVRLWindModeStruct",      "SequenceID",      "uint16"},
{2922,      242,      "SetEAVRLWindModeStruct",      "ServiceExecuteFeedbackFlag",      "uint8"},
{2923,      242,      "SetEAVRLWindModeStruct",      "Options",      "uint32"},
{2924,      242,      "SetEAVRLWindModeStruct",      "SetEAVRLWindMode",      "uint8"},
{2925,      242,      "SetEAVRLWindModeStruct",      "MemoryReq",      "uint8"},
{2926,      242,      "SetEAVRLWindModeRespStruct",      "RespCode",      "uint32"},
{2927,      242,      "SetEAVRLWindModeRespStruct",      "SetEAVRLWindModeNRC",      "uint32"},
{2928,      243,      "SetEAVRRWindModeStruct",      "SOAProtocolVersion",      "uint8"},
{2929,      243,      "SetEAVRRWindModeStruct",      "SOAHeaderType",      "uint8"},
{2930,      243,      "SetEAVRRWindModeStruct",      "SOAHeaderLength",      "uint16"},
{2931,      243,      "SetEAVRRWindModeStruct",      "Flag",      "uint16"},
{2932,      243,      "SetEAVRRWindModeStruct",      "HeaderCRC16",      "uint16"},
{2933,      243,      "SetEAVRRWindModeStruct",      "UserID",      "uint32"},
{2934,      243,      "SetEAVRRWindModeStruct",      "ReqTimeOut",      "uint32"},
{2935,      243,      "SetEAVRRWindModeStruct",      "RequestPriority",      "uint8"},
{2936,      243,      "SetEAVRRWindModeStruct",      "SequenceID",      "uint16"},
{2937,      243,      "SetEAVRRWindModeStruct",      "ServiceExecuteFeedbackFlag",      "uint8"},
{2938,      243,      "SetEAVRRWindModeStruct",      "Options",      "uint32"},
{2939,      243,      "SetEAVRRWindModeStruct",      "SetEAVRRWindMode",      "uint8"},
{2940,      243,      "SetEAVRRWindModeStruct",      "MemoryReq",      "uint8"},
{2941,      243,      "SetEAVRRWindModeRespStruct",      "RespCode",      "uint32"},
{2942,      243,      "SetEAVRRWindModeRespStruct",      "SetEAVRRWindModeNRC",      "uint32"},
{2943,      244,      "SetREAVSweepWindStruct",      "SOAProtocolVersion",      "uint8"},
{2944,      244,      "SetREAVSweepWindStruct",      "SOAHeaderType",      "uint8"},
{2945,      244,      "SetREAVSweepWindStruct",      "SOAHeaderLength",      "uint16"},
{2946,      244,      "SetREAVSweepWindStruct",      "Flag",      "uint16"},
{2947,      244,      "SetREAVSweepWindStruct",      "HeaderCRC16",      "uint16"},
{2948,      244,      "SetREAVSweepWindStruct",      "UserID",      "uint32"},
{2949,      244,      "SetREAVSweepWindStruct",      "ReqTimeOut",      "uint32"},
{2950,      244,      "SetREAVSweepWindStruct",      "RequestPriority",      "uint8"},
{2951,      244,      "SetREAVSweepWindStruct",      "SequenceID",      "uint16"},
{2952,      244,      "SetREAVSweepWindStruct",      "ServiceExecuteFeedbackFlag",      "uint8"},
{2953,      244,      "SetREAVSweepWindStruct",      "Options",      "uint32"},
{2954,      244,      "SetREAVSweepWindStruct",      "SetREAVSweepWind",      "uint8"},
{2955,      244,      "SetREAVSweepWindStruct",      "MemoryReq",      "uint8"},
{2956,      244,      "SetREAVSweepWindRespStruct",      "RespCode",      "uint32"},
{2957,      244,      "SetREAVSweepWindRespStruct",      "SetREAVSweepWindNRC",      "uint32"},
{2958,      245,      "ThermalSys1Struct",      "BTMActualWorkSt",      "uint8"},
{2959,      245,      "ThermalSys1Struct",      "AcSysActualWorkSt",      "uint8"},
{2960,      245,      "ThermalSys1Struct",      "CompSt",      "uint8"},
{2961,      245,      "ThermalSys1Struct",      "HVHSt",      "uint8"},
{2962,      245,      "ThermalSys1Struct",      "HVPowOnReq",      "uint8"},
{2963,      245,      "ThermalSys1Struct",      "AgsOpenLvlReq",      "uint8"},
{2964,      245,      "ThermalSys1Struct",      "RAC_SOV3St",      "uint8"},
{2965,      245,      "ThermalSys1Struct",      "PM2_5FanCtrlReq",      "uint8"},
{2966,      245,      "ThermalSys1Struct",      "LDCUHeatReq",      "uint8"},
{2967,      245,      "ThermalSys1Struct",      "CompHeatingSt",      "uint8"},
{2968,      246,      "ThermalSys2Struct",      "CompComsumePwr",      "float32"},
{2969,      246,      "ThermalSys2Struct",      "HVHComsumePwr",      "float32"},
{2970,      246,      "ThermalSys2Struct",      "FanSpdPwmReq",      "float32"},
{2971,      246,      "ThermalSys2Struct",      "MotWaterPumpSpdReq",      "float32"},
{2972,      246,      "ThermalSys2Struct",      "BatWaterPumpSpdReq",      "float32"},
{2973,      246,      "ThermalSys2Struct",      "CurrentBMScompen",      "float32"},
{2974,      246,      "ThermalSys2Struct",      "CV1_CDVPosFb",      "float32"},
{2975,      246,      "ThermalSys2Struct",      "CV2_CDVPosFb",      "float32"},
{2976,      246,      "ThermalSys2Struct",      "AcPumpSpd",      "float32"},
{2977,      246,      "ThermalSys2Struct",      "EcompActSpd",      "float32"},
{2978,      247,      "ThermalSysSenInfoStruct",      "RefHPT_Temp",      "float32"},
{2979,      247,      "ThermalSysSenInfoStruct",      "RefHPT_Pressure",      "float32"},
{2980,      247,      "ThermalSysSenInfoStruct",      "RefLP_Pressure",      "float32"},
{2981,      247,      "ThermalSysSenInfoStruct",      "ChillerOutRefTemp",      "float32"},
{2982,      247,      "ThermalSysSenInfoStruct",      "EvapOutRefTemp",      "float32"},
{2983,      247,      "ThermalSysSenInfoStruct",      "CompOutRefTemp",      "float32"},
{2984,      247,      "ThermalSysSenInfoStruct",      "RLDuctTempFace",      "float32"},
{2985,      247,      "ThermalSysSenInfoStruct",      "RLDuctTempFoot",      "float32"},
{2986,      247,      "ThermalSysSenInfoStruct",      "RRDuctTempFace",      "float32"},
{2987,      247,      "ThermalSysSenInfoStruct",      "RRDuctTempFoot",      "float32"},
{2988,      247,      "ThermalSysSenInfoStruct",      "ThirdRowDuctTempFace",      "float32"},
{2989,      247,      "ThermalSysSenInfoStruct",      "ThirdRowDuctTempFoot",      "float32"},
{2990,      247,      "ThermalSysSenInfoStruct",      "RRawCabinTemp",      "float32"},
{2991,      247,      "ThermalSysSenInfoStruct",      "REvaporatorTemp",      "float32"},
{2992,      247,      "ThermalSysSenInfoStruct",      "RawExterTemp",      "float32"},
{2993,      247,      "ThermalSysSenInfoStruct",      "RawCabinTemp",      "float32"},
{2994,      247,      "ThermalSysSenInfoStruct",      "EvaporatorTemp",      "float32"},
{2995,      247,      "ThermalSysSenInfoStruct",      "HeatSysWatTemp",      "float32"},
{2996,      247,      "ThermalSysSenInfoStruct",      "DuctTempFaceLeft",      "float32"},
{2997,      247,      "ThermalSysSenInfoStruct",      "DuctTempFootLeft",      "float32"},
{2998,      247,      "ThermalSysSenInfoStruct",      "DuctTempFaceRight",      "float32"},
{2999,      247,      "ThermalSysSenInfoStruct",      "DuctTempFootRight",      "float32"},
{3000,      247,      "ThermalSysSenInfoStruct",      "SolarLeft",      "float32"},
{3001,      247,      "ThermalSysSenInfoStruct",      "SolarRight",      "float32"},
{3002,      247,      "ThermalSysSenInfoStruct",      "OHX_InTemp",      "float32"},
{3003,      247,      "ThermalSysSenInfoStruct",      "OHX_OutTemp",      "float32"},
{3004,      247,      "ThermalSysSenInfoStruct",      "RefLPT_Temp",      "float32"},
{3005,      247,      "ThermalSysSenInfoStruct",      "RefLPT_Pressure",      "float32"},
{3006,      247,      "ThermalSysSenInfoStruct",      "HeatCoreInWatTemp",      "float32"},
{3007,      248,      "ThermalSysActuator1Struct",      "AM_VolFb_Left",      "float32"},
{3008,      248,      "ThermalSysActuator1Struct",      "AM_VolFb_Right",      "float32"},
{3009,      248,      "ThermalSysActuator1Struct",      "AirIntakeMotVolFb",      "float32"},
{3010,      248,      "ThermalSysActuator1Struct",      "AirDisMotVolFb",      "float32"},
{3011,      248,      "ThermalSysActuator1Struct",      "DefMotVolFb",      "float32"},
{3012,      248,      "ThermalSysActuator1Struct",      "BlowerPwmSetVal",      "float32"},
{3013,      248,      "ThermalSysActuator1Struct",      "RearMotVolFb",      "float32"},
{3014,      248,      "ThermalSysActuator1Struct",      "AM_PosFb_RL",      "float32"},
{3015,      248,      "ThermalSysActuator1Struct",      "AM_PosFb_RR",      "float32"},
{3016,      248,      "ThermalSysActuator1Struct",      "EXVPos_AC",      "float32"},
{3017,      248,      "ThermalSysActuator1Struct",      "EXVPos_RAC",      "float32"},
{3018,      248,      "ThermalSysActuator1Struct",      "EXVPos_BAT",      "float32"},
{3019,      248,      "ThermalSysActuator1Struct",      "EXVPos_HP",      "float32"},
{3020,      248,      "ThermalSysActuator1Struct",      "DefCompsMotSetFb",      "float32"},
{3021,      248,      "ThermalSysActuator1Struct",      "AM_VolFb_3rdRow",      "float32"},
{3022,      248,      "ThermalSysActuator1Struct",      "ThirdRowAirDisMotVolFb",      "float32"},
{3023,      248,      "ThermalSysActuator1Struct",      "RBlowerVolFb",      "float32"},
{3024,      248,      "ThermalSysActuator1Struct",      "RAC_EXVPos",      "float32"},
{3025,      248,      "ThermalSysActuator1Struct",      "RBlowerPWMSetVal",      "float32"},
{3026,      248,      "ThermalSysActuator1Struct",      "BatEXVPos",      "float32"},
{3027,      248,      "ThermalSysActuator1Struct",      "AcEXVPos",      "float32"},
{3028,      248,      "ThermalSysActuator1Struct",      "HP_EXVPos",      "float32"},
{3029,      248,      "ThermalSysActuator1Struct",      "SVI_EXVPos",      "float32"},
{3030,      248,      "ThermalSysActuator1Struct",      "HVH_MaxPower",      "float32"},
{3031,      248,      "ThermalSysActuator1Struct",      "HVH_TargetCoolantTemp",      "float32"},
{3032,      248,      "ThermalSysActuator1Struct",      "HVH_Coolant_In_Temp",      "float32"},
{3033,      248,      "ThermalSysActuator1Struct",      "HVH_Coolant_Out_Temp",      "float32"},
{3034,      248,      "ThermalSysActuator1Struct",      "HVH_HV_Current",      "float32"},
{3035,      248,      "ThermalSysActuator1Struct",      "HVH_HV_Voltage",      "float32"},
{3036,      249,      "ThermalSysActuator2Struct",      "TS_PwrRelaySt",      "uint8"},
{3037,      249,      "ThermalSysActuator2Struct",      "SOVSt_OHX2AD",      "uint8"},
{3038,      249,      "ThermalSysActuator2Struct",      "SOVSt_OHX2BEXV_LIN",      "uint8"},
{3039,      249,      "ThermalSysActuator2Struct",      "SOVSt_LCC2EVA",      "uint8"},
{3040,      249,      "ThermalSysActuator2Struct",      "SOVSt_EVAPOUT_LIN",      "uint8"},
{3041,      249,      "ThermalSysActuator2Struct",      "SOVSt_OHX2AD_LIN",      "uint8"},
{3042,      249,      "ThermalSysActuator2Struct",      "SOVSt_HP2OHX_LIN",      "uint8"},
{3043,      249,      "ThermalSysActuator2Struct",      "HVH_HeaterEnable",      "uint8"},
{3044,      249,      "ThermalSysActuator2Struct",      "HVH_ActiveDischarge",      "uint8"},
{3045,      249,      "ThermalSysActuator2Struct",      "HVH_Status",      "uint8"},
{3046,      249,      "ThermalSysActuator2Struct",      "HVH_Config",      "uint8"},
{3047,      250,      "TMC_DTCStruct",      "LftFaceSe_Sht2GND",      "uint8"},
{3048,      250,      "TMC_DTCStruct",      "LftFaceSe_OpenOrSht2BAT",      "uint8"},
{3049,      250,      "TMC_DTCStruct",      "RgtFaceSe_Sht2GND",      "uint8"},
{3050,      250,      "TMC_DTCStruct",      "RgtFaceSe_OpenOrSht2BAT",      "uint8"},
{3051,      250,      "TMC_DTCStruct",      "LftFootSe_Sht2GND",      "uint8"},
{3052,      250,      "TMC_DTCStruct",      "LftFootSe_OpenOrSht2BAT",      "uint8"},
{3053,      250,      "TMC_DTCStruct",      "RgtFootSe_Sht2GND",      "uint8"},
{3054,      250,      "TMC_DTCStruct",      "RgtFootSe_OpenOrSht2BAT",      "uint8"},
{3055,      250,      "TMC_DTCStruct",      "EvapTeSe_Sht2GND",      "uint8"},
{3056,      250,      "TMC_DTCStruct",      "EvapTeSe_OpenOrSht2BAT",      "uint8"},
{3057,      250,      "TMC_DTCStruct",      "ActuDriICSPIErr",      "uint8"},
{3058,      250,      "TMC_DTCStruct",      "ActuDriICSPISendFail",      "uint8"},
{3059,      250,      "TMC_DTCStruct",      "ActuDriICTempWarning",      "uint8"},
{3060,      250,      "TMC_DTCStruct",      "ActuDriICTempShutDown",      "uint8"},
{3061,      250,      "TMC_DTCStruct",      "ModeActFb_Sht2GND",      "uint8"},
{3062,      250,      "TMC_DTCStruct",      "ModeActFb_OpenOrSht2BAT",      "uint8"},
{3063,      250,      "TMC_DTCStruct",      "ModeActDriOpen",      "uint8"},
{3064,      250,      "TMC_DTCStruct",      "ModeActDriSht2Bat",      "uint8"},
{3065,      250,      "TMC_DTCStruct",      "ModeActDriSht2GND",      "uint8"},
{3066,      250,      "TMC_DTCStruct",      "ModeActStall",      "uint8"},
{3067,      250,      "TMC_DTCStruct",      "LftAM_ActFbSht2GND",      "uint8"},
{3068,      250,      "TMC_DTCStruct",      "LftAM_ActFbOpenOrSht2BAT",      "uint8"},
{3069,      250,      "TMC_DTCStruct",      "LftAM_ActDriOpen",      "uint8"},
{3070,      250,      "TMC_DTCStruct",      "LftAM_ActDriSht2Bat",      "uint8"},
{3071,      250,      "TMC_DTCStruct",      "LftAM_ActDriSht2GND",      "uint8"},
{3072,      250,      "TMC_DTCStruct",      "LftAM_ActStall",      "uint8"},
{3073,      250,      "TMC_DTCStruct",      "RgtAM_ActFbSht2GND",      "uint8"},
{3074,      250,      "TMC_DTCStruct",      "RgtAM_ActFbOpenOrSht2BAT",      "uint8"},
{3075,      250,      "TMC_DTCStruct",      "RgtAM_ActDriOpen",      "uint8"},
{3076,      250,      "TMC_DTCStruct",      "RgtAM_ActDriSht2GND",      "uint8"},
{3077,      250,      "TMC_DTCStruct",      "RgtAM_ActDriSht2Bat",      "uint8"},
{3078,      250,      "TMC_DTCStruct",      "RgtAM_ActStall",      "uint8"},
{3079,      250,      "TMC_DTCStruct",      "AirIntake_ActFbSht2GND",      "uint8"},
{3080,      250,      "TMC_DTCStruct",      "AirIntake_ActFbSht2BAT",      "uint8"},
{3081,      250,      "TMC_DTCStruct",      "AirIntake_ActDriOpen",      "uint8"},
{3082,      250,      "TMC_DTCStruct",      "AirIntake_ActDriSht2Bat",      "uint8"},
{3083,      250,      "TMC_DTCStruct",      "AirIntake_ActDriSht2GND",      "uint8"},
{3084,      250,      "TMC_DTCStruct",      "AirIntake_ActStall",      "uint8"},
{3085,      250,      "TMC_DTCStruct",      "Sensor5V1DriShrt2Bat",      "uint8"},
{3086,      250,      "TMC_DTCStruct",      "Sensor5V1DriShrt2Gnd",      "uint8"},
{3087,      250,      "TMC_DTCStruct",      "BlwRlyCtrDriCommandErr",      "uint8"},
{3088,      250,      "TMC_DTCStruct",      "BlwRlyCtrDriOpen",      "uint8"},
{3089,      250,      "TMC_DTCStruct",      "BlwRlyCtrDriShrt2Bat",      "uint8"},
{3090,      250,      "TMC_DTCStruct",      "BlwRlyCtrDriShrt2Gnd",      "uint8"},
{3091,      250,      "TMC_DTCStruct",      "BlwRlyCtrDriOverCurrent",      "uint8"},
{3092,      250,      "TMC_DTCStruct",      "BlwRlyCtrDriOverTemp",      "uint8"},
{3093,      250,      "TMC_DTCStruct",      "AcPumpRlyCtrDriCommandErr",      "uint8"},
{3094,      250,      "TMC_DTCStruct",      "AcPumpRlyCtrDriOpen",      "uint8"},
{3095,      250,      "TMC_DTCStruct",      "AcPumpRlyCtrDriShrt2Bat",      "uint8"},
{3096,      250,      "TMC_DTCStruct",      "AcPumpRlyCtrDriShrt2Gnd",      "uint8"},
{3097,      250,      "TMC_DTCStruct",      "AcPumpRlyCtrDriOverCur",      "uint8"},
{3098,      250,      "TMC_DTCStruct",      "AcPumpRlyCtrDriOverTemp",      "uint8"},
{3099,      250,      "TMC_DTCStruct",      "LCC2EVA_DriShrt2Bat",      "uint8"},
{3100,      250,      "TMC_DTCStruct",      "LCC2EVA_DriShrt2Gnd",      "uint8"},
{3101,      250,      "TMC_DTCStruct",      "LCC2EVA_DriOverCurrent",      "uint8"},
{3102,      250,      "TMC_DTCStruct",      "LCC2EVA_DriOpen",      "uint8"},
{3103,      250,      "TMC_DTCStruct",      "OHX2AD_DriShrt2Bat",      "uint8"},
{3104,      250,      "TMC_DTCStruct",      "OHX2AD_DriShrt2Gnd",      "uint8"},
{3105,      250,      "TMC_DTCStruct",      "OHX2AD_DriOverCurrent",      "uint8"},
{3106,      250,      "TMC_DTCStruct",      "OHX2AD_DriOpen",      "uint8"},
{3107,      250,      "TMC_DTCStruct",      "BlwHearbaetAbnormal",      "uint8"},
{3108,      250,      "TMC_DTCStruct",      "BlwVolAbnormal",      "uint8"},
{3109,      250,      "TMC_DTCStruct",      "BlwStall",      "uint8"},
{3110,      250,      "TMC_DTCStruct",      "BlwInternalErr",      "uint8"},
{3111,      250,      "TMC_DTCStruct",      "ICT_SeSht2GND",      "uint8"},
{3112,      250,      "TMC_DTCStruct",      "ICT_SeOpenOrSht2BAT",      "uint8"},
{3113,      250,      "TMC_DTCStruct",      "OAT_SeSht2GND",      "uint8"},
{3114,      250,      "TMC_DTCStruct",      "OAT_SeOpenOrSht2BAT",      "uint8"},
{3115,      250,      "TMC_DTCStruct",      "SolarLft_SeSht2GND",      "uint8"},
{3116,      250,      "TMC_DTCStruct",      "SolarLft_SeOpenOrSht2BAT",      "uint8"},
{3117,      250,      "TMC_DTCStruct",      "SolarRgt_SeSht2GND",      "uint8"},
{3118,      250,      "TMC_DTCStruct",      "SolarRgt_SeOpenOrSht2BAT",      "uint8"},
{3119,      250,      "TMC_DTCStruct",      "PM2_5SeOutOfRange",      "uint8"},
{3120,      250,      "TMC_DTCStruct",      "PM2_5SeSht2GND",      "uint8"},
{3121,      250,      "TMC_DTCStruct",      "PM2_5SeOpenOrSht2BAT",      "uint8"},
{3122,      250,      "TMC_DTCStruct",      "MuFuNodeLost",      "uint8"},
{3123,      250,      "TMC_DTCStruct",      "AqsErr",      "uint8"},
{3124,      250,      "TMC_DTCStruct",      "AqsNotInstall",      "uint8"},
{3125,      250,      "TMC_DTCStruct",      "LinAmbTempSenErr",      "uint8"},
{3126,      250,      "TMC_DTCStruct",      "LinAmbTempSenNotInstall",      "uint8"},
{3127,      250,      "TMC_DTCStruct",      "DefSeAirHumSht2GND",      "uint8"},
{3128,      250,      "TMC_DTCStruct",      "DefSeAirHumOpenOrSht2BAT",      "uint8"},
{3129,      250,      "TMC_DTCStruct",      "DefSeGlassTeSht2GND",      "uint8"},
{3130,      250,      "TMC_DTCStruct",      "DefSeGlassTeOpenOrSht2BAT",      "uint8"},
{3131,      250,      "TMC_DTCStruct",      "DefSeAirTeSht2GND",      "uint8"},
{3132,      250,      "TMC_DTCStruct",      "DefSeAirTeOpenOrSht2BAT",      "uint8"},
{3133,      250,      "TMC_DTCStruct",      "OHX_OutTeSeSht2GND",      "uint8"},
{3134,      250,      "TMC_DTCStruct",      "OHX_OutTeSeOpenOrSht2BAT",      "uint8"},
{3135,      250,      "TMC_DTCStruct",      "Evap_OutTeSeSht2GND",      "uint8"},
{3136,      250,      "TMC_DTCStruct",      "Evap_OutTeSeOpenOrSht2BAT",      "uint8"},
{3137,      250,      "TMC_DTCStruct",      "CompOutTeSeSht2GND",      "uint8"},
{3138,      250,      "TMC_DTCStruct",      "CompOutTeSeOpenSht2BAT",      "uint8"},
{3139,      250,      "TMC_DTCStruct",      "ChillerOutTeSeSht2GND",      "uint8"},
{3140,      250,      "TMC_DTCStruct",      "ChillerOutTeSeOpenSht2BAT",      "uint8"},
{3141,      250,      "TMC_DTCStruct",      "RefHPT_SePresSht2GND",      "uint8"},
{3142,      250,      "TMC_DTCStruct",      "RefHPT_SePresOpenSht2BAT",      "uint8"},
{3143,      250,      "TMC_DTCStruct",      "RefHPT_SeTeSht2GND",      "uint8"},
{3144,      250,      "TMC_DTCStruct",      "RefHPT_SeTeOpenOrSht2BAT",      "uint8"},
{3145,      250,      "TMC_DTCStruct",      "RefLP_SeSht2GND",      "uint8"},
{3146,      250,      "TMC_DTCStruct",      "RefLP_SeOpenOrSht2BAT",      "uint8"},
{3147,      250,      "TMC_DTCStruct",      "MCV_Stall",      "uint8"},
{3148,      250,      "TMC_DTCStruct",      "MCV_LearnErr",      "uint8"},
{3149,      250,      "TMC_DTCStruct",      "MCV_MotCoilShort",      "uint8"},
{3150,      250,      "TMC_DTCStruct",      "MCV_MotCoilOpen",      "uint8"},
{3151,      250,      "TMC_DTCStruct",      "MCV_OverTemp",      "uint8"},
{3152,      250,      "TMC_DTCStruct",      "MCV_VolOutOfRng",      "uint8"},
{3153,      250,      "TMC_DTCStruct",      "MCV_CommErr",      "uint8"},
{3154,      250,      "TMC_DTCStruct",      "BCV_PosNotReachable",      "uint8"},
{3155,      250,      "TMC_DTCStruct",      "BCV_Stall",      "uint8"},
{3156,      250,      "TMC_DTCStruct",      "BCV_LearnErr",      "uint8"},
{3157,      250,      "TMC_DTCStruct",      "BCV_MotCoilShort",      "uint8"},
{3158,      250,      "TMC_DTCStruct",      "BCV_MotCoilOpen",      "uint8"},
{3159,      250,      "TMC_DTCStruct",      "BCV_OverTemp",      "uint8"},
{3160,      250,      "TMC_DTCStruct",      "BCV_VolOutOfRng",      "uint8"},
{3161,      250,      "TMC_DTCStruct",      "BCV_CommErr",      "uint8"},
{3162,      250,      "TMC_DTCStruct",      "HVH_CommErr",      "uint8"},
{3163,      250,      "TMC_DTCStruct",      "HVH_ComponentPrtctn",      "uint8"},
{3164,      250,      "TMC_DTCStruct",      "HVH_HotspotErr",      "uint8"},
{3165,      250,      "TMC_DTCStruct",      "HVH_TempSensorErr",      "uint8"},
{3166,      250,      "TMC_DTCStruct",      "HVH_DriverErr",      "uint8"},
{3167,      250,      "TMC_DTCStruct",      "HVH_OverCurrErr",      "uint8"},
{3168,      250,      "TMC_DTCStruct",      "HVH_MemInterComErr",      "uint8"},
{3169,      250,      "TMC_DTCStruct",      "HVH_LVolOutOfRng",      "uint8"},
{3170,      250,      "TMC_DTCStruct",      "HVH_HVolOutOfRng",      "uint8"},
{3171,      250,      "TMC_DTCStruct",      "AcCoolantOverTemp",      "uint8"},
{3172,      250,      "TMC_DTCStruct",      "HP_EXV_error_stall",      "uint8"},
{3173,      250,      "TMC_DTCStruct",      "HP_EXV_InitiErr",      "uint8"},
{3174,      250,      "TMC_DTCStruct",      "HP_EXV_CommuErr",      "uint8"},
{3175,      250,      "TMC_DTCStruct",      "HP_EXV_OutOfPosReqRng",      "uint8"},
{3176,      250,      "TMC_DTCStruct",      "HP_EXV_ErrCoilOpen",      "uint8"},
{3177,      250,      "TMC_DTCStruct",      "HP_EXV_ErrCoilShort",      "uint8"},
{3178,      250,      "TMC_DTCStruct",      "HP_EXV_ErrVolAbnormal",      "uint8"},
{3179,      250,      "TMC_DTCStruct",      "HP_EXV_ErrOverTemp",      "uint8"},
{3180,      250,      "TMC_DTCStruct",      "HP_EXVPosNotReachable",      "uint8"},
{3181,      250,      "TMC_DTCStruct",      "AC_EXV_ErrStall",      "uint8"},
{3182,      250,      "TMC_DTCStruct",      "AC_EXV_InitiErr",      "uint8"},
{3183,      250,      "TMC_DTCStruct",      "AC_EXV_CommErr",      "uint8"},
{3184,      250,      "TMC_DTCStruct",      "AC_EXV_OutOfPosReqRng",      "uint8"},
{3185,      250,      "TMC_DTCStruct",      "AC_EXV_ErrCoilOpen",      "uint8"},
{3186,      250,      "TMC_DTCStruct",      "AC_EXV_ErrCoilShort",      "uint8"},
{3187,      250,      "TMC_DTCStruct",      "AC_EXV_ErrVolAbnormal",      "uint8"},
{3188,      250,      "TMC_DTCStruct",      "AC_EXV_ErrOverTemp",      "uint8"},
{3189,      250,      "TMC_DTCStruct",      "AC_EXVPosNotReachable",      "uint8"},
{3190,      250,      "TMC_DTCStruct",      "Bat_EXV_ErrStall",      "uint8"},
{3191,      250,      "TMC_DTCStruct",      "Bat_EXV_InitiErr",      "uint8"},
{3192,      250,      "TMC_DTCStruct",      "Bat_EXVElectricError",      "uint8"},
{3193,      250,      "TMC_DTCStruct",      "BatEXVCommError",      "uint8"},
{3194,      250,      "TMC_DTCStruct",      "Bat_EXVPosNotReachable",      "uint8"},
{3195,      250,      "TMC_DTCStruct",      "ACP_OverDuty",      "uint8"},
{3196,      250,      "TMC_DTCStruct",      "ACP_CommuncationError",      "uint8"},
{3197,      250,      "TMC_DTCStruct",      "ACP_PI_Saturation",      "uint8"},
{3198,      250,      "TMC_DTCStruct",      "ACP_LoseStep",      "uint8"},
{3199,      250,      "TMC_DTCStruct",      "ACP_SelfCheckError",      "uint8"},
{3200,      250,      "TMC_DTCStruct",      "ACP_IPM_Open",      "uint8"},
{3201,      250,      "TMC_DTCStruct",      "ACP_IPM_Short",      "uint8"},
{3202,      250,      "TMC_DTCStruct",      "ACP_TempError",      "uint8"},
{3203,      250,      "TMC_DTCStruct",      "ACP_LvError",      "uint8"},
{3204,      250,      "TMC_DTCStruct",      "ACP_HvError",      "uint8"},
{3205,      250,      "TMC_DTCStruct",      "ACP_OverCurrent",      "uint8"},
{3206,      250,      "TMC_DTCStruct",      "ACP_CurrentOffsetErr",      "uint8"},
{3207,      250,      "TMC_DTCStruct",      "ACP_DiscPreTooHigh",      "uint8"},
{3208,      250,      "TMC_DTCStruct",      "ACP_DiscOverTemp",      "uint8"},
{3209,      250,      "TMC_DTCStruct",      "ACP_SuctionPreTooLow",      "uint8"},
{3210,      250,      "TMC_DTCStruct",      "AC_Pump_LinErr",      "uint8"},
{3211,      250,      "TMC_DTCStruct",      "ACPump_MotorErr",      "uint8"},
{3212,      250,      "TMC_DTCStruct",      "ACPump_DryRunningErr",      "uint8"},
{3213,      250,      "TMC_DTCStruct",      "ACPump_PowerError",      "uint8"},
{3214,      250,      "TMC_DTCStruct",      "ACPump_TempErr",      "uint8"},
{3215,      250,      "TMC_DTCStruct",      "BatPump_LinErr",      "uint8"},
{3216,      250,      "TMC_DTCStruct",      "BatPump_MotorErr",      "uint8"},
{3217,      250,      "TMC_DTCStruct",      "BatPump_DryRunningErr",      "uint8"},
{3218,      250,      "TMC_DTCStruct",      "BatPump_PowerError",      "uint8"},
{3219,      250,      "TMC_DTCStruct",      "BatPump_TempErr",      "uint8"},
{3220,      250,      "TMC_DTCStruct",      "MotPump_LinErr",      "uint8"},
{3221,      250,      "TMC_DTCStruct",      "MotPump_MotorErr",      "uint8"},
{3222,      250,      "TMC_DTCStruct",      "MotPump_DryRunningErr",      "uint8"},
{3223,      250,      "TMC_DTCStruct",      "MotPump_PowerError",      "uint8"},
{3224,      250,      "TMC_DTCStruct",      "MotPump_TempErr",      "uint8"},
{3225,      250,      "TMC_DTCStruct",      "AgsErr",      "uint8"},
{3226,      250,      "TMC_DTCStruct",      "FanHeartbeatAbnormal",      "uint8"},
{3227,      250,      "TMC_DTCStruct",      "FanOverCurrent",      "uint8"},
{3228,      250,      "TMC_DTCStruct",      "FanInternalErr",      "uint8"},
{3229,      250,      "TMC_DTCStruct",      "FanStall",      "uint8"},
{3230,      250,      "TMC_DTCStruct",      "FanVolAbnormal_OverTemp",      "uint8"},
{3231,      250,      "TMC_DTCStruct",      "PlasmaError",      "uint8"},
{3232,      250,      "TMC_DTCStruct",      "PlasmaCtrDriCommandErr",      "uint8"},
{3233,      250,      "TMC_DTCStruct",      "PlasmaCtrDriShrt2Bat",      "uint8"},
{3234,      250,      "TMC_DTCStruct",      "PlasmaCtrDriShrt2GND",      "uint8"},
{3235,      250,      "TMC_DTCStruct",      "PlasmaCtrDriOverCurr",      "uint8"},
{3236,      250,      "TMC_DTCStruct",      "PlasmaCtrDriOverTemp",      "uint8"},
{3237,      250,      "TMC_DTCStruct",      "RearModeActFb_Sht2GND",      "uint8"},
{3238,      250,      "TMC_DTCStruct",      "RMActFb_OpenOrSht2BAT",      "uint8"},
{3239,      250,      "TMC_DTCStruct",      "RearModeActDriOpen",      "uint8"},
{3240,      250,      "TMC_DTCStruct",      "RearModeActDriSht2Bat",      "uint8"},
{3241,      250,      "TMC_DTCStruct",      "RearModeActDriSht2GND",      "uint8"},
{3242,      250,      "TMC_DTCStruct",      "RearModeActStall",      "uint8"},
{3243,      250,      "TMC_DTCStruct",      "HeatCoreInSe_Sht2GND",      "uint8"},
{3244,      250,      "TMC_DTCStruct",      "HCInSe_OpenOrSht2BAT",      "uint8"},
{3245,      250,      "TMC_DTCStruct",      "DefActFb_Sht2GND",      "uint8"},
{3246,      250,      "TMC_DTCStruct",      "DefActFb_OpenOrSht2BAT",      "uint8"},
{3247,      250,      "TMC_DTCStruct",      "DefActDriOpen",      "uint8"},
{3248,      250,      "TMC_DTCStruct",      "DefActDriSht2Bat",      "uint8"},
{3249,      250,      "TMC_DTCStruct",      "DefActDriSht2GND",      "uint8"},
{3250,      250,      "TMC_DTCStruct",      "DefActStall",      "uint8"},
{3251,      250,      "TMC_DTCStruct",      "ThirdRowModeActFb_Sht2GND",      "uint8"},
{3252,      250,      "TMC_DTCStruct",      "ThirdRMActFb_OpenOrSht2BAT",      "uint8"},
{3253,      250,      "TMC_DTCStruct",      "ThirdRowModeActDriOpen",      "uint8"},
{3254,      250,      "TMC_DTCStruct",      "ThirdRowModeActDriSht2Bat",      "uint8"},
{3255,      250,      "TMC_DTCStruct",      "ThirdRowModeActDriSht2GND",      "uint8"},
{3256,      250,      "TMC_DTCStruct",      "ThirdRowModeActStall",      "uint8"},
{3257,      250,      "TMC_DTCStruct",      "OHX2BEXV_DriShrt2Bat",      "uint8"},
{3258,      250,      "TMC_DTCStruct",      "OHX2BEXV_DriShrt2Gnd",      "uint8"},
{3259,      250,      "TMC_DTCStruct",      "OHX2BEXV_DriOverCurrent",      "uint8"},
{3260,      250,      "TMC_DTCStruct",      "OHX2BEXV_DriOpen",      "uint8"},
{3261,      250,      "TMC_DTCStruct",      "EVAPOUT_DriShrt2Bat",      "uint8"},
{3262,      250,      "TMC_DTCStruct",      "EVAPOUT_DriShrt2Gnd",      "uint8"},
{3263,      250,      "TMC_DTCStruct",      "EVAPOUT_DriOverCurrent",      "uint8"},
{3264,      250,      "TMC_DTCStruct",      "EVAPOUT_DriOpen",      "uint8"},
{3265,      250,      "TMC_DTCStruct",      "SVI_EXV_error_stall",      "uint8"},
{3266,      250,      "TMC_DTCStruct",      "SVI_EXV_InitiErr",      "uint8"},
{3267,      250,      "TMC_DTCStruct",      "SVI_EXV_CommuErr",      "uint8"},
{3268,      250,      "TMC_DTCStruct",      "SVI_EXV_OutOfPosReqRng",      "uint8"},
{3269,      250,      "TMC_DTCStruct",      "SVI_EXV_ErrCoilOpen",      "uint8"},
{3270,      250,      "TMC_DTCStruct",      "SVI_EXV_ErrCoilShort",      "uint8"},
{3271,      250,      "TMC_DTCStruct",      "SVI_EXV_ErrVolAbnormal",      "uint8"},
{3272,      250,      "TMC_DTCStruct",      "SVI_EXV_ErrOverTemp",      "uint8"},
{3273,      250,      "TMC_DTCStruct",      "SVI_EXVPosNotReachable",      "uint8"},
{3274,      251,      "AcHCVCtrl_ErrStruct",      "SequenceID",      "uint16"},
{3275,      251,      "AcHCVCtrl_ErrStruct",      "Options_8bit",      "uint8"},
{3276,      251,      "AcHCVCtrl_ErrStruct",      "Options_8bit2",      "uint8"},
{3277,      251,      "AcHCVCtrl_ErrStruct",      "UserID",      "uint32"},
{3278,      251,      "AcHCVCtrl_ErrStruct",      "OpeNRC",      "uint32"},
{3279,      251,      "AcHCVCtrl_ErrStruct",      "OpeErrInfo",      "string[16]"},
{3280,      252,      "HcvStStruct",      "HcvSt",      "uint8"},
{3281,      253,      "TurnOnOFFHCVStruct",      "SOAProtocolVersion",      "uint8"},
{3282,      253,      "TurnOnOFFHCVStruct",      "SOAHeaderType",      "uint8"},
{3283,      253,      "TurnOnOFFHCVStruct",      "SOAHeaderLength",      "uint16"},
{3284,      253,      "TurnOnOFFHCVStruct",      "Flag",      "uint16"},
{3285,      253,      "TurnOnOFFHCVStruct",      "HeaderCRC16",      "uint16"},
{3286,      253,      "TurnOnOFFHCVStruct",      "UserID",      "uint32"},
{3287,      253,      "TurnOnOFFHCVStruct",      "ReqTimeOut",      "uint32"},
{3288,      253,      "TurnOnOFFHCVStruct",      "RequestPriority",      "uint8"},
{3289,      253,      "TurnOnOFFHCVStruct",      "SequenceID",      "uint16"},
{3290,      253,      "TurnOnOFFHCVStruct",      "ServiceExecuteFeedbackFlag",      "uint8"},
{3291,      253,      "TurnOnOFFHCVStruct",      "Options",      "uint32"},
{3292,      253,      "TurnOnOFFHCVStruct",      "TurnOnOFFHCV",      "uint8"},
{3293,      253,      "TurnOnOFFHCVStruct",      "MemoryReq",      "uint8"},
{3294,      253,      "TurnOnOFFHCVRespStruct",      "RespCode",      "uint32"},
{3295,      253,      "TurnOnOFFHCVRespStruct",      "TurnOnOFFHCVNRC",      "uint32"},
{3296,      254,      "RearMirrorHeatService_ErrStruct",      "SequenceID",      "uint16"},
{3297,      254,      "RearMirrorHeatService_ErrStruct",      "Options_8bit",      "uint8"},
{3298,      254,      "RearMirrorHeatService_ErrStruct",      "Options_8bit2",      "uint8"},
{3299,      254,      "RearMirrorHeatService_ErrStruct",      "UserID",      "uint32"},
{3300,      254,      "RearMirrorHeatService_ErrStruct",      "OpeNRC",      "uint32"},
{3301,      254,      "RearMirrorHeatService_ErrStruct",      "OpeErrInfo",      "string[16]"},
{3302,      255,      "RearMirrorHeatStStruct",      "RearMirrorHeatOutputSt",      "uint8"},
{3303,      255,      "RearMirrorHeatStStruct",      "LeftMirrorHeatOutputSt",      "uint8"},
{3304,      255,      "RearMirrorHeatStStruct",      "RightMirrorHeatOutputSt",      "uint8"},
{3305,      255,      "RearMirrorHeatStStruct",      "MirrorHeatOutputSt",      "uint8"},
{3306,      255,      "RearMirrorHeatStStruct",      "IMSHeatingSt",      "uint8"},
{3307,      256,      "RearMirrorHeatCmdStruct",      "SOAProtocolVersion",      "uint8"},
{3308,      256,      "RearMirrorHeatCmdStruct",      "SOAHeaderType",      "uint8"},
{3309,      256,      "RearMirrorHeatCmdStruct",      "SOAHeaderLength",      "uint16"},
{3310,      256,      "RearMirrorHeatCmdStruct",      "Flag",      "uint16"},
{3311,      256,      "RearMirrorHeatCmdStruct",      "HeaderCRC16",      "uint16"},
{3312,      256,      "RearMirrorHeatCmdStruct",      "UserID",      "uint32"},
{3313,      256,      "RearMirrorHeatCmdStruct",      "ReqTimeOut",      "uint32"},
{3314,      256,      "RearMirrorHeatCmdStruct",      "RequestPriority",      "uint8"},
{3315,      256,      "RearMirrorHeatCmdStruct",      "SequenceID",      "uint16"},
{3316,      256,      "RearMirrorHeatCmdStruct",      "ServiceExecuteFeedbackFlag",      "uint8"},
{3317,      256,      "RearMirrorHeatCmdStruct",      "Options",      "uint32"},
{3318,      256,      "RearMirrorHeatCmdStruct",      "RearMirrorHeat",      "uint8"},
{3319,      256,      "RearMirrorHeatCmdRespStruct",      "RespCode",      "uint32"},
{3320,      256,      "RearMirrorHeatCmdRespStruct",      "RearMirrorHeatCmdNRC",      "uint32"},
{3321,      257,      "FrontMirrorHeatService_ErrStruct",      "SequenceID",      "uint16"},
{3322,      257,      "FrontMirrorHeatService_ErrStruct",      "Options_8bit",      "uint8"},
{3323,      257,      "FrontMirrorHeatService_ErrStruct",      "Options_8bit2",      "uint8"},
{3324,      257,      "FrontMirrorHeatService_ErrStruct",      "UserID",      "uint32"},
{3325,      257,      "FrontMirrorHeatService_ErrStruct",      "OpeNRC",      "uint32"},
{3326,      257,      "FrontMirrorHeatService_ErrStruct",      "OpeErrInfo",      "string[16]"},
{3327,      258,      "FrontMirrorHeatStStruct",      "FrontMirrorHeatOutputSt",      "uint8"},
{3328,      259,      "FrontMirrorHeatCmdStruct",      "SOAProtocolVersion",      "uint8"},
{3329,      259,      "FrontMirrorHeatCmdStruct",      "SOAHeaderType",      "uint8"},
{3330,      259,      "FrontMirrorHeatCmdStruct",      "SOAHeaderLength",      "uint16"},
{3331,      259,      "FrontMirrorHeatCmdStruct",      "Flag",      "uint16"},
{3332,      259,      "FrontMirrorHeatCmdStruct",      "HeaderCRC16",      "uint16"},
{3333,      259,      "FrontMirrorHeatCmdStruct",      "UserID",      "uint32"},
{3334,      259,      "FrontMirrorHeatCmdStruct",      "ReqTimeOut",      "uint32"},
{3335,      259,      "FrontMirrorHeatCmdStruct",      "RequestPriority",      "uint8"},
{3336,      259,      "FrontMirrorHeatCmdStruct",      "SequenceID",      "uint16"},
{3337,      259,      "FrontMirrorHeatCmdStruct",      "ServiceExecuteFeedbackFlag",      "uint8"},
{3338,      259,      "FrontMirrorHeatCmdStruct",      "Options",      "uint32"},
{3339,      259,      "FrontMirrorHeatCmdStruct",      "FrontMirrorHeat",      "uint8"},
{3340,      259,      "FrontMirrorHeatCmdRespStruct",      "RespCode",      "uint32"},
{3341,      259,      "FrontMirrorHeatCmdRespStruct",      "FrontMirrorHeatCmdNRC",      "uint32"},
{3342,      260,      "Veh_SlideDoorCtrlService_ErrStruct",      "SequenceID",      "uint16"},
{3343,      260,      "Veh_SlideDoorCtrlService_ErrStruct",      "Options_8bit",      "uint8"},
{3344,      260,      "Veh_SlideDoorCtrlService_ErrStruct",      "Options_8bit2",      "uint8"},
{3345,      260,      "Veh_SlideDoorCtrlService_ErrStruct",      "UserID",      "uint32"},
{3346,      260,      "Veh_SlideDoorCtrlService_ErrStruct",      "OpeNRC",      "uint32"},
{3347,      260,      "Veh_SlideDoorCtrlService_ErrStruct",      "OpeErrInfo",      "string[16]"},
{3348,      261,      "Veh_LSlideDoorCtrStruct",      "SOAProtocolVersion",      "uint8"},
{3349,      261,      "Veh_LSlideDoorCtrStruct",      "SOAHeaderType",      "uint8"},
{3350,      261,      "Veh_LSlideDoorCtrStruct",      "SOAHeaderLength",      "uint16"},
{3351,      261,      "Veh_LSlideDoorCtrStruct",      "Flag",      "uint16"},
{3352,      261,      "Veh_LSlideDoorCtrStruct",      "HeaderCRC16",      "uint16"},
{3353,      261,      "Veh_LSlideDoorCtrStruct",      "UserID",      "uint32"},
{3354,      261,      "Veh_LSlideDoorCtrStruct",      "ReqTimeOut",      "uint32"},
{3355,      261,      "Veh_LSlideDoorCtrStruct",      "RequestPriority",      "uint8"},
{3356,      261,      "Veh_LSlideDoorCtrStruct",      "SequenceID",      "uint16"},
{3357,      261,      "Veh_LSlideDoorCtrStruct",      "ServiceExecuteFeedbackFlag",      "uint8"},
{3358,      261,      "Veh_LSlideDoorCtrStruct",      "Options",      "uint32"},
{3359,      261,      "Veh_LSlideDoorCtrStruct",      "Veh_LSlideDoorCtr",      "uint8"},
{3360,      261,      "Veh_LSlideDoorCtrRespStruct",      "RespCode",      "uint32"},
{3361,      261,      "Veh_LSlideDoorCtrRespStruct",      "Veh_LSlideDoorCtrNRC",      "uint32"},
{3362,      262,      "Veh_LSlideDoorPosCtrStruct",      "SOAProtocolVersion",      "uint8"},
{3363,      262,      "Veh_LSlideDoorPosCtrStruct",      "SOAHeaderType",      "uint8"},
{3364,      262,      "Veh_LSlideDoorPosCtrStruct",      "SOAHeaderLength",      "uint16"},
{3365,      262,      "Veh_LSlideDoorPosCtrStruct",      "Flag",      "uint16"},
{3366,      262,      "Veh_LSlideDoorPosCtrStruct",      "HeaderCRC16",      "uint16"},
{3367,      262,      "Veh_LSlideDoorPosCtrStruct",      "UserID",      "uint32"},
{3368,      262,      "Veh_LSlideDoorPosCtrStruct",      "ReqTimeOut",      "uint32"},
{3369,      262,      "Veh_LSlideDoorPosCtrStruct",      "RequestPriority",      "uint8"},
{3370,      262,      "Veh_LSlideDoorPosCtrStruct",      "SequenceID",      "uint16"},
{3371,      262,      "Veh_LSlideDoorPosCtrStruct",      "ServiceExecuteFeedbackFlag",      "uint8"},
{3372,      262,      "Veh_LSlideDoorPosCtrStruct",      "Options",      "uint32"},
{3373,      262,      "Veh_LSlideDoorPosCtrStruct",      "Veh_LSlideDoorPosReq",      "uint8"},
{3374,      262,      "Veh_LSlideDoorPosCtrRespStruct",      "RespCode",      "uint32"},
{3375,      262,      "Veh_LSlideDoorPosCtrRespStruct",      "Veh_LSlideDoorPosCtrNRC",      "uint32"},
{3376,      263,      "Veh_RSlideDoorCtrStruct",      "SOAProtocolVersion",      "uint8"},
{3377,      263,      "Veh_RSlideDoorCtrStruct",      "SOAHeaderType",      "uint8"},
{3378,      263,      "Veh_RSlideDoorCtrStruct",      "SOAHeaderLength",      "uint16"},
{3379,      263,      "Veh_RSlideDoorCtrStruct",      "Flag",      "uint16"},
{3380,      263,      "Veh_RSlideDoorCtrStruct",      "HeaderCRC16",      "uint16"},
{3381,      263,      "Veh_RSlideDoorCtrStruct",      "UserID",      "uint32"},
{3382,      263,      "Veh_RSlideDoorCtrStruct",      "ReqTimeOut",      "uint32"},
{3383,      263,      "Veh_RSlideDoorCtrStruct",      "RequestPriority",      "uint8"},
{3384,      263,      "Veh_RSlideDoorCtrStruct",      "SequenceID",      "uint16"},
{3385,      263,      "Veh_RSlideDoorCtrStruct",      "ServiceExecuteFeedbackFlag",      "uint8"},
{3386,      263,      "Veh_RSlideDoorCtrStruct",      "Options",      "uint32"},
{3387,      263,      "Veh_RSlideDoorCtrStruct",      "Veh_RSlideDoorCtr",      "uint8"},
{3388,      263,      "Veh_RSlideDoorCtrRespStruct",      "RespCode",      "uint32"},
{3389,      263,      "Veh_RSlideDoorCtrRespStruct",      "Veh_RSlideDoorCtrNRC",      "uint32"},
{3390,      264,      "Veh_RSlideDoorPosCtrStruct",      "SOAProtocolVersion",      "uint8"},
{3391,      264,      "Veh_RSlideDoorPosCtrStruct",      "SOAHeaderType",      "uint8"},
{3392,      264,      "Veh_RSlideDoorPosCtrStruct",      "SOAHeaderLength",      "uint16"},
{3393,      264,      "Veh_RSlideDoorPosCtrStruct",      "Flag",      "uint16"},
{3394,      264,      "Veh_RSlideDoorPosCtrStruct",      "HeaderCRC16",      "uint16"},
{3395,      264,      "Veh_RSlideDoorPosCtrStruct",      "UserID",      "uint32"},
{3396,      264,      "Veh_RSlideDoorPosCtrStruct",      "ReqTimeOut",      "uint32"},
{3397,      264,      "Veh_RSlideDoorPosCtrStruct",      "RequestPriority",      "uint8"},
{3398,      264,      "Veh_RSlideDoorPosCtrStruct",      "SequenceID",      "uint16"},
{3399,      264,      "Veh_RSlideDoorPosCtrStruct",      "ServiceExecuteFeedbackFlag",      "uint8"},
{3400,      264,      "Veh_RSlideDoorPosCtrStruct",      "Options",      "uint32"},
{3401,      264,      "Veh_RSlideDoorPosCtrStruct",      "Veh_RSlideDoorPosReq",      "uint8"},
{3402,      264,      "Veh_RSlideDoorPosCtrRespStruct",      "RespCode",      "uint32"},
{3403,      264,      "Veh_RSlideDoorPosCtrRespStruct",      "Veh_RSlideDoorPosCtrNRC",      "uint32"},
{3404,      265,      "Veh_SlideDoorModeService_ErrStruct",      "SequenceID",      "uint16"},
{3405,      265,      "Veh_SlideDoorModeService_ErrStruct",      "Options_8bit",      "uint8"},
{3406,      265,      "Veh_SlideDoorModeService_ErrStruct",      "Options_8bit2",      "uint8"},
{3407,      265,      "Veh_SlideDoorModeService_ErrStruct",      "UserID",      "uint32"},
{3408,      265,      "Veh_SlideDoorModeService_ErrStruct",      "OpeNRC",      "uint32"},
{3409,      265,      "Veh_SlideDoorModeService_ErrStruct",      "OpeErrInfo",      "string[16]"},
{3410,      266,      "Veh_LSlideDoorModeCfgStruct",      "SOAProtocolVersion",      "uint8"},
{3411,      266,      "Veh_LSlideDoorModeCfgStruct",      "SOAHeaderType",      "uint8"},
{3412,      266,      "Veh_LSlideDoorModeCfgStruct",      "SOAHeaderLength",      "uint16"},
{3413,      266,      "Veh_LSlideDoorModeCfgStruct",      "Flag",      "uint16"},
{3414,      266,      "Veh_LSlideDoorModeCfgStruct",      "HeaderCRC16",      "uint16"},
{3415,      266,      "Veh_LSlideDoorModeCfgStruct",      "UserID",      "uint32"},
{3416,      266,      "Veh_LSlideDoorModeCfgStruct",      "ReqTimeOut",      "uint32"},
{3417,      266,      "Veh_LSlideDoorModeCfgStruct",      "RequestPriority",      "uint8"},
{3418,      266,      "Veh_LSlideDoorModeCfgStruct",      "SequenceID",      "uint16"},
{3419,      266,      "Veh_LSlideDoorModeCfgStruct",      "ServiceExecuteFeedbackFlag",      "uint8"},
{3420,      266,      "Veh_LSlideDoorModeCfgStruct",      "Options",      "uint32"},
{3421,      266,      "Veh_LSlideDoorModeCfgStruct",      "Veh_LSlideDoorModeCfg",      "uint8"},
{3422,      266,      "Veh_LSlideDoorModeCfgRespStruct",      "RespCode",      "uint32"},
{3423,      266,      "Veh_LSlideDoorModeCfgRespStruct",      "Veh_LSlideDoorModeCfgNRC",      "uint32"},
{3424,      267,      "Veh_RSlideDoorModeCfgStruct",      "SOAProtocolVersion",      "uint8"},
{3425,      267,      "Veh_RSlideDoorModeCfgStruct",      "SOAHeaderType",      "uint8"},
{3426,      267,      "Veh_RSlideDoorModeCfgStruct",      "SOAHeaderLength",      "uint16"},
{3427,      267,      "Veh_RSlideDoorModeCfgStruct",      "Flag",      "uint16"},
{3428,      267,      "Veh_RSlideDoorModeCfgStruct",      "HeaderCRC16",      "uint16"},
{3429,      267,      "Veh_RSlideDoorModeCfgStruct",      "UserID",      "uint32"},
{3430,      267,      "Veh_RSlideDoorModeCfgStruct",      "ReqTimeOut",      "uint32"},
{3431,      267,      "Veh_RSlideDoorModeCfgStruct",      "RequestPriority",      "uint8"},
{3432,      267,      "Veh_RSlideDoorModeCfgStruct",      "SequenceID",      "uint16"},
{3433,      267,      "Veh_RSlideDoorModeCfgStruct",      "ServiceExecuteFeedbackFlag",      "uint8"},
{3434,      267,      "Veh_RSlideDoorModeCfgStruct",      "Options",      "uint32"},
{3435,      267,      "Veh_RSlideDoorModeCfgStruct",      "Veh_RSlideDoorModeCfg",      "uint8"},
{3436,      267,      "Veh_RSlideDoorModeCfgRespStruct",      "RespCode",      "uint32"},
{3437,      267,      "Veh_RSlideDoorModeCfgRespStruct",      "Veh_RSlideDoorModeCfgNRC",      "uint32"},
{3438,      268,      "Veh_SeatCtrlService_ErrStruct",      "SequenceID",      "uint16"},
{3439,      268,      "Veh_SeatCtrlService_ErrStruct",      "Options_8bit",      "uint8"},
{3440,      268,      "Veh_SeatCtrlService_ErrStruct",      "Options_8bit2",      "uint8"},
{3441,      268,      "Veh_SeatCtrlService_ErrStruct",      "UserID",      "uint32"},
{3442,      268,      "Veh_SeatCtrlService_ErrStruct",      "OpeNRC",      "uint32"},
{3443,      268,      "Veh_SeatCtrlService_ErrStruct",      "OpeErrInfo",      "string[16]"},
{3444,      269,      "Veh_SeatMassageStsStruct",      "Veh_DrvSeatMassgIntenSts",      "uint8"},
{3445,      269,      "Veh_SeatMassageStsStruct",      "Veh_DrvSeatMassgProgSts",      "uint8"},
{3446,      269,      "Veh_SeatMassageStsStruct",      "Veh_PsngrSeatMassgIntenSts",      "uint8"},
{3447,      269,      "Veh_SeatMassageStsStruct",      "Veh_PsngrSeatMassgProgSts",      "uint8"},
{3448,      269,      "Veh_SeatMassageStsStruct",      "Veh_SecRowLtSeatMassgIntenSts",      "uint8"},
{3449,      269,      "Veh_SeatMassageStsStruct",      "Veh_SecRowLtSeatMassgProgSts",      "uint8"},
{3450,      269,      "Veh_SeatMassageStsStruct",      "Veh_SecRowRtSeatMassgIntenSts",      "uint8"},
{3451,      269,      "Veh_SeatMassageStsStruct",      "Veh_SecRowRtSeatMassgProgSts",      "uint8"},
{3452,      270,      "Veh_SeatLumbStsStruct",      "Veh_DrvSeatLumbRelaxSts",      "uint8"},
{3453,      270,      "Veh_SeatLumbStsStruct",      "Veh_PsngrSeatLumbRelaxSts",      "uint8"},
{3454,      271,      "Veh_SeatLumbRelaxIntenStsStruct",      "Veh_DrvSeatLumbRelaxIntenSts",      "uint8"},
{3455,      271,      "Veh_SeatLumbRelaxIntenStsStruct",      "Veh_PsSeatLumbRelaxIntenSts",      "uint8"},
{3456,      272,      "Veh_SetDrvSeatHeatingStruct",      "SOAProtocolVersion",      "uint8"},
{3457,      272,      "Veh_SetDrvSeatHeatingStruct",      "SOAHeaderType",      "uint8"},
{3458,      272,      "Veh_SetDrvSeatHeatingStruct",      "SOAHeaderLength",      "uint16"},
{3459,      272,      "Veh_SetDrvSeatHeatingStruct",      "Flag",      "uint16"},
{3460,      272,      "Veh_SetDrvSeatHeatingStruct",      "HeaderCRC16",      "uint16"},
{3461,      272,      "Veh_SetDrvSeatHeatingStruct",      "UserID",      "uint32"},
{3462,      272,      "Veh_SetDrvSeatHeatingStruct",      "ReqTimeOut",      "uint32"},
{3463,      272,      "Veh_SetDrvSeatHeatingStruct",      "RequestPriority",      "uint8"},
{3464,      272,      "Veh_SetDrvSeatHeatingStruct",      "SequenceID",      "uint16"},
{3465,      272,      "Veh_SetDrvSeatHeatingStruct",      "ServiceExecuteFeedbackFlag",      "uint8"},
{3466,      272,      "Veh_SetDrvSeatHeatingStruct",      "Options",      "uint32"},
{3467,      272,      "Veh_SetDrvSeatHeatingStruct",      "Veh_DrvSeatHeatingReq",      "uint8"},
{3468,      272,      "Veh_SetDrvSeatHeatingRespStruct",      "RespCode",      "uint32"},
{3469,      272,      "Veh_SetDrvSeatHeatingRespStruct",      "Veh_SetDrvSeatHeatingNRC",      "uint32"},
{3470,      273,      "Veh_SetDrvSeatVentilationStruct",      "SOAProtocolVersion",      "uint8"},
{3471,      273,      "Veh_SetDrvSeatVentilationStruct",      "SOAHeaderType",      "uint8"},
{3472,      273,      "Veh_SetDrvSeatVentilationStruct",      "SOAHeaderLength",      "uint16"},
{3473,      273,      "Veh_SetDrvSeatVentilationStruct",      "Flag",      "uint16"},
{3474,      273,      "Veh_SetDrvSeatVentilationStruct",      "HeaderCRC16",      "uint16"},
{3475,      273,      "Veh_SetDrvSeatVentilationStruct",      "UserID",      "uint32"},
{3476,      273,      "Veh_SetDrvSeatVentilationStruct",      "ReqTimeOut",      "uint32"},
{3477,      273,      "Veh_SetDrvSeatVentilationStruct",      "RequestPriority",      "uint8"},
{3478,      273,      "Veh_SetDrvSeatVentilationStruct",      "SequenceID",      "uint16"},
{3479,      273,      "Veh_SetDrvSeatVentilationStruct",      "ServiceExecuteFeedbackFlag",      "uint8"},
{3480,      273,      "Veh_SetDrvSeatVentilationStruct",      "Options",      "uint32"},
{3481,      273,      "Veh_SetDrvSeatVentilationStruct",      "Veh_DrvSeatVentilationReq",      "uint8"},
{3482,      273,      "Veh_SetDrvSeatVentilationRespStruct",      "RespCode",      "uint32"},
{3483,      273,      "Veh_SetDrvSeatVentilationRespStruct",      "Veh_SetDrvSeatVentilationNRC",      "uint32"},
{3484,      274,      "Veh_SetPsngrSeatHeatingStruct",      "SOAProtocolVersion",      "uint8"},
{3485,      274,      "Veh_SetPsngrSeatHeatingStruct",      "SOAHeaderType",      "uint8"},
{3486,      274,      "Veh_SetPsngrSeatHeatingStruct",      "SOAHeaderLength",      "uint16"},
{3487,      274,      "Veh_SetPsngrSeatHeatingStruct",      "Flag",      "uint16"},
{3488,      274,      "Veh_SetPsngrSeatHeatingStruct",      "HeaderCRC16",      "uint16"},
{3489,      274,      "Veh_SetPsngrSeatHeatingStruct",      "UserID",      "uint32"},
{3490,      274,      "Veh_SetPsngrSeatHeatingStruct",      "ReqTimeOut",      "uint32"},
{3491,      274,      "Veh_SetPsngrSeatHeatingStruct",      "RequestPriority",      "uint8"},
{3492,      274,      "Veh_SetPsngrSeatHeatingStruct",      "SequenceID",      "uint16"},
{3493,      274,      "Veh_SetPsngrSeatHeatingStruct",      "ServiceExecuteFeedbackFlag",      "uint8"},
{3494,      274,      "Veh_SetPsngrSeatHeatingStruct",      "Options",      "uint32"},
{3495,      274,      "Veh_SetPsngrSeatHeatingStruct",      "Veh_PsngrSeatHeatingReq",      "uint8"},
{3496,      274,      "Veh_SetPsngrSeatHeatingRespStruct",      "RespCode",      "uint32"},
{3497,      274,      "Veh_SetPsngrSeatHeatingRespStruct",      "Veh_SetPsngrSeatHeatingNRC",      "uint32"},
{3498,      275,      "Veh_SetPsngrSeatVentilationStruct",      "SOAProtocolVersion",      "uint8"},
{3499,      275,      "Veh_SetPsngrSeatVentilationStruct",      "SOAHeaderType",      "uint8"},
{3500,      275,      "Veh_SetPsngrSeatVentilationStruct",      "SOAHeaderLength",      "uint16"},
{3501,      275,      "Veh_SetPsngrSeatVentilationStruct",      "Flag",      "uint16"},
{3502,      275,      "Veh_SetPsngrSeatVentilationStruct",      "HeaderCRC16",      "uint16"},
{3503,      275,      "Veh_SetPsngrSeatVentilationStruct",      "UserID",      "uint32"},
{3504,      275,      "Veh_SetPsngrSeatVentilationStruct",      "ReqTimeOut",      "uint32"},
{3505,      275,      "Veh_SetPsngrSeatVentilationStruct",      "RequestPriority",      "uint8"},
{3506,      275,      "Veh_SetPsngrSeatVentilationStruct",      "SequenceID",      "uint16"},
{3507,      275,      "Veh_SetPsngrSeatVentilationStruct",      "ServiceExecuteFeedbackFlag",      "uint8"},
{3508,      275,      "Veh_SetPsngrSeatVentilationStruct",      "Options",      "uint32"},
{3509,      275,      "Veh_SetPsngrSeatVentilationStruct",      "Veh_PsngrSeatVentilationReq",      "uint8"},
{3510,      275,      "Veh_SetPsngrSeatVentilationRespStruct",      "RespCode",      "uint32"},
{3511,      275,      "Veh_SetPsngrSeatVentilationRespStruct",      "Veh_SetPsngrSeatVentilationNRC",      "uint32"},
{3512,      276,      "Veh_SetSecRowLtSeatHeatingStruct",      "SOAProtocolVersion",      "uint8"},
{3513,      276,      "Veh_SetSecRowLtSeatHeatingStruct",      "SOAHeaderType",      "uint8"},
{3514,      276,      "Veh_SetSecRowLtSeatHeatingStruct",      "SOAHeaderLength",      "uint16"},
{3515,      276,      "Veh_SetSecRowLtSeatHeatingStruct",      "Flag",      "uint16"},
{3516,      276,      "Veh_SetSecRowLtSeatHeatingStruct",      "HeaderCRC16",      "uint16"},
{3517,      276,      "Veh_SetSecRowLtSeatHeatingStruct",      "UserID",      "uint32"},
{3518,      276,      "Veh_SetSecRowLtSeatHeatingStruct",      "ReqTimeOut",      "uint32"},
{3519,      276,      "Veh_SetSecRowLtSeatHeatingStruct",      "RequestPriority",      "uint8"},
{3520,      276,      "Veh_SetSecRowLtSeatHeatingStruct",      "SequenceID",      "uint16"},
{3521,      276,      "Veh_SetSecRowLtSeatHeatingStruct",      "ServiceExecuteFeedbackFlag",      "uint8"},
{3522,      276,      "Veh_SetSecRowLtSeatHeatingStruct",      "Options",      "uint32"},
{3523,      276,      "Veh_SetSecRowLtSeatHeatingStruct",      "Veh_SecRowLtSeatHeatingReq",      "uint8"},
{3524,      276,      "Veh_SetSecRowLtSeatHeatingRespStruct",      "RespCode",      "uint32"},
{3525,      276,      "Veh_SetSecRowLtSeatHeatingRespStruct",      "Veh_SetSecRowLtSeatHeatingNRC",      "uint32"},
{3526,      277,      "Veh_SetSecRowLtSeatVentilationStruct",      "SOAProtocolVersion",      "uint8"},
{3527,      277,      "Veh_SetSecRowLtSeatVentilationStruct",      "SOAHeaderType",      "uint8"},
{3528,      277,      "Veh_SetSecRowLtSeatVentilationStruct",      "SOAHeaderLength",      "uint16"},
{3529,      277,      "Veh_SetSecRowLtSeatVentilationStruct",      "Flag",      "uint16"},
{3530,      277,      "Veh_SetSecRowLtSeatVentilationStruct",      "HeaderCRC16",      "uint16"},
{3531,      277,      "Veh_SetSecRowLtSeatVentilationStruct",      "UserID",      "uint32"},
{3532,      277,      "Veh_SetSecRowLtSeatVentilationStruct",      "ReqTimeOut",      "uint32"},
{3533,      277,      "Veh_SetSecRowLtSeatVentilationStruct",      "RequestPriority",      "uint8"},
{3534,      277,      "Veh_SetSecRowLtSeatVentilationStruct",      "SequenceID",      "uint16"},
{3535,      277,      "Veh_SetSecRowLtSeatVentilationStruct",      "ServiceExecuteFeedbackFlag",      "uint8"},
{3536,      277,      "Veh_SetSecRowLtSeatVentilationStruct",      "Options",      "uint32"},
{3537,      277,      "Veh_SetSecRowLtSeatVentilationStruct",      "Veh_SecRowLtSeatVentilationReq",      "uint8"},
{3538,      277,      "Veh_SetSecRowLtSeatVentilationRespStruct",      "RespCode",      "uint32"},
{3539,      277,      "Veh_SetSecRowLtSeatVentilationRespStruct",      "Veh_SetSecRowLtSeatVentilationNRC",      "uint32"},
{3540,      278,      "Veh_SetSecRowRtSeatHeatingStruct",      "SOAProtocolVersion",      "uint8"},
{3541,      278,      "Veh_SetSecRowRtSeatHeatingStruct",      "SOAHeaderType",      "uint8"},
{3542,      278,      "Veh_SetSecRowRtSeatHeatingStruct",      "SOAHeaderLength",      "uint16"},
{3543,      278,      "Veh_SetSecRowRtSeatHeatingStruct",      "Flag",      "uint16"},
{3544,      278,      "Veh_SetSecRowRtSeatHeatingStruct",      "HeaderCRC16",      "uint16"},
{3545,      278,      "Veh_SetSecRowRtSeatHeatingStruct",      "UserID",      "uint32"},
{3546,      278,      "Veh_SetSecRowRtSeatHeatingStruct",      "ReqTimeOut",      "uint32"},
{3547,      278,      "Veh_SetSecRowRtSeatHeatingStruct",      "RequestPriority",      "uint8"},
{3548,      278,      "Veh_SetSecRowRtSeatHeatingStruct",      "SequenceID",      "uint16"},
{3549,      278,      "Veh_SetSecRowRtSeatHeatingStruct",      "ServiceExecuteFeedbackFlag",      "uint8"},
{3550,      278,      "Veh_SetSecRowRtSeatHeatingStruct",      "Options",      "uint32"},
{3551,      278,      "Veh_SetSecRowRtSeatHeatingStruct",      "Veh_SecRowRtSeatHeatingReq",      "uint8"},
{3552,      278,      "Veh_SetSecRowRtSeatHeatingRespStruct",      "RespCode",      "uint32"},
{3553,      278,      "Veh_SetSecRowRtSeatHeatingRespStruct",      "Veh_SetSecRowRtSeatHeatingNRC",      "uint32"},
{3554,      279,      "Veh_SetSecRowRtSeatVentilationStruct",      "SOAProtocolVersion",      "uint8"},
{3555,      279,      "Veh_SetSecRowRtSeatVentilationStruct",      "SOAHeaderType",      "uint8"},
{3556,      279,      "Veh_SetSecRowRtSeatVentilationStruct",      "SOAHeaderLength",      "uint16"},
{3557,      279,      "Veh_SetSecRowRtSeatVentilationStruct",      "Flag",      "uint16"},
{3558,      279,      "Veh_SetSecRowRtSeatVentilationStruct",      "HeaderCRC16",      "uint16"},
{3559,      279,      "Veh_SetSecRowRtSeatVentilationStruct",      "UserID",      "uint32"},
{3560,      279,      "Veh_SetSecRowRtSeatVentilationStruct",      "ReqTimeOut",      "uint32"},
{3561,      279,      "Veh_SetSecRowRtSeatVentilationStruct",      "RequestPriority",      "uint8"},
{3562,      279,      "Veh_SetSecRowRtSeatVentilationStruct",      "SequenceID",      "uint16"},
{3563,      279,      "Veh_SetSecRowRtSeatVentilationStruct",      "ServiceExecuteFeedbackFlag",      "uint8"},
{3564,      279,      "Veh_SetSecRowRtSeatVentilationStruct",      "Options",      "uint32"},
{3565,      279,      "Veh_SetSecRowRtSeatVentilationStruct",      "Veh_SecRowRtSeatVentilationReq",      "uint8"},
{3566,      279,      "Veh_SetSecRowRtSeatVentilationRespStruct",      "RespCode",      "uint32"},
{3567,      279,      "Veh_SetSecRowRtSeatVentilationRespStruct",      "Veh_SetSecRowRtSeatVentilationNRC",      "uint32"},
{3568,      280,      "Veh_TurnOnDrvSeatMassageStruct",      "SOAProtocolVersion",      "uint8"},
{3569,      280,      "Veh_TurnOnDrvSeatMassageStruct",      "SOAHeaderType",      "uint8"},
{3570,      280,      "Veh_TurnOnDrvSeatMassageStruct",      "SOAHeaderLength",      "uint16"},
{3571,      280,      "Veh_TurnOnDrvSeatMassageStruct",      "Flag",      "uint16"},
{3572,      280,      "Veh_TurnOnDrvSeatMassageStruct",      "HeaderCRC16",      "uint16"},
{3573,      280,      "Veh_TurnOnDrvSeatMassageStruct",      "UserID",      "uint32"},
{3574,      280,      "Veh_TurnOnDrvSeatMassageStruct",      "ReqTimeOut",      "uint32"},
{3575,      280,      "Veh_TurnOnDrvSeatMassageStruct",      "RequestPriority",      "uint8"},
{3576,      280,      "Veh_TurnOnDrvSeatMassageStruct",      "SequenceID",      "uint16"},
{3577,      280,      "Veh_TurnOnDrvSeatMassageStruct",      "ServiceExecuteFeedbackFlag",      "uint8"},
{3578,      280,      "Veh_TurnOnDrvSeatMassageStruct",      "Options",      "uint32"},
{3579,      280,      "Veh_TurnOnDrvSeatMassageStruct",      "Veh_DrvSeatMassgIntenReq",      "uint8"},
{3580,      280,      "Veh_TurnOnDrvSeatMassageStruct",      "Veh_DrvSeatMassgProgReq",      "uint8"},
{3581,      280,      "Veh_TurnOnDrvSeatMassageRespStruct",      "RespCode",      "uint32"},
{3582,      280,      "Veh_TurnOnDrvSeatMassageRespStruct",      "Veh_TurnOnDrvSeatMassageNRC",      "uint32"},
{3583,      281,      "Veh_SetDrvSeatMassageIntensityStruct",      "SOAProtocolVersion",      "uint8"},
{3584,      281,      "Veh_SetDrvSeatMassageIntensityStruct",      "SOAHeaderType",      "uint8"},
{3585,      281,      "Veh_SetDrvSeatMassageIntensityStruct",      "SOAHeaderLength",      "uint16"},
{3586,      281,      "Veh_SetDrvSeatMassageIntensityStruct",      "Flag",      "uint16"},
{3587,      281,      "Veh_SetDrvSeatMassageIntensityStruct",      "HeaderCRC16",      "uint16"},
{3588,      281,      "Veh_SetDrvSeatMassageIntensityStruct",      "UserID",      "uint32"},
{3589,      281,      "Veh_SetDrvSeatMassageIntensityStruct",      "ReqTimeOut",      "uint32"},
{3590,      281,      "Veh_SetDrvSeatMassageIntensityStruct",      "RequestPriority",      "uint8"},
{3591,      281,      "Veh_SetDrvSeatMassageIntensityStruct",      "SequenceID",      "uint16"},
{3592,      281,      "Veh_SetDrvSeatMassageIntensityStruct",      "ServiceExecuteFeedbackFlag",      "uint8"},
{3593,      281,      "Veh_SetDrvSeatMassageIntensityStruct",      "Options",      "uint32"},
{3594,      281,      "Veh_SetDrvSeatMassageIntensityStruct",      "Veh_DrvSeatMassgIntenReq",      "uint8"},
{3595,      281,      "Veh_SetDrvSeatMassageIntensityRespStruct",      "RespCode",      "uint32"},
{3596,      281,      "Veh_SetDrvSeatMassageIntensityRespStruct",      "Veh_SetDrvSeatMassageIntensityNRC",      "uint32"},
{3597,      282,      "Veh_SetDrvSeatMassageModeStruct",      "SOAProtocolVersion",      "uint8"},
{3598,      282,      "Veh_SetDrvSeatMassageModeStruct",      "SOAHeaderType",      "uint8"},
{3599,      282,      "Veh_SetDrvSeatMassageModeStruct",      "SOAHeaderLength",      "uint16"},
{3600,      282,      "Veh_SetDrvSeatMassageModeStruct",      "Flag",      "uint16"},
{3601,      282,      "Veh_SetDrvSeatMassageModeStruct",      "HeaderCRC16",      "uint16"},
{3602,      282,      "Veh_SetDrvSeatMassageModeStruct",      "UserID",      "uint32"},
{3603,      282,      "Veh_SetDrvSeatMassageModeStruct",      "ReqTimeOut",      "uint32"},
{3604,      282,      "Veh_SetDrvSeatMassageModeStruct",      "RequestPriority",      "uint8"},
{3605,      282,      "Veh_SetDrvSeatMassageModeStruct",      "SequenceID",      "uint16"},
{3606,      282,      "Veh_SetDrvSeatMassageModeStruct",      "ServiceExecuteFeedbackFlag",      "uint8"},
{3607,      282,      "Veh_SetDrvSeatMassageModeStruct",      "Options",      "uint32"},
{3608,      282,      "Veh_SetDrvSeatMassageModeStruct",      "Veh_DrvSeatMassgProgReq",      "uint8"},
{3609,      282,      "Veh_SetDrvSeatMassageModeRespStruct",      "RespCode",      "uint32"},
{3610,      282,      "Veh_SetDrvSeatMassageModeRespStruct",      "Veh_SetDrvSeatMassageModeNRC",      "uint32"},
{3611,      283,      "Veh_TurnOffDrvSeatMassageStruct",      "SOAProtocolVersion",      "uint8"},
{3612,      283,      "Veh_TurnOffDrvSeatMassageStruct",      "SOAHeaderType",      "uint8"},
{3613,      283,      "Veh_TurnOffDrvSeatMassageStruct",      "SOAHeaderLength",      "uint16"},
{3614,      283,      "Veh_TurnOffDrvSeatMassageStruct",      "Flag",      "uint16"},
{3615,      283,      "Veh_TurnOffDrvSeatMassageStruct",      "HeaderCRC16",      "uint16"},
{3616,      283,      "Veh_TurnOffDrvSeatMassageStruct",      "UserID",      "uint32"},
{3617,      283,      "Veh_TurnOffDrvSeatMassageStruct",      "ReqTimeOut",      "uint32"},
{3618,      283,      "Veh_TurnOffDrvSeatMassageStruct",      "RequestPriority",      "uint8"},
{3619,      283,      "Veh_TurnOffDrvSeatMassageStruct",      "SequenceID",      "uint16"},
{3620,      283,      "Veh_TurnOffDrvSeatMassageStruct",      "ServiceExecuteFeedbackFlag",      "uint8"},
{3621,      283,      "Veh_TurnOffDrvSeatMassageStruct",      "Options",      "uint32"},
{3622,      283,      "Veh_TurnOffDrvSeatMassageRespStruct",      "RespCode",      "uint32"},
{3623,      283,      "Veh_TurnOffDrvSeatMassageRespStruct",      "Veh_TurnOffDrvSeatMassageNRC",      "uint32"},
{3624,      284,      "Veh_TurnOnPsngrSeatMassageStruct",      "SOAProtocolVersion",      "uint8"},
{3625,      284,      "Veh_TurnOnPsngrSeatMassageStruct",      "SOAHeaderType",      "uint8"},
{3626,      284,      "Veh_TurnOnPsngrSeatMassageStruct",      "SOAHeaderLength",      "uint16"},
{3627,      284,      "Veh_TurnOnPsngrSeatMassageStruct",      "Flag",      "uint16"},
{3628,      284,      "Veh_TurnOnPsngrSeatMassageStruct",      "HeaderCRC16",      "uint16"},
{3629,      284,      "Veh_TurnOnPsngrSeatMassageStruct",      "UserID",      "uint32"},
{3630,      284,      "Veh_TurnOnPsngrSeatMassageStruct",      "ReqTimeOut",      "uint32"},
{3631,      284,      "Veh_TurnOnPsngrSeatMassageStruct",      "RequestPriority",      "uint8"},
{3632,      284,      "Veh_TurnOnPsngrSeatMassageStruct",      "SequenceID",      "uint16"},
{3633,      284,      "Veh_TurnOnPsngrSeatMassageStruct",      "ServiceExecuteFeedbackFlag",      "uint8"},
{3634,      284,      "Veh_TurnOnPsngrSeatMassageStruct",      "Options",      "uint32"},
{3635,      284,      "Veh_TurnOnPsngrSeatMassageStruct",      "Veh_PsngrSeatMassgIntenReq",      "uint8"},
{3636,      284,      "Veh_TurnOnPsngrSeatMassageStruct",      "Veh_PsngrSeatMassgProgReq",      "uint8"},
{3637,      284,      "Veh_TurnOnPsngrSeatMassageRespStruct",      "RespCode",      "uint32"},
{3638,      284,      "Veh_TurnOnPsngrSeatMassageRespStruct",      "Veh_TurnOnPsngrSeatMassageNRC",      "uint32"},
{3639,      285,      "Veh_SetPsngrSeatMassageIntensityStruct",      "SOAProtocolVersion",      "uint8"},
{3640,      285,      "Veh_SetPsngrSeatMassageIntensityStruct",      "SOAHeaderType",      "uint8"},
{3641,      285,      "Veh_SetPsngrSeatMassageIntensityStruct",      "SOAHeaderLength",      "uint16"},
{3642,      285,      "Veh_SetPsngrSeatMassageIntensityStruct",      "Flag",      "uint16"},
{3643,      285,      "Veh_SetPsngrSeatMassageIntensityStruct",      "HeaderCRC16",      "uint16"},
{3644,      285,      "Veh_SetPsngrSeatMassageIntensityStruct",      "UserID",      "uint32"},
{3645,      285,      "Veh_SetPsngrSeatMassageIntensityStruct",      "ReqTimeOut",      "uint32"},
{3646,      285,      "Veh_SetPsngrSeatMassageIntensityStruct",      "RequestPriority",      "uint8"},
{3647,      285,      "Veh_SetPsngrSeatMassageIntensityStruct",      "SequenceID",      "uint16"},
{3648,      285,      "Veh_SetPsngrSeatMassageIntensityStruct",      "ServiceExecuteFeedbackFlag",      "uint8"},
{3649,      285,      "Veh_SetPsngrSeatMassageIntensityStruct",      "Options",      "uint32"},
{3650,      285,      "Veh_SetPsngrSeatMassageIntensityStruct",      "Veh_PsngrSeatMassgIntenReq",      "uint8"},
{3651,      285,      "Veh_SetPsngrSeatMassageIntensityRespStruct",      "RespCode",      "uint32"},
{3652,      285,      "Veh_SetPsngrSeatMassageIntensityRespStruct",      "Veh_SetPsngrSeatMassageIntensityNRC",      "uint32"},
{3653,      286,      "Veh_SetPsngrSeatMassageModeStruct",      "SOAProtocolVersion",      "uint8"},
{3654,      286,      "Veh_SetPsngrSeatMassageModeStruct",      "SOAHeaderType",      "uint8"},
{3655,      286,      "Veh_SetPsngrSeatMassageModeStruct",      "SOAHeaderLength",      "uint16"},
{3656,      286,      "Veh_SetPsngrSeatMassageModeStruct",      "Flag",      "uint16"},
{3657,      286,      "Veh_SetPsngrSeatMassageModeStruct",      "HeaderCRC16",      "uint16"},
{3658,      286,      "Veh_SetPsngrSeatMassageModeStruct",      "UserID",      "uint32"},
{3659,      286,      "Veh_SetPsngrSeatMassageModeStruct",      "ReqTimeOut",      "uint32"},
{3660,      286,      "Veh_SetPsngrSeatMassageModeStruct",      "RequestPriority",      "uint8"},
{3661,      286,      "Veh_SetPsngrSeatMassageModeStruct",      "SequenceID",      "uint16"},
{3662,      286,      "Veh_SetPsngrSeatMassageModeStruct",      "ServiceExecuteFeedbackFlag",      "uint8"},
{3663,      286,      "Veh_SetPsngrSeatMassageModeStruct",      "Options",      "uint32"},
{3664,      286,      "Veh_SetPsngrSeatMassageModeStruct",      "Veh_PsngrSeatMassgProgReq",      "uint8"},
{3665,      286,      "Veh_SetPsngrSeatMassageModeRespStruct",      "RespCode",      "uint32"},
{3666,      286,      "Veh_SetPsngrSeatMassageModeRespStruct",      "Veh_SetPsngrSeatMassageModeNRC",      "uint32"},
{3667,      287,      "Veh_TurnOffPsngrSeatMassageStruct",      "SOAProtocolVersion",      "uint8"},
{3668,      287,      "Veh_TurnOffPsngrSeatMassageStruct",      "SOAHeaderType",      "uint8"},
{3669,      287,      "Veh_TurnOffPsngrSeatMassageStruct",      "SOAHeaderLength",      "uint16"},
{3670,      287,      "Veh_TurnOffPsngrSeatMassageStruct",      "Flag",      "uint16"},
{3671,      287,      "Veh_TurnOffPsngrSeatMassageStruct",      "HeaderCRC16",      "uint16"},
{3672,      287,      "Veh_TurnOffPsngrSeatMassageStruct",      "UserID",      "uint32"},
{3673,      287,      "Veh_TurnOffPsngrSeatMassageStruct",      "ReqTimeOut",      "uint32"},
{3674,      287,      "Veh_TurnOffPsngrSeatMassageStruct",      "RequestPriority",      "uint8"},
{3675,      287,      "Veh_TurnOffPsngrSeatMassageStruct",      "SequenceID",      "uint16"},
{3676,      287,      "Veh_TurnOffPsngrSeatMassageStruct",      "ServiceExecuteFeedbackFlag",      "uint8"},
{3677,      287,      "Veh_TurnOffPsngrSeatMassageStruct",      "Options",      "uint32"},
{3678,      287,      "Veh_TurnOffPsngrSeatMassageRespStruct",      "RespCode",      "uint32"},
{3679,      287,      "Veh_TurnOffPsngrSeatMassageRespStruct",      "Veh_TurnOffPsngrSeatMassageNRC",      "uint32"},
{3680,      288,      "Veh_SetDrvSeatLumbRelaxStruct",      "SOAProtocolVersion",      "uint8"},
{3681,      288,      "Veh_SetDrvSeatLumbRelaxStruct",      "SOAHeaderType",      "uint8"},
{3682,      288,      "Veh_SetDrvSeatLumbRelaxStruct",      "SOAHeaderLength",      "uint16"},
{3683,      288,      "Veh_SetDrvSeatLumbRelaxStruct",      "Flag",      "uint16"},
{3684,      288,      "Veh_SetDrvSeatLumbRelaxStruct",      "HeaderCRC16",      "uint16"},
{3685,      288,      "Veh_SetDrvSeatLumbRelaxStruct",      "UserID",      "uint32"},
{3686,      288,      "Veh_SetDrvSeatLumbRelaxStruct",      "ReqTimeOut",      "uint32"},
{3687,      288,      "Veh_SetDrvSeatLumbRelaxStruct",      "RequestPriority",      "uint8"},
{3688,      288,      "Veh_SetDrvSeatLumbRelaxStruct",      "SequenceID",      "uint16"},
{3689,      288,      "Veh_SetDrvSeatLumbRelaxStruct",      "ServiceExecuteFeedbackFlag",      "uint8"},
{3690,      288,      "Veh_SetDrvSeatLumbRelaxStruct",      "Options",      "uint32"},
{3691,      288,      "Veh_SetDrvSeatLumbRelaxStruct",      "Veh_DrvSeatLumbRelaxReq",      "uint8"},
{3692,      288,      "Veh_SetDrvSeatLumbRelaxRespStruct",      "RespCode",      "uint32"},
{3693,      288,      "Veh_SetDrvSeatLumbRelaxRespStruct",      "Veh_SetDrvSeatLumbRelaxNRC",      "uint32"},
{3694,      289,      "Veh_SetPsngrSeatLumbRelaxStruct",      "SOAProtocolVersion",      "uint8"},
{3695,      289,      "Veh_SetPsngrSeatLumbRelaxStruct",      "SOAHeaderType",      "uint8"},
{3696,      289,      "Veh_SetPsngrSeatLumbRelaxStruct",      "SOAHeaderLength",      "uint16"},
{3697,      289,      "Veh_SetPsngrSeatLumbRelaxStruct",      "Flag",      "uint16"},
{3698,      289,      "Veh_SetPsngrSeatLumbRelaxStruct",      "HeaderCRC16",      "uint16"},
{3699,      289,      "Veh_SetPsngrSeatLumbRelaxStruct",      "UserID",      "uint32"},
{3700,      289,      "Veh_SetPsngrSeatLumbRelaxStruct",      "ReqTimeOut",      "uint32"},
{3701,      289,      "Veh_SetPsngrSeatLumbRelaxStruct",      "RequestPriority",      "uint8"},
{3702,      289,      "Veh_SetPsngrSeatLumbRelaxStruct",      "SequenceID",      "uint16"},
{3703,      289,      "Veh_SetPsngrSeatLumbRelaxStruct",      "ServiceExecuteFeedbackFlag",      "uint8"},
{3704,      289,      "Veh_SetPsngrSeatLumbRelaxStruct",      "Options",      "uint32"},
{3705,      289,      "Veh_SetPsngrSeatLumbRelaxStruct",      "Veh_PsngrSeatLumbRelaxReq",      "uint8"},
{3706,      289,      "Veh_SetPsngrSeatLumbRelaxRespStruct",      "RespCode",      "uint32"},
{3707,      289,      "Veh_SetPsngrSeatLumbRelaxRespStruct",      "Veh_SetPsngrSeatLumbRelaxNRC",      "uint32"},
{3708,      290,      "Veh_TurnOnSecRowLtSeatMassageStruct",      "SOAProtocolVersion",      "uint8"},
{3709,      290,      "Veh_TurnOnSecRowLtSeatMassageStruct",      "SOAHeaderType",      "uint8"},
{3710,      290,      "Veh_TurnOnSecRowLtSeatMassageStruct",      "SOAHeaderLength",      "uint16"},
{3711,      290,      "Veh_TurnOnSecRowLtSeatMassageStruct",      "Flag",      "uint16"},
{3712,      290,      "Veh_TurnOnSecRowLtSeatMassageStruct",      "HeaderCRC16",      "uint16"},
{3713,      290,      "Veh_TurnOnSecRowLtSeatMassageStruct",      "UserID",      "uint32"},
{3714,      290,      "Veh_TurnOnSecRowLtSeatMassageStruct",      "ReqTimeOut",      "uint32"},
{3715,      290,      "Veh_TurnOnSecRowLtSeatMassageStruct",      "RequestPriority",      "uint8"},
{3716,      290,      "Veh_TurnOnSecRowLtSeatMassageStruct",      "SequenceID",      "uint16"},
{3717,      290,      "Veh_TurnOnSecRowLtSeatMassageStruct",      "ServiceExecuteFeedbackFlag",      "uint8"},
{3718,      290,      "Veh_TurnOnSecRowLtSeatMassageStruct",      "Options",      "uint32"},
{3719,      290,      "Veh_TurnOnSecRowLtSeatMassageStruct",      "Veh_SecRowLtSeatMassgIntenReq",      "uint8"},
{3720,      290,      "Veh_TurnOnSecRowLtSeatMassageStruct",      "Veh_SecRowLtSeatMassgProgReq",      "uint8"},
{3721,      290,      "Veh_TurnOnSecRowLtSeatMassageRespStruct",      "RespCode",      "uint32"},
{3722,      290,      "Veh_TurnOnSecRowLtSeatMassageRespStruct",      "Veh_TurnOnSecRowLtSeatMassageNRC",      "uint32"},
{3723,      291,      "Veh_SetSecRowLtSeatMassageIntensityStruct",      "SOAProtocolVersion",      "uint8"},
{3724,      291,      "Veh_SetSecRowLtSeatMassageIntensityStruct",      "SOAHeaderType",      "uint8"},
{3725,      291,      "Veh_SetSecRowLtSeatMassageIntensityStruct",      "SOAHeaderLength",      "uint16"},
{3726,      291,      "Veh_SetSecRowLtSeatMassageIntensityStruct",      "Flag",      "uint16"},
{3727,      291,      "Veh_SetSecRowLtSeatMassageIntensityStruct",      "HeaderCRC16",      "uint16"},
{3728,      291,      "Veh_SetSecRowLtSeatMassageIntensityStruct",      "UserID",      "uint32"},
{3729,      291,      "Veh_SetSecRowLtSeatMassageIntensityStruct",      "ReqTimeOut",      "uint32"},
{3730,      291,      "Veh_SetSecRowLtSeatMassageIntensityStruct",      "RequestPriority",      "uint8"},
{3731,      291,      "Veh_SetSecRowLtSeatMassageIntensityStruct",      "SequenceID",      "uint16"},
{3732,      291,      "Veh_SetSecRowLtSeatMassageIntensityStruct",      "ServiceExecuteFeedbackFlag",      "uint8"},
{3733,      291,      "Veh_SetSecRowLtSeatMassageIntensityStruct",      "Options",      "uint32"},
{3734,      291,      "Veh_SetSecRowLtSeatMassageIntensityStruct",      "Veh_SecRowLtSeatMassgIntenReq",      "uint8"},
{3735,      291,      "Veh_SetSecRowLtSeatMassageIntensityRespStruct",      "RespCode",      "uint32"},
{3736,      291,      "Veh_SetSecRowLtSeatMassageIntensityRespStruct",      "Veh_SetSecRowLtSeatMassageIntensityNRC",      "uint32"},
{3737,      292,      "Veh_SetSecRowLtSeatMassageModeStruct",      "SOAProtocolVersion",      "uint8"},
{3738,      292,      "Veh_SetSecRowLtSeatMassageModeStruct",      "SOAHeaderType",      "uint8"},
{3739,      292,      "Veh_SetSecRowLtSeatMassageModeStruct",      "SOAHeaderLength",      "uint16"},
{3740,      292,      "Veh_SetSecRowLtSeatMassageModeStruct",      "Flag",      "uint16"},
{3741,      292,      "Veh_SetSecRowLtSeatMassageModeStruct",      "HeaderCRC16",      "uint16"},
{3742,      292,      "Veh_SetSecRowLtSeatMassageModeStruct",      "UserID",      "uint32"},
{3743,      292,      "Veh_SetSecRowLtSeatMassageModeStruct",      "ReqTimeOut",      "uint32"},
{3744,      292,      "Veh_SetSecRowLtSeatMassageModeStruct",      "RequestPriority",      "uint8"},
{3745,      292,      "Veh_SetSecRowLtSeatMassageModeStruct",      "SequenceID",      "uint16"},
{3746,      292,      "Veh_SetSecRowLtSeatMassageModeStruct",      "ServiceExecuteFeedbackFlag",      "uint8"},
{3747,      292,      "Veh_SetSecRowLtSeatMassageModeStruct",      "Options",      "uint32"},
{3748,      292,      "Veh_SetSecRowLtSeatMassageModeStruct",      "Veh_SecRowLtSeatMassgProgReq",      "uint8"},
{3749,      292,      "Veh_SetSecRowLtSeatMassageModeRespStruct",      "RespCode",      "uint32"},
{3750,      292,      "Veh_SetSecRowLtSeatMassageModeRespStruct",      "Veh_SetSecRowLtSeatMassageModeNRC",      "uint32"},
{3751,      293,      "Veh_TurnOffSecRowLtSeatMassageStruct",      "SOAProtocolVersion",      "uint8"},
{3752,      293,      "Veh_TurnOffSecRowLtSeatMassageStruct",      "SOAHeaderType",      "uint8"},
{3753,      293,      "Veh_TurnOffSecRowLtSeatMassageStruct",      "SOAHeaderLength",      "uint16"},
{3754,      293,      "Veh_TurnOffSecRowLtSeatMassageStruct",      "Flag",      "uint16"},
{3755,      293,      "Veh_TurnOffSecRowLtSeatMassageStruct",      "HeaderCRC16",      "uint16"},
{3756,      293,      "Veh_TurnOffSecRowLtSeatMassageStruct",      "UserID",      "uint32"},
{3757,      293,      "Veh_TurnOffSecRowLtSeatMassageStruct",      "ReqTimeOut",      "uint32"},
{3758,      293,      "Veh_TurnOffSecRowLtSeatMassageStruct",      "RequestPriority",      "uint8"},
{3759,      293,      "Veh_TurnOffSecRowLtSeatMassageStruct",      "SequenceID",      "uint16"},
{3760,      293,      "Veh_TurnOffSecRowLtSeatMassageStruct",      "ServiceExecuteFeedbackFlag",      "uint8"},
{3761,      293,      "Veh_TurnOffSecRowLtSeatMassageStruct",      "Options",      "uint32"},
{3762,      293,      "Veh_TurnOffSecRowLtSeatMassageRespStruct",      "RespCode",      "uint32"},
{3763,      293,      "Veh_TurnOffSecRowLtSeatMassageRespStruct",      "Veh_TurnOffSecRowLtSeatMassageNRC",      "uint32"},
{3764,      294,      "Veh_TurnOnSecRowRtSeatMassageStruct",      "SOAProtocolVersion",      "uint8"},
{3765,      294,      "Veh_TurnOnSecRowRtSeatMassageStruct",      "SOAHeaderType",      "uint8"},
{3766,      294,      "Veh_TurnOnSecRowRtSeatMassageStruct",      "SOAHeaderLength",      "uint16"},
{3767,      294,      "Veh_TurnOnSecRowRtSeatMassageStruct",      "Flag",      "uint16"},
{3768,      294,      "Veh_TurnOnSecRowRtSeatMassageStruct",      "HeaderCRC16",      "uint16"},
{3769,      294,      "Veh_TurnOnSecRowRtSeatMassageStruct",      "UserID",      "uint32"},
{3770,      294,      "Veh_TurnOnSecRowRtSeatMassageStruct",      "ReqTimeOut",      "uint32"},
{3771,      294,      "Veh_TurnOnSecRowRtSeatMassageStruct",      "RequestPriority",      "uint8"},
{3772,      294,      "Veh_TurnOnSecRowRtSeatMassageStruct",      "SequenceID",      "uint16"},
{3773,      294,      "Veh_TurnOnSecRowRtSeatMassageStruct",      "ServiceExecuteFeedbackFlag",      "uint8"},
{3774,      294,      "Veh_TurnOnSecRowRtSeatMassageStruct",      "Options",      "uint32"},
{3775,      294,      "Veh_TurnOnSecRowRtSeatMassageStruct",      "Veh_SecRowRtSeatMassgIntenReq",      "uint8"},
{3776,      294,      "Veh_TurnOnSecRowRtSeatMassageStruct",      "Veh_SecRowRtSeatMassgProgReq",      "uint8"},
{3777,      294,      "Veh_TurnOnSecRowRtSeatMassageRespStruct",      "RespCode",      "uint32"},
{3778,      294,      "Veh_TurnOnSecRowRtSeatMassageRespStruct",      "Veh_TurnOnSecRowRtSeatMassageNRC",      "uint32"},
{3779,      295,      "Veh_SetSecRowRtSeatMassageIntensityStruct",      "SOAProtocolVersion",      "uint8"},
{3780,      295,      "Veh_SetSecRowRtSeatMassageIntensityStruct",      "SOAHeaderType",      "uint8"},
{3781,      295,      "Veh_SetSecRowRtSeatMassageIntensityStruct",      "SOAHeaderLength",      "uint16"},
{3782,      295,      "Veh_SetSecRowRtSeatMassageIntensityStruct",      "Flag",      "uint16"},
{3783,      295,      "Veh_SetSecRowRtSeatMassageIntensityStruct",      "HeaderCRC16",      "uint16"},
{3784,      295,      "Veh_SetSecRowRtSeatMassageIntensityStruct",      "UserID",      "uint32"},
{3785,      295,      "Veh_SetSecRowRtSeatMassageIntensityStruct",      "ReqTimeOut",      "uint32"},
{3786,      295,      "Veh_SetSecRowRtSeatMassageIntensityStruct",      "RequestPriority",      "uint8"},
{3787,      295,      "Veh_SetSecRowRtSeatMassageIntensityStruct",      "SequenceID",      "uint16"},
{3788,      295,      "Veh_SetSecRowRtSeatMassageIntensityStruct",      "ServiceExecuteFeedbackFlag",      "uint8"},
{3789,      295,      "Veh_SetSecRowRtSeatMassageIntensityStruct",      "Options",      "uint32"},
{3790,      295,      "Veh_SetSecRowRtSeatMassageIntensityStruct",      "Veh_SecRowRtSeatMassgIntenReq",      "uint8"},
{3791,      295,      "Veh_SetSecRowRtSeatMassageIntensityRespStruct",      "RespCode",      "uint32"},
{3792,      295,      "Veh_SetSecRowRtSeatMassageIntensityRespStruct",      "Veh_SetSecRowRtSeatMassageIntensityNRC",      "uint32"},
{3793,      296,      "Veh_SetSecRowRtSeatMassageModeStruct",      "SOAProtocolVersion",      "uint8"},
{3794,      296,      "Veh_SetSecRowRtSeatMassageModeStruct",      "SOAHeaderType",      "uint8"},
{3795,      296,      "Veh_SetSecRowRtSeatMassageModeStruct",      "SOAHeaderLength",      "uint16"},
{3796,      296,      "Veh_SetSecRowRtSeatMassageModeStruct",      "Flag",      "uint16"},
{3797,      296,      "Veh_SetSecRowRtSeatMassageModeStruct",      "HeaderCRC16",      "uint16"},
{3798,      296,      "Veh_SetSecRowRtSeatMassageModeStruct",      "UserID",      "uint32"},
{3799,      296,      "Veh_SetSecRowRtSeatMassageModeStruct",      "ReqTimeOut",      "uint32"},
{3800,      296,      "Veh_SetSecRowRtSeatMassageModeStruct",      "RequestPriority",      "uint8"},
{3801,      296,      "Veh_SetSecRowRtSeatMassageModeStruct",      "SequenceID",      "uint16"},
{3802,      296,      "Veh_SetSecRowRtSeatMassageModeStruct",      "ServiceExecuteFeedbackFlag",      "uint8"},
{3803,      296,      "Veh_SetSecRowRtSeatMassageModeStruct",      "Options",      "uint32"},
{3804,      296,      "Veh_SetSecRowRtSeatMassageModeStruct",      "Veh_SecRowRtSeatMassgProgReq",      "uint8"},
{3805,      296,      "Veh_SetSecRowRtSeatMassageModeRespStruct",      "RespCode",      "uint32"},
{3806,      296,      "Veh_SetSecRowRtSeatMassageModeRespStruct",      "Veh_SetSecRowRtSeatMassageModeNRC",      "uint32"},
{3807,      297,      "Veh_TurnOffSecRowRtSeatMassageStruct",      "SOAProtocolVersion",      "uint8"},
{3808,      297,      "Veh_TurnOffSecRowRtSeatMassageStruct",      "SOAHeaderType",      "uint8"},
{3809,      297,      "Veh_TurnOffSecRowRtSeatMassageStruct",      "SOAHeaderLength",      "uint16"},
{3810,      297,      "Veh_TurnOffSecRowRtSeatMassageStruct",      "Flag",      "uint16"},
{3811,      297,      "Veh_TurnOffSecRowRtSeatMassageStruct",      "HeaderCRC16",      "uint16"},
{3812,      297,      "Veh_TurnOffSecRowRtSeatMassageStruct",      "UserID",      "uint32"},
{3813,      297,      "Veh_TurnOffSecRowRtSeatMassageStruct",      "ReqTimeOut",      "uint32"},
{3814,      297,      "Veh_TurnOffSecRowRtSeatMassageStruct",      "RequestPriority",      "uint8"},
{3815,      297,      "Veh_TurnOffSecRowRtSeatMassageStruct",      "SequenceID",      "uint16"},
{3816,      297,      "Veh_TurnOffSecRowRtSeatMassageStruct",      "ServiceExecuteFeedbackFlag",      "uint8"},
{3817,      297,      "Veh_TurnOffSecRowRtSeatMassageStruct",      "Options",      "uint32"},
{3818,      297,      "Veh_TurnOffSecRowRtSeatMassageRespStruct",      "RespCode",      "uint32"},
{3819,      297,      "Veh_TurnOffSecRowRtSeatMassageRespStruct",      "Veh_TurnOffSecRowRtSeatMassageNRC",      "uint32"},
{3820,      298,      "Veh_SetDrvSeatLumbRelaxIntenReqStruct",      "SOAProtocolVersion",      "uint8"},
{3821,      298,      "Veh_SetDrvSeatLumbRelaxIntenReqStruct",      "SOAHeaderType",      "uint8"},
{3822,      298,      "Veh_SetDrvSeatLumbRelaxIntenReqStruct",      "SOAHeaderLength",      "uint16"},
{3823,      298,      "Veh_SetDrvSeatLumbRelaxIntenReqStruct",      "Flag",      "uint16"},
{3824,      298,      "Veh_SetDrvSeatLumbRelaxIntenReqStruct",      "HeaderCRC16",      "uint16"},
{3825,      298,      "Veh_SetDrvSeatLumbRelaxIntenReqStruct",      "UserID",      "uint32"},
{3826,      298,      "Veh_SetDrvSeatLumbRelaxIntenReqStruct",      "ReqTimeOut",      "uint32"},
{3827,      298,      "Veh_SetDrvSeatLumbRelaxIntenReqStruct",      "RequestPriority",      "uint8"},
{3828,      298,      "Veh_SetDrvSeatLumbRelaxIntenReqStruct",      "SequenceID",      "uint16"},
{3829,      298,      "Veh_SetDrvSeatLumbRelaxIntenReqStruct",      "ServiceExecuteFeedbackFlag",      "uint8"},
{3830,      298,      "Veh_SetDrvSeatLumbRelaxIntenReqStruct",      "Options",      "uint32"},
{3831,      298,      "Veh_SetDrvSeatLumbRelaxIntenReqStruct",      "Veh_DrvSeatLumbRelaxIntenReq",      "uint8"},
{3832,      298,      "Veh_SetDrvSeatLumbRelaxIntenRespStruct",      "RespCode",      "uint32"},
{3833,      298,      "Veh_SetDrvSeatLumbRelaxIntenRespStruct",      "Veh_SetDrvSeatLumbRelaxIntenNRC",      "uint32"},
{3834,      299,      "Veh_SetPsSeatLumbRelaxIntenReqStruct",      "SOAProtocolVersion",      "uint8"},
{3835,      299,      "Veh_SetPsSeatLumbRelaxIntenReqStruct",      "SOAHeaderType",      "uint8"},
{3836,      299,      "Veh_SetPsSeatLumbRelaxIntenReqStruct",      "SOAHeaderLength",      "uint16"},
{3837,      299,      "Veh_SetPsSeatLumbRelaxIntenReqStruct",      "Flag",      "uint16"},
{3838,      299,      "Veh_SetPsSeatLumbRelaxIntenReqStruct",      "HeaderCRC16",      "uint16"},
{3839,      299,      "Veh_SetPsSeatLumbRelaxIntenReqStruct",      "UserID",      "uint32"},
{3840,      299,      "Veh_SetPsSeatLumbRelaxIntenReqStruct",      "ReqTimeOut",      "uint32"},
{3841,      299,      "Veh_SetPsSeatLumbRelaxIntenReqStruct",      "RequestPriority",      "uint8"},
{3842,      299,      "Veh_SetPsSeatLumbRelaxIntenReqStruct",      "SequenceID",      "uint16"},
{3843,      299,      "Veh_SetPsSeatLumbRelaxIntenReqStruct",      "ServiceExecuteFeedbackFlag",      "uint8"},
{3844,      299,      "Veh_SetPsSeatLumbRelaxIntenReqStruct",      "Options",      "uint32"},
{3845,      299,      "Veh_SetPsSeatLumbRelaxIntenReqStruct",      "Veh_PsSeatLumbRelaxIntenReq",      "uint8"},
{3846,      299,      "Veh_SetPsSeatLumbRelaxIntenRespStruct",      "RespCode",      "uint32"},
{3847,      299,      "Veh_SetPsSeatLumbRelaxIntenRespStruct",      "Veh_SetPsSeatLumbRelaxIntenNRC",      "uint32"},
{3848,      300,      "Veh_SFMService_ErrStruct",      "SequenceID",      "uint16"},
{3849,      300,      "Veh_SFMService_ErrStruct",      "Options_8bit",      "uint8"},
{3850,      300,      "Veh_SFMService_ErrStruct",      "Options_8bit2",      "uint8"},
{3851,      300,      "Veh_SFMService_ErrStruct",      "UserID",      "uint32"},
{3852,      300,      "Veh_SFMService_ErrStruct",      "OpeNRC",      "uint32"},
{3853,      300,      "Veh_SFMService_ErrStruct",      "OpeErrInfo",      "string[16]"},
{3854,      301,      "SFMStStruct",      "SFM_State",      "uint8"},
{3855,      301,      "SFMStStruct",      "SFM_ErrorCode",      "uint8"},
{3856,      302,      "SFMSt2Struct",      "SFM_Pos",      "uint8"},
{3857,      303,      "Veh_SFMOpenCloseCtrStruct",      "SOAProtocolVersion",      "uint8"},
{3858,      303,      "Veh_SFMOpenCloseCtrStruct",      "SOAHeaderType",      "uint8"},
{3859,      303,      "Veh_SFMOpenCloseCtrStruct",      "SOAHeaderLength",      "uint16"},
{3860,      303,      "Veh_SFMOpenCloseCtrStruct",      "Flag",      "uint16"},
{3861,      303,      "Veh_SFMOpenCloseCtrStruct",      "HeaderCRC16",      "uint16"},
{3862,      303,      "Veh_SFMOpenCloseCtrStruct",      "UserID",      "uint32"},
{3863,      303,      "Veh_SFMOpenCloseCtrStruct",      "ReqTimeOut",      "uint32"},
{3864,      303,      "Veh_SFMOpenCloseCtrStruct",      "RequestPriority",      "uint8"},
{3865,      303,      "Veh_SFMOpenCloseCtrStruct",      "SequenceID",      "uint16"},
{3866,      303,      "Veh_SFMOpenCloseCtrStruct",      "ServiceExecuteFeedbackFlag",      "uint8"},
{3867,      303,      "Veh_SFMOpenCloseCtrStruct",      "Options",      "uint32"},
{3868,      303,      "Veh_SFMOpenCloseCtrStruct",      "Veh_SFMOpenCloseCtr",      "uint8"},
{3869,      303,      "Veh_SFMOpenCloseCtrRespStruct",      "RespCode",      "uint32"},
{3870,      303,      "Veh_SFMOpenCloseCtrRespStruct",      "Veh_SFMOpenCloseCtrNRC",      "uint32"},
{3871,      304,      "Veh_SFMPosCtrStruct",      "SOAProtocolVersion",      "uint8"},
{3872,      304,      "Veh_SFMPosCtrStruct",      "SOAHeaderType",      "uint8"},
{3873,      304,      "Veh_SFMPosCtrStruct",      "SOAHeaderLength",      "uint16"},
{3874,      304,      "Veh_SFMPosCtrStruct",      "Flag",      "uint16"},
{3875,      304,      "Veh_SFMPosCtrStruct",      "HeaderCRC16",      "uint16"},
{3876,      304,      "Veh_SFMPosCtrStruct",      "UserID",      "uint32"},
{3877,      304,      "Veh_SFMPosCtrStruct",      "ReqTimeOut",      "uint32"},
{3878,      304,      "Veh_SFMPosCtrStruct",      "RequestPriority",      "uint8"},
{3879,      304,      "Veh_SFMPosCtrStruct",      "SequenceID",      "uint16"},
{3880,      304,      "Veh_SFMPosCtrStruct",      "ServiceExecuteFeedbackFlag",      "uint8"},
{3881,      304,      "Veh_SFMPosCtrStruct",      "Options",      "uint32"},
{3882,      304,      "Veh_SFMPosCtrStruct",      "Veh_SFMPosCtr",      "uint8"},
{3883,      304,      "Veh_SFMPosCtrRespStruct",      "RespCode",      "uint32"},
{3884,      304,      "Veh_SFMPosCtrRespStruct",      "Veh_SFMPosCtrNRC",      "uint32"},
{3885,      305,      "Veh_WindowService_ErrStruct",      "SequenceID",      "uint16"},
{3886,      305,      "Veh_WindowService_ErrStruct",      "Options_8bit",      "uint8"},
{3887,      305,      "Veh_WindowService_ErrStruct",      "Options_8bit2",      "uint8"},
{3888,      305,      "Veh_WindowService_ErrStruct",      "UserID",      "uint32"},
{3889,      305,      "Veh_WindowService_ErrStruct",      "OpeNRC",      "uint32"},
{3890,      305,      "Veh_WindowService_ErrStruct",      "OpeErrInfo",      "string[16]"},
{3891,      306,      "Veh_CtrlAllWinUpDownStruct",      "SOAProtocolVersion",      "uint8"},
{3892,      306,      "Veh_CtrlAllWinUpDownStruct",      "SOAHeaderType",      "uint8"},
{3893,      306,      "Veh_CtrlAllWinUpDownStruct",      "SOAHeaderLength",      "uint16"},
{3894,      306,      "Veh_CtrlAllWinUpDownStruct",      "Flag",      "uint16"},
{3895,      306,      "Veh_CtrlAllWinUpDownStruct",      "HeaderCRC16",      "uint16"},
{3896,      306,      "Veh_CtrlAllWinUpDownStruct",      "UserID",      "uint32"},
{3897,      306,      "Veh_CtrlAllWinUpDownStruct",      "ReqTimeOut",      "uint32"},
{3898,      306,      "Veh_CtrlAllWinUpDownStruct",      "RequestPriority",      "uint8"},
{3899,      306,      "Veh_CtrlAllWinUpDownStruct",      "SequenceID",      "uint16"},
{3900,      306,      "Veh_CtrlAllWinUpDownStruct",      "ServiceExecuteFeedbackFlag",      "uint8"},
{3901,      306,      "Veh_CtrlAllWinUpDownStruct",      "Options",      "uint32"},
{3902,      306,      "Veh_CtrlAllWinUpDownStruct",      "Veh_CtrlAllWinAutoupDown",      "uint8"},
{3903,      306,      "Veh_CtrlAllWinUpDownRespStruct",      "RespCode",      "uint32"},
{3904,      306,      "Veh_CtrlAllWinUpDownRespStruct",      "Veh_CtrlAllWinUpDownNRC",      "uint32"},
{3905,      307,      "Veh_DoorLockService_ErrStruct",      "SequenceID",      "uint16"},
{3906,      307,      "Veh_DoorLockService_ErrStruct",      "Options_8bit",      "uint8"},
{3907,      307,      "Veh_DoorLockService_ErrStruct",      "Options_8bit2",      "uint8"},
{3908,      307,      "Veh_DoorLockService_ErrStruct",      "UserID",      "uint32"},
{3909,      307,      "Veh_DoorLockService_ErrStruct",      "OpeNRC",      "uint32"},
{3910,      307,      "Veh_DoorLockService_ErrStruct",      "OpeErrInfo",      "string[16]"},
{3911,      308,      "Veh_SetDoorLockStateStruct",      "SOAProtocolVersion",      "uint8"},
{3912,      308,      "Veh_SetDoorLockStateStruct",      "SOAHeaderType",      "uint8"},
{3913,      308,      "Veh_SetDoorLockStateStruct",      "SOAHeaderLength",      "uint16"},
{3914,      308,      "Veh_SetDoorLockStateStruct",      "Flag",      "uint16"},
{3915,      308,      "Veh_SetDoorLockStateStruct",      "HeaderCRC16",      "uint16"},
{3916,      308,      "Veh_SetDoorLockStateStruct",      "UserID",      "uint32"},
{3917,      308,      "Veh_SetDoorLockStateStruct",      "ReqTimeOut",      "uint32"},
{3918,      308,      "Veh_SetDoorLockStateStruct",      "RequestPriority",      "uint8"},
{3919,      308,      "Veh_SetDoorLockStateStruct",      "SequenceID",      "uint16"},
{3920,      308,      "Veh_SetDoorLockStateStruct",      "ServiceExecuteFeedbackFlag",      "uint8"},
{3921,      308,      "Veh_SetDoorLockStateStruct",      "Options",      "uint32"},
{3922,      308,      "Veh_SetDoorLockStateStruct",      "Veh_SetDoorLockStateCtr",      "uint8"},
{3923,      308,      "Veh_SetDoorLockStateRespStruct",      "RespCode",      "uint32"},
{3924,      308,      "Veh_SetDoorLockStateRespStruct",      "Veh_SetDoorLockStateNRC",      "uint32"},
{3925,      309,      "Veh_SetDoorOriLockStCmdStruct",      "SOAProtocolVersion",      "uint8"},
{3926,      309,      "Veh_SetDoorOriLockStCmdStruct",      "SOAHeaderType",      "uint8"},
{3927,      309,      "Veh_SetDoorOriLockStCmdStruct",      "SOAHeaderLength",      "uint16"},
{3928,      309,      "Veh_SetDoorOriLockStCmdStruct",      "Flag",      "uint16"},
{3929,      309,      "Veh_SetDoorOriLockStCmdStruct",      "HeaderCRC16",      "uint16"},
{3930,      309,      "Veh_SetDoorOriLockStCmdStruct",      "UserID",      "uint32"},
{3931,      309,      "Veh_SetDoorOriLockStCmdStruct",      "ReqTimeOut",      "uint32"},
{3932,      309,      "Veh_SetDoorOriLockStCmdStruct",      "RequestPriority",      "uint8"},
{3933,      309,      "Veh_SetDoorOriLockStCmdStruct",      "SequenceID",      "uint16"},
{3934,      309,      "Veh_SetDoorOriLockStCmdStruct",      "ServiceExecuteFeedbackFlag",      "uint8"},
{3935,      309,      "Veh_SetDoorOriLockStCmdStruct",      "Options",      "uint32"},
{3936,      309,      "Veh_SetDoorOriLockStCmdStruct",      "Veh_SetDoorOriLockStCmd",      "uint8"},
{3937,      309,      "Veh_SetDoorOriLockStRespStruct",      "RespCode",      "uint32"},
{3938,      309,      "Veh_SetDoorOriLockStRespStruct",      "Veh_SetDoorOriLockStNRC",      "uint32"},
{3939,      310,      "Veh_SetDoorOriUnlockStCmdStruct",      "SOAProtocolVersion",      "uint8"},
{3940,      310,      "Veh_SetDoorOriUnlockStCmdStruct",      "SOAHeaderType",      "uint8"},
{3941,      310,      "Veh_SetDoorOriUnlockStCmdStruct",      "SOAHeaderLength",      "uint16"},
{3942,      310,      "Veh_SetDoorOriUnlockStCmdStruct",      "Flag",      "uint16"},
{3943,      310,      "Veh_SetDoorOriUnlockStCmdStruct",      "HeaderCRC16",      "uint16"},
{3944,      310,      "Veh_SetDoorOriUnlockStCmdStruct",      "UserID",      "uint32"},
{3945,      310,      "Veh_SetDoorOriUnlockStCmdStruct",      "ReqTimeOut",      "uint32"},
{3946,      310,      "Veh_SetDoorOriUnlockStCmdStruct",      "RequestPriority",      "uint8"},
{3947,      310,      "Veh_SetDoorOriUnlockStCmdStruct",      "SequenceID",      "uint16"},
{3948,      310,      "Veh_SetDoorOriUnlockStCmdStruct",      "ServiceExecuteFeedbackFlag",      "uint8"},
{3949,      310,      "Veh_SetDoorOriUnlockStCmdStruct",      "Options",      "uint32"},
{3950,      310,      "Veh_SetDoorOriUnlockStCmdStruct",      "Veh_SetDoorOriUnlockStCmd",      "uint8"},
{3951,      310,      "Veh_SetDoorOriUnlockStRespStruct",      "RespCode",      "uint32"},
{3952,      310,      "Veh_SetDoorOriUnlockStRespStruct",      "Veh_SetDoorOriUnlockStNRC",      "uint32"},
{3953,      311,      "Veh_TailgateControl_ErrStruct",      "SequenceID",      "uint16"},
{3954,      311,      "Veh_TailgateControl_ErrStruct",      "Options_8bit",      "uint8"},
{3955,      311,      "Veh_TailgateControl_ErrStruct",      "Options_8bit2",      "uint8"},
{3956,      311,      "Veh_TailgateControl_ErrStruct",      "UserID",      "uint32"},
{3957,      311,      "Veh_TailgateControl_ErrStruct",      "OpeNRC",      "uint32"},
{3958,      311,      "Veh_TailgateControl_ErrStruct",      "OpeErrInfo",      "string[16]"},
{3959,      312,      "Veh_TgateMvtCtrlStruct",      "SOAProtocolVersion",      "uint8"},
{3960,      312,      "Veh_TgateMvtCtrlStruct",      "SOAHeaderType",      "uint8"},
{3961,      312,      "Veh_TgateMvtCtrlStruct",      "SOAHeaderLength",      "uint16"},
{3962,      312,      "Veh_TgateMvtCtrlStruct",      "Flag",      "uint16"},
{3963,      312,      "Veh_TgateMvtCtrlStruct",      "HeaderCRC16",      "uint16"},
{3964,      312,      "Veh_TgateMvtCtrlStruct",      "UserID",      "uint32"},
{3965,      312,      "Veh_TgateMvtCtrlStruct",      "ReqTimeOut",      "uint32"},
{3966,      312,      "Veh_TgateMvtCtrlStruct",      "RequestPriority",      "uint8"},
{3967,      312,      "Veh_TgateMvtCtrlStruct",      "SequenceID",      "uint16"},
{3968,      312,      "Veh_TgateMvtCtrlStruct",      "ServiceExecuteFeedbackFlag",      "uint8"},
{3969,      312,      "Veh_TgateMvtCtrlStruct",      "Options",      "uint32"},
{3970,      312,      "Veh_TgateMvtCtrlStruct",      "Veh_TgateMvtReq",      "uint8"},
{3971,      312,      "Veh_TgateMvtCtrlRespStruct",      "RespCode",      "uint32"},
{3972,      312,      "Veh_TgateMvtCtrlRespStruct",      "Veh_TgateMvtCtrlNRC",      "uint32"},
{3973,      313,      "Veh_SWSHeatService_ErrStruct",      "SequenceID",      "uint16"},
{3974,      313,      "Veh_SWSHeatService_ErrStruct",      "Options_8bit",      "uint8"},
{3975,      313,      "Veh_SWSHeatService_ErrStruct",      "Options_8bit2",      "uint8"},
{3976,      313,      "Veh_SWSHeatService_ErrStruct",      "UserID",      "uint32"},
{3977,      313,      "Veh_SWSHeatService_ErrStruct",      "OpeNRC",      "uint32"},
{3978,      313,      "Veh_SWSHeatService_ErrStruct",      "OpeErrInfo",      "string[16]"},
{3979,      314,      "SWSHeatStStruct",      "SWSHeatSt",      "uint8"},
{3980,      315,      "Veh_SWSHeatCmdStruct",      "SOAProtocolVersion",      "uint8"},
{3981,      315,      "Veh_SWSHeatCmdStruct",      "SOAHeaderType",      "uint8"},
{3982,      315,      "Veh_SWSHeatCmdStruct",      "SOAHeaderLength",      "uint16"},
{3983,      315,      "Veh_SWSHeatCmdStruct",      "Flag",      "uint16"},
{3984,      315,      "Veh_SWSHeatCmdStruct",      "HeaderCRC16",      "uint16"},
{3985,      315,      "Veh_SWSHeatCmdStruct",      "UserID",      "uint32"},
{3986,      315,      "Veh_SWSHeatCmdStruct",      "ReqTimeOut",      "uint32"},
{3987,      315,      "Veh_SWSHeatCmdStruct",      "RequestPriority",      "uint8"},
{3988,      315,      "Veh_SWSHeatCmdStruct",      "SequenceID",      "uint16"},
{3989,      315,      "Veh_SWSHeatCmdStruct",      "ServiceExecuteFeedbackFlag",      "uint8"},
{3990,      315,      "Veh_SWSHeatCmdStruct",      "Options",      "uint32"},
{3991,      315,      "Veh_SWSHeatCmdStruct",      "Veh_SWSHeatCmd",      "uint8"},
{3992,      315,      "Veh_SWSHeatCmdRespStruct",      "RespCode",      "uint32"},
{3993,      315,      "Veh_SWSHeatCmdRespStruct",      "Veh_SWSHeatCmdNRC",      "uint32"},
{3994,      316,      "Veh_HVACService_ErrStruct",      "SequenceID",      "uint16"},
{3995,      316,      "Veh_HVACService_ErrStruct",      "Options_8bit",      "uint8"},
{3996,      316,      "Veh_HVACService_ErrStruct",      "Options_8bit2",      "uint8"},
{3997,      316,      "Veh_HVACService_ErrStruct",      "UserID",      "uint32"},
{3998,      316,      "Veh_HVACService_ErrStruct",      "OpeNRC",      "uint32"},
{3999,      316,      "Veh_HVACService_ErrStruct",      "OpeErrInfo",      "string[16]"},
{4000,      317,      "Veh_HVACRemotePushStruct",      "Veh_DisinfStPush",      "uint8"},
{4001,      317,      "Veh_HVACRemotePushStruct",      "Veh_AcClrPush",      "uint8"},
{4002,      318,      "Veh_TurnOnOffACStruct",      "SOAProtocolVersion",      "uint8"},
{4003,      318,      "Veh_TurnOnOffACStruct",      "SOAHeaderType",      "uint8"},
{4004,      318,      "Veh_TurnOnOffACStruct",      "SOAHeaderLength",      "uint16"},
{4005,      318,      "Veh_TurnOnOffACStruct",      "Flag",      "uint16"},
{4006,      318,      "Veh_TurnOnOffACStruct",      "HeaderCRC16",      "uint16"},
{4007,      318,      "Veh_TurnOnOffACStruct",      "UserID",      "uint32"},
{4008,      318,      "Veh_TurnOnOffACStruct",      "ReqTimeOut",      "uint32"},
{4009,      318,      "Veh_TurnOnOffACStruct",      "RequestPriority",      "uint8"},
{4010,      318,      "Veh_TurnOnOffACStruct",      "SequenceID",      "uint16"},
{4011,      318,      "Veh_TurnOnOffACStruct",      "ServiceExecuteFeedbackFlag",      "uint8"},
{4012,      318,      "Veh_TurnOnOffACStruct",      "Options",      "uint32"},
{4013,      318,      "Veh_TurnOnOffACStruct",      "Veh_TurnOnOffAC",      "uint8"},
{4014,      318,      "Veh_TurnOnOffACStruct",      "Time",      "uint16"},
{4015,      318,      "Veh_TurnOnOffACStruct",      "MemoryReq",      "uint8"},
{4016,      318,      "Veh_TurnOnOffACRespStruct",      "RespCode",      "uint32"},
{4017,      318,      "Veh_TurnOnOffACRespStruct",      "Veh_TurnOnOffACNRC",      "uint32"},
{4018,      319,      "Veh_TurnOnOffFrACStruct",      "SOAProtocolVersion",      "uint8"},
{4019,      319,      "Veh_TurnOnOffFrACStruct",      "SOAHeaderType",      "uint8"},
{4020,      319,      "Veh_TurnOnOffFrACStruct",      "SOAHeaderLength",      "uint16"},
{4021,      319,      "Veh_TurnOnOffFrACStruct",      "Flag",      "uint16"},
{4022,      319,      "Veh_TurnOnOffFrACStruct",      "HeaderCRC16",      "uint16"},
{4023,      319,      "Veh_TurnOnOffFrACStruct",      "UserID",      "uint32"},
{4024,      319,      "Veh_TurnOnOffFrACStruct",      "ReqTimeOut",      "uint32"},
{4025,      319,      "Veh_TurnOnOffFrACStruct",      "RequestPriority",      "uint8"},
{4026,      319,      "Veh_TurnOnOffFrACStruct",      "SequenceID",      "uint16"},
{4027,      319,      "Veh_TurnOnOffFrACStruct",      "ServiceExecuteFeedbackFlag",      "uint8"},
{4028,      319,      "Veh_TurnOnOffFrACStruct",      "Options",      "uint32"},
{4029,      319,      "Veh_TurnOnOffFrACStruct",      "Veh_TurnOnOffFrAC",      "uint8"},
{4030,      319,      "Veh_TurnOnOffFrACStruct",      "Time",      "uint16"},
{4031,      319,      "Veh_TurnOnOffFrACStruct",      "MemoryReq",      "uint8"},
{4032,      319,      "Veh_TurnOnOffFrACRespStruct",      "RespCode",      "uint32"},
{4033,      319,      "Veh_TurnOnOffFrACRespStruct",      "Veh_TurnOnOffFrACNRC",      "uint32"},
{4034,      320,      "Veh_TurnOnOffRrACStruct",      "SOAProtocolVersion",      "uint8"},
{4035,      320,      "Veh_TurnOnOffRrACStruct",      "SOAHeaderType",      "uint8"},
{4036,      320,      "Veh_TurnOnOffRrACStruct",      "SOAHeaderLength",      "uint16"},
{4037,      320,      "Veh_TurnOnOffRrACStruct",      "Flag",      "uint16"},
{4038,      320,      "Veh_TurnOnOffRrACStruct",      "HeaderCRC16",      "uint16"},
{4039,      320,      "Veh_TurnOnOffRrACStruct",      "UserID",      "uint32"},
{4040,      320,      "Veh_TurnOnOffRrACStruct",      "ReqTimeOut",      "uint32"},
{4041,      320,      "Veh_TurnOnOffRrACStruct",      "RequestPriority",      "uint8"},
{4042,      320,      "Veh_TurnOnOffRrACStruct",      "SequenceID",      "uint16"},
{4043,      320,      "Veh_TurnOnOffRrACStruct",      "ServiceExecuteFeedbackFlag",      "uint8"},
{4044,      320,      "Veh_TurnOnOffRrACStruct",      "Options",      "uint32"},
{4045,      320,      "Veh_TurnOnOffRrACStruct",      "Veh_TurnOnOffRrAC",      "uint8"},
{4046,      320,      "Veh_TurnOnOffRrACStruct",      "Time",      "uint16"},
{4047,      320,      "Veh_TurnOnOffRrACStruct",      "MemoryReq",      "uint8"},
{4048,      320,      "Veh_TurnOnOffRrACRespStruct",      "RespCode",      "uint32"},
{4049,      320,      "Veh_TurnOnOffRrACRespStruct",      "Veh_TurnOnOffRrACNRC",      "uint32"},
{4050,      321,      "Veh_TurnOnOffAutoACStruct",      "SOAProtocolVersion",      "uint8"},
{4051,      321,      "Veh_TurnOnOffAutoACStruct",      "SOAHeaderType",      "uint8"},
{4052,      321,      "Veh_TurnOnOffAutoACStruct",      "SOAHeaderLength",      "uint16"},
{4053,      321,      "Veh_TurnOnOffAutoACStruct",      "Flag",      "uint16"},
{4054,      321,      "Veh_TurnOnOffAutoACStruct",      "HeaderCRC16",      "uint16"},
{4055,      321,      "Veh_TurnOnOffAutoACStruct",      "UserID",      "uint32"},
{4056,      321,      "Veh_TurnOnOffAutoACStruct",      "ReqTimeOut",      "uint32"},
{4057,      321,      "Veh_TurnOnOffAutoACStruct",      "RequestPriority",      "uint8"},
{4058,      321,      "Veh_TurnOnOffAutoACStruct",      "SequenceID",      "uint16"},
{4059,      321,      "Veh_TurnOnOffAutoACStruct",      "ServiceExecuteFeedbackFlag",      "uint8"},
{4060,      321,      "Veh_TurnOnOffAutoACStruct",      "Options",      "uint32"},
{4061,      321,      "Veh_TurnOnOffAutoACStruct",      "Veh_TurnOnOffAutoAC",      "uint8"},
{4062,      321,      "Veh_TurnOnOffAutoACStruct",      "Time",      "uint16"},
{4063,      321,      "Veh_TurnOnOffAutoACStruct",      "MemoryReq",      "uint8"},
{4064,      321,      "Veh_TurnOnOffAutoACRespStruct",      "RespCode",      "uint32"},
{4065,      321,      "Veh_TurnOnOffAutoACRespStruct",      "Veh_TurnOnOffAutoACNRC",      "uint32"},
{4066,      322,      "Veh_TurnOnOffFrAutoACStruct",      "SOAProtocolVersion",      "uint8"},
{4067,      322,      "Veh_TurnOnOffFrAutoACStruct",      "SOAHeaderType",      "uint8"},
{4068,      322,      "Veh_TurnOnOffFrAutoACStruct",      "SOAHeaderLength",      "uint16"},
{4069,      322,      "Veh_TurnOnOffFrAutoACStruct",      "Flag",      "uint16"},
{4070,      322,      "Veh_TurnOnOffFrAutoACStruct",      "HeaderCRC16",      "uint16"},
{4071,      322,      "Veh_TurnOnOffFrAutoACStruct",      "UserID",      "uint32"},
{4072,      322,      "Veh_TurnOnOffFrAutoACStruct",      "ReqTimeOut",      "uint32"},
{4073,      322,      "Veh_TurnOnOffFrAutoACStruct",      "RequestPriority",      "uint8"},
{4074,      322,      "Veh_TurnOnOffFrAutoACStruct",      "SequenceID",      "uint16"},
{4075,      322,      "Veh_TurnOnOffFrAutoACStruct",      "ServiceExecuteFeedbackFlag",      "uint8"},
{4076,      322,      "Veh_TurnOnOffFrAutoACStruct",      "Options",      "uint32"},
{4077,      322,      "Veh_TurnOnOffFrAutoACStruct",      "Veh_TurnOnOffFrAutoAC",      "uint8"},
{4078,      322,      "Veh_TurnOnOffFrAutoACStruct",      "Time",      "uint16"},
{4079,      322,      "Veh_TurnOnOffFrAutoACStruct",      "MemoryReq",      "uint8"},
{4080,      322,      "Veh_TurnOnOffFrAutoACRespStruct",      "RespCode",      "uint32"},
{4081,      322,      "Veh_TurnOnOffFrAutoACRespStruct",      "Veh_TurnOnOffFrAutoACNRC",      "uint32"},
{4082,      323,      "Veh_TurnOnOffRrAutoACStruct",      "SOAProtocolVersion",      "uint8"},
{4083,      323,      "Veh_TurnOnOffRrAutoACStruct",      "SOAHeaderType",      "uint8"},
{4084,      323,      "Veh_TurnOnOffRrAutoACStruct",      "SOAHeaderLength",      "uint16"},
{4085,      323,      "Veh_TurnOnOffRrAutoACStruct",      "Flag",      "uint16"},
{4086,      323,      "Veh_TurnOnOffRrAutoACStruct",      "HeaderCRC16",      "uint16"},
{4087,      323,      "Veh_TurnOnOffRrAutoACStruct",      "UserID",      "uint32"},
{4088,      323,      "Veh_TurnOnOffRrAutoACStruct",      "ReqTimeOut",      "uint32"},
{4089,      323,      "Veh_TurnOnOffRrAutoACStruct",      "RequestPriority",      "uint8"},
{4090,      323,      "Veh_TurnOnOffRrAutoACStruct",      "SequenceID",      "uint16"},
{4091,      323,      "Veh_TurnOnOffRrAutoACStruct",      "ServiceExecuteFeedbackFlag",      "uint8"},
{4092,      323,      "Veh_TurnOnOffRrAutoACStruct",      "Options",      "uint32"},
{4093,      323,      "Veh_TurnOnOffRrAutoACStruct",      "Veh_TurnOnOffRrAutoAC",      "uint8"},
{4094,      323,      "Veh_TurnOnOffRrAutoACStruct",      "Time",      "uint16"},
{4095,      323,      "Veh_TurnOnOffRrAutoACStruct",      "MemoryReq",      "uint8"},
{4096,      323,      "Veh_TurnOnOffRrAutoACRespStruct",      "RespCode",      "uint32"},
{4097,      323,      "Veh_TurnOnOffRrAutoACRespStruct",      "Veh_TurnOnOffRrAutoACNRC",      "uint32"},
{4098,      324,      "Veh_TurnOnOffInsenVentStruct",      "SOAProtocolVersion",      "uint8"},
{4099,      324,      "Veh_TurnOnOffInsenVentStruct",      "SOAHeaderType",      "uint8"},
{4100,      324,      "Veh_TurnOnOffInsenVentStruct",      "SOAHeaderLength",      "uint16"},
{4101,      324,      "Veh_TurnOnOffInsenVentStruct",      "Flag",      "uint16"},
{4102,      324,      "Veh_TurnOnOffInsenVentStruct",      "HeaderCRC16",      "uint16"},
{4103,      324,      "Veh_TurnOnOffInsenVentStruct",      "UserID",      "uint32"},
{4104,      324,      "Veh_TurnOnOffInsenVentStruct",      "ReqTimeOut",      "uint32"},
{4105,      324,      "Veh_TurnOnOffInsenVentStruct",      "RequestPriority",      "uint8"},
{4106,      324,      "Veh_TurnOnOffInsenVentStruct",      "SequenceID",      "uint16"},
{4107,      324,      "Veh_TurnOnOffInsenVentStruct",      "ServiceExecuteFeedbackFlag",      "uint8"},
{4108,      324,      "Veh_TurnOnOffInsenVentStruct",      "Options",      "uint32"},
{4109,      324,      "Veh_TurnOnOffInsenVentStruct",      "Veh_TurnOnOffInsenVent",      "uint8"},
{4110,      324,      "Veh_TurnOnOffInsenVentStruct",      "Time",      "uint16"},
{4111,      324,      "Veh_TurnOnOffInsenVentStruct",      "MemoryReq",      "uint8"},
{4112,      324,      "Veh_TurnOnOffInsenVentRespStruct",      "RespCode",      "uint32"},
{4113,      324,      "Veh_TurnOnOffInsenVentRespStruct",      "Veh_TurnOnOffInsenVentNRC",      "uint32"},
{4114,      325,      "Veh_TurnOnOffDefrostStruct",      "SOAProtocolVersion",      "uint8"},
{4115,      325,      "Veh_TurnOnOffDefrostStruct",      "SOAHeaderType",      "uint8"},
{4116,      325,      "Veh_TurnOnOffDefrostStruct",      "SOAHeaderLength",      "uint16"},
{4117,      325,      "Veh_TurnOnOffDefrostStruct",      "Flag",      "uint16"},
{4118,      325,      "Veh_TurnOnOffDefrostStruct",      "HeaderCRC16",      "uint16"},
{4119,      325,      "Veh_TurnOnOffDefrostStruct",      "UserID",      "uint32"},
{4120,      325,      "Veh_TurnOnOffDefrostStruct",      "ReqTimeOut",      "uint32"},
{4121,      325,      "Veh_TurnOnOffDefrostStruct",      "RequestPriority",      "uint8"},
{4122,      325,      "Veh_TurnOnOffDefrostStruct",      "SequenceID",      "uint16"},
{4123,      325,      "Veh_TurnOnOffDefrostStruct",      "ServiceExecuteFeedbackFlag",      "uint8"},
{4124,      325,      "Veh_TurnOnOffDefrostStruct",      "Options",      "uint32"},
{4125,      325,      "Veh_TurnOnOffDefrostStruct",      "Veh_TurnOnOffDefrost",      "uint8"},
{4126,      325,      "Veh_TurnOnOffDefrostStruct",      "Time",      "uint16"},
{4127,      325,      "Veh_TurnOnOffDefrostStruct",      "MemoryReq",      "uint8"},
{4128,      325,      "Veh_TurnOnOffDefrostRespStruct",      "RespCode",      "uint32"},
{4129,      325,      "Veh_TurnOnOffDefrostRespStruct",      "Veh_TurnOnOffDefrostNRC",      "uint32"},
{4130,      326,      "Veh_TurnOnOffMaxCoolingStruct",      "SOAProtocolVersion",      "uint8"},
{4131,      326,      "Veh_TurnOnOffMaxCoolingStruct",      "SOAHeaderType",      "uint8"},
{4132,      326,      "Veh_TurnOnOffMaxCoolingStruct",      "SOAHeaderLength",      "uint16"},
{4133,      326,      "Veh_TurnOnOffMaxCoolingStruct",      "Flag",      "uint16"},
{4134,      326,      "Veh_TurnOnOffMaxCoolingStruct",      "HeaderCRC16",      "uint16"},
{4135,      326,      "Veh_TurnOnOffMaxCoolingStruct",      "UserID",      "uint32"},
{4136,      326,      "Veh_TurnOnOffMaxCoolingStruct",      "ReqTimeOut",      "uint32"},
{4137,      326,      "Veh_TurnOnOffMaxCoolingStruct",      "RequestPriority",      "uint8"},
{4138,      326,      "Veh_TurnOnOffMaxCoolingStruct",      "SequenceID",      "uint16"},
{4139,      326,      "Veh_TurnOnOffMaxCoolingStruct",      "ServiceExecuteFeedbackFlag",      "uint8"},
{4140,      326,      "Veh_TurnOnOffMaxCoolingStruct",      "Options",      "uint32"},
{4141,      326,      "Veh_TurnOnOffMaxCoolingStruct",      "Veh_TurnOnOffMaxCooling",      "uint8"},
{4142,      326,      "Veh_TurnOnOffMaxCoolingStruct",      "Time",      "uint16"},
{4143,      326,      "Veh_TurnOnOffMaxCoolingRespStruct",      "RespCode",      "uint32"},
{4144,      326,      "Veh_TurnOnOffMaxCoolingRespStruct",      "Veh_TurnOnOffMaxCoolingNRC",      "uint32"},
{4145,      327,      "Veh_TurnOnOffMaxHeatingStruct",      "SOAProtocolVersion",      "uint8"},
{4146,      327,      "Veh_TurnOnOffMaxHeatingStruct",      "SOAHeaderType",      "uint8"},
{4147,      327,      "Veh_TurnOnOffMaxHeatingStruct",      "SOAHeaderLength",      "uint16"},
{4148,      327,      "Veh_TurnOnOffMaxHeatingStruct",      "Flag",      "uint16"},
{4149,      327,      "Veh_TurnOnOffMaxHeatingStruct",      "HeaderCRC16",      "uint16"},
{4150,      327,      "Veh_TurnOnOffMaxHeatingStruct",      "UserID",      "uint32"},
{4151,      327,      "Veh_TurnOnOffMaxHeatingStruct",      "ReqTimeOut",      "uint32"},
{4152,      327,      "Veh_TurnOnOffMaxHeatingStruct",      "RequestPriority",      "uint8"},
{4153,      327,      "Veh_TurnOnOffMaxHeatingStruct",      "SequenceID",      "uint16"},
{4154,      327,      "Veh_TurnOnOffMaxHeatingStruct",      "ServiceExecuteFeedbackFlag",      "uint8"},
{4155,      327,      "Veh_TurnOnOffMaxHeatingStruct",      "Options",      "uint32"},
{4156,      327,      "Veh_TurnOnOffMaxHeatingStruct",      "Veh_TurnOnOffMaxHeating",      "uint8"},
{4157,      327,      "Veh_TurnOnOffMaxHeatingStruct",      "Time",      "uint16"},
{4158,      327,      "Veh_TurnOnOffMaxHeatingRespStruct",      "RespCode",      "uint32"},
{4159,      327,      "Veh_TurnOnOffMaxHeatingRespStruct",      "Veh_TurnOnOffMaxHeatingNRC",      "uint32"},
{4160,      328,      "Veh_TurnOnOffSterilizationStruct",      "SOAProtocolVersion",      "uint8"},
{4161,      328,      "Veh_TurnOnOffSterilizationStruct",      "SOAHeaderType",      "uint8"},
{4162,      328,      "Veh_TurnOnOffSterilizationStruct",      "SOAHeaderLength",      "uint16"},
{4163,      328,      "Veh_TurnOnOffSterilizationStruct",      "Flag",      "uint16"},
{4164,      328,      "Veh_TurnOnOffSterilizationStruct",      "HeaderCRC16",      "uint16"},
{4165,      328,      "Veh_TurnOnOffSterilizationStruct",      "UserID",      "uint32"},
{4166,      328,      "Veh_TurnOnOffSterilizationStruct",      "ReqTimeOut",      "uint32"},
{4167,      328,      "Veh_TurnOnOffSterilizationStruct",      "RequestPriority",      "uint8"},
{4168,      328,      "Veh_TurnOnOffSterilizationStruct",      "SequenceID",      "uint16"},
{4169,      328,      "Veh_TurnOnOffSterilizationStruct",      "ServiceExecuteFeedbackFlag",      "uint8"},
{4170,      328,      "Veh_TurnOnOffSterilizationStruct",      "Options",      "uint32"},
{4171,      328,      "Veh_TurnOnOffSterilizationStruct",      "Veh_TurnOnOffSterilization",      "uint8"},
{4172,      328,      "Veh_TurnOnOffSterilizationStruct",      "Time",      "uint16"},
{4173,      328,      "Veh_TurnOnOffSterilizationRespStruct",      "RespCode",      "uint32"},
{4174,      328,      "Veh_TurnOnOffSterilizationRespStruct",      "Veh_TurnOnOffSterilizationNRC",      "uint32"},
{4175,      329,      "Veh_SetACAfterBlowStruct",      "SOAProtocolVersion",      "uint8"},
{4176,      329,      "Veh_SetACAfterBlowStruct",      "SOAHeaderType",      "uint8"},
{4177,      329,      "Veh_SetACAfterBlowStruct",      "SOAHeaderLength",      "uint16"},
{4178,      329,      "Veh_SetACAfterBlowStruct",      "Flag",      "uint16"},
{4179,      329,      "Veh_SetACAfterBlowStruct",      "HeaderCRC16",      "uint16"},
{4180,      329,      "Veh_SetACAfterBlowStruct",      "UserID",      "uint32"},
{4181,      329,      "Veh_SetACAfterBlowStruct",      "ReqTimeOut",      "uint32"},
{4182,      329,      "Veh_SetACAfterBlowStruct",      "RequestPriority",      "uint8"},
{4183,      329,      "Veh_SetACAfterBlowStruct",      "SequenceID",      "uint16"},
{4184,      329,      "Veh_SetACAfterBlowStruct",      "ServiceExecuteFeedbackFlag",      "uint8"},
{4185,      329,      "Veh_SetACAfterBlowStruct",      "Options",      "uint32"},
{4186,      329,      "Veh_SetACAfterBlowStruct",      "Veh_SetACAfterBlow",      "uint8"},
{4187,      329,      "Veh_SetACAfterBlowStruct",      "Time",      "uint16"},
{4188,      329,      "Veh_SetACAfterBlowRespStruct",      "RespCode",      "uint32"},
{4189,      329,      "Veh_SetACAfterBlowRespStruct",      "Veh_SetACAfterBlowNRC",      "uint32"},
{4190,      330,      "Veh_TurnOnOffACSelfCleanStruct",      "SOAProtocolVersion",      "uint8"},
{4191,      330,      "Veh_TurnOnOffACSelfCleanStruct",      "SOAHeaderType",      "uint8"},
{4192,      330,      "Veh_TurnOnOffACSelfCleanStruct",      "SOAHeaderLength",      "uint16"},
{4193,      330,      "Veh_TurnOnOffACSelfCleanStruct",      "Flag",      "uint16"},
{4194,      330,      "Veh_TurnOnOffACSelfCleanStruct",      "HeaderCRC16",      "uint16"},
{4195,      330,      "Veh_TurnOnOffACSelfCleanStruct",      "UserID",      "uint32"},
{4196,      330,      "Veh_TurnOnOffACSelfCleanStruct",      "ReqTimeOut",      "uint32"},
{4197,      330,      "Veh_TurnOnOffACSelfCleanStruct",      "RequestPriority",      "uint8"},
{4198,      330,      "Veh_TurnOnOffACSelfCleanStruct",      "SequenceID",      "uint16"},
{4199,      330,      "Veh_TurnOnOffACSelfCleanStruct",      "ServiceExecuteFeedbackFlag",      "uint8"},
{4200,      330,      "Veh_TurnOnOffACSelfCleanStruct",      "Options",      "uint32"},
{4201,      330,      "Veh_TurnOnOffACSelfCleanStruct",      "Veh_TurnOnOffACSelfClean",      "uint8"},
{4202,      330,      "Veh_TurnOnOffACSelfCleanStruct",      "Time",      "uint16"},
{4203,      330,      "Veh_TurnOnOffACSelfCleanRespStruct",      "RespCode",      "uint32"},
{4204,      330,      "Veh_TurnOnOffACSelfCleanRespStruct",      "Veh_TurnOnOffACSelfCleanNRC",      "uint32"},
{4205,      331,      "Veh_SetDrvTempStruct",      "SOAProtocolVersion",      "uint8"},
{4206,      331,      "Veh_SetDrvTempStruct",      "SOAHeaderType",      "uint8"},
{4207,      331,      "Veh_SetDrvTempStruct",      "SOAHeaderLength",      "uint16"},
{4208,      331,      "Veh_SetDrvTempStruct",      "Flag",      "uint16"},
{4209,      331,      "Veh_SetDrvTempStruct",      "HeaderCRC16",      "uint16"},
{4210,      331,      "Veh_SetDrvTempStruct",      "UserID",      "uint32"},
{4211,      331,      "Veh_SetDrvTempStruct",      "ReqTimeOut",      "uint32"},
{4212,      331,      "Veh_SetDrvTempStruct",      "RequestPriority",      "uint8"},
{4213,      331,      "Veh_SetDrvTempStruct",      "SequenceID",      "uint16"},
{4214,      331,      "Veh_SetDrvTempStruct",      "ServiceExecuteFeedbackFlag",      "uint8"},
{4215,      331,      "Veh_SetDrvTempStruct",      "Options",      "uint32"},
{4216,      331,      "Veh_SetDrvTempStruct",      "Veh_SetDrvTemp",      "float32"},
{4217,      331,      "Veh_SetDrvTempStruct",      "Time",      "uint16"},
{4218,      331,      "Veh_SetDrvTempStruct",      "MemoryReq",      "uint8"},
{4219,      331,      "Veh_SetDrvTempRespStruct",      "RespCode",      "uint32"},
{4220,      331,      "Veh_SetDrvTempRespStruct",      "Veh_SetDrvTempNRC",      "uint32"},
{4221,      332,      "Veh_SetPsnTempStruct",      "SOAProtocolVersion",      "uint8"},
{4222,      332,      "Veh_SetPsnTempStruct",      "SOAHeaderType",      "uint8"},
{4223,      332,      "Veh_SetPsnTempStruct",      "SOAHeaderLength",      "uint16"},
{4224,      332,      "Veh_SetPsnTempStruct",      "Flag",      "uint16"},
{4225,      332,      "Veh_SetPsnTempStruct",      "HeaderCRC16",      "uint16"},
{4226,      332,      "Veh_SetPsnTempStruct",      "UserID",      "uint32"},
{4227,      332,      "Veh_SetPsnTempStruct",      "ReqTimeOut",      "uint32"},
{4228,      332,      "Veh_SetPsnTempStruct",      "RequestPriority",      "uint8"},
{4229,      332,      "Veh_SetPsnTempStruct",      "SequenceID",      "uint16"},
{4230,      332,      "Veh_SetPsnTempStruct",      "ServiceExecuteFeedbackFlag",      "uint8"},
{4231,      332,      "Veh_SetPsnTempStruct",      "Options",      "uint32"},
{4232,      332,      "Veh_SetPsnTempStruct",      "Veh_SetPsnTemp",      "float32"},
{4233,      332,      "Veh_SetPsnTempStruct",      "Time",      "uint16"},
{4234,      332,      "Veh_SetPsnTempStruct",      "MemoryReq",      "uint8"},
{4235,      332,      "Veh_SetPsnTempRespStruct",      "RespCode",      "uint32"},
{4236,      332,      "Veh_SetPsnTempRespStruct",      "Veh_SetPsnTempNRC",      "uint32"},
{4237,      333,      "Veh_SetRLTempStruct",      "SOAProtocolVersion",      "uint8"},
{4238,      333,      "Veh_SetRLTempStruct",      "SOAHeaderType",      "uint8"},
{4239,      333,      "Veh_SetRLTempStruct",      "SOAHeaderLength",      "uint16"},
{4240,      333,      "Veh_SetRLTempStruct",      "Flag",      "uint16"},
{4241,      333,      "Veh_SetRLTempStruct",      "HeaderCRC16",      "uint16"},
{4242,      333,      "Veh_SetRLTempStruct",      "UserID",      "uint32"},
{4243,      333,      "Veh_SetRLTempStruct",      "ReqTimeOut",      "uint32"},
{4244,      333,      "Veh_SetRLTempStruct",      "RequestPriority",      "uint8"},
{4245,      333,      "Veh_SetRLTempStruct",      "SequenceID",      "uint16"},
{4246,      333,      "Veh_SetRLTempStruct",      "ServiceExecuteFeedbackFlag",      "uint8"},
{4247,      333,      "Veh_SetRLTempStruct",      "Options",      "uint32"},
{4248,      333,      "Veh_SetRLTempStruct",      "Veh_SetRLTemp",      "float32"},
{4249,      333,      "Veh_SetRLTempStruct",      "Time",      "uint16"},
{4250,      333,      "Veh_SetRLTempStruct",      "MemoryReq",      "uint8"},
{4251,      333,      "Veh_SetRLTempRespStruct",      "RespCode",      "uint32"},
{4252,      333,      "Veh_SetRLTempRespStruct",      "Veh_SetRLTempNRC",      "uint32"},
{4253,      334,      "Veh_SetRRTempStruct",      "SOAProtocolVersion",      "uint8"},
{4254,      334,      "Veh_SetRRTempStruct",      "SOAHeaderType",      "uint8"},
{4255,      334,      "Veh_SetRRTempStruct",      "SOAHeaderLength",      "uint16"},
{4256,      334,      "Veh_SetRRTempStruct",      "Flag",      "uint16"},
{4257,      334,      "Veh_SetRRTempStruct",      "HeaderCRC16",      "uint16"},
{4258,      334,      "Veh_SetRRTempStruct",      "UserID",      "uint32"},
{4259,      334,      "Veh_SetRRTempStruct",      "ReqTimeOut",      "uint32"},
{4260,      334,      "Veh_SetRRTempStruct",      "RequestPriority",      "uint8"},
{4261,      334,      "Veh_SetRRTempStruct",      "SequenceID",      "uint16"},
{4262,      334,      "Veh_SetRRTempStruct",      "ServiceExecuteFeedbackFlag",      "uint8"},
{4263,      334,      "Veh_SetRRTempStruct",      "Options",      "uint32"},
{4264,      334,      "Veh_SetRRTempStruct",      "Veh_SetRRTemp",      "float32"},
{4265,      334,      "Veh_SetRRTempStruct",      "Time",      "uint16"},
{4266,      334,      "Veh_SetRRTempStruct",      "MemoryReq",      "uint8"},
{4267,      334,      "Veh_SetRRTempRespStruct",      "RespCode",      "uint32"},
{4268,      334,      "Veh_SetRRTempRespStruct",      "Veh_SetRRTempNRC",      "uint32"},
{4269,      335,      "Veh_Set3rdRowTempStruct",      "SOAProtocolVersion",      "uint8"},
{4270,      335,      "Veh_Set3rdRowTempStruct",      "SOAHeaderType",      "uint8"},
{4271,      335,      "Veh_Set3rdRowTempStruct",      "SOAHeaderLength",      "uint16"},
{4272,      335,      "Veh_Set3rdRowTempStruct",      "Flag",      "uint16"},
{4273,      335,      "Veh_Set3rdRowTempStruct",      "HeaderCRC16",      "uint16"},
{4274,      335,      "Veh_Set3rdRowTempStruct",      "UserID",      "uint32"},
{4275,      335,      "Veh_Set3rdRowTempStruct",      "ReqTimeOut",      "uint32"},
{4276,      335,      "Veh_Set3rdRowTempStruct",      "RequestPriority",      "uint8"},
{4277,      335,      "Veh_Set3rdRowTempStruct",      "SequenceID",      "uint16"},
{4278,      335,      "Veh_Set3rdRowTempStruct",      "ServiceExecuteFeedbackFlag",      "uint8"},
{4279,      335,      "Veh_Set3rdRowTempStruct",      "Options",      "uint32"},
{4280,      335,      "Veh_Set3rdRowTempStruct",      "Veh_Set3rdRowTemp",      "float32"},
{4281,      335,      "Veh_Set3rdRowTempStruct",      "Time",      "uint16"},
{4282,      335,      "Veh_Set3rdRowTempStruct",      "MemoryReq",      "uint8"},
{4283,      335,      "Veh_Set3rdRowTempRespStruct",      "RespCode",      "uint32"},
{4284,      335,      "Veh_Set3rdRowTempRespStruct",      "Veh_Set3rdRowTempNRC",      "uint32"},
{4285,      336,      "Veh_SetSyncStruct",      "SOAProtocolVersion",      "uint8"},
{4286,      336,      "Veh_SetSyncStruct",      "SOAHeaderType",      "uint8"},
{4287,      336,      "Veh_SetSyncStruct",      "SOAHeaderLength",      "uint16"},
{4288,      336,      "Veh_SetSyncStruct",      "Flag",      "uint16"},
{4289,      336,      "Veh_SetSyncStruct",      "HeaderCRC16",      "uint16"},
{4290,      336,      "Veh_SetSyncStruct",      "UserID",      "uint32"},
{4291,      336,      "Veh_SetSyncStruct",      "ReqTimeOut",      "uint32"},
{4292,      336,      "Veh_SetSyncStruct",      "RequestPriority",      "uint8"},
{4293,      336,      "Veh_SetSyncStruct",      "SequenceID",      "uint16"},
{4294,      336,      "Veh_SetSyncStruct",      "ServiceExecuteFeedbackFlag",      "uint8"},
{4295,      336,      "Veh_SetSyncStruct",      "Options",      "uint32"},
{4296,      336,      "Veh_SetSyncStruct",      "Veh_SetSync",      "uint8"},
{4297,      336,      "Veh_SetSyncStruct",      "Time",      "uint16"},
{4298,      336,      "Veh_SetSyncStruct",      "MemoryReq",      "uint8"},
{4299,      336,      "Veh_SetSyncRespStruct",      "RespCode",      "uint32"},
{4300,      336,      "Veh_SetSyncRespStruct",      "Veh_SetSyncNRC",      "uint32"},
{4301,      337,      "Veh_CtrlFrWindSpdStruct",      "SOAProtocolVersion",      "uint8"},
{4302,      337,      "Veh_CtrlFrWindSpdStruct",      "SOAHeaderType",      "uint8"},
{4303,      337,      "Veh_CtrlFrWindSpdStruct",      "SOAHeaderLength",      "uint16"},
{4304,      337,      "Veh_CtrlFrWindSpdStruct",      "Flag",      "uint16"},
{4305,      337,      "Veh_CtrlFrWindSpdStruct",      "HeaderCRC16",      "uint16"},
{4306,      337,      "Veh_CtrlFrWindSpdStruct",      "UserID",      "uint32"},
{4307,      337,      "Veh_CtrlFrWindSpdStruct",      "ReqTimeOut",      "uint32"},
{4308,      337,      "Veh_CtrlFrWindSpdStruct",      "RequestPriority",      "uint8"},
{4309,      337,      "Veh_CtrlFrWindSpdStruct",      "SequenceID",      "uint16"},
{4310,      337,      "Veh_CtrlFrWindSpdStruct",      "ServiceExecuteFeedbackFlag",      "uint8"},
{4311,      337,      "Veh_CtrlFrWindSpdStruct",      "Options",      "uint32"},
{4312,      337,      "Veh_CtrlFrWindSpdStruct",      "Veh_CtrlFrWindSpd",      "uint8"},
{4313,      337,      "Veh_CtrlFrWindSpdStruct",      "Time",      "uint16"},
{4314,      337,      "Veh_CtrlFrWindSpdStruct",      "MemoryReq",      "uint8"},
{4315,      337,      "Veh_CtrlFrWindSpdRespStruct",      "RespCode",      "uint32"},
{4316,      337,      "Veh_CtrlFrWindSpdRespStruct",      "Veh_CtrlFrWindSpdNRC",      "uint32"},
{4317,      338,      "Veh_CtrlRrWindSpdStruct",      "SOAProtocolVersion",      "uint8"},
{4318,      338,      "Veh_CtrlRrWindSpdStruct",      "SOAHeaderType",      "uint8"},
{4319,      338,      "Veh_CtrlRrWindSpdStruct",      "SOAHeaderLength",      "uint16"},
{4320,      338,      "Veh_CtrlRrWindSpdStruct",      "Flag",      "uint16"},
{4321,      338,      "Veh_CtrlRrWindSpdStruct",      "HeaderCRC16",      "uint16"},
{4322,      338,      "Veh_CtrlRrWindSpdStruct",      "UserID",      "uint32"},
{4323,      338,      "Veh_CtrlRrWindSpdStruct",      "ReqTimeOut",      "uint32"},
{4324,      338,      "Veh_CtrlRrWindSpdStruct",      "RequestPriority",      "uint8"},
{4325,      338,      "Veh_CtrlRrWindSpdStruct",      "SequenceID",      "uint16"},
{4326,      338,      "Veh_CtrlRrWindSpdStruct",      "ServiceExecuteFeedbackFlag",      "uint8"},
{4327,      338,      "Veh_CtrlRrWindSpdStruct",      "Options",      "uint32"},
{4328,      338,      "Veh_CtrlRrWindSpdStruct",      "Veh_CtrlRrWindSpd",      "uint8"},
{4329,      338,      "Veh_CtrlRrWindSpdStruct",      "Time",      "uint16"},
{4330,      338,      "Veh_CtrlRrWindSpdStruct",      "MemoryReq",      "uint8"},
{4331,      338,      "Veh_CtrlRrWindSpdRespStruct",      "RespCode",      "uint32"},
{4332,      338,      "Veh_CtrlRrWindSpdRespStruct",      "Veh_CtrlRrWindSpdNRC",      "uint32"},
{4333,      339,      "Veh_SetAirIntakeStruct",      "SOAProtocolVersion",      "uint8"},
{4334,      339,      "Veh_SetAirIntakeStruct",      "SOAHeaderType",      "uint8"},
{4335,      339,      "Veh_SetAirIntakeStruct",      "SOAHeaderLength",      "uint16"},
{4336,      339,      "Veh_SetAirIntakeStruct",      "Flag",      "uint16"},
{4337,      339,      "Veh_SetAirIntakeStruct",      "HeaderCRC16",      "uint16"},
{4338,      339,      "Veh_SetAirIntakeStruct",      "UserID",      "uint32"},
{4339,      339,      "Veh_SetAirIntakeStruct",      "ReqTimeOut",      "uint32"},
{4340,      339,      "Veh_SetAirIntakeStruct",      "RequestPriority",      "uint8"},
{4341,      339,      "Veh_SetAirIntakeStruct",      "SequenceID",      "uint16"},
{4342,      339,      "Veh_SetAirIntakeStruct",      "ServiceExecuteFeedbackFlag",      "uint8"},
{4343,      339,      "Veh_SetAirIntakeStruct",      "Options",      "uint32"},
{4344,      339,      "Veh_SetAirIntakeStruct",      "Veh_SetAirIntake",      "uint8"},
{4345,      339,      "Veh_SetAirIntakeStruct",      "MemoryReq",      "uint8"},
{4346,      339,      "Veh_SetAirIntakeRespStruct",      "RespCode",      "uint32"},
{4347,      339,      "Veh_SetAirIntakeRespStruct",      "Veh_SetAirIntakeNRC",      "uint32"},
{4348,      340,      "Veh_SetFrAirDisModeStruct",      "SOAProtocolVersion",      "uint8"},
{4349,      340,      "Veh_SetFrAirDisModeStruct",      "SOAHeaderType",      "uint8"},
{4350,      340,      "Veh_SetFrAirDisModeStruct",      "SOAHeaderLength",      "uint16"},
{4351,      340,      "Veh_SetFrAirDisModeStruct",      "Flag",      "uint16"},
{4352,      340,      "Veh_SetFrAirDisModeStruct",      "HeaderCRC16",      "uint16"},
{4353,      340,      "Veh_SetFrAirDisModeStruct",      "UserID",      "uint32"},
{4354,      340,      "Veh_SetFrAirDisModeStruct",      "ReqTimeOut",      "uint32"},
{4355,      340,      "Veh_SetFrAirDisModeStruct",      "RequestPriority",      "uint8"},
{4356,      340,      "Veh_SetFrAirDisModeStruct",      "SequenceID",      "uint16"},
{4357,      340,      "Veh_SetFrAirDisModeStruct",      "ServiceExecuteFeedbackFlag",      "uint8"},
{4358,      340,      "Veh_SetFrAirDisModeStruct",      "Options",      "uint32"},
{4359,      340,      "Veh_SetFrAirDisModeStruct",      "Veh_SetFrAirDisMode",      "uint8"},
{4360,      340,      "Veh_SetFrAirDisModeStruct",      "MemoryReq",      "uint8"},
{4361,      340,      "Veh_SetFrAirDisModeRespStruct",      "RespCode",      "uint32"},
{4362,      340,      "Veh_SetFrAirDisModeRespStruct",      "Veh_SetFrAirDisModeNRC",      "uint32"},
{4363,      341,      "Veh_SetRrAirDisModeStruct",      "SOAProtocolVersion",      "uint8"},
{4364,      341,      "Veh_SetRrAirDisModeStruct",      "SOAHeaderType",      "uint8"},
{4365,      341,      "Veh_SetRrAirDisModeStruct",      "SOAHeaderLength",      "uint16"},
{4366,      341,      "Veh_SetRrAirDisModeStruct",      "Flag",      "uint16"},
{4367,      341,      "Veh_SetRrAirDisModeStruct",      "HeaderCRC16",      "uint16"},
{4368,      341,      "Veh_SetRrAirDisModeStruct",      "UserID",      "uint32"},
{4369,      341,      "Veh_SetRrAirDisModeStruct",      "ReqTimeOut",      "uint32"},
{4370,      341,      "Veh_SetRrAirDisModeStruct",      "RequestPriority",      "uint8"},
{4371,      341,      "Veh_SetRrAirDisModeStruct",      "SequenceID",      "uint16"},
{4372,      341,      "Veh_SetRrAirDisModeStruct",      "ServiceExecuteFeedbackFlag",      "uint8"},
{4373,      341,      "Veh_SetRrAirDisModeStruct",      "Options",      "uint32"},
{4374,      341,      "Veh_SetRrAirDisModeStruct",      "Veh_SetRrAirDisMode",      "uint8"},
{4375,      341,      "Veh_SetRrAirDisModeStruct",      "MemoryReq",      "uint8"},
{4376,      341,      "Veh_SetRrAirDisModeRespStruct",      "RespCode",      "uint32"},
{4377,      341,      "Veh_SetRrAirDisModeRespStruct",      "Veh_SetRrAirDisModeNRC",      "uint32"},
{4378,      342,      "Veh_Set3rdRowAirDisModeStruct",      "SOAProtocolVersion",      "uint8"},
{4379,      342,      "Veh_Set3rdRowAirDisModeStruct",      "SOAHeaderType",      "uint8"},
{4380,      342,      "Veh_Set3rdRowAirDisModeStruct",      "SOAHeaderLength",      "uint16"},
{4381,      342,      "Veh_Set3rdRowAirDisModeStruct",      "Flag",      "uint16"},
{4382,      342,      "Veh_Set3rdRowAirDisModeStruct",      "HeaderCRC16",      "uint16"},
{4383,      342,      "Veh_Set3rdRowAirDisModeStruct",      "UserID",      "uint32"},
{4384,      342,      "Veh_Set3rdRowAirDisModeStruct",      "ReqTimeOut",      "uint32"},
{4385,      342,      "Veh_Set3rdRowAirDisModeStruct",      "RequestPriority",      "uint8"},
{4386,      342,      "Veh_Set3rdRowAirDisModeStruct",      "SequenceID",      "uint16"},
{4387,      342,      "Veh_Set3rdRowAirDisModeStruct",      "ServiceExecuteFeedbackFlag",      "uint8"},
{4388,      342,      "Veh_Set3rdRowAirDisModeStruct",      "Options",      "uint32"},
{4389,      342,      "Veh_Set3rdRowAirDisModeStruct",      "Veh_Set3rdRowAirDisMode",      "uint8"},
{4390,      342,      "Veh_Set3rdRowAirDisModeStruct",      "MemoryReq",      "uint8"},
{4391,      342,      "Veh_Set3rdRowAirDisModeRespStruct",      "RespCode",      "uint32"},
{4392,      342,      "Veh_Set3rdRowAirDisModeRespStruct",      "Veh_Set3rdRowAirDisModeNRC",      "uint32"},
{4393,      343,      "Veh_SetOnOffECOModeStruct",      "SOAProtocolVersion",      "uint8"},
{4394,      343,      "Veh_SetOnOffECOModeStruct",      "SOAHeaderType",      "uint8"},
{4395,      343,      "Veh_SetOnOffECOModeStruct",      "SOAHeaderLength",      "uint16"},
{4396,      343,      "Veh_SetOnOffECOModeStruct",      "Flag",      "uint16"},
{4397,      343,      "Veh_SetOnOffECOModeStruct",      "HeaderCRC16",      "uint16"},
{4398,      343,      "Veh_SetOnOffECOModeStruct",      "UserID",      "uint32"},
{4399,      343,      "Veh_SetOnOffECOModeStruct",      "ReqTimeOut",      "uint32"},
{4400,      343,      "Veh_SetOnOffECOModeStruct",      "RequestPriority",      "uint8"},
{4401,      343,      "Veh_SetOnOffECOModeStruct",      "SequenceID",      "uint16"},
{4402,      343,      "Veh_SetOnOffECOModeStruct",      "ServiceExecuteFeedbackFlag",      "uint8"},
{4403,      343,      "Veh_SetOnOffECOModeStruct",      "Options",      "uint32"},
{4404,      343,      "Veh_SetOnOffECOModeStruct",      "Veh_SetOnOffECOMode",      "uint8"},
{4405,      343,      "Veh_SetOnOffECOModeStruct",      "MemoryReq",      "uint8"},
{4406,      343,      "Veh_SetOnOffECOModeRespStruct",      "RespCode",      "uint32"},
{4407,      343,      "Veh_SetOnOffECOModeRespStruct",      "Veh_SetOnOffECOModeNRC",      "uint32"},
{4408,      344,      "Veh_SetOnOffDeodorizeStruct",      "SOAProtocolVersion",      "uint8"},
{4409,      344,      "Veh_SetOnOffDeodorizeStruct",      "SOAHeaderType",      "uint8"},
{4410,      344,      "Veh_SetOnOffDeodorizeStruct",      "SOAHeaderLength",      "uint16"},
{4411,      344,      "Veh_SetOnOffDeodorizeStruct",      "Flag",      "uint16"},
{4412,      344,      "Veh_SetOnOffDeodorizeStruct",      "HeaderCRC16",      "uint16"},
{4413,      344,      "Veh_SetOnOffDeodorizeStruct",      "UserID",      "uint32"},
{4414,      344,      "Veh_SetOnOffDeodorizeStruct",      "ReqTimeOut",      "uint32"},
{4415,      344,      "Veh_SetOnOffDeodorizeStruct",      "RequestPriority",      "uint8"},
{4416,      344,      "Veh_SetOnOffDeodorizeStruct",      "SequenceID",      "uint16"},
{4417,      344,      "Veh_SetOnOffDeodorizeStruct",      "ServiceExecuteFeedbackFlag",      "uint8"},
{4418,      344,      "Veh_SetOnOffDeodorizeStruct",      "Options",      "uint32"},
{4419,      344,      "Veh_SetOnOffDeodorizeStruct",      "Veh_SetOnOffDeodorize",      "uint8"},
{4420,      344,      "Veh_SetOnOffDeodorizeStruct",      "Time",      "uint16"},
{4421,      344,      "Veh_SetOnOffDeodorizeStruct",      "MemoryReq",      "uint8"},
{4422,      344,      "Veh_SetOnOffDeodorizeRespStruct",      "RespCode",      "uint32"},
{4423,      344,      "Veh_SetOnOffDeodorizeRespStruct",      "Veh_SetOnOffDeodorizeNRC",      "uint32"},
{4424,      345,      "Veh_SetEAVDrvWindModeStruct",      "SOAProtocolVersion",      "uint8"},
{4425,      345,      "Veh_SetEAVDrvWindModeStruct",      "SOAHeaderType",      "uint8"},
{4426,      345,      "Veh_SetEAVDrvWindModeStruct",      "SOAHeaderLength",      "uint16"},
{4427,      345,      "Veh_SetEAVDrvWindModeStruct",      "Flag",      "uint16"},
{4428,      345,      "Veh_SetEAVDrvWindModeStruct",      "HeaderCRC16",      "uint16"},
{4429,      345,      "Veh_SetEAVDrvWindModeStruct",      "UserID",      "uint32"},
{4430,      345,      "Veh_SetEAVDrvWindModeStruct",      "ReqTimeOut",      "uint32"},
{4431,      345,      "Veh_SetEAVDrvWindModeStruct",      "RequestPriority",      "uint8"},
{4432,      345,      "Veh_SetEAVDrvWindModeStruct",      "SequenceID",      "uint16"},
{4433,      345,      "Veh_SetEAVDrvWindModeStruct",      "ServiceExecuteFeedbackFlag",      "uint8"},
{4434,      345,      "Veh_SetEAVDrvWindModeStruct",      "Options",      "uint32"},
{4435,      345,      "Veh_SetEAVDrvWindModeStruct",      "Veh_SetEAVDrvWindMode",      "uint8"},
{4436,      345,      "Veh_SetEAVDrvWindModeStruct",      "MemoryReq",      "uint8"},
{4437,      345,      "Veh_SetEAVDrvWindModeRespStruct",      "RespCode",      "uint32"},
{4438,      345,      "Veh_SetEAVDrvWindModeRespStruct",      "Veh_SetEAVDrvWindModeNRC",      "uint32"},
{4439,      346,      "Veh_SetEAVPsnWindModeStruct",      "SOAProtocolVersion",      "uint8"},
{4440,      346,      "Veh_SetEAVPsnWindModeStruct",      "SOAHeaderType",      "uint8"},
{4441,      346,      "Veh_SetEAVPsnWindModeStruct",      "SOAHeaderLength",      "uint16"},
{4442,      346,      "Veh_SetEAVPsnWindModeStruct",      "Flag",      "uint16"},
{4443,      346,      "Veh_SetEAVPsnWindModeStruct",      "HeaderCRC16",      "uint16"},
{4444,      346,      "Veh_SetEAVPsnWindModeStruct",      "UserID",      "uint32"},
{4445,      346,      "Veh_SetEAVPsnWindModeStruct",      "ReqTimeOut",      "uint32"},
{4446,      346,      "Veh_SetEAVPsnWindModeStruct",      "RequestPriority",      "uint8"},
{4447,      346,      "Veh_SetEAVPsnWindModeStruct",      "SequenceID",      "uint16"},
{4448,      346,      "Veh_SetEAVPsnWindModeStruct",      "ServiceExecuteFeedbackFlag",      "uint8"},
{4449,      346,      "Veh_SetEAVPsnWindModeStruct",      "Options",      "uint32"},
{4450,      346,      "Veh_SetEAVPsnWindModeStruct",      "Veh_SetEAVPsnWindMode",      "uint8"},
{4451,      346,      "Veh_SetEAVPsnWindModeStruct",      "MemoryReq",      "uint8"},
{4452,      346,      "Veh_SetEAVPsnWindModeRespStruct",      "RespCode",      "uint32"},
{4453,      346,      "Veh_SetEAVPsnWindModeRespStruct",      "Veh_SetEAVPsnWindModeNRC",      "uint32"},
{4454,      347,      "Veh_SetEAVSweepWindStruct",      "SOAProtocolVersion",      "uint8"},
{4455,      347,      "Veh_SetEAVSweepWindStruct",      "SOAHeaderType",      "uint8"},
{4456,      347,      "Veh_SetEAVSweepWindStruct",      "SOAHeaderLength",      "uint16"},
{4457,      347,      "Veh_SetEAVSweepWindStruct",      "Flag",      "uint16"},
{4458,      347,      "Veh_SetEAVSweepWindStruct",      "HeaderCRC16",      "uint16"},
{4459,      347,      "Veh_SetEAVSweepWindStruct",      "UserID",      "uint32"},
{4460,      347,      "Veh_SetEAVSweepWindStruct",      "ReqTimeOut",      "uint32"},
{4461,      347,      "Veh_SetEAVSweepWindStruct",      "RequestPriority",      "uint8"},
{4462,      347,      "Veh_SetEAVSweepWindStruct",      "SequenceID",      "uint16"},
{4463,      347,      "Veh_SetEAVSweepWindStruct",      "ServiceExecuteFeedbackFlag",      "uint8"},
{4464,      347,      "Veh_SetEAVSweepWindStruct",      "Options",      "uint32"},
{4465,      347,      "Veh_SetEAVSweepWindStruct",      "Veh_SetEAVSweepWind",      "uint8"},
{4466,      347,      "Veh_SetEAVSweepWindStruct",      "MemoryReq",      "uint8"},
{4467,      347,      "Veh_SetEAVSweepWindRespStruct",      "RespCode",      "uint32"},
{4468,      347,      "Veh_SetEAVSweepWindRespStruct",      "Veh_SetEAVSweepWindNRC",      "uint32"},
{4469,      348,      "Veh_SetEAVDrvLeftHorzPosStruct",      "SOAProtocolVersion",      "uint8"},
{4470,      348,      "Veh_SetEAVDrvLeftHorzPosStruct",      "SOAHeaderType",      "uint8"},
{4471,      348,      "Veh_SetEAVDrvLeftHorzPosStruct",      "SOAHeaderLength",      "uint16"},
{4472,      348,      "Veh_SetEAVDrvLeftHorzPosStruct",      "Flag",      "uint16"},
{4473,      348,      "Veh_SetEAVDrvLeftHorzPosStruct",      "HeaderCRC16",      "uint16"},
{4474,      348,      "Veh_SetEAVDrvLeftHorzPosStruct",      "UserID",      "uint32"},
{4475,      348,      "Veh_SetEAVDrvLeftHorzPosStruct",      "ReqTimeOut",      "uint32"},
{4476,      348,      "Veh_SetEAVDrvLeftHorzPosStruct",      "RequestPriority",      "uint8"},
{4477,      348,      "Veh_SetEAVDrvLeftHorzPosStruct",      "SequenceID",      "uint16"},
{4478,      348,      "Veh_SetEAVDrvLeftHorzPosStruct",      "ServiceExecuteFeedbackFlag",      "uint8"},
{4479,      348,      "Veh_SetEAVDrvLeftHorzPosStruct",      "Options",      "uint32"},
{4480,      348,      "Veh_SetEAVDrvLeftHorzPosStruct",      "Veh_SetEAVDrvLeftHorzPos",      "uint8"},
{4481,      348,      "Veh_SetEAVDrvLeftHorzPosStruct",      "MemoryReq",      "uint8"},
{4482,      348,      "Veh_SetEAVDrvLeftHorzPosRespStruct",      "RespCode",      "uint32"},
{4483,      348,      "Veh_SetEAVDrvLeftHorzPosRespStruct",      "Veh_SetEAVDrvLeftHorzPosNRC",      "uint32"},
{4484,      349,      "Veh_SetEAVDrvLeftVertPosStruct",      "SOAProtocolVersion",      "uint8"},
{4485,      349,      "Veh_SetEAVDrvLeftVertPosStruct",      "SOAHeaderType",      "uint8"},
{4486,      349,      "Veh_SetEAVDrvLeftVertPosStruct",      "SOAHeaderLength",      "uint16"},
{4487,      349,      "Veh_SetEAVDrvLeftVertPosStruct",      "Flag",      "uint16"},
{4488,      349,      "Veh_SetEAVDrvLeftVertPosStruct",      "HeaderCRC16",      "uint16"},
{4489,      349,      "Veh_SetEAVDrvLeftVertPosStruct",      "UserID",      "uint32"},
{4490,      349,      "Veh_SetEAVDrvLeftVertPosStruct",      "ReqTimeOut",      "uint32"},
{4491,      349,      "Veh_SetEAVDrvLeftVertPosStruct",      "RequestPriority",      "uint8"},
{4492,      349,      "Veh_SetEAVDrvLeftVertPosStruct",      "SequenceID",      "uint16"},
{4493,      349,      "Veh_SetEAVDrvLeftVertPosStruct",      "ServiceExecuteFeedbackFlag",      "uint8"},
{4494,      349,      "Veh_SetEAVDrvLeftVertPosStruct",      "Options",      "uint32"},
{4495,      349,      "Veh_SetEAVDrvLeftVertPosStruct",      "Veh_SetEAVDrvLeftVertPos",      "uint8"},
{4496,      349,      "Veh_SetEAVDrvLeftVertPosStruct",      "MemoryReq",      "uint8"},
{4497,      349,      "Veh_SetEAVDrvLeftVertPosRespStruct",      "RespCode",      "uint32"},
{4498,      349,      "Veh_SetEAVDrvLeftVertPosRespStruct",      "Veh_SetEAVDrvLeftVertPosNRC",      "uint32"},
{4499,      350,      "Veh_SetEAVDrvRightVertPosStruct",      "SOAProtocolVersion",      "uint8"},
{4500,      350,      "Veh_SetEAVDrvRightVertPosStruct",      "SOAHeaderType",      "uint8"},
{4501,      350,      "Veh_SetEAVDrvRightVertPosStruct",      "SOAHeaderLength",      "uint16"},
{4502,      350,      "Veh_SetEAVDrvRightVertPosStruct",      "Flag",      "uint16"},
{4503,      350,      "Veh_SetEAVDrvRightVertPosStruct",      "HeaderCRC16",      "uint16"},
{4504,      350,      "Veh_SetEAVDrvRightVertPosStruct",      "UserID",      "uint32"},
{4505,      350,      "Veh_SetEAVDrvRightVertPosStruct",      "ReqTimeOut",      "uint32"},
{4506,      350,      "Veh_SetEAVDrvRightVertPosStruct",      "RequestPriority",      "uint8"},
{4507,      350,      "Veh_SetEAVDrvRightVertPosStruct",      "SequenceID",      "uint16"},
{4508,      350,      "Veh_SetEAVDrvRightVertPosStruct",      "ServiceExecuteFeedbackFlag",      "uint8"},
{4509,      350,      "Veh_SetEAVDrvRightVertPosStruct",      "Options",      "uint32"},
{4510,      350,      "Veh_SetEAVDrvRightVertPosStruct",      "Veh_SetEAVDrvRightVertPos",      "uint8"},
{4511,      350,      "Veh_SetEAVDrvRightVertPosStruct",      "MemoryReq",      "uint8"},
{4512,      350,      "Veh_SetEAVDrvRightVertPosRespStruct",      "RespCode",      "uint32"},
{4513,      350,      "Veh_SetEAVDrvRightVertPosRespStruct",      "Veh_SetEAVDrvRightVertPosNRC",      "uint32"},
{4514,      351,      "Veh_SetEAVDrvRightHorzPosStruct",      "SOAProtocolVersion",      "uint8"},
{4515,      351,      "Veh_SetEAVDrvRightHorzPosStruct",      "SOAHeaderType",      "uint8"},
{4516,      351,      "Veh_SetEAVDrvRightHorzPosStruct",      "SOAHeaderLength",      "uint16"},
{4517,      351,      "Veh_SetEAVDrvRightHorzPosStruct",      "Flag",      "uint16"},
{4518,      351,      "Veh_SetEAVDrvRightHorzPosStruct",      "HeaderCRC16",      "uint16"},
{4519,      351,      "Veh_SetEAVDrvRightHorzPosStruct",      "UserID",      "uint32"},
{4520,      351,      "Veh_SetEAVDrvRightHorzPosStruct",      "ReqTimeOut",      "uint32"},
{4521,      351,      "Veh_SetEAVDrvRightHorzPosStruct",      "RequestPriority",      "uint8"},
{4522,      351,      "Veh_SetEAVDrvRightHorzPosStruct",      "SequenceID",      "uint16"},
{4523,      351,      "Veh_SetEAVDrvRightHorzPosStruct",      "ServiceExecuteFeedbackFlag",      "uint8"},
{4524,      351,      "Veh_SetEAVDrvRightHorzPosStruct",      "Options",      "uint32"},
{4525,      351,      "Veh_SetEAVDrvRightHorzPosStruct",      "Veh_SetEAVDrvRightHorzPos",      "uint8"},
{4526,      351,      "Veh_SetEAVDrvRightHorzPosStruct",      "MemoryReq",      "uint8"},
{4527,      351,      "Veh_SetEAVDrvRightHorzPosRespStruct",      "RespCode",      "uint32"},
{4528,      351,      "Veh_SetEAVDrvRightHorzPosRespStruct",      "Veh_SetEAVDrvRightHorzPosNRC",      "uint32"},
{4529,      352,      "Veh_SetEAVPsnLeftHorzPosStruct",      "SOAProtocolVersion",      "uint8"},
{4530,      352,      "Veh_SetEAVPsnLeftHorzPosStruct",      "SOAHeaderType",      "uint8"},
{4531,      352,      "Veh_SetEAVPsnLeftHorzPosStruct",      "SOAHeaderLength",      "uint16"},
{4532,      352,      "Veh_SetEAVPsnLeftHorzPosStruct",      "Flag",      "uint16"},
{4533,      352,      "Veh_SetEAVPsnLeftHorzPosStruct",      "HeaderCRC16",      "uint16"},
{4534,      352,      "Veh_SetEAVPsnLeftHorzPosStruct",      "UserID",      "uint32"},
{4535,      352,      "Veh_SetEAVPsnLeftHorzPosStruct",      "ReqTimeOut",      "uint32"},
{4536,      352,      "Veh_SetEAVPsnLeftHorzPosStruct",      "RequestPriority",      "uint8"},
{4537,      352,      "Veh_SetEAVPsnLeftHorzPosStruct",      "SequenceID",      "uint16"},
{4538,      352,      "Veh_SetEAVPsnLeftHorzPosStruct",      "ServiceExecuteFeedbackFlag",      "uint8"},
{4539,      352,      "Veh_SetEAVPsnLeftHorzPosStruct",      "Options",      "uint32"},
{4540,      352,      "Veh_SetEAVPsnLeftHorzPosStruct",      "Veh_SetEAVPsnLeftHorzPos",      "uint8"},
{4541,      352,      "Veh_SetEAVPsnLeftHorzPosStruct",      "MemoryReq",      "uint8"},
{4542,      352,      "Veh_SetEAVPsnLeftHorzPosRespStruct",      "RespCode",      "uint32"},
{4543,      352,      "Veh_SetEAVPsnLeftHorzPosRespStruct",      "Veh_SetEAVPsnLeftHorzPosNRC",      "uint32"},
{4544,      353,      "Veh_SetEAVPsnLeftVertPosStruct",      "SOAProtocolVersion",      "uint8"},
{4545,      353,      "Veh_SetEAVPsnLeftVertPosStruct",      "SOAHeaderType",      "uint8"},
{4546,      353,      "Veh_SetEAVPsnLeftVertPosStruct",      "SOAHeaderLength",      "uint16"},
{4547,      353,      "Veh_SetEAVPsnLeftVertPosStruct",      "Flag",      "uint16"},
{4548,      353,      "Veh_SetEAVPsnLeftVertPosStruct",      "HeaderCRC16",      "uint16"},
{4549,      353,      "Veh_SetEAVPsnLeftVertPosStruct",      "UserID",      "uint32"},
{4550,      353,      "Veh_SetEAVPsnLeftVertPosStruct",      "ReqTimeOut",      "uint32"},
{4551,      353,      "Veh_SetEAVPsnLeftVertPosStruct",      "RequestPriority",      "uint8"},
{4552,      353,      "Veh_SetEAVPsnLeftVertPosStruct",      "SequenceID",      "uint16"},
{4553,      353,      "Veh_SetEAVPsnLeftVertPosStruct",      "ServiceExecuteFeedbackFlag",      "uint8"},
{4554,      353,      "Veh_SetEAVPsnLeftVertPosStruct",      "Options",      "uint32"},
{4555,      353,      "Veh_SetEAVPsnLeftVertPosStruct",      "Veh_SetEAVPsnLeftVertPos",      "uint8"},
{4556,      353,      "Veh_SetEAVPsnLeftVertPosStruct",      "MemoryReq",      "uint8"},
{4557,      353,      "Veh_SetEAVPsnLeftVertPosRespStruct",      "RespCode",      "uint32"},
{4558,      353,      "Veh_SetEAVPsnLeftVertPosRespStruct",      "Veh_SetEAVPsnLeftVertPosNRC",      "uint32"},
{4559,      354,      "Veh_SetEAVPsnRightVertPosStruct",      "SOAProtocolVersion",      "uint8"},
{4560,      354,      "Veh_SetEAVPsnRightVertPosStruct",      "SOAHeaderType",      "uint8"},
{4561,      354,      "Veh_SetEAVPsnRightVertPosStruct",      "SOAHeaderLength",      "uint16"},
{4562,      354,      "Veh_SetEAVPsnRightVertPosStruct",      "Flag",      "uint16"},
{4563,      354,      "Veh_SetEAVPsnRightVertPosStruct",      "HeaderCRC16",      "uint16"},
{4564,      354,      "Veh_SetEAVPsnRightVertPosStruct",      "UserID",      "uint32"},
{4565,      354,      "Veh_SetEAVPsnRightVertPosStruct",      "ReqTimeOut",      "uint32"},
{4566,      354,      "Veh_SetEAVPsnRightVertPosStruct",      "RequestPriority",      "uint8"},
{4567,      354,      "Veh_SetEAVPsnRightVertPosStruct",      "SequenceID",      "uint16"},
{4568,      354,      "Veh_SetEAVPsnRightVertPosStruct",      "ServiceExecuteFeedbackFlag",      "uint8"},
{4569,      354,      "Veh_SetEAVPsnRightVertPosStruct",      "Options",      "uint32"},
{4570,      354,      "Veh_SetEAVPsnRightVertPosStruct",      "Veh_SetEAVPsnRightVertPos",      "uint8"},
{4571,      354,      "Veh_SetEAVPsnRightVertPosStruct",      "MemoryReq",      "uint8"},
{4572,      354,      "Veh_SetEAVPsnRightVertPosRespStruct",      "RespCode",      "uint32"},
{4573,      354,      "Veh_SetEAVPsnRightVertPosRespStruct",      "Veh_SetEAVPsnRightVertPosNRC",      "uint32"},
{4574,      355,      "Veh_SetEAVPsnRightHorzPosStruct",      "SOAProtocolVersion",      "uint8"},
{4575,      355,      "Veh_SetEAVPsnRightHorzPosStruct",      "SOAHeaderType",      "uint8"},
{4576,      355,      "Veh_SetEAVPsnRightHorzPosStruct",      "SOAHeaderLength",      "uint16"},
{4577,      355,      "Veh_SetEAVPsnRightHorzPosStruct",      "Flag",      "uint16"},
{4578,      355,      "Veh_SetEAVPsnRightHorzPosStruct",      "HeaderCRC16",      "uint16"},
{4579,      355,      "Veh_SetEAVPsnRightHorzPosStruct",      "UserID",      "uint32"},
{4580,      355,      "Veh_SetEAVPsnRightHorzPosStruct",      "ReqTimeOut",      "uint32"},
{4581,      355,      "Veh_SetEAVPsnRightHorzPosStruct",      "RequestPriority",      "uint8"},
{4582,      355,      "Veh_SetEAVPsnRightHorzPosStruct",      "SequenceID",      "uint16"},
{4583,      355,      "Veh_SetEAVPsnRightHorzPosStruct",      "ServiceExecuteFeedbackFlag",      "uint8"},
{4584,      355,      "Veh_SetEAVPsnRightHorzPosStruct",      "Options",      "uint32"},
{4585,      355,      "Veh_SetEAVPsnRightHorzPosStruct",      "Veh_SetEAVPsnRightHorzPos",      "uint8"},
{4586,      355,      "Veh_SetEAVPsnRightHorzPosStruct",      "MemoryReq",      "uint8"},
{4587,      355,      "Veh_SetEAVPsnRightHorzPosRespStruct",      "RespCode",      "uint32"},
{4588,      355,      "Veh_SetEAVPsnRightHorzPosRespStruct",      "Veh_SetEAVPsnRightHorzPosNRC",      "uint32"},
{4589,      356,      "Veh_TurnOnOffAirCleanStruct",      "SOAProtocolVersion",      "uint8"},
{4590,      356,      "Veh_TurnOnOffAirCleanStruct",      "SOAHeaderType",      "uint8"},
{4591,      356,      "Veh_TurnOnOffAirCleanStruct",      "SOAHeaderLength",      "uint16"},
{4592,      356,      "Veh_TurnOnOffAirCleanStruct",      "Flag",      "uint16"},
{4593,      356,      "Veh_TurnOnOffAirCleanStruct",      "HeaderCRC16",      "uint16"},
{4594,      356,      "Veh_TurnOnOffAirCleanStruct",      "UserID",      "uint32"},
{4595,      356,      "Veh_TurnOnOffAirCleanStruct",      "ReqTimeOut",      "uint32"},
{4596,      356,      "Veh_TurnOnOffAirCleanStruct",      "RequestPriority",      "uint8"},
{4597,      356,      "Veh_TurnOnOffAirCleanStruct",      "SequenceID",      "uint16"},
{4598,      356,      "Veh_TurnOnOffAirCleanStruct",      "ServiceExecuteFeedbackFlag",      "uint8"},
{4599,      356,      "Veh_TurnOnOffAirCleanStruct",      "Options",      "uint32"},
{4600,      356,      "Veh_TurnOnOffAirCleanStruct",      "Veh_TurnOnOffAirClean",      "uint8"},
{4601,      356,      "Veh_TurnOnOffAirCleanStruct",      "MemoryReq",      "uint8"},
{4602,      356,      "Veh_TurnOnOffAirCleanRespStruct",      "RespCode",      "uint32"},
{4603,      356,      "Veh_TurnOnOffAirCleanRespStruct",      "Veh_TurnOnOffAirCleanNRC",      "uint32"},
{4604,      357,      "Veh_TurnOnOffAQSStruct",      "SOAProtocolVersion",      "uint8"},
{4605,      357,      "Veh_TurnOnOffAQSStruct",      "SOAHeaderType",      "uint8"},
{4606,      357,      "Veh_TurnOnOffAQSStruct",      "SOAHeaderLength",      "uint16"},
{4607,      357,      "Veh_TurnOnOffAQSStruct",      "Flag",      "uint16"},
{4608,      357,      "Veh_TurnOnOffAQSStruct",      "HeaderCRC16",      "uint16"},
{4609,      357,      "Veh_TurnOnOffAQSStruct",      "UserID",      "uint32"},
{4610,      357,      "Veh_TurnOnOffAQSStruct",      "ReqTimeOut",      "uint32"},
{4611,      357,      "Veh_TurnOnOffAQSStruct",      "RequestPriority",      "uint8"},
{4612,      357,      "Veh_TurnOnOffAQSStruct",      "SequenceID",      "uint16"},
{4613,      357,      "Veh_TurnOnOffAQSStruct",      "ServiceExecuteFeedbackFlag",      "uint8"},
{4614,      357,      "Veh_TurnOnOffAQSStruct",      "Options",      "uint32"},
{4615,      357,      "Veh_TurnOnOffAQSStruct",      "Veh_TurnOnOffAQS",      "uint8"},
{4616,      357,      "Veh_TurnOnOffAQSStruct",      "MemoryReq",      "uint8"},
{4617,      357,      "Veh_TurnOnOffAQSRespStruct",      "RespCode",      "uint32"},
{4618,      357,      "Veh_TurnOnOffAQSRespStruct",      "Veh_TurnOnOffAQSNRC",      "uint32"},
{4619,      358,      "Veh_TurnOnOFFHCVStruct",      "SOAProtocolVersion",      "uint8"},
{4620,      358,      "Veh_TurnOnOFFHCVStruct",      "SOAHeaderType",      "uint8"},
{4621,      358,      "Veh_TurnOnOFFHCVStruct",      "SOAHeaderLength",      "uint16"},
{4622,      358,      "Veh_TurnOnOFFHCVStruct",      "Flag",      "uint16"},
{4623,      358,      "Veh_TurnOnOFFHCVStruct",      "HeaderCRC16",      "uint16"},
{4624,      358,      "Veh_TurnOnOFFHCVStruct",      "UserID",      "uint32"},
{4625,      358,      "Veh_TurnOnOFFHCVStruct",      "ReqTimeOut",      "uint32"},
{4626,      358,      "Veh_TurnOnOFFHCVStruct",      "RequestPriority",      "uint8"},
{4627,      358,      "Veh_TurnOnOFFHCVStruct",      "SequenceID",      "uint16"},
{4628,      358,      "Veh_TurnOnOFFHCVStruct",      "ServiceExecuteFeedbackFlag",      "uint8"},
{4629,      358,      "Veh_TurnOnOFFHCVStruct",      "Options",      "uint32"},
{4630,      358,      "Veh_TurnOnOFFHCVStruct",      "Veh_TurnOnOFFHCV",      "uint8"},
{4631,      358,      "Veh_TurnOnOFFHCVStruct",      "Time",      "uint16"},
{4632,      358,      "Veh_TurnOnOFFHCVStruct",      "MemoryReq",      "uint8"},
{4633,      358,      "Veh_TurnOnOFFHCVRespStruct",      "RespCode",      "uint32"},
{4634,      358,      "Veh_TurnOnOFFHCVRespStruct",      "Veh_TurnOnOFFHCVNRC",      "uint32"},
{4635,      359,      "Veh_DriverTempUpStruct",      "SOAProtocolVersion",      "uint8"},
{4636,      359,      "Veh_DriverTempUpStruct",      "SOAHeaderType",      "uint8"},
{4637,      359,      "Veh_DriverTempUpStruct",      "SOAHeaderLength",      "uint16"},
{4638,      359,      "Veh_DriverTempUpStruct",      "Flag",      "uint16"},
{4639,      359,      "Veh_DriverTempUpStruct",      "HeaderCRC16",      "uint16"},
{4640,      359,      "Veh_DriverTempUpStruct",      "UserID",      "uint32"},
{4641,      359,      "Veh_DriverTempUpStruct",      "ReqTimeOut",      "uint32"},
{4642,      359,      "Veh_DriverTempUpStruct",      "RequestPriority",      "uint8"},
{4643,      359,      "Veh_DriverTempUpStruct",      "SequenceID",      "uint16"},
{4644,      359,      "Veh_DriverTempUpStruct",      "ServiceExecuteFeedbackFlag",      "uint8"},
{4645,      359,      "Veh_DriverTempUpStruct",      "Options",      "uint32"},
{4646,      359,      "Veh_DriverTempUpStruct",      "Veh_DriverTempUp",      "uint8"},
{4647,      359,      "Veh_DriverTempUpStruct",      "Time",      "uint16"},
{4648,      359,      "Veh_DriverTempUpStruct",      "MemoryReq",      "uint8"},
{4649,      359,      "Veh_DriverTempUpRespStruct",      "RespCode",      "uint32"},
{4650,      359,      "Veh_DriverTempUpRespStruct",      "Veh_DriverTempUpNRC",      "uint32"},
{4651,      360,      "Veh_DriverTempDownStruct",      "SOAProtocolVersion",      "uint8"},
{4652,      360,      "Veh_DriverTempDownStruct",      "SOAHeaderType",      "uint8"},
{4653,      360,      "Veh_DriverTempDownStruct",      "SOAHeaderLength",      "uint16"},
{4654,      360,      "Veh_DriverTempDownStruct",      "Flag",      "uint16"},
{4655,      360,      "Veh_DriverTempDownStruct",      "HeaderCRC16",      "uint16"},
{4656,      360,      "Veh_DriverTempDownStruct",      "UserID",      "uint32"},
{4657,      360,      "Veh_DriverTempDownStruct",      "ReqTimeOut",      "uint32"},
{4658,      360,      "Veh_DriverTempDownStruct",      "RequestPriority",      "uint8"},
{4659,      360,      "Veh_DriverTempDownStruct",      "SequenceID",      "uint16"},
{4660,      360,      "Veh_DriverTempDownStruct",      "ServiceExecuteFeedbackFlag",      "uint8"},
{4661,      360,      "Veh_DriverTempDownStruct",      "Options",      "uint32"},
{4662,      360,      "Veh_DriverTempDownStruct",      "Veh_DriverTempDown",      "uint8"},
{4663,      360,      "Veh_DriverTempDownStruct",      "Time",      "uint16"},
{4664,      360,      "Veh_DriverTempDownStruct",      "MemoryReq",      "uint8"},
{4665,      360,      "Veh_DriverTempDownRespStruct",      "RespCode",      "uint32"},
{4666,      360,      "Veh_DriverTempDownRespStruct",      "Veh_DriverTempDownNRC",      "uint32"},
{4667,      361,      "Veh_PsnTempUpStruct",      "SOAProtocolVersion",      "uint8"},
{4668,      361,      "Veh_PsnTempUpStruct",      "SOAHeaderType",      "uint8"},
{4669,      361,      "Veh_PsnTempUpStruct",      "SOAHeaderLength",      "uint16"},
{4670,      361,      "Veh_PsnTempUpStruct",      "Flag",      "uint16"},
{4671,      361,      "Veh_PsnTempUpStruct",      "HeaderCRC16",      "uint16"},
{4672,      361,      "Veh_PsnTempUpStruct",      "UserID",      "uint32"},
{4673,      361,      "Veh_PsnTempUpStruct",      "ReqTimeOut",      "uint32"},
{4674,      361,      "Veh_PsnTempUpStruct",      "RequestPriority",      "uint8"},
{4675,      361,      "Veh_PsnTempUpStruct",      "SequenceID",      "uint16"},
{4676,      361,      "Veh_PsnTempUpStruct",      "ServiceExecuteFeedbackFlag",      "uint8"},
{4677,      361,      "Veh_PsnTempUpStruct",      "Options",      "uint32"},
{4678,      361,      "Veh_PsnTempUpStruct",      "Veh_PsnTempUp",      "uint8"},
{4679,      361,      "Veh_PsnTempUpStruct",      "Time",      "uint16"},
{4680,      361,      "Veh_PsnTempUpStruct",      "MemoryReq",      "uint8"},
{4681,      361,      "Veh_PsnTempUpRespStruct",      "RespCode",      "uint32"},
{4682,      361,      "Veh_PsnTempUpRespStruct",      "Veh_PsnTempUpNRC",      "uint32"},
{4683,      362,      "Veh_PsnTempDownStruct",      "SOAProtocolVersion",      "uint8"},
{4684,      362,      "Veh_PsnTempDownStruct",      "SOAHeaderType",      "uint8"},
{4685,      362,      "Veh_PsnTempDownStruct",      "SOAHeaderLength",      "uint16"},
{4686,      362,      "Veh_PsnTempDownStruct",      "Flag",      "uint16"},
{4687,      362,      "Veh_PsnTempDownStruct",      "HeaderCRC16",      "uint16"},
{4688,      362,      "Veh_PsnTempDownStruct",      "UserID",      "uint32"},
{4689,      362,      "Veh_PsnTempDownStruct",      "ReqTimeOut",      "uint32"},
{4690,      362,      "Veh_PsnTempDownStruct",      "RequestPriority",      "uint8"},
{4691,      362,      "Veh_PsnTempDownStruct",      "SequenceID",      "uint16"},
{4692,      362,      "Veh_PsnTempDownStruct",      "ServiceExecuteFeedbackFlag",      "uint8"},
{4693,      362,      "Veh_PsnTempDownStruct",      "Options",      "uint32"},
{4694,      362,      "Veh_PsnTempDownStruct",      "Veh_PsnTempDown",      "uint8"},
{4695,      362,      "Veh_PsnTempDownStruct",      "Time",      "uint16"},
{4696,      362,      "Veh_PsnTempDownStruct",      "MemoryReq",      "uint8"},
{4697,      362,      "Veh_PsnTempDownRespStruct",      "RespCode",      "uint32"},
{4698,      362,      "Veh_PsnTempDownRespStruct",      "Veh_PsnTempDownNRC",      "uint32"},
{4699,      363,      "Veh_RLTempUpStruct",      "SOAProtocolVersion",      "uint8"},
{4700,      363,      "Veh_RLTempUpStruct",      "SOAHeaderType",      "uint8"},
{4701,      363,      "Veh_RLTempUpStruct",      "SOAHeaderLength",      "uint16"},
{4702,      363,      "Veh_RLTempUpStruct",      "Flag",      "uint16"},
{4703,      363,      "Veh_RLTempUpStruct",      "HeaderCRC16",      "uint16"},
{4704,      363,      "Veh_RLTempUpStruct",      "UserID",      "uint32"},
{4705,      363,      "Veh_RLTempUpStruct",      "ReqTimeOut",      "uint32"},
{4706,      363,      "Veh_RLTempUpStruct",      "RequestPriority",      "uint8"},
{4707,      363,      "Veh_RLTempUpStruct",      "SequenceID",      "uint16"},
{4708,      363,      "Veh_RLTempUpStruct",      "ServiceExecuteFeedbackFlag",      "uint8"},
{4709,      363,      "Veh_RLTempUpStruct",      "Options",      "uint32"},
{4710,      363,      "Veh_RLTempUpStruct",      "Veh_RLTempUp",      "uint8"},
{4711,      363,      "Veh_RLTempUpStruct",      "Time",      "uint16"},
{4712,      363,      "Veh_RLTempUpStruct",      "MemoryReq",      "uint8"},
{4713,      363,      "Veh_RLTempUpRespStruct",      "RespCode",      "uint32"},
{4714,      363,      "Veh_RLTempUpRespStruct",      "Veh_RLTempUpNRC",      "uint32"},
{4715,      364,      "Veh_RLTempDownStruct",      "SOAProtocolVersion",      "uint8"},
{4716,      364,      "Veh_RLTempDownStruct",      "SOAHeaderType",      "uint8"},
{4717,      364,      "Veh_RLTempDownStruct",      "SOAHeaderLength",      "uint16"},
{4718,      364,      "Veh_RLTempDownStruct",      "Flag",      "uint16"},
{4719,      364,      "Veh_RLTempDownStruct",      "HeaderCRC16",      "uint16"},
{4720,      364,      "Veh_RLTempDownStruct",      "UserID",      "uint32"},
{4721,      364,      "Veh_RLTempDownStruct",      "ReqTimeOut",      "uint32"},
{4722,      364,      "Veh_RLTempDownStruct",      "RequestPriority",      "uint8"},
{4723,      364,      "Veh_RLTempDownStruct",      "SequenceID",      "uint16"},
{4724,      364,      "Veh_RLTempDownStruct",      "ServiceExecuteFeedbackFlag",      "uint8"},
{4725,      364,      "Veh_RLTempDownStruct",      "Options",      "uint32"},
{4726,      364,      "Veh_RLTempDownStruct",      "Veh_RLTempDown",      "uint8"},
{4727,      364,      "Veh_RLTempDownStruct",      "Time",      "uint16"},
{4728,      364,      "Veh_RLTempDownStruct",      "MemoryReq",      "uint8"},
{4729,      364,      "Veh_RLTempDownRespStruct",      "RespCode",      "uint32"},
{4730,      364,      "Veh_RLTempDownRespStruct",      "Veh_RLTempDownNRC",      "uint32"},
{4731,      365,      "Veh_RRTempUpStruct",      "SOAProtocolVersion",      "uint8"},
{4732,      365,      "Veh_RRTempUpStruct",      "SOAHeaderType",      "uint8"},
{4733,      365,      "Veh_RRTempUpStruct",      "SOAHeaderLength",      "uint16"},
{4734,      365,      "Veh_RRTempUpStruct",      "Flag",      "uint16"},
{4735,      365,      "Veh_RRTempUpStruct",      "HeaderCRC16",      "uint16"},
{4736,      365,      "Veh_RRTempUpStruct",      "UserID",      "uint32"},
{4737,      365,      "Veh_RRTempUpStruct",      "ReqTimeOut",      "uint32"},
{4738,      365,      "Veh_RRTempUpStruct",      "RequestPriority",      "uint8"},
{4739,      365,      "Veh_RRTempUpStruct",      "SequenceID",      "uint16"},
{4740,      365,      "Veh_RRTempUpStruct",      "ServiceExecuteFeedbackFlag",      "uint8"},
{4741,      365,      "Veh_RRTempUpStruct",      "Options",      "uint32"},
{4742,      365,      "Veh_RRTempUpStruct",      "Veh_RRTempUp",      "uint8"},
{4743,      365,      "Veh_RRTempUpStruct",      "Time",      "uint16"},
{4744,      365,      "Veh_RRTempUpStruct",      "MemoryReq",      "uint8"},
{4745,      365,      "Veh_RRTempUpRespStruct",      "RespCode",      "uint32"},
{4746,      365,      "Veh_RRTempUpRespStruct",      "Veh_RRTempUpNRC",      "uint32"},
{4747,      366,      "Veh_RRTempDownStruct",      "SOAProtocolVersion",      "uint8"},
{4748,      366,      "Veh_RRTempDownStruct",      "SOAHeaderType",      "uint8"},
{4749,      366,      "Veh_RRTempDownStruct",      "SOAHeaderLength",      "uint16"},
{4750,      366,      "Veh_RRTempDownStruct",      "Flag",      "uint16"},
{4751,      366,      "Veh_RRTempDownStruct",      "HeaderCRC16",      "uint16"},
{4752,      366,      "Veh_RRTempDownStruct",      "UserID",      "uint32"},
{4753,      366,      "Veh_RRTempDownStruct",      "ReqTimeOut",      "uint32"},
{4754,      366,      "Veh_RRTempDownStruct",      "RequestPriority",      "uint8"},
{4755,      366,      "Veh_RRTempDownStruct",      "SequenceID",      "uint16"},
{4756,      366,      "Veh_RRTempDownStruct",      "ServiceExecuteFeedbackFlag",      "uint8"},
{4757,      366,      "Veh_RRTempDownStruct",      "Options",      "uint32"},
{4758,      366,      "Veh_RRTempDownStruct",      "Veh_RRTempDown",      "uint8"},
{4759,      366,      "Veh_RRTempDownStruct",      "Time",      "uint16"},
{4760,      366,      "Veh_RRTempDownStruct",      "MemoryReq",      "uint8"},
{4761,      366,      "Veh_RRTempDownRespStruct",      "RespCode",      "uint32"},
{4762,      366,      "Veh_RRTempDownRespStruct",      "Veh_RRTempDownNRC",      "uint32"},
{4763,      367,      "Veh_3rdRowTempUpStruct",      "SOAProtocolVersion",      "uint8"},
{4764,      367,      "Veh_3rdRowTempUpStruct",      "SOAHeaderType",      "uint8"},
{4765,      367,      "Veh_3rdRowTempUpStruct",      "SOAHeaderLength",      "uint16"},
{4766,      367,      "Veh_3rdRowTempUpStruct",      "Flag",      "uint16"},
{4767,      367,      "Veh_3rdRowTempUpStruct",      "HeaderCRC16",      "uint16"},
{4768,      367,      "Veh_3rdRowTempUpStruct",      "UserID",      "uint32"},
{4769,      367,      "Veh_3rdRowTempUpStruct",      "ReqTimeOut",      "uint32"},
{4770,      367,      "Veh_3rdRowTempUpStruct",      "RequestPriority",      "uint8"},
{4771,      367,      "Veh_3rdRowTempUpStruct",      "SequenceID",      "uint16"},
{4772,      367,      "Veh_3rdRowTempUpStruct",      "ServiceExecuteFeedbackFlag",      "uint8"},
{4773,      367,      "Veh_3rdRowTempUpStruct",      "Options",      "uint32"},
{4774,      367,      "Veh_3rdRowTempUpStruct",      "Veh_3rdRowTempUp",      "uint8"},
{4775,      367,      "Veh_3rdRowTempUpStruct",      "Time",      "uint16"},
{4776,      367,      "Veh_3rdRowTempUpStruct",      "MemoryReq",      "uint8"},
{4777,      367,      "Veh_3rdRowTempUpRespStruct",      "RespCode",      "uint32"},
{4778,      367,      "Veh_3rdRowTempUpRespStruct",      "Veh_3rdRowTempUpNRC",      "uint32"},
{4779,      368,      "Veh_3rdRowTempDownStruct",      "SOAProtocolVersion",      "uint8"},
{4780,      368,      "Veh_3rdRowTempDownStruct",      "SOAHeaderType",      "uint8"},
{4781,      368,      "Veh_3rdRowTempDownStruct",      "SOAHeaderLength",      "uint16"},
{4782,      368,      "Veh_3rdRowTempDownStruct",      "Flag",      "uint16"},
{4783,      368,      "Veh_3rdRowTempDownStruct",      "HeaderCRC16",      "uint16"},
{4784,      368,      "Veh_3rdRowTempDownStruct",      "UserID",      "uint32"},
{4785,      368,      "Veh_3rdRowTempDownStruct",      "ReqTimeOut",      "uint32"},
{4786,      368,      "Veh_3rdRowTempDownStruct",      "RequestPriority",      "uint8"},
{4787,      368,      "Veh_3rdRowTempDownStruct",      "SequenceID",      "uint16"},
{4788,      368,      "Veh_3rdRowTempDownStruct",      "ServiceExecuteFeedbackFlag",      "uint8"},
{4789,      368,      "Veh_3rdRowTempDownStruct",      "Options",      "uint32"},
{4790,      368,      "Veh_3rdRowTempDownStruct",      "Veh_3rdRowTempDown",      "uint8"},
{4791,      368,      "Veh_3rdRowTempDownStruct",      "Time",      "uint16"},
{4792,      368,      "Veh_3rdRowTempDownStruct",      "MemoryReq",      "uint8"},
{4793,      368,      "Veh_3rdRowTempDownRespStruct",      "RespCode",      "uint32"},
{4794,      368,      "Veh_3rdRowTempDownRespStruct",      "Veh_3rdRowTempDownNRC",      "uint32"},
{4795,      369,      "Veh_FrWindSpdUpStruct",      "SOAProtocolVersion",      "uint8"},
{4796,      369,      "Veh_FrWindSpdUpStruct",      "SOAHeaderType",      "uint8"},
{4797,      369,      "Veh_FrWindSpdUpStruct",      "SOAHeaderLength",      "uint16"},
{4798,      369,      "Veh_FrWindSpdUpStruct",      "Flag",      "uint16"},
{4799,      369,      "Veh_FrWindSpdUpStruct",      "HeaderCRC16",      "uint16"},
{4800,      369,      "Veh_FrWindSpdUpStruct",      "UserID",      "uint32"},
{4801,      369,      "Veh_FrWindSpdUpStruct",      "ReqTimeOut",      "uint32"},
{4802,      369,      "Veh_FrWindSpdUpStruct",      "RequestPriority",      "uint8"},
{4803,      369,      "Veh_FrWindSpdUpStruct",      "SequenceID",      "uint16"},
{4804,      369,      "Veh_FrWindSpdUpStruct",      "ServiceExecuteFeedbackFlag",      "uint8"},
{4805,      369,      "Veh_FrWindSpdUpStruct",      "Options",      "uint32"},
{4806,      369,      "Veh_FrWindSpdUpStruct",      "Veh_FrWindSpdUp",      "uint8"},
{4807,      369,      "Veh_FrWindSpdUpStruct",      "Time",      "uint16"},
{4808,      369,      "Veh_FrWindSpdUpStruct",      "MemoryReq",      "uint8"},
{4809,      369,      "Veh_FrWindSpdUpRespStruct",      "RespCode",      "uint32"},
{4810,      369,      "Veh_FrWindSpdUpRespStruct",      "Veh_FrWindSpdUpNRC",      "uint32"},
{4811,      370,      "Veh_FrWindSpdDownStruct",      "SOAProtocolVersion",      "uint8"},
{4812,      370,      "Veh_FrWindSpdDownStruct",      "SOAHeaderType",      "uint8"},
{4813,      370,      "Veh_FrWindSpdDownStruct",      "SOAHeaderLength",      "uint16"},
{4814,      370,      "Veh_FrWindSpdDownStruct",      "Flag",      "uint16"},
{4815,      370,      "Veh_FrWindSpdDownStruct",      "HeaderCRC16",      "uint16"},
{4816,      370,      "Veh_FrWindSpdDownStruct",      "UserID",      "uint32"},
{4817,      370,      "Veh_FrWindSpdDownStruct",      "ReqTimeOut",      "uint32"},
{4818,      370,      "Veh_FrWindSpdDownStruct",      "RequestPriority",      "uint8"},
{4819,      370,      "Veh_FrWindSpdDownStruct",      "SequenceID",      "uint16"},
{4820,      370,      "Veh_FrWindSpdDownStruct",      "ServiceExecuteFeedbackFlag",      "uint8"},
{4821,      370,      "Veh_FrWindSpdDownStruct",      "Options",      "uint32"},
{4822,      370,      "Veh_FrWindSpdDownStruct",      "Veh_FrWindSpdDown",      "uint8"},
{4823,      370,      "Veh_FrWindSpdDownStruct",      "Time",      "uint16"},
{4824,      370,      "Veh_FrWindSpdDownStruct",      "MemoryReq",      "uint8"},
{4825,      370,      "Veh_FrWindSpdDownRespStruct",      "RespCode",      "uint32"},
{4826,      370,      "Veh_FrWindSpdDownRespStruct",      "Veh_FrWindSpdDownNRC",      "uint32"},
{4827,      371,      "Veh_RrWindSpdUpStruct",      "SOAProtocolVersion",      "uint8"},
{4828,      371,      "Veh_RrWindSpdUpStruct",      "SOAHeaderType",      "uint8"},
{4829,      371,      "Veh_RrWindSpdUpStruct",      "SOAHeaderLength",      "uint16"},
{4830,      371,      "Veh_RrWindSpdUpStruct",      "Flag",      "uint16"},
{4831,      371,      "Veh_RrWindSpdUpStruct",      "HeaderCRC16",      "uint16"},
{4832,      371,      "Veh_RrWindSpdUpStruct",      "UserID",      "uint32"},
{4833,      371,      "Veh_RrWindSpdUpStruct",      "ReqTimeOut",      "uint32"},
{4834,      371,      "Veh_RrWindSpdUpStruct",      "RequestPriority",      "uint8"},
{4835,      371,      "Veh_RrWindSpdUpStruct",      "SequenceID",      "uint16"},
{4836,      371,      "Veh_RrWindSpdUpStruct",      "ServiceExecuteFeedbackFlag",      "uint8"},
{4837,      371,      "Veh_RrWindSpdUpStruct",      "Options",      "uint32"},
{4838,      371,      "Veh_RrWindSpdUpStruct",      "Veh_RrWindSpdUp",      "uint8"},
{4839,      371,      "Veh_RrWindSpdUpStruct",      "Time",      "uint16"},
{4840,      371,      "Veh_RrWindSpdUpStruct",      "MemoryReq",      "uint8"},
{4841,      371,      "Veh_RrWindSpdUpRespStruct",      "RespCode",      "uint32"},
{4842,      371,      "Veh_RrWindSpdUpRespStruct",      "Veh_RrWindSpdUpNRC",      "uint32"},
{4843,      372,      "Veh_RrWindSpdDownStruct",      "SOAProtocolVersion",      "uint8"},
{4844,      372,      "Veh_RrWindSpdDownStruct",      "SOAHeaderType",      "uint8"},
{4845,      372,      "Veh_RrWindSpdDownStruct",      "SOAHeaderLength",      "uint16"},
{4846,      372,      "Veh_RrWindSpdDownStruct",      "Flag",      "uint16"},
{4847,      372,      "Veh_RrWindSpdDownStruct",      "HeaderCRC16",      "uint16"},
{4848,      372,      "Veh_RrWindSpdDownStruct",      "UserID",      "uint32"},
{4849,      372,      "Veh_RrWindSpdDownStruct",      "ReqTimeOut",      "uint32"},
{4850,      372,      "Veh_RrWindSpdDownStruct",      "RequestPriority",      "uint8"},
{4851,      372,      "Veh_RrWindSpdDownStruct",      "SequenceID",      "uint16"},
{4852,      372,      "Veh_RrWindSpdDownStruct",      "ServiceExecuteFeedbackFlag",      "uint8"},
{4853,      372,      "Veh_RrWindSpdDownStruct",      "Options",      "uint32"},
{4854,      372,      "Veh_RrWindSpdDownStruct",      "Veh_RrWindSpdDown",      "uint8"},
{4855,      372,      "Veh_RrWindSpdDownStruct",      "Time",      "uint16"},
{4856,      372,      "Veh_RrWindSpdDownStruct",      "MemoryReq",      "uint8"},
{4857,      372,      "Veh_RrWindSpdDownRespStruct",      "RespCode",      "uint32"},
{4858,      372,      "Veh_RrWindSpdDownRespStruct",      "Veh_RrWindSpdDownNRC",      "uint32"},
{4859,      373,      "Veh_FrAirDisModeBtnStruct",      "SOAProtocolVersion",      "uint8"},
{4860,      373,      "Veh_FrAirDisModeBtnStruct",      "SOAHeaderType",      "uint8"},
{4861,      373,      "Veh_FrAirDisModeBtnStruct",      "SOAHeaderLength",      "uint16"},
{4862,      373,      "Veh_FrAirDisModeBtnStruct",      "Flag",      "uint16"},
{4863,      373,      "Veh_FrAirDisModeBtnStruct",      "HeaderCRC16",      "uint16"},
{4864,      373,      "Veh_FrAirDisModeBtnStruct",      "UserID",      "uint32"},
{4865,      373,      "Veh_FrAirDisModeBtnStruct",      "ReqTimeOut",      "uint32"},
{4866,      373,      "Veh_FrAirDisModeBtnStruct",      "RequestPriority",      "uint8"},
{4867,      373,      "Veh_FrAirDisModeBtnStruct",      "SequenceID",      "uint16"},
{4868,      373,      "Veh_FrAirDisModeBtnStruct",      "ServiceExecuteFeedbackFlag",      "uint8"},
{4869,      373,      "Veh_FrAirDisModeBtnStruct",      "Options",      "uint32"},
{4870,      373,      "Veh_FrAirDisModeBtnStruct",      "Veh_FrAirDisModeBtn",      "uint8"},
{4871,      373,      "Veh_FrAirDisModeBtnStruct",      "MemoryReq",      "uint8"},
{4872,      373,      "Veh_FrAirDisModeBtnRespStruct",      "RespCode",      "uint32"},
{4873,      373,      "Veh_FrAirDisModeBtnRespStruct",      "Veh_FrAirDisModeBtnNRC",      "uint32"},
{4874,      374,      "Veh_RrAirDisModeBtnStruct",      "SOAProtocolVersion",      "uint8"},
{4875,      374,      "Veh_RrAirDisModeBtnStruct",      "SOAHeaderType",      "uint8"},
{4876,      374,      "Veh_RrAirDisModeBtnStruct",      "SOAHeaderLength",      "uint16"},
{4877,      374,      "Veh_RrAirDisModeBtnStruct",      "Flag",      "uint16"},
{4878,      374,      "Veh_RrAirDisModeBtnStruct",      "HeaderCRC16",      "uint16"},
{4879,      374,      "Veh_RrAirDisModeBtnStruct",      "UserID",      "uint32"},
{4880,      374,      "Veh_RrAirDisModeBtnStruct",      "ReqTimeOut",      "uint32"},
{4881,      374,      "Veh_RrAirDisModeBtnStruct",      "RequestPriority",      "uint8"},
{4882,      374,      "Veh_RrAirDisModeBtnStruct",      "SequenceID",      "uint16"},
{4883,      374,      "Veh_RrAirDisModeBtnStruct",      "ServiceExecuteFeedbackFlag",      "uint8"},
{4884,      374,      "Veh_RrAirDisModeBtnStruct",      "Options",      "uint32"},
{4885,      374,      "Veh_RrAirDisModeBtnStruct",      "Veh_RrAirDisModeBtn",      "uint8"},
{4886,      374,      "Veh_RrAirDisModeBtnStruct",      "MemoryReq",      "uint8"},
{4887,      374,      "Veh_RrAirDisModeBtnRespStruct",      "RespCode",      "uint32"},
{4888,      374,      "Veh_RrAirDisModeBtnRespStruct",      "Veh_RrAirDisModeBtnNRC",      "uint32"},
{4889,      375,      "Veh_3rdRowAirDisModeBtnStruct",      "SOAProtocolVersion",      "uint8"},
{4890,      375,      "Veh_3rdRowAirDisModeBtnStruct",      "SOAHeaderType",      "uint8"},
{4891,      375,      "Veh_3rdRowAirDisModeBtnStruct",      "SOAHeaderLength",      "uint16"},
{4892,      375,      "Veh_3rdRowAirDisModeBtnStruct",      "Flag",      "uint16"},
{4893,      375,      "Veh_3rdRowAirDisModeBtnStruct",      "HeaderCRC16",      "uint16"},
{4894,      375,      "Veh_3rdRowAirDisModeBtnStruct",      "UserID",      "uint32"},
{4895,      375,      "Veh_3rdRowAirDisModeBtnStruct",      "ReqTimeOut",      "uint32"},
{4896,      375,      "Veh_3rdRowAirDisModeBtnStruct",      "RequestPriority",      "uint8"},
{4897,      375,      "Veh_3rdRowAirDisModeBtnStruct",      "SequenceID",      "uint16"},
{4898,      375,      "Veh_3rdRowAirDisModeBtnStruct",      "ServiceExecuteFeedbackFlag",      "uint8"},
{4899,      375,      "Veh_3rdRowAirDisModeBtnStruct",      "Options",      "uint32"},
{4900,      375,      "Veh_3rdRowAirDisModeBtnStruct",      "Veh_3rdRowAirDisModeBtn",      "uint8"},
{4901,      375,      "Veh_3rdRowAirDisModeBtnStruct",      "MemoryReq",      "uint8"},
{4902,      375,      "Veh_3rdRowAirDisModeBtnRespStruct",      "RespCode",      "uint32"},
{4903,      375,      "Veh_3rdRowAirDisModeBtnRespStruct",      "Veh_3rdRowAirDisModeBtnNRC",      "uint32"},
{4904,      376,      "Veh_SetEAVRLWindModeStruct",      "SOAProtocolVersion",      "uint8"},
{4905,      376,      "Veh_SetEAVRLWindModeStruct",      "SOAHeaderType",      "uint8"},
{4906,      376,      "Veh_SetEAVRLWindModeStruct",      "SOAHeaderLength",      "uint16"},
{4907,      376,      "Veh_SetEAVRLWindModeStruct",      "Flag",      "uint16"},
{4908,      376,      "Veh_SetEAVRLWindModeStruct",      "HeaderCRC16",      "uint16"},
{4909,      376,      "Veh_SetEAVRLWindModeStruct",      "UserID",      "uint32"},
{4910,      376,      "Veh_SetEAVRLWindModeStruct",      "ReqTimeOut",      "uint32"},
{4911,      376,      "Veh_SetEAVRLWindModeStruct",      "RequestPriority",      "uint8"},
{4912,      376,      "Veh_SetEAVRLWindModeStruct",      "SequenceID",      "uint16"},
{4913,      376,      "Veh_SetEAVRLWindModeStruct",      "ServiceExecuteFeedbackFlag",      "uint8"},
{4914,      376,      "Veh_SetEAVRLWindModeStruct",      "Options",      "uint32"},
{4915,      376,      "Veh_SetEAVRLWindModeStruct",      "Veh_SetEAVRLWindMode",      "uint8"},
{4916,      376,      "Veh_SetEAVRLWindModeStruct",      "MemoryReq",      "uint8"},
{4917,      376,      "Veh_SetEAVRLWindModeRespStruct",      "RespCode",      "uint32"},
{4918,      376,      "Veh_SetEAVRLWindModeRespStruct",      "Veh_SetEAVRLWindModeNRC",      "uint32"},
{4919,      377,      "Veh_SetEAVRRWindModeStruct",      "SOAProtocolVersion",      "uint8"},
{4920,      377,      "Veh_SetEAVRRWindModeStruct",      "SOAHeaderType",      "uint8"},
{4921,      377,      "Veh_SetEAVRRWindModeStruct",      "SOAHeaderLength",      "uint16"},
{4922,      377,      "Veh_SetEAVRRWindModeStruct",      "Flag",      "uint16"},
{4923,      377,      "Veh_SetEAVRRWindModeStruct",      "HeaderCRC16",      "uint16"},
{4924,      377,      "Veh_SetEAVRRWindModeStruct",      "UserID",      "uint32"},
{4925,      377,      "Veh_SetEAVRRWindModeStruct",      "ReqTimeOut",      "uint32"},
{4926,      377,      "Veh_SetEAVRRWindModeStruct",      "RequestPriority",      "uint8"},
{4927,      377,      "Veh_SetEAVRRWindModeStruct",      "SequenceID",      "uint16"},
{4928,      377,      "Veh_SetEAVRRWindModeStruct",      "ServiceExecuteFeedbackFlag",      "uint8"},
{4929,      377,      "Veh_SetEAVRRWindModeStruct",      "Options",      "uint32"},
{4930,      377,      "Veh_SetEAVRRWindModeStruct",      "Veh_SetEAVRRWindMode",      "uint8"},
{4931,      377,      "Veh_SetEAVRRWindModeStruct",      "MemoryReq",      "uint8"},
{4932,      377,      "Veh_SetEAVRRWindModeRespStruct",      "RespCode",      "uint32"},
{4933,      377,      "Veh_SetEAVRRWindModeRespStruct",      "Veh_SetEAVRRWindModeNRC",      "uint32"},
{4934,      378,      "Veh_SetREAVSweepWindStruct",      "SOAProtocolVersion",      "uint8"},
{4935,      378,      "Veh_SetREAVSweepWindStruct",      "SOAHeaderType",      "uint8"},
{4936,      378,      "Veh_SetREAVSweepWindStruct",      "SOAHeaderLength",      "uint16"},
{4937,      378,      "Veh_SetREAVSweepWindStruct",      "Flag",      "uint16"},
{4938,      378,      "Veh_SetREAVSweepWindStruct",      "HeaderCRC16",      "uint16"},
{4939,      378,      "Veh_SetREAVSweepWindStruct",      "UserID",      "uint32"},
{4940,      378,      "Veh_SetREAVSweepWindStruct",      "ReqTimeOut",      "uint32"},
{4941,      378,      "Veh_SetREAVSweepWindStruct",      "RequestPriority",      "uint8"},
{4942,      378,      "Veh_SetREAVSweepWindStruct",      "SequenceID",      "uint16"},
{4943,      378,      "Veh_SetREAVSweepWindStruct",      "ServiceExecuteFeedbackFlag",      "uint8"},
{4944,      378,      "Veh_SetREAVSweepWindStruct",      "Options",      "uint32"},
{4945,      378,      "Veh_SetREAVSweepWindStruct",      "Veh_SetREAVSweepWind",      "uint8"},
{4946,      378,      "Veh_SetREAVSweepWindStruct",      "MemoryReq",      "uint8"},
{4947,      378,      "Veh_SetREAVSweepWindRespStruct",      "RespCode",      "uint32"},
{4948,      378,      "Veh_SetREAVSweepWindRespStruct",      "Veh_SetREAVSweepWindNRC",      "uint32"},
{4949,      379,      "Veh_SetEAVRLHorzPosStruct",      "SOAProtocolVersion",      "uint8"},
{4950,      379,      "Veh_SetEAVRLHorzPosStruct",      "SOAHeaderType",      "uint8"},
{4951,      379,      "Veh_SetEAVRLHorzPosStruct",      "SOAHeaderLength",      "uint16"},
{4952,      379,      "Veh_SetEAVRLHorzPosStruct",      "Flag",      "uint16"},
{4953,      379,      "Veh_SetEAVRLHorzPosStruct",      "HeaderCRC16",      "uint16"},
{4954,      379,      "Veh_SetEAVRLHorzPosStruct",      "UserID",      "uint32"},
{4955,      379,      "Veh_SetEAVRLHorzPosStruct",      "ReqTimeOut",      "uint32"},
{4956,      379,      "Veh_SetEAVRLHorzPosStruct",      "RequestPriority",      "uint8"},
{4957,      379,      "Veh_SetEAVRLHorzPosStruct",      "SequenceID",      "uint16"},
{4958,      379,      "Veh_SetEAVRLHorzPosStruct",      "ServiceExecuteFeedbackFlag",      "uint8"},
{4959,      379,      "Veh_SetEAVRLHorzPosStruct",      "Options",      "uint32"},
{4960,      379,      "Veh_SetEAVRLHorzPosStruct",      "Veh_SetEAVRLHorzPos",      "uint8"},
{4961,      379,      "Veh_SetEAVRLHorzPosStruct",      "MemoryReq",      "uint8"},
{4962,      379,      "Veh_SetEAVRLHorzPosRespStruct",      "RespCode",      "uint32"},
{4963,      379,      "Veh_SetEAVRLHorzPosRespStruct",      "Veh_SetEAVRLHorzPosNRC",      "uint32"},
{4964,      380,      "Veh_SetEAVRLVertPosStruct",      "SOAProtocolVersion",      "uint8"},
{4965,      380,      "Veh_SetEAVRLVertPosStruct",      "SOAHeaderType",      "uint8"},
{4966,      380,      "Veh_SetEAVRLVertPosStruct",      "SOAHeaderLength",      "uint16"},
{4967,      380,      "Veh_SetEAVRLVertPosStruct",      "Flag",      "uint16"},
{4968,      380,      "Veh_SetEAVRLVertPosStruct",      "HeaderCRC16",      "uint16"},
{4969,      380,      "Veh_SetEAVRLVertPosStruct",      "UserID",      "uint32"},
{4970,      380,      "Veh_SetEAVRLVertPosStruct",      "ReqTimeOut",      "uint32"},
{4971,      380,      "Veh_SetEAVRLVertPosStruct",      "RequestPriority",      "uint8"},
{4972,      380,      "Veh_SetEAVRLVertPosStruct",      "SequenceID",      "uint16"},
{4973,      380,      "Veh_SetEAVRLVertPosStruct",      "ServiceExecuteFeedbackFlag",      "uint8"},
{4974,      380,      "Veh_SetEAVRLVertPosStruct",      "Options",      "uint32"},
{4975,      380,      "Veh_SetEAVRLVertPosStruct",      "Veh_SetEAVRLVertPos",      "uint8"},
{4976,      380,      "Veh_SetEAVRLVertPosStruct",      "MemoryReq",      "uint8"},
{4977,      380,      "Veh_SetEAVRLVertPosRespStruct",      "RespCode",      "uint32"},
{4978,      380,      "Veh_SetEAVRLVertPosRespStruct",      "Veh_SetEAVRLVertPosNRC",      "uint32"},
{4979,      381,      "Veh_SetEAVRRHorzPosStruct",      "SOAProtocolVersion",      "uint8"},
{4980,      381,      "Veh_SetEAVRRHorzPosStruct",      "SOAHeaderType",      "uint8"},
{4981,      381,      "Veh_SetEAVRRHorzPosStruct",      "SOAHeaderLength",      "uint16"},
{4982,      381,      "Veh_SetEAVRRHorzPosStruct",      "Flag",      "uint16"},
{4983,      381,      "Veh_SetEAVRRHorzPosStruct",      "HeaderCRC16",      "uint16"},
{4984,      381,      "Veh_SetEAVRRHorzPosStruct",      "UserID",      "uint32"},
{4985,      381,      "Veh_SetEAVRRHorzPosStruct",      "ReqTimeOut",      "uint32"},
{4986,      381,      "Veh_SetEAVRRHorzPosStruct",      "RequestPriority",      "uint8"},
{4987,      381,      "Veh_SetEAVRRHorzPosStruct",      "SequenceID",      "uint16"},
{4988,      381,      "Veh_SetEAVRRHorzPosStruct",      "ServiceExecuteFeedbackFlag",      "uint8"},
{4989,      381,      "Veh_SetEAVRRHorzPosStruct",      "Options",      "uint32"},
{4990,      381,      "Veh_SetEAVRRHorzPosStruct",      "Veh_SetEAVRRHorzPos",      "uint8"},
{4991,      381,      "Veh_SetEAVRRHorzPosStruct",      "MemoryReq",      "uint8"},
{4992,      381,      "Veh_SetEAVRRHorzPosRespStruct",      "RespCode",      "uint32"},
{4993,      381,      "Veh_SetEAVRRHorzPosRespStruct",      "Veh_SetEAVRRHorzPosNRC",      "uint32"},
{4994,      382,      "Veh_SetEAVRRVertPosStruct",      "SOAProtocolVersion",      "uint8"},
{4995,      382,      "Veh_SetEAVRRVertPosStruct",      "SOAHeaderType",      "uint8"},
{4996,      382,      "Veh_SetEAVRRVertPosStruct",      "SOAHeaderLength",      "uint16"},
{4997,      382,      "Veh_SetEAVRRVertPosStruct",      "Flag",      "uint16"},
{4998,      382,      "Veh_SetEAVRRVertPosStruct",      "HeaderCRC16",      "uint16"},
{4999,      382,      "Veh_SetEAVRRVertPosStruct",      "UserID",      "uint32"},
{5000,      382,      "Veh_SetEAVRRVertPosStruct",      "ReqTimeOut",      "uint32"},
{5001,      382,      "Veh_SetEAVRRVertPosStruct",      "RequestPriority",      "uint8"},
{5002,      382,      "Veh_SetEAVRRVertPosStruct",      "SequenceID",      "uint16"},
{5003,      382,      "Veh_SetEAVRRVertPosStruct",      "ServiceExecuteFeedbackFlag",      "uint8"},
{5004,      382,      "Veh_SetEAVRRVertPosStruct",      "Options",      "uint32"},
{5005,      382,      "Veh_SetEAVRRVertPosStruct",      "Veh_SetEAVRRVertPos",      "uint8"},
{5006,      382,      "Veh_SetEAVRRVertPosStruct",      "MemoryReq",      "uint8"},
{5007,      382,      "Veh_SetEAVRRVertPosRespStruct",      "RespCode",      "uint32"},
{5008,      382,      "Veh_SetEAVRRVertPosRespStruct",      "Veh_SetEAVRRVertPosNRC",      "uint32"},
{5009,      383,      "Veh_SetBlowCompensationStruct",      "SOAProtocolVersion",      "uint8"},
{5010,      383,      "Veh_SetBlowCompensationStruct",      "SOAHeaderType",      "uint8"},
{5011,      383,      "Veh_SetBlowCompensationStruct",      "SOAHeaderLength",      "uint16"},
{5012,      383,      "Veh_SetBlowCompensationStruct",      "Flag",      "uint16"},
{5013,      383,      "Veh_SetBlowCompensationStruct",      "HeaderCRC16",      "uint16"},
{5014,      383,      "Veh_SetBlowCompensationStruct",      "UserID",      "uint32"},
{5015,      383,      "Veh_SetBlowCompensationStruct",      "ReqTimeOut",      "uint32"},
{5016,      383,      "Veh_SetBlowCompensationStruct",      "RequestPriority",      "uint8"},
{5017,      383,      "Veh_SetBlowCompensationStruct",      "SequenceID",      "uint16"},
{5018,      383,      "Veh_SetBlowCompensationStruct",      "ServiceExecuteFeedbackFlag",      "uint8"},
{5019,      383,      "Veh_SetBlowCompensationStruct",      "Options",      "uint32"},
{5020,      383,      "Veh_SetBlowCompensationStruct",      "Veh_SetBlowCompensation",      "uint8"},
{5021,      383,      "Veh_SetBlowCompensationStruct",      "MemoryReq",      "uint8"},
{5022,      383,      "Veh_SetBlowCompensationRespStruct",      "RespCode",      "uint32"},
{5023,      383,      "Veh_SetBlowCompensationRespStruct",      "Veh_SetBlowCompensationNRC",      "uint32"},
{5024,      384,      "Veh_RearMirrorHeatService_ErrStruct",      "SequenceID",      "uint16"},
{5025,      384,      "Veh_RearMirrorHeatService_ErrStruct",      "Options_8bit",      "uint8"},
{5026,      384,      "Veh_RearMirrorHeatService_ErrStruct",      "Options_8bit2",      "uint8"},
{5027,      384,      "Veh_RearMirrorHeatService_ErrStruct",      "UserID",      "uint32"},
{5028,      384,      "Veh_RearMirrorHeatService_ErrStruct",      "OpeNRC",      "uint32"},
{5029,      384,      "Veh_RearMirrorHeatService_ErrStruct",      "OpeErrInfo",      "string[16]"},
{5030,      385,      "Veh_RearMirrorHeatStruct",      "SOAProtocolVersion",      "uint8"},
{5031,      385,      "Veh_RearMirrorHeatStruct",      "SOAHeaderType",      "uint8"},
{5032,      385,      "Veh_RearMirrorHeatStruct",      "SOAHeaderLength",      "uint16"},
{5033,      385,      "Veh_RearMirrorHeatStruct",      "Flag",      "uint16"},
{5034,      385,      "Veh_RearMirrorHeatStruct",      "HeaderCRC16",      "uint16"},
{5035,      385,      "Veh_RearMirrorHeatStruct",      "UserID",      "uint32"},
{5036,      385,      "Veh_RearMirrorHeatStruct",      "ReqTimeOut",      "uint32"},
{5037,      385,      "Veh_RearMirrorHeatStruct",      "RequestPriority",      "uint8"},
{5038,      385,      "Veh_RearMirrorHeatStruct",      "SequenceID",      "uint16"},
{5039,      385,      "Veh_RearMirrorHeatStruct",      "ServiceExecuteFeedbackFlag",      "uint8"},
{5040,      385,      "Veh_RearMirrorHeatStruct",      "Options",      "uint32"},
{5041,      385,      "Veh_RearMirrorHeatStruct",      "Veh_RearMirrorHeat",      "uint8"},
{5042,      385,      "Veh_RearMirrorHeatRespStruct",      "RespCode",      "uint32"},
{5043,      385,      "Veh_RearMirrorHeatRespStruct",      "Veh_RearMirrorHeatNRC",      "uint32"},
{5044,      386,      "Veh_SFSService_ErrStruct",      "SequenceID",      "uint16"},
{5045,      386,      "Veh_SFSService_ErrStruct",      "Options_8bit",      "uint8"},
{5046,      386,      "Veh_SFSService_ErrStruct",      "Options_8bit2",      "uint8"},
{5047,      386,      "Veh_SFSService_ErrStruct",      "UserID",      "uint32"},
{5048,      386,      "Veh_SFSService_ErrStruct",      "OpeNRC",      "uint32"},
{5049,      386,      "Veh_SFSService_ErrStruct",      "OpeErrInfo",      "string[16]"},
{5050,      387,      "SFSStStruct",      "SFS_Sw_St",      "uint8"},
{5051,      387,      "SFSStStruct",      "SFS_Ch_St",      "uint8"},
{5052,      387,      "SFSStStruct",      "SFS_Con_St",      "uint8"},
{5053,      387,      "SFSStStruct",      "SFS_WorkSt",      "uint8"},
{5054,      387,      "SFSStStruct",      "SFS_Change_St",      "uint8"},
{5055,      387,      "SFSStStruct",      "SFS_Init_St",      "uint8"},
{5056,      387,      "SFSStStruct",      "SFS_Fan_Err",      "uint8"},
{5057,      387,      "SFSStStruct",      "SFS_Mot_Err",      "uint8"},
{5058,      387,      "SFSStStruct",      "SFS_OvrVolt_Err",      "uint8"},
{5059,      387,      "SFSStStruct",      "SFS_UndVolt_Err",      "uint8"},
{5060,      387,      "SFSStStruct",      "SFS_Ch1_Type",      "uint8"},
{5061,      387,      "SFSStStruct",      "SFS_Ch2_Type",      "uint8"},
{5062,      387,      "SFSStStruct",      "SFS_Ch3_Type",      "uint8"},
{5063,      387,      "SFSStStruct",      "SFS_Ch1_Lev_St",      "uint8"},
{5064,      387,      "SFSStStruct",      "SFS_Ch2_Lev_St",      "uint8"},
{5065,      387,      "SFSStStruct",      "SFS_Ch3_Lev_St",      "uint8"},
{5066,      387,      "SFSStStruct",      "SFS_Ch1ResetResp",      "uint8"},
{5067,      387,      "SFSStStruct",      "SFS_Ch2ResetResp",      "uint8"},
{5068,      387,      "SFSStStruct",      "SFS_Ch3ResetResp",      "uint8"},
{5069,      387,      "SFSStStruct",      "SFS_EepromError",      "uint8"},
{5070,      387,      "SFSStStruct",      "FRS_Expiry_Container_1",      "uint8"},
{5071,      387,      "SFSStStruct",      "FRS_Expiry_Container_2",      "uint8"},
{5072,      387,      "SFSStStruct",      "FRS_Expiry_Container_3",      "uint8"},
{5073,      387,      "SFSStStruct",      "SFS_LIN_Err",      "uint8"},
{5074,      388,      "Veh_TurnOnOffSFSStruct",      "SOAProtocolVersion",      "uint8"},
{5075,      388,      "Veh_TurnOnOffSFSStruct",      "SOAHeaderType",      "uint8"},
{5076,      388,      "Veh_TurnOnOffSFSStruct",      "SOAHeaderLength",      "uint16"},
{5077,      388,      "Veh_TurnOnOffSFSStruct",      "Flag",      "uint16"},
{5078,      388,      "Veh_TurnOnOffSFSStruct",      "HeaderCRC16",      "uint16"},
{5079,      388,      "Veh_TurnOnOffSFSStruct",      "UserID",      "uint32"},
{5080,      388,      "Veh_TurnOnOffSFSStruct",      "ReqTimeOut",      "uint32"},
{5081,      388,      "Veh_TurnOnOffSFSStruct",      "RequestPriority",      "uint8"},
{5082,      388,      "Veh_TurnOnOffSFSStruct",      "SequenceID",      "uint16"},
{5083,      388,      "Veh_TurnOnOffSFSStruct",      "ServiceExecuteFeedbackFlag",      "uint8"},
{5084,      388,      "Veh_TurnOnOffSFSStruct",      "Options",      "uint32"},
{5085,      388,      "Veh_TurnOnOffSFSStruct",      "Veh_TurnOnOffSFS",      "uint8"},
{5086,      388,      "Veh_TurnOnOffSFSStruct",      "Time",      "uint16"},
{5087,      388,      "Veh_TurnOnOffSFSStruct",      "MemoryReq",      "uint8"},
{5088,      388,      "Veh_TurnOnOffSFSRespStruct",      "RespCode",      "uint32"},
{5089,      388,      "Veh_TurnOnOffSFSRespStruct",      "Veh_TurnOnOffSFSNRC",      "uint32"},
{5090,      389,      "Veh_SetSFSChanelStruct",      "SOAProtocolVersion",      "uint8"},
{5091,      389,      "Veh_SetSFSChanelStruct",      "SOAHeaderType",      "uint8"},
{5092,      389,      "Veh_SetSFSChanelStruct",      "SOAHeaderLength",      "uint16"},
{5093,      389,      "Veh_SetSFSChanelStruct",      "Flag",      "uint16"},
{5094,      389,      "Veh_SetSFSChanelStruct",      "HeaderCRC16",      "uint16"},
{5095,      389,      "Veh_SetSFSChanelStruct",      "UserID",      "uint32"},
{5096,      389,      "Veh_SetSFSChanelStruct",      "ReqTimeOut",      "uint32"},
{5097,      389,      "Veh_SetSFSChanelStruct",      "RequestPriority",      "uint8"},
{5098,      389,      "Veh_SetSFSChanelStruct",      "SequenceID",      "uint16"},
{5099,      389,      "Veh_SetSFSChanelStruct",      "ServiceExecuteFeedbackFlag",      "uint8"},
{5100,      389,      "Veh_SetSFSChanelStruct",      "Options",      "uint32"},
{5101,      389,      "Veh_SetSFSChanelStruct",      "Veh_SetSFSChanel",      "uint8"},
{5102,      389,      "Veh_SetSFSChanelStruct",      "MemoryReq",      "uint8"},
{5103,      389,      "Veh_SetSFSChanelRespStruct",      "RespCode",      "uint32"},
{5104,      389,      "Veh_SetSFSChanelRespStruct",      "Veh_SetSFSChanelNRC",      "uint32"},
{5105,      390,      "Veh_SetSFSConStruct",      "SOAProtocolVersion",      "uint8"},
{5106,      390,      "Veh_SetSFSConStruct",      "SOAHeaderType",      "uint8"},
{5107,      390,      "Veh_SetSFSConStruct",      "SOAHeaderLength",      "uint16"},
{5108,      390,      "Veh_SetSFSConStruct",      "Flag",      "uint16"},
{5109,      390,      "Veh_SetSFSConStruct",      "HeaderCRC16",      "uint16"},
{5110,      390,      "Veh_SetSFSConStruct",      "UserID",      "uint32"},
{5111,      390,      "Veh_SetSFSConStruct",      "ReqTimeOut",      "uint32"},
{5112,      390,      "Veh_SetSFSConStruct",      "RequestPriority",      "uint8"},
{5113,      390,      "Veh_SetSFSConStruct",      "SequenceID",      "uint16"},
{5114,      390,      "Veh_SetSFSConStruct",      "ServiceExecuteFeedbackFlag",      "uint8"},
{5115,      390,      "Veh_SetSFSConStruct",      "Options",      "uint32"},
{5116,      390,      "Veh_SetSFSConStruct",      "Veh_SetSFSCon",      "uint8"},
{5117,      390,      "Veh_SetSFSConStruct",      "MemoryReq",      "uint8"},
{5118,      390,      "Veh_SetSFSConRespStruct",      "RespCode",      "uint32"},
{5119,      390,      "Veh_SetSFSConRespStruct",      "Veh_SetSFSConNRC",      "uint32"},
{5120,      391,      "Veh_SFSCh1ResetRqStruct",      "SOAProtocolVersion",      "uint8"},
{5121,      391,      "Veh_SFSCh1ResetRqStruct",      "SOAHeaderType",      "uint8"},
{5122,      391,      "Veh_SFSCh1ResetRqStruct",      "SOAHeaderLength",      "uint16"},
{5123,      391,      "Veh_SFSCh1ResetRqStruct",      "Flag",      "uint16"},
{5124,      391,      "Veh_SFSCh1ResetRqStruct",      "HeaderCRC16",      "uint16"},
{5125,      391,      "Veh_SFSCh1ResetRqStruct",      "UserID",      "uint32"},
{5126,      391,      "Veh_SFSCh1ResetRqStruct",      "ReqTimeOut",      "uint32"},
{5127,      391,      "Veh_SFSCh1ResetRqStruct",      "RequestPriority",      "uint8"},
{5128,      391,      "Veh_SFSCh1ResetRqStruct",      "SequenceID",      "uint16"},
{5129,      391,      "Veh_SFSCh1ResetRqStruct",      "ServiceExecuteFeedbackFlag",      "uint8"},
{5130,      391,      "Veh_SFSCh1ResetRqStruct",      "Options",      "uint32"},
{5131,      391,      "Veh_SFSCh1ResetRqStruct",      "Veh_SFSCh1ResetRq",      "uint8"},
{5132,      391,      "Veh_SFSCh1ResetRqRespStruct",      "RespCode",      "uint32"},
{5133,      391,      "Veh_SFSCh1ResetRqRespStruct",      "Veh_SFSCh1ResetRqNRC",      "uint32"},
{5134,      392,      "Veh_SFSCh2ResetRqStruct",      "SOAProtocolVersion",      "uint8"},
{5135,      392,      "Veh_SFSCh2ResetRqStruct",      "SOAHeaderType",      "uint8"},
{5136,      392,      "Veh_SFSCh2ResetRqStruct",      "SOAHeaderLength",      "uint16"},
{5137,      392,      "Veh_SFSCh2ResetRqStruct",      "Flag",      "uint16"},
{5138,      392,      "Veh_SFSCh2ResetRqStruct",      "HeaderCRC16",      "uint16"},
{5139,      392,      "Veh_SFSCh2ResetRqStruct",      "UserID",      "uint32"},
{5140,      392,      "Veh_SFSCh2ResetRqStruct",      "ReqTimeOut",      "uint32"},
{5141,      392,      "Veh_SFSCh2ResetRqStruct",      "RequestPriority",      "uint8"},
{5142,      392,      "Veh_SFSCh2ResetRqStruct",      "SequenceID",      "uint16"},
{5143,      392,      "Veh_SFSCh2ResetRqStruct",      "ServiceExecuteFeedbackFlag",      "uint8"},
{5144,      392,      "Veh_SFSCh2ResetRqStruct",      "Options",      "uint32"},
{5145,      392,      "Veh_SFSCh2ResetRqStruct",      "Veh_SFSCh2ResetRq",      "uint8"},
{5146,      392,      "Veh_SFSCh2ResetRqRespStruct",      "RespCode",      "uint32"},
{5147,      392,      "Veh_SFSCh2ResetRqRespStruct",      "Veh_SFSCh2ResetRqNRC",      "uint32"},
{5148,      393,      "Veh_SFSCh3ResetRqStruct",      "SOAProtocolVersion",      "uint8"},
{5149,      393,      "Veh_SFSCh3ResetRqStruct",      "SOAHeaderType",      "uint8"},
{5150,      393,      "Veh_SFSCh3ResetRqStruct",      "SOAHeaderLength",      "uint16"},
{5151,      393,      "Veh_SFSCh3ResetRqStruct",      "Flag",      "uint16"},
{5152,      393,      "Veh_SFSCh3ResetRqStruct",      "HeaderCRC16",      "uint16"},
{5153,      393,      "Veh_SFSCh3ResetRqStruct",      "UserID",      "uint32"},
{5154,      393,      "Veh_SFSCh3ResetRqStruct",      "ReqTimeOut",      "uint32"},
{5155,      393,      "Veh_SFSCh3ResetRqStruct",      "RequestPriority",      "uint8"},
{5156,      393,      "Veh_SFSCh3ResetRqStruct",      "SequenceID",      "uint16"},
{5157,      393,      "Veh_SFSCh3ResetRqStruct",      "ServiceExecuteFeedbackFlag",      "uint8"},
{5158,      393,      "Veh_SFSCh3ResetRqStruct",      "Options",      "uint32"},
{5159,      393,      "Veh_SFSCh3ResetRqStruct",      "Veh_SFSCh3ResetRq",      "uint8"},
{5160,      393,      "Veh_SFSCh3ResetRqRespStruct",      "RespCode",      "uint32"},
{5161,      393,      "Veh_SFSCh3ResetRqRespStruct",      "Veh_SFSCh3ResetRqNRC",      "uint32"},
{5162,      394,      "Veh_FrontMirrorHeatService_ErrStruct",      "SequenceID",      "uint16"},
{5163,      394,      "Veh_FrontMirrorHeatService_ErrStruct",      "Options_8bit",      "uint8"},
{5164,      394,      "Veh_FrontMirrorHeatService_ErrStruct",      "Options_8bit2",      "uint8"},
{5165,      394,      "Veh_FrontMirrorHeatService_ErrStruct",      "UserID",      "uint32"},
{5166,      394,      "Veh_FrontMirrorHeatService_ErrStruct",      "OpeNRC",      "uint32"},
{5167,      394,      "Veh_FrontMirrorHeatService_ErrStruct",      "OpeErrInfo",      "string[16]"},
{5168,      395,      "Veh_FrontMirrorHeatStruct",      "SOAProtocolVersion",      "uint8"},
{5169,      395,      "Veh_FrontMirrorHeatStruct",      "SOAHeaderType",      "uint8"},
{5170,      395,      "Veh_FrontMirrorHeatStruct",      "SOAHeaderLength",      "uint16"},
{5171,      395,      "Veh_FrontMirrorHeatStruct",      "Flag",      "uint16"},
{5172,      395,      "Veh_FrontMirrorHeatStruct",      "HeaderCRC16",      "uint16"},
{5173,      395,      "Veh_FrontMirrorHeatStruct",      "UserID",      "uint32"},
{5174,      395,      "Veh_FrontMirrorHeatStruct",      "ReqTimeOut",      "uint32"},
{5175,      395,      "Veh_FrontMirrorHeatStruct",      "RequestPriority",      "uint8"},
{5176,      395,      "Veh_FrontMirrorHeatStruct",      "SequenceID",      "uint16"},
{5177,      395,      "Veh_FrontMirrorHeatStruct",      "ServiceExecuteFeedbackFlag",      "uint8"},
{5178,      395,      "Veh_FrontMirrorHeatStruct",      "Options",      "uint32"},
{5179,      395,      "Veh_FrontMirrorHeatStruct",      "Veh_FrontMirrorHeat",      "uint8"},
{5180,      395,      "Veh_FrontMirrorHeatRespStruct",      "RespCode",      "uint32"},
{5181,      395,      "Veh_FrontMirrorHeatRespStruct",      "Veh_FrontMirrorHeatNRC",      "uint32"},
{5182,      396,      "Veh_BodySts_DoorStruct",      "Veh_AlarmSt",      "uint8"},
{5183,      396,      "Veh_BodySts_DoorStruct",      "Veh_DriverDoorAjarSt",      "uint8"},
{5184,      396,      "Veh_BodySts_DoorStruct",      "Veh_PsngrDoorAjarSt",      "uint8"},
{5185,      396,      "Veh_BodySts_DoorStruct",      "Veh_RLDoorAjarSt",      "uint8"},
{5186,      396,      "Veh_BodySts_DoorStruct",      "Veh_RRDoorAjarSt",      "uint8"},
{5187,      396,      "Veh_BodySts_DoorStruct",      "Veh_BonnetAjarSt",      "uint8"},
{5188,      396,      "Veh_BodySts_DoorStruct",      "Veh_TailgateSt",      "uint8"},
{5189,      396,      "Veh_BodySts_DoorStruct",      "Veh_LockLogicSt",      "uint8"},
{5190,      396,      "Veh_BodySts_DoorStruct",      "Veh_DriveLockOrHandleSt",      "uint8"},
{5191,      396,      "Veh_BodySts_DoorStruct",      "Veh_PsngrHandleSt",      "uint8"},
{5192,      396,      "Veh_BodySts_DoorStruct",      "Veh_RLHandleSt",      "uint8"},
{5193,      396,      "Veh_BodySts_DoorStruct",      "Veh_RRHandleSt",      "uint8"},
{5194,      397,      "Veh_BodySts_PwrStruct",      "Veh_PowerMode",      "uint8"},
{5195,      397,      "Veh_BodySts_PwrStruct",      "Veh_PowerDistributionMode",      "uint8"},
{5196,      397,      "Veh_BodySts_PwrStruct",      "Veh_GWDiagnosticSt",      "uint8"},
{5197,      397,      "Veh_BodySts_PwrStruct",      "Veh_VehicleMode",      "uint8"},
{5198,      397,      "Veh_BodySts_PwrStruct",      "Veh_EVSysReadySt",      "uint8"},
{5199,      397,      "Veh_BodySts_PwrStruct",      "Veh_CurrentGearLev",      "uint8"},
{5200,      398,      "Veh_BodySts_SeatStruct",      "Veh_DrvSeatOccupancySt",      "uint8"},
{5201,      398,      "Veh_BodySts_SeatStruct",      "Veh_PsngrSeatOccupancySt",      "uint8"},
{5202,      398,      "Veh_BodySts_SeatStruct",      "Veh_SecRowLtSeatOccupancySt",      "uint8"},
{5203,      398,      "Veh_BodySts_SeatStruct",      "Veh_SecRowMidSeatOccupancySt",      "uint8"},
{5204,      398,      "Veh_BodySts_SeatStruct",      "Veh_SecRowRtSeatOccupancySt",      "uint8"},
{5205,      398,      "Veh_BodySts_SeatStruct",      "Veh_TrdRowLtSeatOccupancySt",      "uint8"},
{5206,      398,      "Veh_BodySts_SeatStruct",      "Veh_TrdRowMidSeatOccupancySt",      "uint8"},
{5207,      398,      "Veh_BodySts_SeatStruct",      "Veh_TrdRowRtSeatOccupancySt",      "uint8"},
{5208,      398,      "Veh_BodySts_SeatStruct",      "Veh_DrvSeatBeltBuckleSt",      "uint8"},
{5209,      398,      "Veh_BodySts_SeatStruct",      "Veh_PsngrSeatBeltBuckleSt",      "uint8"},
{5210,      398,      "Veh_BodySts_SeatStruct",      "Veh_SecRowLtSeatBeltBuckleSt",      "uint8"},
{5211,      398,      "Veh_BodySts_SeatStruct",      "Veh_SecRowMidSeatBeltBuckleSt",      "uint8"},
{5212,      398,      "Veh_BodySts_SeatStruct",      "Veh_SecRowRtSeatBeltBuckleSt",      "uint8"},
{5213,      398,      "Veh_BodySts_SeatStruct",      "Veh_TrdRowLtSeatBeltBuckleSt",      "uint8"},
{5214,      398,      "Veh_BodySts_SeatStruct",      "Veh_TrdRowMidSeatBeltBuckleSt",      "uint8"},
{5215,      398,      "Veh_BodySts_SeatStruct",      "Veh_TrdRowRtSeatBeltBuckleSt",      "uint8"},
{5216,      399,      "Veh_BodySts5_PowertrainStruct",      "Veh_VehSpdVD",      "uint8"},
{5217,      399,      "Veh_BodySts5_PowertrainStruct",      "Veh_VehSpd",      "float32"},
{5218,      399,      "Veh_BodySts5_PowertrainStruct",      "Veh_dstBatDisp",      "float32"},
{5219,      399,      "Veh_BodySts5_PowertrainStruct",      "Veh_BMS_SOC_Disp",      "float32"},
{5220,      400,      "SOAEngineInterSignalStruct",      "SOAEngineHVPowerReq",      "uint8"},
{5221,      400,      "SOAEngineInterSignalStruct",      "HVACHVReq",      "uint8"},
{5222,      400,      "SOAEngineInterSignalStruct",      "FrontMirrorHeatHVReq",      "uint8"},
{5223,      400,      "SOAEngineInterSignalStruct",      "RearMirrorHeatHVReq",      "uint8"},
{5224,      400,      "SOAEngineInterSignalStruct",      "SFSHVReq",      "uint8"},
{5225,      400,      "SOAEngineInterSignalStruct",      "SWSHeatHVreq",      "uint8"},
{5226,      400,      "SOAEngineInterSignalStruct",      "SeatVentilationHVReq",      "uint8"},
{5227,      400,      "SOAEngineInterSignalStruct",      "SeatHeatHVReq",      "uint8"},
{5228,      400,      "SOAEngineInterSignalStruct",      "HVACTime",      "uint16"},
{5229,      400,      "SOAEngineInterSignalStruct",      "FrontMirrorHeatTime",      "uint16"},
{5230,      400,      "SOAEngineInterSignalStruct",      "RearMirrorHeatTime",      "uint16"},
{5231,      400,      "SOAEngineInterSignalStruct",      "SFSTime",      "uint16"},
{5232,      400,      "SOAEngineInterSignalStruct",      "SWSHeatTime",      "uint16"},
{5233,      400,      "SOAEngineInterSignalStruct",      "SeatVentilationTime",      "uint16"},
{5234,      400,      "SOAEngineInterSignalStruct",      "SeatHeatHVReqTime",      "uint16"},
{5235,      401,      "EntryExitService_ErrStruct",      "SequenceID",      "uint16"},
{5236,      401,      "EntryExitService_ErrStruct",      "Options_8bit",      "uint8"},
{5237,      401,      "EntryExitService_ErrStruct",      "Options_8bit2",      "uint8"},
{5238,      401,      "EntryExitService_ErrStruct",      "UserID",      "uint32"},
{5239,      401,      "EntryExitService_ErrStruct",      "OpeNRC",      "uint32"},
{5240,      401,      "EntryExitService_ErrStruct",      "OpeErrInfo",      "string[16]"},
{5241,      402,      "EntryExitCfgStStruct",      "UnlockHazardLightCfgFb",      "uint8"},
{5242,      402,      "EntryExitCfgStStruct",      "UnlockHornCfgFb",      "uint8"},
{5243,      402,      "EntryExitCfgStStruct",      "LockHazardLightCfgFb",      "uint8"},
{5244,      402,      "EntryExitCfgStStruct",      "LockHornCfgFb",      "uint8"},
{5245,      402,      "EntryExitCfgStStruct",      "PollingWelcomeCfgFb",      "uint8"},
{5246,      403,      "EntryExitFuncStStruct",      "PElockUnlockSt",      "uint8"},
{5247,      404,      "UnlockHazardLightSetStruct",      "SOAProtocolVersion",      "uint8"},
{5248,      404,      "UnlockHazardLightSetStruct",      "SOAHeaderType",      "uint8"},
{5249,      404,      "UnlockHazardLightSetStruct",      "SOAHeaderLength",      "uint16"},
{5250,      404,      "UnlockHazardLightSetStruct",      "Flag",      "uint16"},
{5251,      404,      "UnlockHazardLightSetStruct",      "HeaderCRC16",      "uint16"},
{5252,      404,      "UnlockHazardLightSetStruct",      "UserID",      "uint32"},
{5253,      404,      "UnlockHazardLightSetStruct",      "ReqTimeOut",      "uint32"},
{5254,      404,      "UnlockHazardLightSetStruct",      "RequestPriority",      "uint8"},
{5255,      404,      "UnlockHazardLightSetStruct",      "SequenceID",      "uint16"},
{5256,      404,      "UnlockHazardLightSetStruct",      "ServiceExecuteFeedbackFlag",      "uint8"},
{5257,      404,      "UnlockHazardLightSetStruct",      "Options",      "uint32"},
{5258,      404,      "UnlockHazardLightSetStruct",      "UnlockHazardLightCfg",      "uint8"},
{5259,      404,      "UnlockHazardLightSetRespStruct",      "RespCode",      "uint32"},
{5260,      404,      "UnlockHazardLightSetRespStruct",      "UnlockHazardLightSetNRC",      "uint32"},
{5261,      405,      "UnlockHornSetStruct",      "SOAProtocolVersion",      "uint8"},
{5262,      405,      "UnlockHornSetStruct",      "SOAHeaderType",      "uint8"},
{5263,      405,      "UnlockHornSetStruct",      "SOAHeaderLength",      "uint16"},
{5264,      405,      "UnlockHornSetStruct",      "Flag",      "uint16"},
{5265,      405,      "UnlockHornSetStruct",      "HeaderCRC16",      "uint16"},
{5266,      405,      "UnlockHornSetStruct",      "UserID",      "uint32"},
{5267,      405,      "UnlockHornSetStruct",      "ReqTimeOut",      "uint32"},
{5268,      405,      "UnlockHornSetStruct",      "RequestPriority",      "uint8"},
{5269,      405,      "UnlockHornSetStruct",      "SequenceID",      "uint16"},
{5270,      405,      "UnlockHornSetStruct",      "ServiceExecuteFeedbackFlag",      "uint8"},
{5271,      405,      "UnlockHornSetStruct",      "Options",      "uint32"},
{5272,      405,      "UnlockHornSetStruct",      "UnlockHornCfg",      "uint8"},
{5273,      405,      "UnlockHornSetRespStruct",      "RespCode",      "uint32"},
{5274,      405,      "UnlockHornSetRespStruct",      "UnlockHornSetNRC",      "uint32"},
{5275,      406,      "LockHazardLightSetStruct",      "SOAProtocolVersion",      "uint8"},
{5276,      406,      "LockHazardLightSetStruct",      "SOAHeaderType",      "uint8"},
{5277,      406,      "LockHazardLightSetStruct",      "SOAHeaderLength",      "uint16"},
{5278,      406,      "LockHazardLightSetStruct",      "Flag",      "uint16"},
{5279,      406,      "LockHazardLightSetStruct",      "HeaderCRC16",      "uint16"},
{5280,      406,      "LockHazardLightSetStruct",      "UserID",      "uint32"},
{5281,      406,      "LockHazardLightSetStruct",      "ReqTimeOut",      "uint32"},
{5282,      406,      "LockHazardLightSetStruct",      "RequestPriority",      "uint8"},
{5283,      406,      "LockHazardLightSetStruct",      "SequenceID",      "uint16"},
{5284,      406,      "LockHazardLightSetStruct",      "ServiceExecuteFeedbackFlag",      "uint8"},
{5285,      406,      "LockHazardLightSetStruct",      "Options",      "uint32"},
{5286,      406,      "LockHazardLightSetStruct",      "LockHazardLightCfg",      "uint8"},
{5287,      406,      "LockHazardLightSetRespStruct",      "RespCode",      "uint32"},
{5288,      406,      "LockHazardLightSetRespStruct",      "LockHazardLightSetNRC",      "uint32"},
{5289,      407,      "LockHornSetStruct",      "SOAProtocolVersion",      "uint8"},
{5290,      407,      "LockHornSetStruct",      "SOAHeaderType",      "uint8"},
{5291,      407,      "LockHornSetStruct",      "SOAHeaderLength",      "uint16"},
{5292,      407,      "LockHornSetStruct",      "Flag",      "uint16"},
{5293,      407,      "LockHornSetStruct",      "HeaderCRC16",      "uint16"},
{5294,      407,      "LockHornSetStruct",      "UserID",      "uint32"},
{5295,      407,      "LockHornSetStruct",      "ReqTimeOut",      "uint32"},
{5296,      407,      "LockHornSetStruct",      "RequestPriority",      "uint8"},
{5297,      407,      "LockHornSetStruct",      "SequenceID",      "uint16"},
{5298,      407,      "LockHornSetStruct",      "ServiceExecuteFeedbackFlag",      "uint8"},
{5299,      407,      "LockHornSetStruct",      "Options",      "uint32"},
{5300,      407,      "LockHornSetStruct",      "LockHornCfg",      "uint8"},
{5301,      407,      "LockHornSetRespStruct",      "RespCode",      "uint32"},
{5302,      407,      "LockHornSetRespStruct",      "LockHornSetNRC",      "uint32"},
{5303,      408,      "PollingWelcomeSetStruct",      "SOAProtocolVersion",      "uint8"},
{5304,      408,      "PollingWelcomeSetStruct",      "SOAHeaderType",      "uint8"},
{5305,      408,      "PollingWelcomeSetStruct",      "SOAHeaderLength",      "uint16"},
{5306,      408,      "PollingWelcomeSetStruct",      "Flag",      "uint16"},
{5307,      408,      "PollingWelcomeSetStruct",      "HeaderCRC16",      "uint16"},
{5308,      408,      "PollingWelcomeSetStruct",      "UserID",      "uint32"},
{5309,      408,      "PollingWelcomeSetStruct",      "ReqTimeOut",      "uint32"},
{5310,      408,      "PollingWelcomeSetStruct",      "RequestPriority",      "uint8"},
{5311,      408,      "PollingWelcomeSetStruct",      "SequenceID",      "uint16"},
{5312,      408,      "PollingWelcomeSetStruct",      "ServiceExecuteFeedbackFlag",      "uint8"},
{5313,      408,      "PollingWelcomeSetStruct",      "Options",      "uint32"},
{5314,      408,      "PollingWelcomeSetStruct",      "PollingWelcomeCfg",      "uint8"},
{5315,      408,      "PollingWelcomeSetRespStruct",      "RespCode",      "uint32"},
{5316,      408,      "PollingWelcomeSetRespStruct",      "PollingWelcomeSetNRC",      "uint32"},
{5317,      409,      "EntryExitPEFuncSetStruct",      "SOAProtocolVersion",      "uint8"},
{5318,      409,      "EntryExitPEFuncSetStruct",      "SOAHeaderType",      "uint8"},
{5319,      409,      "EntryExitPEFuncSetStruct",      "SOAHeaderLength",      "uint16"},
{5320,      409,      "EntryExitPEFuncSetStruct",      "Flag",      "uint16"},
{5321,      409,      "EntryExitPEFuncSetStruct",      "HeaderCRC16",      "uint16"},
{5322,      409,      "EntryExitPEFuncSetStruct",      "UserID",      "uint32"},
{5323,      409,      "EntryExitPEFuncSetStruct",      "ReqTimeOut",      "uint32"},
{5324,      409,      "EntryExitPEFuncSetStruct",      "RequestPriority",      "uint8"},
{5325,      409,      "EntryExitPEFuncSetStruct",      "SequenceID",      "uint16"},
{5326,      409,      "EntryExitPEFuncSetStruct",      "ServiceExecuteFeedbackFlag",      "uint8"},
{5327,      409,      "EntryExitPEFuncSetStruct",      "Options",      "uint32"},
{5328,      409,      "EntryExitPEFuncSetStruct",      "EntryExitPEFuncDisableReq",      "uint8"},
{5329,      409,      "EntryExitPEFuncSetRespStruct",      "RespCode",      "uint32"},
{5330,      409,      "EntryExitPEFuncSetRespStruct",      "EntryExitPEFuncSetNRC",      "uint32"},
{5331,      410,      "RWiperService_ErrStruct",      "SequenceID",      "uint16"},
{5332,      410,      "RWiperService_ErrStruct",      "Options_8bit",      "uint8"},
{5333,      410,      "RWiperService_ErrStruct",      "Options_8bit2",      "uint8"},
{5334,      410,      "RWiperService_ErrStruct",      "UserID",      "uint32"},
{5335,      410,      "RWiperService_ErrStruct",      "OpeNRC",      "uint32"},
{5336,      410,      "RWiperService_ErrStruct",      "OpeErrInfo",      "string[16]"},
{5337,      411,      "RWiperStStruct",      "RWiperWashSwSt",      "uint8"},
{5338,      411,      "RWiperStStruct",      "RWiperReturnSt",      "uint8"},
{5339,      411,      "RWiperStStruct",      "RWiperMotorOutputSt",      "uint8"},
{5340,      411,      "RWiperStStruct",      "RWiperServiceFB",      "uint8"},
{5341,      412,      "RWiperServiceCmdStruct",      "SOAProtocolVersion",      "uint8"},
{5342,      412,      "RWiperServiceCmdStruct",      "SOAHeaderType",      "uint8"},
{5343,      412,      "RWiperServiceCmdStruct",      "SOAHeaderLength",      "uint16"},
{5344,      412,      "RWiperServiceCmdStruct",      "Flag",      "uint16"},
{5345,      412,      "RWiperServiceCmdStruct",      "HeaderCRC16",      "uint16"},
{5346,      412,      "RWiperServiceCmdStruct",      "UserID",      "uint32"},
{5347,      412,      "RWiperServiceCmdStruct",      "ReqTimeOut",      "uint32"},
{5348,      412,      "RWiperServiceCmdStruct",      "RequestPriority",      "uint8"},
{5349,      412,      "RWiperServiceCmdStruct",      "SequenceID",      "uint16"},
{5350,      412,      "RWiperServiceCmdStruct",      "ServiceExecuteFeedbackFlag",      "uint8"},
{5351,      412,      "RWiperServiceCmdStruct",      "Options",      "uint32"},
{5352,      412,      "RWiperServiceCmdStruct",      "RWiperServiceCmd",      "uint8"},
{5353,      412,      "RWiperServiceCmdRespStruct",      "RespCode",      "uint32"},
{5354,      412,      "RWiperServiceCmdRespStruct",      "RWiperServiceCmdNRC",      "uint32"},
{5355,      413,      "LeadAcidbattState1Struct",      "LVCharReqEnable",      "uint8"},
{5356,      413,      "LeadAcidbattState1Struct",      "LVCharSt",      "uint8"},
{5357,      413,      "LeadAcidbattState1Struct",      "LVCharSuccCount",      "uint8"},
{5358,      413,      "LeadAcidbattState1Struct",      "LVCharFailCount",      "uint8"},
{5359,      413,      "LeadAcidbattState1Struct",      "LVCharSource",      "uint8"},
{5360,      413,      "LeadAcidbattState1Struct",      "LDCU_BattSOCSate",      "uint8"},
{5361,      414,      "LeadAcidbattState2Struct",      "EBSBattSOC",      "float32"},
{5362,      414,      "LeadAcidbattState2Struct",      "EBSBattVolt",      "float32"},
{5363,      414,      "LeadAcidbattState2Struct",      "EBSBattCurr",      "float32"},
{5364,      414,      "LeadAcidbattState2Struct",      "EBS_T_BATT",      "float32"},
{5365,      414,      "LeadAcidbattState2Struct",      "LDCUI_V_KL30Volt",      "float32"},
{5366,      415,      "LithiumIonbattState1Struct",      "LBMS_LVCharReq",      "uint8"},
{5367,      415,      "LithiumIonbattState1Struct",      "LBMS_LVBatWorkSt",      "uint8"},
{5368,      415,      "LithiumIonbattState1Struct",      "LBMS_ChrgMode",      "uint8"},
{5369,      415,      "LithiumIonbattState1Struct",      "LBMS_DisChrgMosSt",      "uint8"},
{5370,      415,      "LithiumIonbattState1Struct",      "LBMS_ChrgMosSt",      "uint8"},
{5371,      415,      "LithiumIonbattState1Struct",      "LBMS_LockElecPreWarning",      "uint8"},
{5372,      415,      "LithiumIonbattState1Struct",      "LBMS_DisChrgMosSt",      "uint8"},
{5373,      415,      "LithiumIonbattState1Struct",      "LBMS_PackMode",      "uint8"},
{5374,      416,      "LithiumIonbattState2Struct",      "LBMS_SOC",      "float32"},
{5375,      416,      "LithiumIonbattState2Struct",      "LBMS_SOE",      "float32"},
{5376,      416,      "LithiumIonbattState2Struct",      "LBMS_SOH",      "float32"},
{5377,      416,      "LithiumIonbattState2Struct",      "LBMS_PackInternalVoltage",      "float32"},
{5378,      416,      "LithiumIonbattState2Struct",      "LBMS_PackExternalVoltage",      "float32"},
{5379,      416,      "LithiumIonbattState2Struct",      "LBMS_PackCurrent",      "float32"},
{5380,      416,      "LithiumIonbattState2Struct",      "LBMS_RequestChrgVoltage",      "float32"},
{5381,      416,      "LithiumIonbattState2Struct",      "LBMS_SOCCharReqSuccCount",      "float32"},
{5382,      416,      "LithiumIonbattState2Struct",      "LBMS_SOCCharReqFailCount",      "float32"},
{5383,      416,      "LithiumIonbattState2Struct",      "LBMS_VoltCharReqSuccCount",      "float32"},
{5384,      416,      "LithiumIonbattState2Struct",      "LBMS_VoltCharReqFailCount",      "float32"},
{5385,      417,      "LithiumIonbattState3Struct",      "LBMS_PackOvTempFault",      "uint8"},
{5386,      417,      "LithiumIonbattState3Struct",      "LBMS_PackUnTempFault",      "uint8"},
{5387,      417,      "LithiumIonbattState3Struct",      "LBMS_CellUnVoltFault",      "uint8"},
{5388,      417,      "LithiumIonbattState3Struct",      "LBMS_CellOvVoltFault",      "uint8"},
{5389,      417,      "LithiumIonbattState3Struct",      "LBMS_PackUnVoltFault",      "uint8"},
{5390,      417,      "LithiumIonbattState3Struct",      "LBMS_PackOvVoltFault",      "uint8"},
{5391,      417,      "LithiumIonbattState3Struct",      "LBMS_DischrgOvCurrentFault",      "uint8"},
{5392,      417,      "LithiumIonbattState3Struct",      "LBMS_ChrgOvCurrentFault",      "uint8"},
{5393,      417,      "LithiumIonbattState3Struct",      "LBMS_PackTempDiffFault",      "uint8"},
{5394,      417,      "LithiumIonbattState3Struct",      "LBMS_CellVoltDiffFault",      "uint8"},
{5395,      417,      "LithiumIonbattState3Struct",      "LBMS_LTempSocLowFault",      "uint8"},
{5396,      417,      "LithiumIonbattState3Struct",      "LBMS_CommFail",      "uint8"},
{5397,      417,      "LithiumIonbattState3Struct",      "LBMS_NtcFault",      "uint8"},
{5398,      417,      "LithiumIonbattState3Struct",      "LDCU_MonLBMSCommuSt",      "uint8"},
{5399,      417,      "LithiumIonbattState3Struct",      "LBMS_RelayFault",      "uint8"},
{5400,      417,      "LithiumIonbattState3Struct",      "LBMS_SensorFault",      "uint8"},
{5401,      417,      "LithiumIonbattState3Struct",      "LBMS_CurrentVoltageFault",      "uint8"},
{5402,      417,      "LithiumIonbattState3Struct",      "LBMS_ChargeFault",      "uint8"},
{5403,      417,      "LithiumIonbattState3Struct",      "LBMS_MOSDisconnectionReason",      "uint8"},
{5404,      417,      "LithiumIonbattState3Struct",      "LBMS_LVBatFaultSt",      "uint8"},
{5405,      418,      "InteriorLightService_ErrStruct",      "SequenceID",      "uint16"},
{5406,      418,      "InteriorLightService_ErrStruct",      "Options_8bit",      "uint8"},
{5407,      418,      "InteriorLightService_ErrStruct",      "Options_8bit2",      "uint8"},
{5408,      418,      "InteriorLightService_ErrStruct",      "UserID",      "uint32"},
{5409,      418,      "InteriorLightService_ErrStruct",      "OpeNRC",      "uint32"},
{5410,      418,      "InteriorLightService_ErrStruct",      "OpeErrInfo",      "string[16]"},
{5411,      419,      "InteriorLightState1Struct",      "DomeLightModeFb",      "uint8"},
{5412,      419,      "InteriorLightState1Struct",      "DomelightBrightCfgFb",      "uint8"},
{5413,      419,      "InteriorLightState1Struct",      "FLDomeLightOnRes",      "uint8"},
{5414,      419,      "InteriorLightState1Struct",      "FRDomeLightOnRes",      "uint8"},
{5415,      419,      "InteriorLightState1Struct",      "RLDomeLightOnRes",      "uint8"},
{5416,      419,      "InteriorLightState1Struct",      "RRDomeLightOnRes",      "uint8"},
{5417,      419,      "InteriorLightState1Struct",      "TLDomeLightOnRes",      "uint8"},
{5418,      419,      "InteriorLightState1Struct",      "TRDomeLightOnRes",      "uint8"},
{5419,      419,      "InteriorLightState1Struct",      "FLDomeLightOffRes",      "uint8"},
{5420,      419,      "InteriorLightState1Struct",      "FRDomeLightOffRes",      "uint8"},
{5421,      419,      "InteriorLightState1Struct",      "RLDomeLightOffRes",      "uint8"},
{5422,      419,      "InteriorLightState1Struct",      "RRDomeLightOffRes",      "uint8"},
{5423,      419,      "InteriorLightState1Struct",      "TLDomeLightOffRes",      "uint8"},
{5424,      419,      "InteriorLightState1Struct",      "TRDomeLightOffRes",      "uint8"},
{5425,      419,      "InteriorLightState1Struct",      "FLDomeLightSwSt",      "uint8"},
{5426,      419,      "InteriorLightState1Struct",      "FRDomeLightSwSt",      "uint8"},
{5427,      419,      "InteriorLightState1Struct",      "RLDomeLightSwSt",      "uint8"},
{5428,      419,      "InteriorLightState1Struct",      "RRDomeLightSwSt",      "uint8"},
{5429,      419,      "InteriorLightState1Struct",      "TLDomeLightSwSt",      "uint8"},
{5430,      419,      "InteriorLightState1Struct",      "TRDomeLightSwSt",      "uint8"},
{5431,      419,      "InteriorLightState1Struct",      "FLDomeLightOutput",      "uint8"},
{5432,      419,      "InteriorLightState1Struct",      "FRDomeLightOutput",      "uint8"},
{5433,      419,      "InteriorLightState1Struct",      "RLDomeLightOutput",      "uint8"},
{5434,      419,      "InteriorLightState1Struct",      "RRDomeLightOutput",      "uint8"},
{5435,      419,      "InteriorLightState1Struct",      "TLDomeLightOutput",      "uint8"},
{5436,      419,      "InteriorLightState1Struct",      "TRDomeLightOutput",      "uint8"},
{5437,      419,      "InteriorLightState1Struct",      "FDomeLightOutput",      "uint8"},
{5438,      419,      "InteriorLightState1Struct",      "TrunkLightOutput",      "uint8"},
{5439,      419,      "InteriorLightState1Struct",      "LBackLightOutput",      "uint8"},
{5440,      419,      "InteriorLightState1Struct",      "RBackLightOutput",      "uint8"},
{5441,      419,      "InteriorLightState1Struct",      "LFootlightoutput",      "uint8"},
{5442,      419,      "InteriorLightState1Struct",      "RFootlightoutput",      "uint8"},
{5443,      420,      "SetDomeLightModeStruct",      "SOAProtocolVersion",      "uint8"},
{5444,      420,      "SetDomeLightModeStruct",      "SOAHeaderType",      "uint8"},
{5445,      420,      "SetDomeLightModeStruct",      "SOAHeaderLength",      "uint16"},
{5446,      420,      "SetDomeLightModeStruct",      "Flag",      "uint16"},
{5447,      420,      "SetDomeLightModeStruct",      "HeaderCRC16",      "uint16"},
{5448,      420,      "SetDomeLightModeStruct",      "UserID",      "uint32"},
{5449,      420,      "SetDomeLightModeStruct",      "ReqTimeOut",      "uint32"},
{5450,      420,      "SetDomeLightModeStruct",      "RequestPriority",      "uint8"},
{5451,      420,      "SetDomeLightModeStruct",      "SequenceID",      "uint16"},
{5452,      420,      "SetDomeLightModeStruct",      "ServiceExecuteFeedbackFlag",      "uint8"},
{5453,      420,      "SetDomeLightModeStruct",      "Options",      "uint32"},
{5454,      420,      "SetDomeLightModeStruct",      "DomeLightModeCfg",      "uint8"},
{5455,      420,      "SetDomeLightModeRespStruct",      "RespCode",      "uint32"},
{5456,      420,      "SetDomeLightModeRespStruct",      "SetDomeLightModeNRC",      "uint32"},
{5457,      421,      "SetDomeLightBrightStruct",      "SOAProtocolVersion",      "uint8"},
{5458,      421,      "SetDomeLightBrightStruct",      "SOAHeaderType",      "uint8"},
{5459,      421,      "SetDomeLightBrightStruct",      "SOAHeaderLength",      "uint16"},
{5460,      421,      "SetDomeLightBrightStruct",      "Flag",      "uint16"},
{5461,      421,      "SetDomeLightBrightStruct",      "HeaderCRC16",      "uint16"},
{5462,      421,      "SetDomeLightBrightStruct",      "UserID",      "uint32"},
{5463,      421,      "SetDomeLightBrightStruct",      "ReqTimeOut",      "uint32"},
{5464,      421,      "SetDomeLightBrightStruct",      "RequestPriority",      "uint8"},
{5465,      421,      "SetDomeLightBrightStruct",      "SequenceID",      "uint16"},
{5466,      421,      "SetDomeLightBrightStruct",      "ServiceExecuteFeedbackFlag",      "uint8"},
{5467,      421,      "SetDomeLightBrightStruct",      "Options",      "uint32"},
{5468,      421,      "SetDomeLightBrightStruct",      "DomelightBrightCfg",      "uint8"},
{5469,      421,      "SetDomeLightBrightRespStruct",      "RespCode",      "uint32"},
{5470,      421,      "SetDomeLightBrightRespStruct",      "SetDomeLightBrightNRC",      "uint32"},
{5471,      422,      "DomeLightCtrlStruct",      "SOAProtocolVersion",      "uint8"},
{5472,      422,      "DomeLightCtrlStruct",      "SOAHeaderType",      "uint8"},
{5473,      422,      "DomeLightCtrlStruct",      "SOAHeaderLength",      "uint16"},
{5474,      422,      "DomeLightCtrlStruct",      "Flag",      "uint16"},
{5475,      422,      "DomeLightCtrlStruct",      "HeaderCRC16",      "uint16"},
{5476,      422,      "DomeLightCtrlStruct",      "UserID",      "uint32"},
{5477,      422,      "DomeLightCtrlStruct",      "ReqTimeOut",      "uint32"},
{5478,      422,      "DomeLightCtrlStruct",      "RequestPriority",      "uint8"},
{5479,      422,      "DomeLightCtrlStruct",      "SequenceID",      "uint16"},
{5480,      422,      "DomeLightCtrlStruct",      "ServiceExecuteFeedbackFlag",      "uint8"},
{5481,      422,      "DomeLightCtrlStruct",      "Options",      "uint32"},
{5482,      422,      "DomeLightCtrlStruct",      "DomeLightCmd",      "uint8"},
{5483,      422,      "DomeLightCtrlRespStruct",      "RespCode",      "uint32"},
{5484,      422,      "DomeLightCtrlRespStruct",      "DomeLightCtrlNRC",      "uint32"},
{5485,      423,      "FLDomeLightCtrlStruct",      "SOAProtocolVersion",      "uint8"},
{5486,      423,      "FLDomeLightCtrlStruct",      "SOAHeaderType",      "uint8"},
{5487,      423,      "FLDomeLightCtrlStruct",      "SOAHeaderLength",      "uint16"},
{5488,      423,      "FLDomeLightCtrlStruct",      "Flag",      "uint16"},
{5489,      423,      "FLDomeLightCtrlStruct",      "HeaderCRC16",      "uint16"},
{5490,      423,      "FLDomeLightCtrlStruct",      "UserID",      "uint32"},
{5491,      423,      "FLDomeLightCtrlStruct",      "ReqTimeOut",      "uint32"},
{5492,      423,      "FLDomeLightCtrlStruct",      "RequestPriority",      "uint8"},
{5493,      423,      "FLDomeLightCtrlStruct",      "SequenceID",      "uint16"},
{5494,      423,      "FLDomeLightCtrlStruct",      "ServiceExecuteFeedbackFlag",      "uint8"},
{5495,      423,      "FLDomeLightCtrlStruct",      "Options",      "uint32"},
{5496,      423,      "FLDomeLightCtrlStruct",      "FLDomeLightCmd",      "uint8"},
{5497,      423,      "FLDomeLightCtrlRespStruct",      "RespCode",      "uint32"},
{5498,      423,      "FLDomeLightCtrlRespStruct",      "FLDomeLightCtrlNRC",      "uint32"},
{5499,      424,      "FRDomeLightCtrlStruct",      "SOAProtocolVersion",      "uint8"},
{5500,      424,      "FRDomeLightCtrlStruct",      "SOAHeaderType",      "uint8"},
{5501,      424,      "FRDomeLightCtrlStruct",      "SOAHeaderLength",      "uint16"},
{5502,      424,      "FRDomeLightCtrlStruct",      "Flag",      "uint16"},
{5503,      424,      "FRDomeLightCtrlStruct",      "HeaderCRC16",      "uint16"},
{5504,      424,      "FRDomeLightCtrlStruct",      "UserID",      "uint32"},
{5505,      424,      "FRDomeLightCtrlStruct",      "ReqTimeOut",      "uint32"},
{5506,      424,      "FRDomeLightCtrlStruct",      "RequestPriority",      "uint8"},
{5507,      424,      "FRDomeLightCtrlStruct",      "SequenceID",      "uint16"},
{5508,      424,      "FRDomeLightCtrlStruct",      "ServiceExecuteFeedbackFlag",      "uint8"},
{5509,      424,      "FRDomeLightCtrlStruct",      "Options",      "uint32"},
{5510,      424,      "FRDomeLightCtrlStruct",      "FRDomeLightCmd",      "uint8"},
{5511,      424,      "FRDomeLightCtrlRespStruct",      "RespCode",      "uint32"},
{5512,      424,      "FRDomeLightCtrlRespStruct",      "FRDomeLightCtrlNRC",      "uint32"},
{5513,      425,      "RLDomeLightCtrlStruct",      "SOAProtocolVersion",      "uint8"},
{5514,      425,      "RLDomeLightCtrlStruct",      "SOAHeaderType",      "uint8"},
{5515,      425,      "RLDomeLightCtrlStruct",      "SOAHeaderLength",      "uint16"},
{5516,      425,      "RLDomeLightCtrlStruct",      "Flag",      "uint16"},
{5517,      425,      "RLDomeLightCtrlStruct",      "HeaderCRC16",      "uint16"},
{5518,      425,      "RLDomeLightCtrlStruct",      "UserID",      "uint32"},
{5519,      425,      "RLDomeLightCtrlStruct",      "ReqTimeOut",      "uint32"},
{5520,      425,      "RLDomeLightCtrlStruct",      "RequestPriority",      "uint8"},
{5521,      425,      "RLDomeLightCtrlStruct",      "SequenceID",      "uint16"},
{5522,      425,      "RLDomeLightCtrlStruct",      "ServiceExecuteFeedbackFlag",      "uint8"},
{5523,      425,      "RLDomeLightCtrlStruct",      "Options",      "uint32"},
{5524,      425,      "RLDomeLightCtrlStruct",      "RLDomeLightCmd",      "uint8"},
{5525,      425,      "RLDomeLightCtrlRespStruct",      "RespCode",      "uint32"},
{5526,      425,      "RLDomeLightCtrlRespStruct",      "RLDomeLightCtrlNRC",      "uint32"},
{5527,      426,      "RRDomeLightCtrlStruct",      "SOAProtocolVersion",      "uint8"},
{5528,      426,      "RRDomeLightCtrlStruct",      "SOAHeaderType",      "uint8"},
{5529,      426,      "RRDomeLightCtrlStruct",      "SOAHeaderLength",      "uint16"},
{5530,      426,      "RRDomeLightCtrlStruct",      "Flag",      "uint16"},
{5531,      426,      "RRDomeLightCtrlStruct",      "HeaderCRC16",      "uint16"},
{5532,      426,      "RRDomeLightCtrlStruct",      "UserID",      "uint32"},
{5533,      426,      "RRDomeLightCtrlStruct",      "ReqTimeOut",      "uint32"},
{5534,      426,      "RRDomeLightCtrlStruct",      "RequestPriority",      "uint8"},
{5535,      426,      "RRDomeLightCtrlStruct",      "SequenceID",      "uint16"},
{5536,      426,      "RRDomeLightCtrlStruct",      "ServiceExecuteFeedbackFlag",      "uint8"},
{5537,      426,      "RRDomeLightCtrlStruct",      "Options",      "uint32"},
{5538,      426,      "RRDomeLightCtrlStruct",      "RRDomeLightCmd",      "uint8"},
{5539,      426,      "RRDomeLightCtrlRespStruct",      "RespCode",      "uint32"},
{5540,      426,      "RRDomeLightCtrlRespStruct",      "RRDomeLightCtrlNRC",      "uint32"},
{5541,      427,      "TLDomeLightCtrlStruct",      "SOAProtocolVersion",      "uint8"},
{5542,      427,      "TLDomeLightCtrlStruct",      "SOAHeaderType",      "uint8"},
{5543,      427,      "TLDomeLightCtrlStruct",      "SOAHeaderLength",      "uint16"},
{5544,      427,      "TLDomeLightCtrlStruct",      "Flag",      "uint16"},
{5545,      427,      "TLDomeLightCtrlStruct",      "HeaderCRC16",      "uint16"},
{5546,      427,      "TLDomeLightCtrlStruct",      "UserID",      "uint32"},
{5547,      427,      "TLDomeLightCtrlStruct",      "ReqTimeOut",      "uint32"},
{5548,      427,      "TLDomeLightCtrlStruct",      "RequestPriority",      "uint8"},
{5549,      427,      "TLDomeLightCtrlStruct",      "SequenceID",      "uint16"},
{5550,      427,      "TLDomeLightCtrlStruct",      "ServiceExecuteFeedbackFlag",      "uint8"},
{5551,      427,      "TLDomeLightCtrlStruct",      "Options",      "uint32"},
{5552,      427,      "TLDomeLightCtrlStruct",      "TLDomeLightCmd",      "uint8"},
{5553,      427,      "TLDomeLightCtrlRespStruct",      "RespCode",      "uint32"},
{5554,      427,      "TLDomeLightCtrlRespStruct",      "TLDomeLightCtrlNRC",      "uint32"},
{5555,      428,      "TRDomeLightCtrlStruct",      "SOAProtocolVersion",      "uint8"},
{5556,      428,      "TRDomeLightCtrlStruct",      "SOAHeaderType",      "uint8"},
{5557,      428,      "TRDomeLightCtrlStruct",      "SOAHeaderLength",      "uint16"},
{5558,      428,      "TRDomeLightCtrlStruct",      "Flag",      "uint16"},
{5559,      428,      "TRDomeLightCtrlStruct",      "HeaderCRC16",      "uint16"},
{5560,      428,      "TRDomeLightCtrlStruct",      "UserID",      "uint32"},
{5561,      428,      "TRDomeLightCtrlStruct",      "ReqTimeOut",      "uint32"},
{5562,      428,      "TRDomeLightCtrlStruct",      "RequestPriority",      "uint8"},
{5563,      428,      "TRDomeLightCtrlStruct",      "SequenceID",      "uint16"},
{5564,      428,      "TRDomeLightCtrlStruct",      "ServiceExecuteFeedbackFlag",      "uint8"},
{5565,      428,      "TRDomeLightCtrlStruct",      "Options",      "uint32"},
{5566,      428,      "TRDomeLightCtrlStruct",      "TRDomeLightCmd",      "uint8"},
{5567,      428,      "TRDomeLightCtrlRespStruct",      "RespCode",      "uint32"},
{5568,      428,      "TRDomeLightCtrlRespStruct",      "TRDomeLightCtrlNRC",      "uint32"},
{5569,      429,      "TrunkLightCtrlStruct",      "SOAProtocolVersion",      "uint8"},
{5570,      429,      "TrunkLightCtrlStruct",      "SOAHeaderType",      "uint8"},
{5571,      429,      "TrunkLightCtrlStruct",      "SOAHeaderLength",      "uint16"},
{5572,      429,      "TrunkLightCtrlStruct",      "Flag",      "uint16"},
{5573,      429,      "TrunkLightCtrlStruct",      "HeaderCRC16",      "uint16"},
{5574,      429,      "TrunkLightCtrlStruct",      "UserID",      "uint32"},
{5575,      429,      "TrunkLightCtrlStruct",      "ReqTimeOut",      "uint32"},
{5576,      429,      "TrunkLightCtrlStruct",      "RequestPriority",      "uint8"},
{5577,      429,      "TrunkLightCtrlStruct",      "SequenceID",      "uint16"},
{5578,      429,      "TrunkLightCtrlStruct",      "ServiceExecuteFeedbackFlag",      "uint8"},
{5579,      429,      "TrunkLightCtrlStruct",      "Options",      "uint32"},
{5580,      429,      "TrunkLightCtrlStruct",      "TrunkLightCmd",      "uint8"},
{5581,      429,      "TrunkLightCtrlRespStruct",      "RespCode",      "uint32"},
{5582,      429,      "TrunkLightCtrlRespStruct",      "TrunkLightCtrlNRC",      "uint32"},
{5583,      430,      "FLFootLightCtrlStruct",      "SOAProtocolVersion",      "uint8"},
{5584,      430,      "FLFootLightCtrlStruct",      "SOAHeaderType",      "uint8"},
{5585,      430,      "FLFootLightCtrlStruct",      "SOAHeaderLength",      "uint16"},
{5586,      430,      "FLFootLightCtrlStruct",      "Flag",      "uint16"},
{5587,      430,      "FLFootLightCtrlStruct",      "HeaderCRC16",      "uint16"},
{5588,      430,      "FLFootLightCtrlStruct",      "UserID",      "uint32"},
{5589,      430,      "FLFootLightCtrlStruct",      "ReqTimeOut",      "uint32"},
{5590,      430,      "FLFootLightCtrlStruct",      "RequestPriority",      "uint8"},
{5591,      430,      "FLFootLightCtrlStruct",      "SequenceID",      "uint16"},
{5592,      430,      "FLFootLightCtrlStruct",      "ServiceExecuteFeedbackFlag",      "uint8"},
{5593,      430,      "FLFootLightCtrlStruct",      "Options",      "uint32"},
{5594,      430,      "FLFootLightCtrlStruct",      "FLFootLightCmd",      "uint8"},
{5595,      430,      "FLFootLightCtrlRespStruct",      "RespCode",      "uint32"},
{5596,      430,      "FLFootLightCtrlRespStruct",      "FLFootLightCtrlNRC",      "uint32"},
{5597,      431,      "FRFootLightCtrlStruct",      "SOAProtocolVersion",      "uint8"},
{5598,      431,      "FRFootLightCtrlStruct",      "SOAHeaderType",      "uint8"},
{5599,      431,      "FRFootLightCtrlStruct",      "SOAHeaderLength",      "uint16"},
{5600,      431,      "FRFootLightCtrlStruct",      "Flag",      "uint16"},
{5601,      431,      "FRFootLightCtrlStruct",      "HeaderCRC16",      "uint16"},
{5602,      431,      "FRFootLightCtrlStruct",      "UserID",      "uint32"},
{5603,      431,      "FRFootLightCtrlStruct",      "ReqTimeOut",      "uint32"},
{5604,      431,      "FRFootLightCtrlStruct",      "RequestPriority",      "uint8"},
{5605,      431,      "FRFootLightCtrlStruct",      "SequenceID",      "uint16"},
{5606,      431,      "FRFootLightCtrlStruct",      "ServiceExecuteFeedbackFlag",      "uint8"},
{5607,      431,      "FRFootLightCtrlStruct",      "Options",      "uint32"},
{5608,      431,      "FRFootLightCtrlStruct",      "FRFootLightCmd",      "uint8"},
{5609,      431,      "FRFootLightCtrlRespStruct",      "RespCode",      "uint32"},
{5610,      431,      "FRFootLightCtrlRespStruct",      "FRFootLightCtrlNRC",      "uint32"},
{5611,      432,      "WelCarpetLightService_ErrStruct",      "SequenceID",      "uint16"},
{5612,      432,      "WelCarpetLightService_ErrStruct",      "Options_8bit",      "uint8"},
{5613,      432,      "WelCarpetLightService_ErrStruct",      "Options_8bit2",      "uint8"},
{5614,      432,      "WelCarpetLightService_ErrStruct",      "UserID",      "uint32"},
{5615,      432,      "WelCarpetLightService_ErrStruct",      "OpeNRC",      "uint32"},
{5616,      432,      "WelCarpetLightService_ErrStruct",      "OpeErrInfo",      "string[16]"},
{5617,      433,      "WelCarpetLightState1Struct",      "WelCarpetLightCfgSt",      "uint8"},
{5618,      433,      "WelCarpetLightState1Struct",      "LWelLightBlanketOnRes",      "uint8"},
{5619,      433,      "WelCarpetLightState1Struct",      "RWelLightBlanketOnRes",      "uint8"},
{5620,      433,      "WelCarpetLightState1Struct",      "LWelLightBlanketOffRes",      "uint8"},
{5621,      433,      "WelCarpetLightState1Struct",      "RWelLightBlanketOffRes",      "uint8"},
{5622,      433,      "WelCarpetLightState1Struct",      "LWelLightBlanketOutput",      "uint8"},
{5623,      433,      "WelCarpetLightState1Struct",      "RWelLightBlanketOutput",      "uint8"},
{5624,      434,      "WelCarpetLightCfgStruct",      "SOAProtocolVersion",      "uint8"},
{5625,      434,      "WelCarpetLightCfgStruct",      "SOAHeaderType",      "uint8"},
{5626,      434,      "WelCarpetLightCfgStruct",      "SOAHeaderLength",      "uint16"},
{5627,      434,      "WelCarpetLightCfgStruct",      "Flag",      "uint16"},
{5628,      434,      "WelCarpetLightCfgStruct",      "HeaderCRC16",      "uint16"},
{5629,      434,      "WelCarpetLightCfgStruct",      "UserID",      "uint32"},
{5630,      434,      "WelCarpetLightCfgStruct",      "ReqTimeOut",      "uint32"},
{5631,      434,      "WelCarpetLightCfgStruct",      "RequestPriority",      "uint8"},
{5632,      434,      "WelCarpetLightCfgStruct",      "SequenceID",      "uint16"},
{5633,      434,      "WelCarpetLightCfgStruct",      "ServiceExecuteFeedbackFlag",      "uint8"},
{5634,      434,      "WelCarpetLightCfgStruct",      "Options",      "uint32"},
{5635,      434,      "WelCarpetLightCfgStruct",      "WelCarpetLightCfgCmd",      "uint8"},
{5636,      434,      "WelCarpetLightCfgRespStruct",      "RespCode",      "uint32"},
{5637,      434,      "WelCarpetLightCfgRespStruct",      "WelCarpetLightCfgNRC",      "uint32"},
{5638,      435,      "LWelCarpetLightCtrlStruct",      "SOAProtocolVersion",      "uint8"},
{5639,      435,      "LWelCarpetLightCtrlStruct",      "SOAHeaderType",      "uint8"},
{5640,      435,      "LWelCarpetLightCtrlStruct",      "SOAHeaderLength",      "uint16"},
{5641,      435,      "LWelCarpetLightCtrlStruct",      "Flag",      "uint16"},
{5642,      435,      "LWelCarpetLightCtrlStruct",      "HeaderCRC16",      "uint16"},
{5643,      435,      "LWelCarpetLightCtrlStruct",      "UserID",      "uint32"},
{5644,      435,      "LWelCarpetLightCtrlStruct",      "ReqTimeOut",      "uint32"},
{5645,      435,      "LWelCarpetLightCtrlStruct",      "RequestPriority",      "uint8"},
{5646,      435,      "LWelCarpetLightCtrlStruct",      "SequenceID",      "uint16"},
{5647,      435,      "LWelCarpetLightCtrlStruct",      "ServiceExecuteFeedbackFlag",      "uint8"},
{5648,      435,      "LWelCarpetLightCtrlStruct",      "Options",      "uint32"},
{5649,      435,      "LWelCarpetLightCtrlStruct",      "LWelCarpetLightCmd",      "uint8"},
{5650,      435,      "LWelCarpetLightCtrlRespStruct",      "RespCode",      "uint32"},
{5651,      435,      "LWelCarpetLightCtrlRespStruct",      "LWelCarpetLightCtrlNRC",      "uint32"},
{5652,      436,      "RWelCarpetLightCtrlStruct",      "SOAProtocolVersion",      "uint8"},
{5653,      436,      "RWelCarpetLightCtrlStruct",      "SOAHeaderType",      "uint8"},
{5654,      436,      "RWelCarpetLightCtrlStruct",      "SOAHeaderLength",      "uint16"},
{5655,      436,      "RWelCarpetLightCtrlStruct",      "Flag",      "uint16"},
{5656,      436,      "RWelCarpetLightCtrlStruct",      "HeaderCRC16",      "uint16"},
{5657,      436,      "RWelCarpetLightCtrlStruct",      "UserID",      "uint32"},
{5658,      436,      "RWelCarpetLightCtrlStruct",      "ReqTimeOut",      "uint32"},
{5659,      436,      "RWelCarpetLightCtrlStruct",      "RequestPriority",      "uint8"},
{5660,      436,      "RWelCarpetLightCtrlStruct",      "SequenceID",      "uint16"},
{5661,      436,      "RWelCarpetLightCtrlStruct",      "ServiceExecuteFeedbackFlag",      "uint8"},
{5662,      436,      "RWelCarpetLightCtrlStruct",      "Options",      "uint32"},
{5663,      436,      "RWelCarpetLightCtrlStruct",      "RWelCarpetLightCmd",      "uint8"},
{5664,      436,      "RWelCarpetLightCtrlRespStruct",      "RespCode",      "uint32"},
{5665,      436,      "RWelCarpetLightCtrlRespStruct",      "RWelCarpetLightCtrlNRC",      "uint32"},
{5666,      437,      "HornService_ErrStruct",      "SequenceID",      "uint16"},
{5667,      437,      "HornService_ErrStruct",      "Options_8bit",      "uint8"},
{5668,      437,      "HornService_ErrStruct",      "Options_8bit2",      "uint8"},
{5669,      437,      "HornService_ErrStruct",      "UserID",      "uint32"},
{5670,      437,      "HornService_ErrStruct",      "OpeNRC",      "uint32"},
{5671,      437,      "HornService_ErrStruct",      "OpeErrInfo",      "string[16]"},
{5672,      438,      "HornStStruct",      "HornActivationSt",      "uint8"},
{5673,      439,      "HornCtrlStruct",      "SOAProtocolVersion",      "uint8"},
{5674,      439,      "HornCtrlStruct",      "SOAHeaderType",      "uint8"},
{5675,      439,      "HornCtrlStruct",      "SOAHeaderLength",      "uint16"},
{5676,      439,      "HornCtrlStruct",      "Flag",      "uint16"},
{5677,      439,      "HornCtrlStruct",      "HeaderCRC16",      "uint16"},
{5678,      439,      "HornCtrlStruct",      "UserID",      "uint32"},
{5679,      439,      "HornCtrlStruct",      "ReqTimeOut",      "uint32"},
{5680,      439,      "HornCtrlStruct",      "RequestPriority",      "uint8"},
{5681,      439,      "HornCtrlStruct",      "SequenceID",      "uint16"},
{5682,      439,      "HornCtrlStruct",      "ServiceExecuteFeedbackFlag",      "uint8"},
{5683,      439,      "HornCtrlStruct",      "Options",      "uint32"},
{5684,      439,      "HornCtrlStruct",      "HornCmd",      "uint8"},
{5685,      439,      "HornCtrlStruct",      "HornPeriod",      "uint16"},
{5686,      439,      "HornCtrlStruct",      "HornDuty",      "uint8"},
{5687,      439,      "HornCtrlStruct",      "HornCycleTimes",      "uint16"},
{5688,      439,      "HornCtrlRespStruct",      "RespCode",      "uint32"},
{5689,      439,      "HornCtrlRespStruct",      "HornCtrlNRC",      "uint32"},
{5690,      440,      "ARSservice_ErrStruct",      "SequenceID",      "uint16"},
{5691,      440,      "ARSservice_ErrStruct",      "Options_8bit",      "uint8"},
{5692,      440,      "ARSservice_ErrStruct",      "Options_8bit2",      "uint8"},
{5693,      440,      "ARSservice_ErrStruct",      "UserID",      "uint32"},
{5694,      440,      "ARSservice_ErrStruct",      "OpeNRC",      "uint32"},
{5695,      440,      "ARSservice_ErrStruct",      "OpeErrInfo",      "string[16]"},
{5696,      441,      "ARSSysSt1Struct",      "ARSModeSt",      "uint8"},
{5697,      441,      "ARSSysSt1Struct",      "ARSMoveSt",      "uint8"},
{5698,      441,      "ARSSysSt1Struct",      "ARSInitSt",      "uint8"},
{5699,      441,      "ARSSysSt1Struct",      "ARSMotStallSt",      "uint8"},
{5700,      441,      "ARSSysSt1Struct",      "ARSHALLErrSt",      "uint8"},
{5701,      441,      "ARSSysSt1Struct",      "ARSWorkSt",      "uint8"},
{5702,      441,      "ARSSysSt1Struct",      "VehLockARSAutoFoldSetFd",      "uint8"},
{5703,      442,      "ARSSysSt2Struct",      "ARSPstValu",      "uint8"},
{5704,      442,      "ARSSysSt2Struct",      "ARSCurtHallCnt",      "uint16"},
{5705,      443,      "CtrlARSMovStruct",      "SOAProtocolVersion",      "uint8"},
{5706,      443,      "CtrlARSMovStruct",      "SOAHeaderType",      "uint8"},
{5707,      443,      "CtrlARSMovStruct",      "SOAHeaderLength",      "uint16"},
{5708,      443,      "CtrlARSMovStruct",      "Flag",      "uint16"},
{5709,      443,      "CtrlARSMovStruct",      "HeaderCRC16",      "uint16"},
{5710,      443,      "CtrlARSMovStruct",      "UserID",      "uint32"},
{5711,      443,      "CtrlARSMovStruct",      "ReqTimeOut",      "uint32"},
{5712,      443,      "CtrlARSMovStruct",      "RequestPriority",      "uint8"},
{5713,      443,      "CtrlARSMovStruct",      "SequenceID",      "uint16"},
{5714,      443,      "CtrlARSMovStruct",      "ServiceExecuteFeedbackFlag",      "uint8"},
{5715,      443,      "CtrlARSMovStruct",      "Options",      "uint32"},
{5716,      443,      "CtrlARSMovStruct",      "ARSCtrlReq",      "uint8"},
{5717,      443,      "CtrlARSMovRespStruct",      "RespCode",      "uint32"},
{5718,      443,      "CtrlARSMovRespStruct",      "CtrlARSMovNRC",      "uint32"},
{5719,      444,      "CtrlARSModeStruct",      "SOAProtocolVersion",      "uint8"},
{5720,      444,      "CtrlARSModeStruct",      "SOAHeaderType",      "uint8"},
{5721,      444,      "CtrlARSModeStruct",      "SOAHeaderLength",      "uint16"},
{5722,      444,      "CtrlARSModeStruct",      "Flag",      "uint16"},
{5723,      444,      "CtrlARSModeStruct",      "HeaderCRC16",      "uint16"},
{5724,      444,      "CtrlARSModeStruct",      "UserID",      "uint32"},
{5725,      444,      "CtrlARSModeStruct",      "ReqTimeOut",      "uint32"},
{5726,      444,      "CtrlARSModeStruct",      "RequestPriority",      "uint8"},
{5727,      444,      "CtrlARSModeStruct",      "SequenceID",      "uint16"},
{5728,      444,      "CtrlARSModeStruct",      "ServiceExecuteFeedbackFlag",      "uint8"},
{5729,      444,      "CtrlARSModeStruct",      "Options",      "uint32"},
{5730,      444,      "CtrlARSModeStruct",      "ARSModeReq",      "uint8"},
{5731,      444,      "CtrlARSModeRespStruct",      "RespCode",      "uint32"},
{5732,      444,      "CtrlARSModeRespStruct",      "CtrlARSModeNRC",      "uint32"},
{5733,      445,      "CtrlARSLearnStruct",      "SOAProtocolVersion",      "uint8"},
{5734,      445,      "CtrlARSLearnStruct",      "SOAHeaderType",      "uint8"},
{5735,      445,      "CtrlARSLearnStruct",      "SOAHeaderLength",      "uint16"},
{5736,      445,      "CtrlARSLearnStruct",      "Flag",      "uint16"},
{5737,      445,      "CtrlARSLearnStruct",      "HeaderCRC16",      "uint16"},
{5738,      445,      "CtrlARSLearnStruct",      "UserID",      "uint32"},
{5739,      445,      "CtrlARSLearnStruct",      "ReqTimeOut",      "uint32"},
{5740,      445,      "CtrlARSLearnStruct",      "RequestPriority",      "uint8"},
{5741,      445,      "CtrlARSLearnStruct",      "SequenceID",      "uint16"},
{5742,      445,      "CtrlARSLearnStruct",      "ServiceExecuteFeedbackFlag",      "uint8"},
{5743,      445,      "CtrlARSLearnStruct",      "Options",      "uint32"},
{5744,      445,      "CtrlARSLearnStruct",      "ARSLearnPer",      "uint8"},
{5745,      445,      "CtrlARSLearnRespStruct",      "RespCode",      "uint32"},
{5746,      445,      "CtrlARSLearnRespStruct",      "CtrlARSLearnNRC",      "uint32"},
{5747,      446,      "CtrlVehLockARSAutoFoldStruct",      "SOAProtocolVersion",      "uint8"},
{5748,      446,      "CtrlVehLockARSAutoFoldStruct",      "SOAHeaderType",      "uint8"},
{5749,      446,      "CtrlVehLockARSAutoFoldStruct",      "SOAHeaderLength",      "uint16"},
{5750,      446,      "CtrlVehLockARSAutoFoldStruct",      "Flag",      "uint16"},
{5751,      446,      "CtrlVehLockARSAutoFoldStruct",      "HeaderCRC16",      "uint16"},
{5752,      446,      "CtrlVehLockARSAutoFoldStruct",      "UserID",      "uint32"},
{5753,      446,      "CtrlVehLockARSAutoFoldStruct",      "ReqTimeOut",      "uint32"},
{5754,      446,      "CtrlVehLockARSAutoFoldStruct",      "RequestPriority",      "uint8"},
{5755,      446,      "CtrlVehLockARSAutoFoldStruct",      "SequenceID",      "uint16"},
{5756,      446,      "CtrlVehLockARSAutoFoldStruct",      "ServiceExecuteFeedbackFlag",      "uint8"},
{5757,      446,      "CtrlVehLockARSAutoFoldStruct",      "Options",      "uint32"},
{5758,      446,      "CtrlVehLockARSAutoFoldStruct",      "VehLockARSAutoFoldSet",      "uint8"},
{5759,      446,      "CtrlVehLockARSAutoFoldRespStruct",      "RespCode",      "uint32"},
{5760,      446,      "CtrlVehLockARSAutoFoldRespStruct",      "CtrlVehLockARSAutoFoldNRC",      "uint32"},
{5761,      447,      "DoorLockService2_ErrStruct",      "SequenceID",      "uint16"},
{5762,      447,      "DoorLockService2_ErrStruct",      "Options_8bit",      "uint8"},
{5763,      447,      "DoorLockService2_ErrStruct",      "Options_8bit2",      "uint8"},
{5764,      447,      "DoorLockService2_ErrStruct",      "UserID",      "uint32"},
{5765,      447,      "DoorLockService2_ErrStruct",      "OpeNRC",      "uint32"},
{5766,      447,      "DoorLockService2_ErrStruct",      "OpeErrInfo",      "string[16]"},
{5767,      448,      "DoorLockSt2Struct",      "BonnetAjarSt",      "uint8"},
{5768,      448,      "DoorLockSt2Struct",      "BonnetRelayFailSt",      "uint8"},
{5769,      448,      "DoorLockSt2Struct",      "BonnetUnlockOutoutSt",      "uint8"},
{5770,      448,      "DoorLockSt2Struct",      "BonnetUnlockOperateFailSt",      "uint8"},
{5771,      448,      "DoorLockSt2Struct",      "GloveBoxUnlockoutputSt",      "uint8"},
{5772,      448,      "DoorLockSt2Struct",      "BonnetDiagnosticMode",      "uint8"},
{5773,      448,      "DoorLockSt2Struct",      "BonnetRelaySt",      "uint8"},
{5774,      448,      "DoorLockSt2Struct",      "BonnetRelayOutputSt",      "uint8"},
{5775,      448,      "DoorLockSt2Struct",      "GloveBoxThemoProtectSt",      "uint8"},
{5776,      448,      "DoorLockSt2Struct",      "GloveBoxThemoProtectCnt",      "uint8"},
{5777,      448,      "DoorLockSt2Struct",      "GloveBoxThemoProtectTimer",      "uint8"},
{5778,      449,      "BonnetUnlockCtrStruct",      "SOAProtocolVersion",      "uint8"},
{5779,      449,      "BonnetUnlockCtrStruct",      "SOAHeaderType",      "uint8"},
{5780,      449,      "BonnetUnlockCtrStruct",      "SOAHeaderLength",      "uint16"},
{5781,      449,      "BonnetUnlockCtrStruct",      "Flag",      "uint16"},
{5782,      449,      "BonnetUnlockCtrStruct",      "HeaderCRC16",      "uint16"},
{5783,      449,      "BonnetUnlockCtrStruct",      "UserID",      "uint32"},
{5784,      449,      "BonnetUnlockCtrStruct",      "ReqTimeOut",      "uint32"},
{5785,      449,      "BonnetUnlockCtrStruct",      "RequestPriority",      "uint8"},
{5786,      449,      "BonnetUnlockCtrStruct",      "SequenceID",      "uint16"},
{5787,      449,      "BonnetUnlockCtrStruct",      "ServiceExecuteFeedbackFlag",      "uint8"},
{5788,      449,      "BonnetUnlockCtrStruct",      "Options",      "uint32"},
{5789,      449,      "BonnetUnlockCtrStruct",      "BonnetUnlockCmd",      "uint8"},
{5790,      449,      "BonnetUnlockCtrRespStruct",      "RespCode",      "uint32"},
{5791,      449,      "BonnetUnlockCtrRespStruct",      "BonnetUnlockCtrNRC",      "uint32"},
{5792,      450,      "CtrlGloveBoxOpenStruct",      "SOAProtocolVersion",      "uint8"},
{5793,      450,      "CtrlGloveBoxOpenStruct",      "SOAHeaderType",      "uint8"},
{5794,      450,      "CtrlGloveBoxOpenStruct",      "SOAHeaderLength",      "uint16"},
{5795,      450,      "CtrlGloveBoxOpenStruct",      "Flag",      "uint16"},
{5796,      450,      "CtrlGloveBoxOpenStruct",      "HeaderCRC16",      "uint16"},
{5797,      450,      "CtrlGloveBoxOpenStruct",      "UserID",      "uint32"},
{5798,      450,      "CtrlGloveBoxOpenStruct",      "ReqTimeOut",      "uint32"},
{5799,      450,      "CtrlGloveBoxOpenStruct",      "RequestPriority",      "uint8"},
{5800,      450,      "CtrlGloveBoxOpenStruct",      "SequenceID",      "uint16"},
{5801,      450,      "CtrlGloveBoxOpenStruct",      "ServiceExecuteFeedbackFlag",      "uint8"},
{5802,      450,      "CtrlGloveBoxOpenStruct",      "Options",      "uint32"},
{5803,      450,      "CtrlGloveBoxOpenStruct",      "GloveBoxCtrlReq",      "uint8"},
{5804,      450,      "CtrlGloveBoxOpenRespStruct",      "RespCode",      "uint32"},
{5805,      450,      "CtrlGloveBoxOpenRespStruct",      "CtrlGloveBoxOpenNRC",      "uint32"},
{5806,      451,      "Veh_RockingDoorCtrlService_ErrStruct",      "SequenceID",      "uint16"},
{5807,      451,      "Veh_RockingDoorCtrlService_ErrStruct",      "Options_8bit",      "uint8"},
{5808,      451,      "Veh_RockingDoorCtrlService_ErrStruct",      "Options_8bit2",      "uint8"},
{5809,      451,      "Veh_RockingDoorCtrlService_ErrStruct",      "UserID",      "uint32"},
{5810,      451,      "Veh_RockingDoorCtrlService_ErrStruct",      "OpeNRC",      "uint32"},
{5811,      451,      "Veh_RockingDoorCtrlService_ErrStruct",      "OpeErrInfo",      "string[16]"},
{5812,      452,      "Veh_LeftRockingDoorCtrlStruct",      "SOAProtocolVersion",      "uint8"},
{5813,      452,      "Veh_LeftRockingDoorCtrlStruct",      "SOAHeaderType",      "uint8"},
{5814,      452,      "Veh_LeftRockingDoorCtrlStruct",      "SOAHeaderLength",      "uint16"},
{5815,      452,      "Veh_LeftRockingDoorCtrlStruct",      "Flag",      "uint16"},
{5816,      452,      "Veh_LeftRockingDoorCtrlStruct",      "HeaderCRC16",      "uint16"},
{5817,      452,      "Veh_LeftRockingDoorCtrlStruct",      "UserID",      "uint32"},
{5818,      452,      "Veh_LeftRockingDoorCtrlStruct",      "ReqTimeOut",      "uint32"},
{5819,      452,      "Veh_LeftRockingDoorCtrlStruct",      "RequestPriority",      "uint8"},
{5820,      452,      "Veh_LeftRockingDoorCtrlStruct",      "SequenceID",      "uint16"},
{5821,      452,      "Veh_LeftRockingDoorCtrlStruct",      "ServiceExecuteFeedbackFlag",      "uint8"},
{5822,      452,      "Veh_LeftRockingDoorCtrlStruct",      "Options",      "uint32"},
{5823,      452,      "Veh_LeftRockingDoorCtrlStruct",      "RockingDoorMoveCmd",      "uint8"},
{5824,      452,      "Veh_LeftRockingDoorCtrlRespStruct",      "RespCode",      "uint32"},
{5825,      452,      "Veh_LeftRockingDoorCtrlRespStruct",      "Veh_LeftRockingDoorCtrlNRC",      "uint32"},
{5826,      453,      "Veh_RightRockingDoorCtrlStruct",      "SOAProtocolVersion",      "uint8"},
{5827,      453,      "Veh_RightRockingDoorCtrlStruct",      "SOAHeaderType",      "uint8"},
{5828,      453,      "Veh_RightRockingDoorCtrlStruct",      "SOAHeaderLength",      "uint16"},
{5829,      453,      "Veh_RightRockingDoorCtrlStruct",      "Flag",      "uint16"},
{5830,      453,      "Veh_RightRockingDoorCtrlStruct",      "HeaderCRC16",      "uint16"},
{5831,      453,      "Veh_RightRockingDoorCtrlStruct",      "UserID",      "uint32"},
{5832,      453,      "Veh_RightRockingDoorCtrlStruct",      "ReqTimeOut",      "uint32"},
{5833,      453,      "Veh_RightRockingDoorCtrlStruct",      "RequestPriority",      "uint8"},
{5834,      453,      "Veh_RightRockingDoorCtrlStruct",      "SequenceID",      "uint16"},
{5835,      453,      "Veh_RightRockingDoorCtrlStruct",      "ServiceExecuteFeedbackFlag",      "uint8"},
{5836,      453,      "Veh_RightRockingDoorCtrlStruct",      "Options",      "uint32"},
{5837,      453,      "Veh_RightRockingDoorCtrlStruct",      "RockingDoorMoveCmd",      "uint8"},
{5838,      453,      "Veh_RightRockingDoorCtrlRespStruct",      "RespCode",      "uint32"},
{5839,      453,      "Veh_RightRockingDoorCtrlRespStruct",      "Veh_RightRockingDoorCtrlNRC",      "uint32"},
{5840,      454,      "RockingDoorCtrlService_ErrStruct",      "SequenceID",      "uint16"},
{5841,      454,      "RockingDoorCtrlService_ErrStruct",      "Options_8bit",      "uint8"},
{5842,      454,      "RockingDoorCtrlService_ErrStruct",      "Options_8bit2",      "uint8"},
{5843,      454,      "RockingDoorCtrlService_ErrStruct",      "UserID",      "uint32"},
{5844,      454,      "RockingDoorCtrlService_ErrStruct",      "OpeNRC",      "uint32"},
{5845,      454,      "RockingDoorCtrlService_ErrStruct",      "OpeErrInfo",      "string[16]"},
{5846,      455,      "LeftRockingDoorSysSt1Struct",      "SDC_SysErr",      "uint8"},
{5847,      455,      "LeftRockingDoorSysSt1Struct",      "SDC_SysRuningSt",      "uint8"},
{5848,      455,      "LeftRockingDoorSysSt1Struct",      "SDC_AntipintchSt",      "uint8"},
{5849,      455,      "LeftRockingDoorSysSt1Struct",      "SDC_OpenPercent",      "uint8"},
{5850,      455,      "LeftRockingDoorSysSt1Struct",      "SDC_DenormalizeSt",      "uint8"},
{5851,      455,      "LeftRockingDoorSysSt1Struct",      "SDC_PreventPlaySt",      "uint8"},
{5852,      455,      "LeftRockingDoorSysSt1Struct",      "SDC_ObstacleSt",      "uint8"},
{5853,      455,      "LeftRockingDoorSysSt1Struct",      "SDC_OpenResource",      "uint8"},
{5854,      455,      "LeftRockingDoorSysSt1Struct",      "SDC_CloseResource",      "uint8"},
{5855,      456,      "RightRockingDoorSysSt2Struct",      "SDC_SysErr",      "uint8"},
{5856,      456,      "RightRockingDoorSysSt2Struct",      "SDC_SysRuningSt",      "uint8"},
{5857,      456,      "RightRockingDoorSysSt2Struct",      "SDC_AntipintchSt",      "uint8"},
{5858,      456,      "RightRockingDoorSysSt2Struct",      "SDC_OpenPercent",      "uint8"},
{5859,      456,      "RightRockingDoorSysSt2Struct",      "SDC_DenormalizeSt",      "uint8"},
{5860,      456,      "RightRockingDoorSysSt2Struct",      "SDC_PreventPlaySt",      "uint8"},
{5861,      456,      "RightRockingDoorSysSt2Struct",      "SDC_ObstacleSt",      "uint8"},
{5862,      456,      "RightRockingDoorSysSt2Struct",      "SDC_OpenResource",      "uint8"},
{5863,      456,      "RightRockingDoorSysSt2Struct",      "SDC_CloseResource",      "uint8"},
{5864,      457,      "RightRockingDoorRadarInfoStruct",      "SDC_L_MoveReq",      "uint8"},
{5865,      457,      "RightRockingDoorRadarInfoStruct",      "SDC_R_MoveReq",      "uint8"},
{5866,      457,      "RightRockingDoorRadarInfoStruct",      "SDC_LRadarSts",      "uint8"},
{5867,      457,      "RightRockingDoorRadarInfoStruct",      "SDC_RRadarSts",      "uint8"},
{5868,      457,      "RightRockingDoorRadarInfoStruct",      "SDC_LDoorDetection",      "uint8"},
{5869,      457,      "RightRockingDoorRadarInfoStruct",      "SDC_RDoorDetection",      "uint8"},
{5870,      458,      "RockingDoorSettingFbStruct",      "SDC_OpenPercentCfgSts",      "uint8"},
{5871,      458,      "RockingDoorSettingFbStruct",      "SDC_BrakeCloseCfgSts",      "uint8"},
{5872,      458,      "RockingDoorSettingFbStruct",      "SDC_KeyOpenCfgSts",      "uint8"},
{5873,      458,      "RockingDoorSettingFbStruct",      "SDC_WinOpenCfgSts",      "uint8"},
{5874,      458,      "RockingDoorSettingFbStruct",      "SDC_ManualModeCfgSts",      "uint8"},
{5875,      459,      "SDC_ManualModeCfgStruct",      "SOAProtocolVersion",      "uint8"},
{5876,      459,      "SDC_ManualModeCfgStruct",      "SOAHeaderType",      "uint8"},
{5877,      459,      "SDC_ManualModeCfgStruct",      "SOAHeaderLength",      "uint16"},
{5878,      459,      "SDC_ManualModeCfgStruct",      "Flag",      "uint16"},
{5879,      459,      "SDC_ManualModeCfgStruct",      "HeaderCRC16",      "uint16"},
{5880,      459,      "SDC_ManualModeCfgStruct",      "UserID",      "uint32"},
{5881,      459,      "SDC_ManualModeCfgStruct",      "ReqTimeOut",      "uint32"},
{5882,      459,      "SDC_ManualModeCfgStruct",      "RequestPriority",      "uint8"},
{5883,      459,      "SDC_ManualModeCfgStruct",      "SequenceID",      "uint16"},
{5884,      459,      "SDC_ManualModeCfgStruct",      "ServiceExecuteFeedbackFlag",      "uint8"},
{5885,      459,      "SDC_ManualModeCfgStruct",      "Options",      "uint32"},
{5886,      459,      "SDC_ManualModeCfgStruct",      "SDC_ManualModeCfg",      "uint8"},
{5887,      459,      "SDC_ManualModeSetRespStruct",      "RespCode",      "uint32"},
{5888,      459,      "SDC_ManualModeSetRespStruct",      "SDC_ManualModeSetNRC",      "uint32"},
{5889,      460,      "SDC_OpenPercentCfgStruct",      "SOAProtocolVersion",      "uint8"},
{5890,      460,      "SDC_OpenPercentCfgStruct",      "SOAHeaderType",      "uint8"},
{5891,      460,      "SDC_OpenPercentCfgStruct",      "SOAHeaderLength",      "uint16"},
{5892,      460,      "SDC_OpenPercentCfgStruct",      "Flag",      "uint16"},
{5893,      460,      "SDC_OpenPercentCfgStruct",      "HeaderCRC16",      "uint16"},
{5894,      460,      "SDC_OpenPercentCfgStruct",      "UserID",      "uint32"},
{5895,      460,      "SDC_OpenPercentCfgStruct",      "ReqTimeOut",      "uint32"},
{5896,      460,      "SDC_OpenPercentCfgStruct",      "RequestPriority",      "uint8"},
{5897,      460,      "SDC_OpenPercentCfgStruct",      "SequenceID",      "uint16"},
{5898,      460,      "SDC_OpenPercentCfgStruct",      "ServiceExecuteFeedbackFlag",      "uint8"},
{5899,      460,      "SDC_OpenPercentCfgStruct",      "Options",      "uint32"},
{5900,      460,      "SDC_OpenPercentCfgStruct",      "SDC_OpenPercentCfg",      "uint8"},
{5901,      460,      "SDC_OpenPercentSetRespStruct",      "RespCode",      "uint32"},
{5902,      460,      "SDC_OpenPercentSetRespStruct",      "SDC_OpenPercentSetNRC",      "uint32"},
{5903,      461,      "SDC_BrakeCloseCfgStruct",      "SOAProtocolVersion",      "uint8"},
{5904,      461,      "SDC_BrakeCloseCfgStruct",      "SOAHeaderType",      "uint8"},
{5905,      461,      "SDC_BrakeCloseCfgStruct",      "SOAHeaderLength",      "uint16"},
{5906,      461,      "SDC_BrakeCloseCfgStruct",      "Flag",      "uint16"},
{5907,      461,      "SDC_BrakeCloseCfgStruct",      "HeaderCRC16",      "uint16"},
{5908,      461,      "SDC_BrakeCloseCfgStruct",      "UserID",      "uint32"},
{5909,      461,      "SDC_BrakeCloseCfgStruct",      "ReqTimeOut",      "uint32"},
{5910,      461,      "SDC_BrakeCloseCfgStruct",      "RequestPriority",      "uint8"},
{5911,      461,      "SDC_BrakeCloseCfgStruct",      "SequenceID",      "uint16"},
{5912,      461,      "SDC_BrakeCloseCfgStruct",      "ServiceExecuteFeedbackFlag",      "uint8"},
{5913,      461,      "SDC_BrakeCloseCfgStruct",      "Options",      "uint32"},
{5914,      461,      "SDC_BrakeCloseCfgStruct",      "SDC_BrakeCloseCfg",      "uint8"},
{5915,      461,      "SDC_BrakeCloseSetRespStruct",      "RespCode",      "uint32"},
{5916,      461,      "SDC_BrakeCloseSetRespStruct",      "SDC_BrakeCloseSetNRC",      "uint32"},
{5917,      462,      "SDC_WinOpenCfgStruct",      "SOAProtocolVersion",      "uint8"},
{5918,      462,      "SDC_WinOpenCfgStruct",      "SOAHeaderType",      "uint8"},
{5919,      462,      "SDC_WinOpenCfgStruct",      "SOAHeaderLength",      "uint16"},
{5920,      462,      "SDC_WinOpenCfgStruct",      "Flag",      "uint16"},
{5921,      462,      "SDC_WinOpenCfgStruct",      "HeaderCRC16",      "uint16"},
{5922,      462,      "SDC_WinOpenCfgStruct",      "UserID",      "uint32"},
{5923,      462,      "SDC_WinOpenCfgStruct",      "ReqTimeOut",      "uint32"},
{5924,      462,      "SDC_WinOpenCfgStruct",      "RequestPriority",      "uint8"},
{5925,      462,      "SDC_WinOpenCfgStruct",      "SequenceID",      "uint16"},
{5926,      462,      "SDC_WinOpenCfgStruct",      "ServiceExecuteFeedbackFlag",      "uint8"},
{5927,      462,      "SDC_WinOpenCfgStruct",      "Options",      "uint32"},
{5928,      462,      "SDC_WinOpenCfgStruct",      "SDC_WinOpenCfg",      "uint8"},
{5929,      462,      "SDC_WinOpenSetRespStruct",      "RespCode",      "uint32"},
{5930,      462,      "SDC_WinOpenSetRespStruct",      "SDC_WinOpenSetNRC",      "uint32"},
{5931,      463,      "SDC_KeyOpenCfgStruct",      "SOAProtocolVersion",      "uint8"},
{5932,      463,      "SDC_KeyOpenCfgStruct",      "SOAHeaderType",      "uint8"},
{5933,      463,      "SDC_KeyOpenCfgStruct",      "SOAHeaderLength",      "uint16"},
{5934,      463,      "SDC_KeyOpenCfgStruct",      "Flag",      "uint16"},
{5935,      463,      "SDC_KeyOpenCfgStruct",      "HeaderCRC16",      "uint16"},
{5936,      463,      "SDC_KeyOpenCfgStruct",      "UserID",      "uint32"},
{5937,      463,      "SDC_KeyOpenCfgStruct",      "ReqTimeOut",      "uint32"},
{5938,      463,      "SDC_KeyOpenCfgStruct",      "RequestPriority",      "uint8"},
{5939,      463,      "SDC_KeyOpenCfgStruct",      "SequenceID",      "uint16"},
{5940,      463,      "SDC_KeyOpenCfgStruct",      "ServiceExecuteFeedbackFlag",      "uint8"},
{5941,      463,      "SDC_KeyOpenCfgStruct",      "Options",      "uint32"},
{5942,      463,      "SDC_KeyOpenCfgStruct",      "SDC_KeyOpenCfg",      "uint8"},
{5943,      463,      "SDC_KeyOpenSetRespStruct",      "RespCode",      "uint32"},
{5944,      463,      "SDC_KeyOpenSetRespStruct",      "SDC_KeyOpenSetNRC",      "uint32"},
{5945,      464,      "LeftRockingDoorCtrlStruct",      "SOAProtocolVersion",      "uint8"},
{5946,      464,      "LeftRockingDoorCtrlStruct",      "SOAHeaderType",      "uint8"},
{5947,      464,      "LeftRockingDoorCtrlStruct",      "SOAHeaderLength",      "uint16"},
{5948,      464,      "LeftRockingDoorCtrlStruct",      "Flag",      "uint16"},
{5949,      464,      "LeftRockingDoorCtrlStruct",      "HeaderCRC16",      "uint16"},
{5950,      464,      "LeftRockingDoorCtrlStruct",      "UserID",      "uint32"},
{5951,      464,      "LeftRockingDoorCtrlStruct",      "ReqTimeOut",      "uint32"},
{5952,      464,      "LeftRockingDoorCtrlStruct",      "RequestPriority",      "uint8"},
{5953,      464,      "LeftRockingDoorCtrlStruct",      "SequenceID",      "uint16"},
{5954,      464,      "LeftRockingDoorCtrlStruct",      "ServiceExecuteFeedbackFlag",      "uint8"},
{5955,      464,      "LeftRockingDoorCtrlStruct",      "Options",      "uint32"},
{5956,      464,      "LeftRockingDoorCtrlStruct",      "RockingDoorMoveCmd",      "uint8"},
{5957,      464,      "LeftRockingDoorCtrlRespStruct",      "RespCode",      "uint32"},
{5958,      464,      "LeftRockingDoorCtrlRespStruct",      "LeftRockingDoorCtrlNRC",      "uint32"},
{5959,      465,      "RightRockingDoorCtrlStruct",      "SOAProtocolVersion",      "uint8"},
{5960,      465,      "RightRockingDoorCtrlStruct",      "SOAHeaderType",      "uint8"},
{5961,      465,      "RightRockingDoorCtrlStruct",      "SOAHeaderLength",      "uint16"},
{5962,      465,      "RightRockingDoorCtrlStruct",      "Flag",      "uint16"},
{5963,      465,      "RightRockingDoorCtrlStruct",      "HeaderCRC16",      "uint16"},
{5964,      465,      "RightRockingDoorCtrlStruct",      "UserID",      "uint32"},
{5965,      465,      "RightRockingDoorCtrlStruct",      "ReqTimeOut",      "uint32"},
{5966,      465,      "RightRockingDoorCtrlStruct",      "RequestPriority",      "uint8"},
{5967,      465,      "RightRockingDoorCtrlStruct",      "SequenceID",      "uint16"},
{5968,      465,      "RightRockingDoorCtrlStruct",      "ServiceExecuteFeedbackFlag",      "uint8"},
{5969,      465,      "RightRockingDoorCtrlStruct",      "Options",      "uint32"},
{5970,      465,      "RightRockingDoorCtrlStruct",      "RockingDoorMoveCmd",      "uint8"},
{5971,      465,      "RightRockingDoorCtrlRespStruct",      "RespCode",      "uint32"},
{5972,      465,      "RightRockingDoorCtrlRespStruct",      "RightRockingDoorCtrlNRC",      "uint32"},
{5973,      466,      "RoofService_ErrStruct",      "SequenceID",      "uint16"},
{5974,      466,      "RoofService_ErrStruct",      "Options_8bit",      "uint8"},
{5975,      466,      "RoofService_ErrStruct",      "Options_8bit2",      "uint8"},
{5976,      466,      "RoofService_ErrStruct",      "UserID",      "uint32"},
{5977,      466,      "RoofService_ErrStruct",      "OpeNRC",      "uint32"},
{5978,      466,      "RoofService_ErrStruct",      "OpeErrInfo",      "string[16]"},
{5979,      467,      "RoofSysSt1Struct",      "RoofMoveStatus",      "uint8"},
{5980,      467,      "RoofSysSt1Struct",      "RoofPoslevl",      "uint8"},
{5981,      467,      "RoofSysSt1Struct",      "RoofInitializedStatus",      "uint8"},
{5982,      467,      "RoofSysSt1Struct",      "RoofHallStatus",      "uint8"},
{5983,      467,      "RoofSysSt1Struct",      "RoofAntiPinchStatus",      "uint8"},
{5984,      467,      "RoofSysSt1Struct",      "RoofTermalProtec",      "uint8"},
{5985,      467,      "RoofSysSt1Struct",      "RoofMotorOutput_P",      "uint8"},
{5986,      467,      "RoofSysSt1Struct",      "RoofMotorOutput_N",      "uint8"},
{5987,      468,      "RoofSysSt2Struct",      "RoofPosValue",      "uint8"},
{5988,      468,      "RoofSysSt2Struct",      "RoofHallCnt_X",      "uint16"},
{5989,      468,      "RoofSysSt2Struct",      "RoofHallCnt_Y",      "uint16"},
{5990,      468,      "RoofSysSt2Struct",      "RoofCurtHallCnt",      "uint16"},
{5991,      469,      "RoofMovCmdStruct",      "SOAProtocolVersion",      "uint8"},
{5992,      469,      "RoofMovCmdStruct",      "SOAHeaderType",      "uint8"},
{5993,      469,      "RoofMovCmdStruct",      "SOAHeaderLength",      "uint16"},
{5994,      469,      "RoofMovCmdStruct",      "Flag",      "uint16"},
{5995,      469,      "RoofMovCmdStruct",      "HeaderCRC16",      "uint16"},
{5996,      469,      "RoofMovCmdStruct",      "UserID",      "uint32"},
{5997,      469,      "RoofMovCmdStruct",      "ReqTimeOut",      "uint32"},
{5998,      469,      "RoofMovCmdStruct",      "RequestPriority",      "uint8"},
{5999,      469,      "RoofMovCmdStruct",      "SequenceID",      "uint16"},
{6000,      469,      "RoofMovCmdStruct",      "ServiceExecuteFeedbackFlag",      "uint8"},
{6001,      469,      "RoofMovCmdStruct",      "Options",      "uint32"},
{6002,      469,      "RoofMovCmdStruct",      "RoofMovCmd",      "uint8"},
{6003,      469,      "CtrlRoofMovRespStruct",      "RespCode",      "uint32"},
{6004,      469,      "CtrlRoofMovRespStruct",      "CtrlRoofMovNRC",      "uint32"},
{6005,      470,      "CtrlRoofPosTargtStruct",      "SOAProtocolVersion",      "uint8"},
{6006,      470,      "CtrlRoofPosTargtStruct",      "SOAHeaderType",      "uint8"},
{6007,      470,      "CtrlRoofPosTargtStruct",      "SOAHeaderLength",      "uint16"},
{6008,      470,      "CtrlRoofPosTargtStruct",      "Flag",      "uint16"},
{6009,      470,      "CtrlRoofPosTargtStruct",      "HeaderCRC16",      "uint16"},
{6010,      470,      "CtrlRoofPosTargtStruct",      "UserID",      "uint32"},
{6011,      470,      "CtrlRoofPosTargtStruct",      "ReqTimeOut",      "uint32"},
{6012,      470,      "CtrlRoofPosTargtStruct",      "RequestPriority",      "uint8"},
{6013,      470,      "CtrlRoofPosTargtStruct",      "SequenceID",      "uint16"},
{6014,      470,      "CtrlRoofPosTargtStruct",      "ServiceExecuteFeedbackFlag",      "uint8"},
{6015,      470,      "CtrlRoofPosTargtStruct",      "Options",      "uint32"},
{6016,      470,      "CtrlRoofPosTargtStruct",      "CtrlRoofPosTargt",      "uint8"},
{6017,      470,      "CtrlRoofPosTargtMovRespStruct",      "RespCode",      "uint32"},
{6018,      470,      "CtrlRoofPosTargtMovRespStruct",      "CtrlRoofPosTargtMovNRC",      "uint32"},
{6019,      471,      "CtrlRoofLearnPerStruct",      "SOAProtocolVersion",      "uint8"},
{6020,      471,      "CtrlRoofLearnPerStruct",      "SOAHeaderType",      "uint8"},
{6021,      471,      "CtrlRoofLearnPerStruct",      "SOAHeaderLength",      "uint16"},
{6022,      471,      "CtrlRoofLearnPerStruct",      "Flag",      "uint16"},
{6023,      471,      "CtrlRoofLearnPerStruct",      "HeaderCRC16",      "uint16"},
{6024,      471,      "CtrlRoofLearnPerStruct",      "UserID",      "uint32"},
{6025,      471,      "CtrlRoofLearnPerStruct",      "ReqTimeOut",      "uint32"},
{6026,      471,      "CtrlRoofLearnPerStruct",      "RequestPriority",      "uint8"},
{6027,      471,      "CtrlRoofLearnPerStruct",      "SequenceID",      "uint16"},
{6028,      471,      "CtrlRoofLearnPerStruct",      "ServiceExecuteFeedbackFlag",      "uint8"},
{6029,      471,      "CtrlRoofLearnPerStruct",      "Options",      "uint32"},
{6030,      471,      "CtrlRoofLearnPerStruct",      "CtrlRoofLearnPer",      "uint8"},
{6031,      471,      "CtrlRoofLearnRespStruct",      "RespCode",      "uint32"},
{6032,      471,      "CtrlRoofLearnRespStruct",      "CtrlRoofLearnNRC",      "uint32"},
{6033,      472,      "TboxImuDataStruct",      "TboxImuTemp",      "float32"},
{6034,      472,      "TboxImuDataStruct",      "TboxImuAcceIX",      "float32"},
{6035,      472,      "TboxImuDataStruct",      "TboxImuAcceIY",      "float32"},
{6036,      472,      "TboxImuDataStruct",      "TboxImuAcceIZ",      "float32"},
{6037,      472,      "TboxImuDataStruct",      "TboxImuGyroX",      "float32"},
{6038,      472,      "TboxImuDataStruct",      "TboxImuGyroY",      "float32"},
{6039,      472,      "TboxImuDataStruct",      "TboxImuGyroZ",      "float32"},
{6040,      472,      "TboxImuDataStruct",      "TboxImuTime",      "uint64"},
{6041,      473,      "ADASMomentService_ErrStruct",      "SequenceID",      "uint16"},
{6042,      473,      "ADASMomentService_ErrStruct",      "Options_8bit",      "uint8"},
{6043,      473,      "ADASMomentService_ErrStruct",      "Options_8bit2",      "uint8"},
{6044,      473,      "ADASMomentService_ErrStruct",      "UserID",      "uint32"},
{6045,      473,      "ADASMomentService_ErrStruct",      "OpeNRC",      "uint32"},
{6046,      473,      "ADASMomentService_ErrStruct",      "OpeErrInfo",      "string[16]"},
{6047,      474,      "DriveTripInfoStruct",      "TripGON",      "float32"},
{6048,      474,      "DriveTripInfoStruct",      "TripTime",      "uint16"},
{6049,      474,      "DriveTripInfoStruct",      "ADASTripSinceIGON",      "float32"},
{6050,      474,      "DriveTripInfoStruct",      "ADASTripSinceITime",      "uint16"},
{6051,      474,      "DriveTripInfoStruct",      "ADASACCTripSinceIGON",      "float32"},
{6052,      474,      "DriveTripInfoStruct",      "ADASACCTripSinceITime",      "uint16"},
{6053,      474,      "DriveTripInfoStruct",      "ADASLCCTripSinceIGON",      "float32"},
{6054,      474,      "DriveTripInfoStruct",      "ADASLCCTripSinceITime",      "uint16"},
{6055,      474,      "DriveTripInfoStruct",      "ADASNGDTripSinceIGON",      "float32"},
{6056,      474,      "DriveTripInfoStruct",      "ADASNGDTripSinceITime",      "uint16"},
{6057,      475,      "ParkingTripInfoStruct",      "ADASParkingCount",      "uint8"},
{6058,      475,      "ParkingTripInfoStruct",      "ADASASPParkingCount",      "uint8"},
{6059,      475,      "ParkingTripInfoStruct",      "ADASAPAParkingCount",      "uint8"},
{6060,      475,      "ParkingTripInfoStruct",      "ADASSVPParkingCount",      "uint8"},
{6061,      475,      "ParkingTripInfoStruct",      "ADASAPAParkingTime",      "uint16"},
{6062,      475,      "ParkingTripInfoStruct",      "ADASSVPParkingIGON",      "float32"},
{6063,      476,      "ADASMomentSwtStruct",      "ADASMomentSwt",      "uint8"},
{6064,      477,      "ADASMomentTripSwtStruct",      "ADASMomentTripSwt",      "uint8"}
};
}
